## tests/benchmarks/bootup_time/testcase.yaml
```yaml
common:
  sysbuild: true
  tags:
    - ci_tests_benchmarks_current_consumption
    - ppk_power_measure
  harness: pytest

tests:
  benchmarks.bootup_time:
    integration_platforms:
      - nrf54h20dk/nrf54h20/cpuapp
    platform_allow:
      - nrf52840dk/nrf52840
      - nrf5340dk/nrf5340/cpuapp
      - nrf54h20dk/nrf54h20/cpuapp
      - nrf54l15dk/nrf54l15/cpuapp
      - nrf54lm20dk/nrf54lm20a/cpuapp
      - nrf54lm20dk/nrf54lm20b/cpuapp
      - nrf54ls05dk/nrf54ls05a/cpuapp
      - nrf54ls05dk/nrf54ls05b/cpuapp
      - nrf54lv10dk/nrf54lv10a/cpuapp
      - nrf54lc10dk/nrf54lc10a/cpuapp
      - nrf54lv10dk/nrf54lv10a/cpuapp/ns
    harness_config:
      pytest_root:
        - "${CUSTOM_ROOT_TEST_DIR}/test_measure_power_consumption.py::test_measure_and_data_dump_bootup_time"

  benchmarks.bootup_time.no_wait:
    integration_platforms:
      - nrf54h20dk/nrf54h20/cpuapp
    platform_allow:
      - nrf54h20dk/nrf54h20/cpuapp
      - nrf54l15dk/nrf54l15/cpuapp
      - nrf54lm20dk/nrf54lm20a/cpuapp
      - nrf54lm20dk/nrf54lm20b/cpuapp
      - nrf54ls05dk/nrf54ls05a/cpuapp
      - nrf54ls05dk/nrf54ls05b/cpuapp
      - nrf54lv10dk/nrf54lv10a/cpuapp
      - nrf54lc10dk/nrf54lc10a/cpuapp
      - nrf54lv10dk/nrf54lv10a/cpuapp/ns
    extra_args:
      - CONFIG_SYSTEM_CLOCK_NO_WAIT=y
    harness_config:
      pytest_root:
        - "${CUSTOM_ROOT_TEST_DIR}/test_measure_power_consumption.py::test_measure_and_data_dump_bootup_time"

  benchmarks.bootup_time.mcuboot:
    integration_platforms:
      - nrf54h20dk/nrf54h20/cpuapp
    platform_allow:
      - nrf52840dk/nrf52840
      - nrf5340dk/nrf5340/cpuapp
      - nrf54h20dk/nrf54h20/cpuapp
      - nrf54l15dk/nrf54l15/cpuapp
      - nrf54lm20dk/nrf54lm20a/cpuapp
      - nrf54lm20dk/nrf54lm20b/cpuapp
      - nrf54lv10dk/nrf54lv10a/cpuapp
      - nrf54lc10dk/nrf54lc10a/cpuapp
    extra_args:
      - SB_CONFIG_BOOTLOADER_MCUBOOT=y
    harness_config:
      pytest_root:
        - "${CUSTOM_ROOT_TEST_DIR}/test_measure_power_consumption.py::test_measure_and_data_dump_bootup_time_mcuboot"

  benchmarks.bootup_time.ext_flash:
    integration_platforms:
      - nrf54h20dk/nrf54h20/cpuapp
    platform_allow:
      - nrf52840dk/nrf52840
      - nrf5340dk/nrf5340/cpuapp
      - nrf54h20dk/nrf54h20/cpuapp
      - nrf54l15dk/nrf54l15/cpuapp
      - nrf54lm20dk/nrf54lm20a/cpuapp
      - nrf54lm20dk/nrf54lm20b/cpuapp
    extra_args:
      - CONFIG_FLASH=y
    harness_config:
      pytest_root:
        - "${CUSTOM_ROOT_TEST_DIR}/test_measure_power_consumption.py::test_measure_and_data_dump_bootup_time"

  benchmarks.bootup_time.all_cores:
    integration_platforms:
      - nrf54h20dk/nrf54h20/cpuapp
    platform_allow:
      - nrf54h20dk/nrf54h20/cpuapp
    extra_args:
      - SB_CONFIG_NETCORE_TESTAPP=y
      - SB_CONFIG_PPRCORE_TESTAPP=y
      - SB_CONFIG_FLPRCORE_TESTAPP=y
    harness_config:
      pytest_root:
        - "${CUSTOM_ROOT_TEST_DIR}/test_measure_power_consumption.py::test_measure_and_data_dump_bootup_time_all_cores"

  benchmarks.bootup_time.lfrc.54h:
    integration_platforms:
      - nrf54h20dk/nrf54h20/cpuapp
    platform_allow:
      - nrf54h20dk/nrf54h20/cpuapp
    harness_config:
      fixture: lfclk_at_lfrc
      pytest_root:
        - "${CUSTOM_ROOT_TEST_DIR}/test_measure_power_consumption.py::test_measure_and_data_dump_bootup_time"

  benchmarks.bootup_time.lfrc.54l:
    integration_platforms:
      - nrf54l15dk/nrf54l15/cpuapp
    platform_allow:
      - nrf54l15dk/nrf54l15/cpuapp
      - nrf54lm20dk/nrf54lm20a/cpuapp
      - nrf54lm20dk/nrf54lm20b/cpuapp
      - nrf54ls05dk/nrf54ls05a/cpuapp
      - nrf54ls05dk/nrf54ls05b/cpuapp
      - nrf54lv10dk/nrf54lv10a/cpuapp
      - nrf54lc10dk/nrf54lc10a/cpuapp
      - nrf54lv10dk/nrf54lv10a/cpuapp/ns
    extra_args:
      - CONFIG_CLOCK_CONTROL_NRF_K32SRC_RC=y
    harness_config:
      pytest_root:
        - "${CUSTOM_ROOT_TEST_DIR}/test_measure_power_consumption.py::test_measure_and_data_dump_bootup_time_lfrc_54l"

  benchmarks.bootup_time.pm:
    integration_platforms:
      - nrf54h20dk/nrf54h20/cpuapp
    platform_allow:
      - nrf54h20dk/nrf54h20/cpuapp
    extra_args:
      - CONFIG_PM=y
      - CONFIG_POWEROFF=y
      - SB_CONFIG_NETCORE_TESTAPP=y
    harness_config:
      pytest_root:
        - "${CUSTOM_ROOT_TEST_DIR}/test_measure_power_consumption.py::test_measure_and_data_dump_bootup_time"
```

## tests/benchmarks/current_consumption/beacon_idle/boards/nrf54h20dk_nrf54h20_cpuapp.conf
```kconfig
#
# Copyright (c) 2025 Nordic Semiconductor ASA
#
# SPDX-License-Identifier: LicenseRef-Nordic-5-Clause
#

CONFIG_SOC_NRF54H20_CPURAD_ENABLE=y
```

## tests/benchmarks/current_consumption/beacon_idle/testcase.yaml
```yaml
common:
  sysbuild: true
  tags:
    - ci_tests_benchmarks_current_consumption
    - ppk_power_measure
    - bluetooth
  harness: pytest

tests:
  benchmarks.current_consumption.beacon_idle.nrf54h:
    platform_allow:
      - nrf54h20dk/nrf54h20/cpuapp
    integration_platforms:
      - nrf54h20dk/nrf54h20/cpuapp
    extra_args:
      - ipc_radio_CONFIG_PM=y
      - ipc_radio_CONFIG_PM_DEVICE=y
      - ipc_radio_CONFIG_PM_DEVICE_RUNTIME=y
      - ipc_radio_POWEROFF=y
      - SB_CONFIG_NETCORE_IPC_RADIO=y
      - SB_CONFIG_NETCORE_IPC_RADIO_BT_HCI_IPC=y
    harness_config:
      fixture: ppk_power_measure
      pytest_root:
        - "${CUSTOM_ROOT_TEST_DIR}/test_measure_power_consumption.py::test_measure_and_data_dump_power_consumption_beacon_idle"

  benchmarks.current_consumption.beacon_idle.nrf54l:
    platform_allow: &54l_test_platforms
      - nrf54l15dk/nrf54l15/cpuapp
      - nrf54lm20dk/nrf54lm20a/cpuapp
      - nrf54lm20dk/nrf54lm20b/cpuapp
      - nrf54ls05dk/nrf54ls05a/cpuapp
      - nrf54ls05dk/nrf54ls05b/cpuapp
      - nrf54lv10dk/nrf54lv10a/cpuapp
      - nrf54lc10dk/nrf54lc10a/cpuapp
    integration_platforms:
      - nrf54l15dk/nrf54l15/cpuapp
    harness_config:
      fixture: ppk_power_measure
      pytest_root:
        - "${CUSTOM_ROOT_TEST_DIR}/test_measure_power_consumption.py::test_measure_and_data_dump_power_consumption_beacon_idle"

  benchmarks.current_consumption.beacon_idle.nrf54l.ldo:
    platform_allow: *54l_test_platforms
    integration_platforms:
      - nrf54l15dk/nrf54l15/cpuapp
    required_snippets:
      - nordic-vregmain-ldo
    harness_config:
      fixture: ppk_power_measure
      pytest_root:
        - "${CUSTOM_ROOT_TEST_DIR}/test_measure_power_consumption.py::test_measure_and_data_dump_power_consumption_beacon_idle_ldo"

  benchmarks.current_consumption.beacon_idle.nrf54l.lfrc:
    platform_allow: *54l_test_platforms
    integration_platforms:
      - nrf54l15dk/nrf54l15/cpuapp
    extra_configs:
      - CONFIG_CLOCK_CONTROL_NRF_K32SRC_RC=y
    harness_config:
      fixture: ppk_power_measure
      pytest_root:
        - "${CUSTOM_ROOT_TEST_DIR}/test_measure_power_consumption.py::test_measure_and_data_dump_power_consumption_beacon_idle"
```

## tests/benchmarks/current_consumption/beacon_vs_vdd/testcase.yaml
```yaml
common:
  sysbuild: true
  tags:
    - ci_tests_benchmarks_current_consumption
    - ppk_power_measure
    - bluetooth
  harness: pytest
  harness_config:
    fixture: ppk_power_measure
    pytest_root:
      - "${CUSTOM_ROOT_TEST_DIR}/test_measure_power_consumption.py::test_measure_power_consumption_beacon_vs_supply_voltage"
tests:
  benchmarks.current_consumption.beacon_vs_vdd:
    platform_allow:
      - nrf52840dk/nrf52840
      - nrf54l15dk/nrf54l15/cpuapp
    integration_platforms:
      - nrf54l15dk/nrf54l15/cpuapp
  benchmarks.current_consumption.beacon_vs_vdd.with_netcore:
    platform_allow:
      - nrf5340dk/nrf5340/cpuapp
      - nrf54h20dk/nrf54h20/cpuapp
    integration_platforms:
      - nrf54h20dk/nrf54h20/cpuapp
    extra_args:
      - SB_CONFIG_NETCORE_IPC_RADIO=y
      - SB_CONFIG_NETCORE_IPC_RADIO_BT_HCI_IPC=y
      - SNIPPET=hw-flow-control
```

## tests/benchmarks/current_consumption/beacon_vs_vddh/testcase.yaml
```yaml
common:
  sysbuild: true
  tags:
    - ci_tests_benchmarks_current_consumption
    - ppk_power_measure
    - bluetooth
tests:
  benchmarks.current_consumption.beacon_vs_vddh:
    platform_allow:
      - nrf54h20dk/nrf54h20/cpuapp
    integration_platforms:
      - nrf54h20dk/nrf54h20/cpuapp
    extra_args:
      - SB_CONFIG_NETCORE_IPC_RADIO=y
      - SB_CONFIG_NETCORE_IPC_RADIO_BT_HCI_IPC=y
    harness: pytest
    harness_config:
      fixture: ppk_power_measure
      pytest_root:
        - "${CUSTOM_ROOT_TEST_DIR}/test_measure_power_consumption.py::test_measure_power_consumption_beacon_vs_vddh_nrf54h"
```

## tests/benchmarks/current_consumption/early_system_off/testcase.yaml
```yaml
common:
  tags:
    - ci_tests_benchmarks_current_consumption
    - ppk_power_measure
  harness: pytest
  harness_config:
    pytest_root:
      - "${CUSTOM_ROOT_TEST_DIR}/test_measure_power_consumption.py::test_measure_early_system_off"

tests:
  benchmarks.early_system_off:
    platform_allow: &early_system_off_test_platforms
      - nrf54l15dk/nrf54l15/cpuapp
      - nrf54lm20dk/nrf54lm20a/cpuapp
      - nrf54lm20dk/nrf54lm20b/cpuapp
      - nrf54ls05dk/nrf54ls05a/cpuapp
      - nrf54ls05dk/nrf54ls05b/cpuapp
      - nrf54lv10dk/nrf54lv10a/cpuapp
      - nrf54lc10dk/nrf54lc10a/cpuapp
      - nrf54lv10dk/nrf54lv10a/cpuapp/ns
    integration_platforms:
      - nrf54l15dk/nrf54l15/cpuapp

  benchmarks.early_system_off.lfrc:
    platform_allow: *early_system_off_test_platforms
    integration_platforms:
      - nrf54l15dk/nrf54l15/cpuapp
    extra_configs:
      - CONFIG_CLOCK_CONTROL_NRF_K32SRC_RC=y
```

## tests/benchmarks/current_consumption/fll16_mode/Kconfig.sysbuild
```kconfig
#
# Copyright (c) 2026 Nordic Semiconductor ASA
#
# SPDX-License-Identifier: LicenseRef-Nordic-5-Clause
#

config SUPPORT_NETCORE_REMOTE_SLEEP_FOREVER
	bool
	default y if SOC_NRF54H20_CPUAPP

choice NETCORE
	default NETCORE_REMOTE_SLEEP_FOREVER if SUPPORT_NETCORE_REMOTE_SLEEP_FOREVER

config NETCORE_REMOTE_SLEEP_FOREVER
	bool "Remote sleep forever image"

endchoice

if !NETCORE_NONE

config NETCORE_IMAGE_NAME
	default "remote_sleep_forever" if NETCORE_REMOTE_SLEEP_FOREVER

config NETCORE_IMAGE_PATH
	default "${ZEPHYR_NRF_MODULE_DIR}/tests/benchmarks/power_consumption/common/remote_sleep_forever" if NETCORE_REMOTE_SLEEP_FOREVER

endif # !NETCORE_NONE

source "share/sysbuild/Kconfig"
```

## tests/benchmarks/current_consumption/gpio_idle/Kconfig.sysbuild
```kconfig
#
# Copyright (c) 2025 Nordic Semiconductor ASA
#
# SPDX-License-Identifier: LicenseRef-Nordic-5-Clause
#

if SOC_NRF54H20_CPUAPP

choice NETCORE
	default NETCORE_EMPTY

endchoice

endif

source "share/sysbuild/Kconfig"
```

## tests/benchmarks/current_consumption/gpio_idle/testcase.yaml
```yaml
common:
  sysbuild: true
  tags:
    - ci_tests_benchmarks_current_consumption
    - ppk_power_measure
tests:
  benchmarks.current_consumption.gpio_idle:
    platform_allow:
      - nrf52840dk/nrf52840
      - nrf5340dk/nrf5340/cpuapp
      - nrf54h20dk/nrf54h20/cpuapp
      - nrf54h20dk/nrf54h20/cpurad
      - nrf54l15dk/nrf54l15/cpuapp
      - nrf54lm20dk/nrf54lm20a/cpuapp
      - nrf54lv10dk/nrf54lv10a/cpuapp
    integration_platforms:
      - nrf54l15dk/nrf54l15/cpuapp
    harness: pytest
    harness_config:
      fixture: ppk_power_measure
      pytest_root:
        - "${CUSTOM_ROOT_TEST_DIR}/test_measure_power_consumption.py::test_measure_and_data_dump_power_consumption_with_rx_wakeup_gpio_idle"
    timeout: 80
```

## tests/benchmarks/current_consumption/lfrc_idle/testcase.yaml
```yaml
common:
  sysbuild: true
  tags:
    - ci_tests_benchmarks_current_consumption
    - ppk_power_measure
    - clock_control
tests:
  benchmarks.current_consumption.lfclk_idle:
    platform_allow:
      - nrf54h20dk/nrf54h20/cpuapp
    integration_platforms:
      - nrf54h20dk/nrf54h20/cpuapp
    harness: pytest
    harness_config:
      fixture: ppk_power_measure
      pytest_root:
        - "${CUSTOM_ROOT_TEST_DIR}/test_measure_power_consumption.py::test_measure_and_data_dump_power_consumption_lfclk_source_change"
```

## tests/benchmarks/current_consumption/multicore_system_off/testcase.yaml
```yaml
common:
  sysbuild: true
  tags: ci_tests_benchmarks_current_consumption ppk_power_measure

tests:
  benchmarks.current_consumption.multicore_system_off:
    platform_allow:
      - nrf54l15dk/nrf54l15/cpuapp
    integration_platforms:
      - nrf54l15dk/nrf54l15/cpuapp
    extra_args:
      - SB_CONF_FILE=sysbuild/nrf54l15dk_nrf54l15_cpuflpr.conf
      - SB_CONFIG_PARTITION_MANAGER=n
    harness: pytest
    harness_config:
      fixture: ppk_power_measure
      pytest_root:
        - "${CUSTOM_ROOT_TEST_DIR}/test_measure_power_consumption.py::test_measure_and_data_dump_power_consumption_multicore_system_off"
    timeout: 80
```

## tests/benchmarks/current_consumption/nfc_idle/Kconfig.sysbuild
```kconfig
#
# Copyright (c) 2024 Nordic Semiconductor ASA
#
# SPDX-License-Identifier: LicenseRef-Nordic-5-Clause
#

source "${ZEPHYR_BASE}/share/sysbuild/Kconfig"

config REMOTE_BOARD
	string
	default "$(BOARD)/nrf54h20/cpurad" if SOC_NRF54H20_CPUAPP
```
