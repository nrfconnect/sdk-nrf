## sysbuild/Kconfig.suit_provisioning
```kconfig
#
# Copyright (c) 2024 Nordic Semiconductor
#
# SPDX-License-Identifier: LicenseRef-Nordic-5-Clause
#

menu "SUIT provisioning"

config SUIT_MPI_GENERATE
	bool "Generate SUIT Manifest Provisioning Information binary"
	default y if SOC_SERIES_NRF54HX || SOC_SERIES_NRF92X
	depends on !SOC_NRF54H20_IRON

if SUIT_MPI_GENERATE

config SUIT_ENVELOPE_OUTPUT_MPI_MERGE
	bool "Merge MPI files into final SUIT_ENVELOPE_OUTPUT_ARTIFACT"
	default y

rsource "suit_provisioning/Kconfig.nrf54h20"
rsource "suit_provisioning/Kconfig.nrf9280"

endif # SUIT_MPI_GENERATE

endmenu
```

## sysbuild/Kconfig.sw_io_devices
```kconfig
# Copyright (c) 2024 Nordic Semiconductor
#
# SPDX-License-Identifier: LicenseRef-Nordic-5-Clause

menu "SW IO devices"

menuconfig SW_IO_DEVICES
	bool "Software IO devices"

if SW_IO_DEVICES

config EGPIO_FLPR_APPLICATION
	bool "Nordic eGPIO FLPR application"
	help
	  Include FLPR side eGPIO application in build.
	  FLPR eGPIO application is an eGPIO driver built for an FLPR core that receives commands
	  from the app core and controls the pin states based on them.

endif # SW_IO_DEVICES

endmenu
```

## sysbuild/Kconfig.sysbuild
```kconfig
#
# Copyright (c) 2022 Nordic Semiconductor
#
# SPDX-License-Identifier: LicenseRef-Nordic-5-Clause
#

# This file contains extra images which can be used with sysbuild based builds.

config BUILD_OUTPUT_BIN
	bool "Build a binary in BIN format"
	default y
	help
	  Build a "raw" binary zephyr/zephyr.bin in the build directory.
	  The name of this file can be customized with CONFIG_KERNEL_BIN_NAME.
	  This will be applied to all target images.

config BUILD_OUTPUT_HEX
	bool "Build a binary in HEX format"
	default y
	help
	  Build an Intel HEX binary zephyr/zephyr.hex in the build directory.
	  The name of this file can be customized with CONFIG_KERNEL_BIN_NAME.
	  This will be applied to all target images.

# TODO: NCSDK-28330
# This check will fail for variants
BOARD_NS_QUALIFIER_CHECK := $(substring,$(BOARD_QUALIFIERS),-3)

config BOARD_IS_NON_SECURE
	bool
	default y if "$(BOARD_NS_QUALIFIER_CHECK)" = "/ns"

rsource "Kconfig.appcore"
rsource "Kconfig.flprcore"
rsource "Kconfig.netcore"
rsource "Kconfig.pprcore"
rsource "Kconfig.radio_loader"
rsource "Kconfig.secureboot"
rsource "Kconfig.mcuboot"
rsource "Kconfig.dfu"
rsource "Kconfig.xip"
rsource "Kconfig.bt_fast_pair"
rsource "Kconfig.zip"
rsource "Kconfig.matter"
rsource "Kconfig.wifi"
rsource "Kconfig.approtect"
rsource "Kconfig.lwm2m_carrier"
rsource "Kconfig.cracen"
rsource "Kconfig.tfm"
rsource "Kconfig.firmware_loader"
rsource "Kconfig.firmware_loader_radio"
rsource "Kconfig.kmu_prot_ram_inv"
```

## sysbuild/Kconfig.tfm
```kconfig
# Copyright (c) 2024 Nordic Semiconductor
#
# SPDX-License-Identifier: LicenseRef-Nordic-5-Clause

menu "TF-M"
	depends on BOARD_IS_NON_SECURE

config TFM_OTP_PSA_CERTIFICATE_REFERENCE
	bool "Include TF-M attestation PSA certificate reference"
	depends on BOARD_IS_NON_SECURE
	help
	  Include the optional PSA certificate reference in the TF-M attestation token.
	  Stored in one-time programmable (OTP) memory during provisioning.

config TFM_PSA_CERTIFICATE_REFERENCE_VALUE
	string "TF-M PSA Certificate Reference"
	depends on TFM_OTP_PSA_CERTIFICATE_REFERENCE
	depends on BOARD_IS_NON_SECURE
	default "0632793519546-10200" if SOC_NRF9160
	default "0632793519539-10100" if SOC_NRF5340_CPUAPP
	default ""
	help
	  The reference of the PSA certificate.
	  Certificate details available at https://www.psacertified.org.

endmenu
```

## sysbuild/Kconfig.wifi
```kconfig
# Copyright (c) 2024 Nordic Semiconductor
#
# SPDX-License-Identifier: LicenseRef-Nordic-5-Clause

menu "Wi-Fi"

menuconfig WIFI_NRF70
	bool "nRF700x"

if WIFI_NRF70

choice WIFI_NRF70_OPER_MODES
	bool "nRF700x operating mode"
	default WIFI_NRF70_SYSTEM_MODE
	help
	  Select the operating mode of the nRF700x driver

config WIFI_NRF70_SYSTEM_MODE
	bool "Enable nRF70 system mode"
	help
	  Select this option to enable system mode of the nRF700x driver

config WIFI_NRF70_SCAN_ONLY
	bool "Enable nRF70 scan only mode"
	help
	  Select this option to enable scan only mode of the nRF700x driver

config WIFI_NRF70_OFFLOADED_RAW_TX
	bool "Offloaded raw tx mode of the nRF700x driver"

config WIFI_NRF70_RADIO_TEST
	bool "Radio test mode of the nRF700x driver"

config WIFI_NRF70_SYSTEM_WITH_RAW_MODES
	bool "Enable nRF70 system mode with raw modes"
	help
	  Select this option to enable system mode of the nRF700x driver with raw modes

endchoice

choice WIFI_PATCHES_EXT_FLASH_SUPPORT
	bool "nRF700x FW patch location"
	help
	  Use this option to select where the nRF700x firmware patches are stored, this allows
	  moving them to external flash which can help reduce the code memory size of the
	  application, but requires external memory to be available for storing the patches.

config WIFI_PATCHES_EXT_FLASH_DISABLED
	bool "RAM"

config WIFI_PATCHES_EXT_FLASH_XIP
	bool "Relocate to external memory and execute from there"
	# nRF7002 supports SPI based external flash access with no XIP
	depends on !BOARD_NRF7002DK_NRF5340_CPUAPP && !BOARD_NRF7002DK_NRF5340_CPUAPP_NS
	# Disable until Matter DFU changes are ready
	# default y if BOARD_NRF5340DK_NRF5340_CPUAPP || BOARD_NRF52840DK_NRF52840

config WIFI_PATCHES_EXT_FLASH_STORE
	bool "Relocate to external memory but execute from RAM"
	# nRF7002 supports SPI based external memory access but missing tools support
	# TODO: Enable when tools support is available (NRFJPROG-157)
	depends on !BOARD_NRF7002DK_NRF5340_CPUAPP && !BOARD_NRF7002DK_NRF5340_CPUAPP_NS

endchoice

endif # WIFI_NRF70

endmenu
```

## sysbuild/Kconfig.xip
```kconfig
# Copyright (c) 2023-2024 Nordic Semiconductor
#
# SPDX-License-Identifier: LicenseRef-Nordic-5-Clause

config SUPPORT_QSPI_XIP
	bool
	default y if SOC_NRF52840
	default y if SOC_NRF5340_CPUAPP
	default y if SOC_SERIES_NRF91

config QSPI_XIP_SPLIT_IMAGE
	bool "QSPI XIP split image"
	depends on SUPPORT_QSPI_XIP && BOOTLOADER_MCUBOOT && PARTITION_MANAGER
	depends on PM_EXTERNAL_FLASH_MCUBOOT_SECONDARY
	depends on MCUBOOT_MODE_OVERWRITE_ONLY || MCUBOOT_MODE_DIRECT_XIP
	help
	  Configures images and build system to support executing code from QSPI flash in XIP
	  mode. Will also configure an additional image for MCUboot (if enabled) to allow for
	  updating the image.

	  Requires `mcuboot_primary_X` and `mcuboot_secondary_X` entries in a partition manager
	  configuration file where X is the QSPI XIP image number.
```

## sysbuild/Kconfig.zip
```kconfig
# Copyright (c) 2024 Nordic Semiconductor
#
# SPDX-License-Identifier: LicenseRef-Nordic-5-Clause

menuconfig DFU_ZIP
	bool "Create DFU zip package"
	depends on BOOTLOADER_MCUBOOT || (SECURE_BOOT_APPCORE && SECURE_BOOT_BUILD_S1_VARIANT_IMAGE)
	default y
	help
	  Build DFU zip package that contains a manifest file and selected update images.

if DFU_ZIP

config DFU_ZIP_APP
	bool "Application update"
	default y
	help
	  Include application update in DFU zip.

if BOOTLOADER_MCUBOOT

config DFU_ZIP_NET
	bool "Network core update"
	depends on SUPPORT_NETCORE
	depends on !NETCORE_NONE
	depends on (SECURE_BOOT_NETCORE && NETCORE_APP_UPDATE) || SOC_SERIES_NRF54H
	default y
	help
	  Include network-core update in DFU zip.

config DFU_ZIP_WIFI_FW_PATCH
	bool "nRF70 firmware patch"
	depends on PARTITION_MANAGER
	depends on WIFI_NRF70
	depends on (WIFI_PATCHES_EXT_FLASH_XIP || WIFI_PATCHES_EXT_FLASH_STORE)
	default y
	help
	  Include nRF7x firmware patch in DFU zip.

config DFU_ZIP_BLUETOOTH_MESH_METADATA
	bool "Bluetooth mesh metadata"
	help
	  Includes metadata for bluetooth mesh.

if DFU_ZIP_BLUETOOTH_MESH_METADATA

choice DFU_ZIP_BLUETOOTH_MESH_METADATA_FWID
	prompt "Source of Firmware ID to include in metadata file"
	optional

config DFU_ZIP_BLUETOOTH_MESH_METADATA_FWID_CUSTOM
	bool "Use a custom Firmware ID"
	help
	  The value to include as Firmware ID in the Bluetooth Mesh metadata file is set using
	  ``SB_CONFIG_DFU_ZIP_BLUETOOTH_MESH_METADATA_FWID_CUSTOM_HEX``.
	  Note: You are required to make sure that the Firmware ID used when initializing the DFU
	  Server matches the ID in the metadata file.

config DFU_ZIP_BLUETOOTH_MESH_METADATA_FWID_MCUBOOT_VERSION
	bool "Use a Firmware ID generated from the MCUboot version"
	help
	  Includes a Firmware ID in the Bluetooth Mesh metadata file consisting of the values of
	  ``CONFIG_BT_COMPANY_ID`` and ``CONFIG_MCUBOOT_IMGTOOL_SIGN_VERSION``.
	  Note: You are required to make sure that the Firmware ID used when initializing the DFU
	  Server matches the ID in the metadata file.

endchoice

if DFU_ZIP_BLUETOOTH_MESH_METADATA_FWID_CUSTOM

config DFU_ZIP_BLUETOOTH_MESH_METADATA_FWID_CUSTOM_HEX
	string "HEX string to use as Firmware ID"
	help
	  The raw value of this option is included as the Firmware ID in the Bluetooth Mesh metadata
	  file. This must be a valid hex string, and must at minimum begin with a Company ID in
	  little-endian order. The rest of the string is vendor-specific version information and may
	  be empty.
	  Note: You are required to make sure that the Firmware ID used when initializing the DFU
	  Server matches the ID in the metadata file.

endif # DFU_ZIP_BLUETOOTH_MESH_METADATA_FWID_CUSTOM

endif # DFU_ZIP_BLUETOOTH_MESH_METADATA

endif # BOOTLOADER_MCUBOOT

endif # DFU_ZIP
```

## tests/Kconfig
```kconfig
#
# Copyright (c) 2019 Nordic Semiconductor
#
# SPDX-License-Identifier: LicenseRef-Nordic-5-Clause
#

menu "Test"

rsource "unity/Kconfig"
rsource "mocks/Kconfig"

endmenu
```

## tests/asset_tracker_v2/debug_module/Kconfig
```kconfig
#
# Copyright (c) 2021 Nordic Semiconductor ASA
#
# SPDX-License-Identifier: LicenseRef-Nordic-5-Clause
#

source "Kconfig.zephyr"
```

## tests/asset_tracker_v2/json_common/Kconfig
```kconfig
#
# Copyright (c) 2021 Nordic Semiconductor ASA
#
# SPDX-License-Identifier: LicenseRef-Nordic-5-Clause
#

menu "JSON common test"

rsource "${ZEPHYR_BASE}/../nrf/applications/asset_tracker_v2/src/cloud/cloud_codec/Kconfig"
source "Kconfig.zephyr"

endmenu
```

## tests/benchmarks/bootup_time/Kconfig.sysbuild
```kconfig
#
# Copyright (c) 2025 Nordic Semiconductor ASA
#
# SPDX-License-Identifier: LicenseRef-Nordic-5-Clause
#

config SUPPORT_NETCORE_TESTAPP
	bool
	default y if SOC_NRF54H20_CPUAPP

choice NETCORE

config NETCORE_TESTAPP
	bool "testapp image"

endchoice

if !NETCORE_NONE

config NETCORE_IMAGE_NAME
	default "testapp_cpunet" if NETCORE_TESTAPP

config NETCORE_IMAGE_PATH
	default "${ZEPHYR_NRF_MODULE_DIR}/tests/benchmarks/bootup_time/testapp" if NETCORE_TESTAPP

endif # !NETCORE_NONE

config SUPPORT_PPRCORE_TESTAPP
	bool
	default y if SOC_NRF54H20_CPUAPP

choice PPRCORE

config PPRCORE_TESTAPP
	bool "testapp image"

endchoice

if !PPRCORE_NONE

config PPRCORE_IMAGE_NAME
	default "testapp_cpuppr" if PPRCORE_TESTAPP

config PPRCORE_IMAGE_PATH
	default "${ZEPHYR_NRF_MODULE_DIR}/tests/benchmarks/bootup_time/testapp" if PPRCORE_TESTAPP

endif # !PPRCORE_NONE

config SUPPORT_FLPRCORE_TESTAPP
	bool
	default y if SOC_NRF54H20_CPUAPP

choice FLPRCORE

config FLPRCORE_TESTAPP
	bool "testapp image"

endchoice

if !FLPRCORE_NONE

config FLPRCORE_IMAGE_NAME
	default "testapp_cpuflpr" if FLPRCORE_TESTAPP

config FLPRCORE_IMAGE_PATH
	default "${ZEPHYR_NRF_MODULE_DIR}/tests/benchmarks/bootup_time/testapp" if FLPRCORE_TESTAPP

endif # !FLPRCORE_NONE

source "share/sysbuild/Kconfig"
```

## tests/benchmarks/bootup_time/testapp/boards/nrf54h20dk_nrf54h20_cpurad.conf
```kconfig
CONFIG_CONSOLE=n
CONFIG_UART_CONSOLE=n
CONFIG_SERIAL=n
CONFIG_BOOT_BANNER=n
CONFIG_NCS_BOOT_BANNER=n
```
