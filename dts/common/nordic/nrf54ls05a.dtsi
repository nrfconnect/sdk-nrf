/*
 * Copyright (c) 2026 Nordic Semiconductor ASA
 *
 * SPDX-License-Identifier: LicenseRef-Nordic-5-Clause
 */

#include "nrf54ls05_a_b.dtsi"

&cpuapp_sram {
	reg = <0x20000000 DT_SIZE_K(64)>;
	ranges = <0x0 0x20000000 DT_SIZE_K(64)>;
};
