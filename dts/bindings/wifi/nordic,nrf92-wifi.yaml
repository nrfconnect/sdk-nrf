## dts/bindings/wifi/nordic,nrf92-wifi.yaml
```yaml
# Copyright (c) 2026 Nordic Semiconductor ASA
# SPDX-License-Identifier: LicenseRef-Nordic-5-Clause

description: Nordic nRF92 Wi-Fi

compatible: "nordic,nrf92-wifi"
```

## dts/bindings/wifi/wifi-tx-power-2g.yaml
```yaml
# Copyright (c) 2025 Nordic Semiconductor ASA
# SPDX-License-Identifier: LicenseRef-Nordic-5-Clause

description: |
  This is a representation of the Wi-Fi transmit power ceilings
  i.e., maximum transmit power allowed for 2.4GHz band. Based on the
  RF performance of the device, the transmit power can be limited
  for different data rates and sub-bands to get the best performance.
  Resolution is 1 dBm

properties:
  wifi-max-tx-pwr-2g-dsss:
    type: int
    required: true
    description: Maximum transmit power allowed in 2.4GHz band for DSSS/CCK rates
  wifi-max-tx-pwr-2g-mcs0:
    type: int
    required: true
    description: Maximum transmit power allowed in 2.4GHz band for MCS0
  wifi-max-tx-pwr-2g-mcs7:
    type: int
    required: true
    description: Maximum transmit power allowed in 2.4GHz band for MCS7
```

## ext/Kconfig
```kconfig
#
# Copyright (c) 2018 Nordic Semiconductor
#
# SPDX-License-Identifier: LicenseRef-Nordic-5-Clause
#

menu "External libraries"

rsource "freebsd-getopt/Kconfig"
rsource "iperf3/Kconfig"
rsource "curl/Kconfig"

endmenu
```

## ext/cjson/Kconfig
```kconfig
#
# Copyright (c) 2018 Nordic Semiconductor
#
# SPDX-License-Identifier: LicenseRef-BSD-5-Clause-Nordic
#

# Kconfig - cJSON Library for Zephyr

config  CJSON_LIB
	bool "cJSON library"
	# Since minimal libc lacks sscanf and strtod we need to use newlibc
	# Allow external libc to allow native posix to be used for unit test
	depends on NEWLIB_LIBC || EXTERNAL_LIBC
	default n
	help
	  Enable the cJSON Library
```

## ext/curl/Kconfig
```kconfig
#
# Copyright (c) 2021 Nordic Semiconductor
#
# SPDX-License-Identifier: LicenseRef-Nordic-5-Clause
#

# Enables client to have NRF_CURL in synchronization with client's own flag.
config NRF_CURL_PROMPTLESS
	bool

config NRF_CURL
	bool "Curl" if !NRF_CURL_PROMPTLESS
	depends on POSIX_API && !PTHREAD_IPC && !NET_SOCKETS_POSIX_NAMES && NEWLIB_LIBC
	imply NEWLIB_LIBC_FLOAT_PRINTF
	help
	  Curl support for NRF.

if NRF_CURL
menu "NRF CURL selections"

#invisible configs:
config NRF_CURL_LIB
	bool
	default y

config NRF_CURL_TOOL
	bool
	default y

config NRF_CURL_INTEGRATION
	bool "Curl changes for NRF"
	default y
	help
	  Compile cURL for nRF Connect SDK integration.
	  This setting will enable nRF Connect SDK specific changes in the cURL library.
	  If cURL is planned to be used in nRF Connect SDK context then this setting
	  must be enabled.

# The name of this option is mandated by zephyr_interface_library_named cmake directive.
config APP_LINK_WITH_CURL
	bool "Link 'app' with CURL"
	default y
	help
	  Add CURL header files to the 'app' include path. It may be
	  disabled if the include paths for CURL are causing aliasing
	  issues for 'app'.

endmenu #NRF_CURL
endif #NRF_CURL
```

## ext/freebsd-getopt/Kconfig
```kconfig
#
# Copyright (c) 2020 Nordic Semiconductor
#
# SPDX-License-Identifier: LicenseRef-Nordic-5-Clause
#

# Getopt Library for Zephyr

config  GETOPT_LIB
	bool "Getopt library"
	depends on POSIX_API 
	help
	  Enable the Getopt Library
```

## ext/iperf3/Kconfig
```kconfig
#
# Copyright (c) 2020 Nordic Semiconductor
#
# SPDX-License-Identifier: LicenseRef-Nordic-5-Clause
#

# iperf3 NRF integration

# Enables client to have NRF_IPERF3 in synchronization with client's own flag.
config NRF_IPERF3_PROMPTLESS
	bool

config  NRF_IPERF3
	bool "Iperf3 NRF integration" if !NRF_IPERF3_PROMPTLESS
	depends on POSIX_API && !PTHREAD_IPC && !NET_SOCKETS_POSIX_NAMES && NEWLIB_LIBC && CJSON_LIB
	help
	  Enable Iperf3 NRF integration

if NRF_IPERF3
menu "NRF Iperf3 selections"

config NRF_IPERF3_HOST_NAME
	string "iperf3 host name"
	default "nrf9160"
	help
	  The iperf3 host name.
	  The host name will be sent as part of a cookie.

config NRF_IPERF3_RESULTS_WAIT_TIME
	int "Maximum response wait time (seconds)"
	default 15
	help
	  Maximum time in seconds to be waited to send and recv results.

config NRF_IPERF3_CLIENT_TEST_START_TIME
	int "Test start delay"
	default 15
	help
	  Time in seconds from control socket creation to actual data transfer start.

config NRF_IPERF3_CLIENT_TEST_ENDING_TIMEOUT
	int "Test ending timeout"
	default 480
	help
	  Time in seconds to wait in TEST_END state.

# The name of this option is mandated by zephyr_interface_library_named cmake directive.
config APP_LINK_WITH_IPERF3
	bool "Link 'app' with IPERF3"
	default y
	help
	  Add IPERF3 header files to the 'app' include path. It may be
	  disabled if the include paths for IPERF3 are causing aliasing
	  issues for 'app'.

#invisible configs:
config NRF_IPERF3_INTEGRATION
	bool
	default y

config NRF_IPERF3_NONBLOCKING_CLIENT_CHANGES
	bool
	default y

config NRF_IPERF3_MULTICONTEXT_SUPPORT
	bool
	default y
	depends on NRF_IPERF3_INTEGRATION

endmenu #NRF iperf3
endif #NRF_IPERF3
```

## ext/sbc/Kconfig
```kconfig
#
# Copyright (c) 2022 Nordic Semiconductor
#
# SPDX-License-Identifier: LicenseRef-Nordic-5-Clause
#

config SBC
	bool "SBC codec"
	help
	  Enable the SBC audio codec.
```

## lib/Kconfig
```kconfig
#
# Copyright (c) 2018 Nordic Semiconductor ASA
#
# SPDX-License-Identifier: LicenseRef-Nordic-5-Clause
#

menu "Libraries"

rsource "bin/Kconfig"
rsource "nrf_modem_lib/Kconfig"
rsource "adp536x/Kconfig"
rsource "at_monitor/Kconfig"
rsource "st25r3911b/Kconfig"
rsource "flash_patch/Kconfig"
rsource "lte_link_control/Kconfig"
rsource "fprotect/Kconfig"
rsource "at_cmd_custom/Kconfig"
rsource "at_host/Kconfig"
rsource "dk_buttons_and_leds/Kconfig"
rsource "at_cmd_parser/Kconfig"
rsource "modem_battery/Kconfig"
rsource "modem_info/Kconfig"
rsource "pdn/Kconfig"
rsource "multithreading_lock/Kconfig"
rsource "fatal_error/Kconfig"
rsource "sms/Kconfig"
rsource "gcf_sms/Kconfig"
rsource "modem_key_mgmt/Kconfig"
rsource "supl/Kconfig"
rsource "date_time/Kconfig"
rsource "hw_id/Kconfig"
rsource "ram_pwrdn/Kconfig"
rsource "edge_impulse/Kconfig"
rsource "wave_gen/Kconfig"
rsource "hw_unique_key/Kconfig"
rsource "modem_jwt/Kconfig"
rsource "modem_slm/Kconfig"
rsource "modem_attest_token/Kconfig"
rsource "location/Kconfig"
rsource "at_shell/Kconfig"
rsource "modem_antenna/Kconfig"
rsource "qos/Kconfig"
rsource "identity_key/Kconfig"
rsource "sfloat/Kconfig"
rsource "contin_array/Kconfig"
rsource "pcm_mix/Kconfig"
rsource "tone/Kconfig"
rsource "pcm_stream_channel_modifier/Kconfig"
rsource "data_fifo/Kconfig"
rsource "fem_al/Kconfig"
rsource "sample_rate_converter/Kconfig"
rsource "boot_banner/Kconfig"

endmenu
```

## lib/accel_to_angle/Kconfig
```kconfig
#
# Copyright (c) 2026 Nordic Semiconductor ASA
#
# SPDX-License-Identifier: LicenseRef-Nordic-5-Clause
#

config ACCEL_TO_ANGLE
	bool "Acceleration to angle conversion library"
	help
	  Enable acceleration to angle conversion library.

if ACCEL_TO_ANGLE

module = ACCEL_TO_ANGLE
module-str = Acceleration to Angle Conversion Library
source "subsys/logging/Kconfig.template.log_config"

config ACCEL_TO_ANGLE_LOG_LEVEL_DBG
	select REQUIRES_FLOAT_PRINTF

endif # ACCEL_TO_ANGLE
```

## lib/adp536x/Kconfig
```kconfig
# ADP536x
#
# Copyright (c) 2019 Nordic Semiconductor
#
# SPDX-License-Identifier: LicenseRef-Nordic-5-Clause
#

config ADP536X
	bool "ADP536x"
	default y
	depends on !IS_BOOTLOADER_IMG
	depends on DT_HAS_ADI_ADP5360_ENABLED
	select I2C
	help
	  Enable ADP536x
```

## lib/agps/Kconfig
```kconfig
#
# Copyright (c) 2020 Nordic Semiconductor ASA
#
# SPDX-License-Identifier: LicenseRef-Nordic-5-Clause
#

config AGPS
	bool "A-GPS library"
	depends on NRF_MODEM_LIB
	help
	  A library to simplify switching between A-GPS data sources.

if AGPS

choice
	bool "A-GPS data source"
	default AGPS_SRC_NRF_CLOUD

config AGPS_SRC_NRF_CLOUD
	bool "Use nRF Cloud as data source"
	imply NRF_CLOUD_AGPS
	help
	  To request A-GPS data from nRF Cloud via MQTT, CONFIG_NRF_CLOUD_MQTT
	  must be enabled and the connection must already be established.
	  When a request for A-GPS data is sent to nRF Cloud, the response will
	  be received on the same socket as all other nRF Cloud communication,
	  and the data will have to be processed further in the application.
	  A-GPS data can also be requested from nRF Cloud via REST.

config AGPS_SRC_SUPL
	bool "Use SUPL as data source"
	imply SUPL_CLIENT_LIB
	help
	  Note that a request for A-GPS data using SUPL service will block until
	  the data is received from the SUPL server, processed and written to
	  the GPS module.

endchoice

if AGPS_SRC_SUPL

config AGPS_SUPL_HOST_NAME
	string "SUPL host name"
	default "supl.google.com"

config AGPS_SUPL_PORT
	int "SUPL port"
	default 7276

endif # AGPS_SRC_SUPL

endif # AGPS

module = AGPS
module-str = A-GPS
source "${ZEPHYR_BASE}/subsys/logging/Kconfig.template.log_config"
```

## lib/app_jwt/Kconfig
```kconfig
#
# Copyright (c) 2024 Nordic Semiconductor ASA
#
# SPDX-License-Identifier: LicenseRef-Nordic-5-Clause
#

menuconfig APP_JWT
	bool "Application JWT Library"
	select BASE64
	# Needed for time and date
	select DATE_TIME
	select NET_SOCKETS
	select NETWORKING
	# Needed to print integer values in JSON
	select CJSON_LIB
	select CBPRINTF_FP_SUPPORT
	select NRF_SECURITY
	select PSA_SSF_CRYPTO_CLIENT
	select PSA_WANT_KEY_TYPE_ECC_KEY_PAIR_IMPORT
	select PSA_WANT_ALG_ECDSA
	select PSA_WANT_ECC_SECP_R1_256
	select PSA_WANT_ALG_SHA_256
	# Enable Device Info service
	select NRF_IRONSIDE_BOOT_REPORT

if APP_JWT

config APP_JWT_DEFAULT_TIMESTAMP
	int "Default timestamp to use in case time value is 0"
	default 1735682400

config APP_JWT_DEFAULT_IDENTITY_KEY_ID
	hex "Default identity key id used for signing a JWT"
	default 0x7fffc001

config APP_JWT_VERIFY_SIGNATURE
	bool "Verify signature after signing"
	default y

config APP_JWT_PRINT_EXPORTED_PUBKEY_DER
	bool "Print to terminal the DER formatted public key"

module=APP_JWT
module-str=User App JWT
source "$(ZEPHYR_BASE)/subsys/logging/Kconfig.template.log_config"

endif # APP_JWT
```

## lib/at_cmd/Kconfig
```kconfig
#
# Copyright (c) 2019 Nordic Semiconductor
#
# SPDX-License-Identifier: LicenseRef-Nordic-5-Clause
#

menu "AT Command driver"

config AT_CMD
	bool "AT Command driver"
	depends on NRF_MODEM_LIB

if AT_CMD

config AT_CMD_SYS_INIT
	bool "Initialize the AT Command driver during system init"
	default y if NRF_MODEM_LIB_SYS_INIT

if AT_CMD_SYS_INIT

config AT_CMD_INIT_PRIORITY
	int "AT Command driver init priority"
	default 40

endif

config AT_CMD_THREAD_PRIO
	int "AT thread priority level"
	range 0 NUM_PREEMPT_PRIORITIES
	default 0 if !MULTITHREADING
	default 10

config AT_CMD_THREAD_STACK_SIZE
	int "AT thread stack size"
	default 1024

config AT_CMD_QUEUE_LEN
	int "Maximum number of queued AT commands"
	default 16

config AT_CMD_RESPONSE_MAX_LEN
	int "Maximum AT command response length"
	default 2700

module = AT_CMD
module-str = AT command driver
source "${ZEPHYR_BASE}/subsys/logging/Kconfig.template.log_config"

endif # AT_CMD

endmenu
```

## lib/at_cmd_custom/Kconfig
```kconfig
#
# Copyright (c) 2022 Nordic Semiconductor ASA
#
# SPDX-License-Identifier: LicenseRef-Nordic-5-Clause
#

menuconfig AT_CMD_CUSTOM
	bool "Custom AT commands"

if AT_CMD_CUSTOM

module=AT_CMD_CUSTOM
module-dep=LOG
module-str= AT custom command library
source "${ZEPHYR_BASE}/subsys/logging/Kconfig.template.log_config"

endif # AT_CMD_CUSTOM
```

## lib/at_cmd_parser/Kconfig
```kconfig
#
# Copyright (c) 2019 Nordic Semiconductor ASA
#
# SPDX-License-Identifier: LicenseRef-Nordic-5-Clause
#

config AT_CMD_PARSER
	bool "AT command parser library"
	depends on NEWLIB_LIBC || EXTERNAL_LIBC || PICOLIBC
```

## lib/at_custom_cmd/Kconfig
```kconfig
#
# Copyright (c) 2022 Nordic Semiconductor ASA
#
# SPDX-License-Identifier: LicenseRef-Nordic-5-Clause
#

menuconfig AT_CUSTOM_CMD
	bool "Custom AT commands"

if AT_CUSTOM_CMD

module=AT_CUSTOM_CMD
module-dep=LOG
module-str= AT custom command library
source "${ZEPHYR_BASE}/subsys/logging/Kconfig.template.log_config"

endif # AT_CUSTOM_CMD
```

## lib/at_host/Kconfig
```kconfig
#
# Copyright (c) 2018 Nordic Semiconductor
#
# SPDX-License-Identifier: LicenseRef-Nordic-5-Clause
#

menuconfig AT_HOST_LIBRARY
	bool "AT Host Library for nrf91"
	depends on NRF_MODEM_LIB
	select AT_MONITOR

if AT_HOST_LIBRARY

config AT_HOST_UART_INIT_TIMEOUT
	int "Timeout waiting for a valid UART line on init (ms)"
	help
		If the selected UART has error conditions during init caused by
		e. g. a floating RX line during boot, at_host will clear the
		errors and retry for this amount of time.
	default 500

choice
	prompt "Termination Mode"
	default CR_TERMINATION
	depends on AT_HOST_LIBRARY
	help
		Sets the termination ending from the serial terminal
		Levels are:
		-  NULL Termination
		-  CR Termination
		-  LF Termination
		-  CR+LF Termination

		WARNING! Some AT commands (like AT+CMGS) use CR internally.
		Selecting CR Termination will render those commands unavailable.
	config NULL_TERMINATION
		bool "NULL Termination"
	config CR_TERMINATION
		bool "CR Termination"
	config LF_TERMINATION
		bool "LF Termination"
	config CR_LF_TERMINATION
		bool "CR+LF Termination"
endchoice

config AT_HOST_TERMINATION
	int
	default 0 if NULL_TERMINATION
	default 1 if CR_TERMINATION
	default 2 if LF_TERMINATION
	default 3 if CR_LF_TERMINATION

config AT_HOST_CMD_MAX_LEN
	int "Maximum AT command length"
	help
		The maximum allowed length of an AT command passed through the
		AT host. The space is allocated statically.
	range 0 4096
	default 4096

config AT_HOST_THREAD_PRIO
	int "AT host workqueue thread priority level"
	range 0 NUM_PREEMPT_PRIORITIES
	default 0 if !MULTITHREADING
	default 10

module = AT_HOST
module-str = AT host
source "${ZEPHYR_BASE}/subsys/logging/Kconfig.template.log_config"

endif # AT_HOST_LIBRARY
```

## lib/at_monitor/Kconfig
```kconfig
#
# Copyright (c) 2021 Nordic Semiconductor ASA
#
# SPDX-License-Identifier: LicenseRef-Nordic-5-Clause
#

menuconfig AT_MONITOR
	bool "AT notification monitor"

if AT_MONITOR

config AT_MONITOR_HEAP_SIZE
	int "Heap size for notifications"
	range 64 4096
	default 256

config AT_MONITOR_USE_DEDICATED_WORKQUEUE
	bool "Use dedicated workqueue to dispatch notifications"
	default y

if AT_MONITOR_USE_DEDICATED_WORKQUEUE

config AT_MONITOR_WORKQ_STACK_SIZE
	int "Workqueue stack size"
	default 768

config AT_MONITOR_WORKQ_PRIO_OVERRIDE
	bool "Override default workqueue priority"

config AT_MONITOR_WORKQ_PRIO
	int "Workqueue priority" if AT_MONITOR_WORKQ_PRIO_OVERRIDE
	default -1

endif # AT_MONITOR_USE_DEDICATED_WORKQUEUE

module=AT_MONITOR
module-dep=LOG
module-str= AT notification monitor library
source "${ZEPHYR_BASE}/subsys/logging/Kconfig.template.log_config"

endif # AT_MONITOR
```

## lib/at_notif/Kconfig
```kconfig
#
# Copyright (c) 2019 Nordic Semiconductor ASA
#
# SPDX-License-Identifier: LicenseRef-Nordic-5-Clause
#

menuconfig AT_NOTIF
	bool "AT-command notification manager"
	depends on AT_CMD
	help
	  A library for managing AT-command notifications.

if AT_NOTIF

config AT_NOTIF_SYS_INIT
	bool "Initialize the AT-command notification manager during system init"
	default y if AT_CMD_SYS_INIT

module=AT_NOTIF
module-dep=LOG
module-str= AT-command notification management library
source "${ZEPHYR_BASE}/subsys/logging/Kconfig.template.log_config"

endif # AT_NOTIF
```
