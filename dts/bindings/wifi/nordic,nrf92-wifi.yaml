## lib/at_shell/Kconfig
```kconfig
#
# Copyright (c) 2021 Nordic Semiconductor
#
# SPDX-License-Identifier: LicenseRef-Nordic-5-Clause
#

menuconfig AT_SHELL
	bool "AT Shell"
	depends on NRF_MODEM_LIB
	depends on SHELL
	select AT_MONITOR
	help
	  Adds the AT command capability to shell. The shell command is called
	  "at" and will interpret arguments as AT commands, and print back the
	  response from the modem.

if AT_SHELL

config AT_SHELL_CMD_RESPONSE_MAX_LEN
	int "Maximum AT command response length"
	default 2700

config AT_SHELL_UNESCAPE_LF
	bool "Unescape linefeed"
	help
	  Replaces \n with <CR><LF>. This enables commands such as AT%CMNG=0 to
	  properly receive certificates that ordinarily have multiple lines.
	  The certificate must have been preprocessed to replace EOL sequences
	  with a literal \ character followed by an n character.

config AT_SHELL_CMD_MODE
	bool "AT command mode (shell bypass)"
	help
	  AT command mode is an interactive "shell bypass" mode where raw input is forwarded as
	  AT commands. Supports pipelining and echo handling.

if AT_SHELL_CMD_MODE

choice
	prompt "AT cmd mode line termination"
	default AT_SHELL_CMD_MODE_CR_TERMINATION

config AT_SHELL_CMD_MODE_NULL_TERMINATION
	bool "Null termination"

config AT_SHELL_CMD_MODE_CR_TERMINATION
	bool "CR termination"

config AT_SHELL_CMD_MODE_LF_TERMINATION
	bool "LF termination"

config AT_SHELL_CMD_MODE_CR_LF_TERMINATION
	bool "CR+LF termination"

endchoice

config AT_SHELL_CMD_MODE_TERMINATION
	int
	default 0 if AT_SHELL_CMD_MODE_NULL_TERMINATION
	default 1 if AT_SHELL_CMD_MODE_CR_TERMINATION
	default 2 if AT_SHELL_CMD_MODE_LF_TERMINATION
	default 3 if AT_SHELL_CMD_MODE_CR_LF_TERMINATION
	help
	  Internal numeric representation of line termination mode.

config AT_SHELL_CMD_MODE_ECHO_DEFAULT
	bool "Local echo in AT command mode"
	default y
	help
	  Enables local echo in AT command mode by default.

endif # AT_SHELL_CMD_MODE

endif # AT_SHELL
```

## lib/at_sms_cert/Kconfig
```kconfig
# Copyright (c) 2021 Nordic Semiconductor
#
# SPDX-License-Identifier: LicenseRef-Nordic-5-Clause
#

menuconfig AT_SMS_CERT
	bool "AT SMS commands for certification"
	depends on SOC_NRF9160_SICA
	help
	  Provide an implementation of the following SMS-related AT commands for certification purposes:
	  AT+CPMS
	  AT+CSMS
	  AT+CSCA
	  AT+CSCS
	  AT+CMGD
	  AT+CMSS
	  AT+CMGW

if AT_SMS_CERT

config AT_SMS_CERT_SYS_INIT
	bool "Initialize during SYS_INIT"
	default y
	help
	  Initialize the AT SMS Certification library automatically during the SYS_INIT sequence.

module = AT_SMS_CERT
module-str = AT SMS Cert
source "subsys/logging/Kconfig.template.log_config"

endif # AT_SMS_CERT
```

## lib/attest_token/Kconfig
```kconfig
#
# Copyright (c) 2026 Nordic Semiconductor ASA
#
# SPDX-License-Identifier: LicenseRef-Nordic-5-Clause
#

menuconfig ATTEST_TOKEN
	bool "Attestation token library"
	help
	  Device attestation token library. The backend is selected automatically based on the
	  target:
	    - nRF91 Series: modem backend (AT%ATTESTTOKEN command).
	    - nRF92 Series: application core backend (PSA crypto + IronSide SE).

if ATTEST_TOKEN

config ATTEST_TOKEN_BACKEND_MODEM
	bool
	default y if SOC_SERIES_NRF91
	depends on NRF_MODEM_LIB
	help
	  Use the modem attestation token backend.

config ATTEST_TOKEN_BACKEND_APP
	bool
	default y if SOC_SERIES_NRF92
	depends on HAS_IRONSIDE_SE
	select BASE64
	select PSA_CRYPTO
	select PSA_WANT_KEY_TYPE_ECC_KEY_PAIR_IMPORT
	select PSA_WANT_ALG_ECDSA
	select PSA_WANT_ECC_SECP_R1_256
	select PSA_WANT_ALG_SHA_256
	select PSA_WANT_GENERATE_RANDOM
	help
	  Use the application core attestation token backend.

config ATTEST_TOKEN_PARSING
	bool "Parsing of the attestation token"
	default y
	select ZCBOR
	select BASE64
	help
	  Enable attest_token_parse() and attest_token_get_uuids() functions, which decode the CBOR
	  payload of the attestation token to extract the device UUID, firmware UUID, nonce,
	  device type, and message type.

module=ATTEST_TOKEN
module-str=Attestation Token
source "$(ZEPHYR_BASE)/subsys/logging/Kconfig.template.log_config"

endif # ATTEST_TOKEN
```

## lib/bin/Kconfig
```kconfig
#
# Copyright (c) 2019 Nordic Semiconductor
#
# SPDX-License-Identifier: LicenseRef-Nordic-5-Clause
#

menu "Binary libraries"

rsource "lwm2m_carrier/Kconfig"

endmenu
```

## lib/bin/bt_ll_acs_nrf53/Kconfig
```kconfig
#
# Copyright (c) 2023 Nordic Semiconductor
#
# SPDX-License-Identifier: LicenseRef-Nordic-5-Clause
#

config BT_LL_ACS_NRF53
	bool "LE Audio Controller Subsystem for nRF53"
	select EXPERIMENTAL
	depends on (SOC_NRF5340_CPUAPP || SOC_NRF5340_CPUNET)
	help
	  Use LE Audio Controller Subsystem Link Layer binary. Only for nRF53 NET core.

#----------------------------------------------------------------------------#
menu "Log levels"

module = BLE_HCI_VSC
module-str = ble-hci-vsc
source "subsys/logging/Kconfig.template.log_config"

endmenu # Log levels
```
