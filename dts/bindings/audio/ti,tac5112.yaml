## dts/bindings/audio/ti,tac5112.yaml
```yaml
# Copyright (c) 2026 Nordic Semiconductor ASA
#
# SPDX-License-Identifier: LicenseRef-Nordic-5-Clause
#

description: |
  Texas Instruments TAC5112 low-power stereo audio codec.
  The TAC5112 is controlled over I2C (this binding) or SPI (not supported
  by this driver) and carries PCM audio over a TDM/I2S/LJ audio serial
  interface (ASI) wired separately (e.g. to an nRF5-series I2S peripheral).
  The driver supports both ASI target mode, where the host generates BCLK and
  FSYNC, and ASI controller mode, where the codec generates those clocks from
  its PLL.
  Example:
      &i2c0 {
              tac5112: audio-codec@50 {
                      compatible = "ti,tac5112";
                      reg = <0x50>;
                      reset-gpios = <&gpio0 3 GPIO_ACTIVE_LOW>;
                      fault-gpios = <&gpio0 4 GPIO_ACTIVE_LOW>;
                      input-channels = <0x3>;
                      output-channels = <0x3>;
              };
      };
compatible: "ti,tac5112"

include: i2c-device.yaml

properties:
  input-channels:
    type: int
    default: 0x3
    enum:
      - 0x0
      - 0x1
      - 0x2
      - 0x3
      - 0x4
      - 0x5
      - 0x6
      - 0x7
      - 0x8
      - 0x9
      - 0xa
      - 0xb
      - 0xc
      - 0xd
      - 0xe
      - 0xf
    description: |
      Initial bitmask of ADC record (input) channels the driver enables in
      audio_codec_configure(), where bit 0 is channel 1 up to bit 3 for
      channel 4 (valid range 0x0 to 0xf). The default 0x3 enables the two
      stereo channels and is the only configuration presently supported.
      When any input channel is enabled the driver also powers the ADC
      and MICBIAS. Set to 0 to leave the record path disabled. The selection
      can be changed at runtime with tac5112_set_channels().
  output-channels:
    type: int
    default: 0x3
    enum:
      - 0x0
      - 0x1
      - 0x2
      - 0x3
      - 0x4
      - 0x5
      - 0x6
      - 0x7
      - 0x8
      - 0x9
      - 0xa
      - 0xb
      - 0xc
      - 0xd
      - 0xe
      - 0xf
    description: |
      Initial bitmask of DAC playback (output) channels the driver enables
      in audio_codec_configure(), where bit 0 is channel 1 up to bit 3 for
      channel 4 (valid range 0x0 to 0xf). The default 0x3 enables the two
      stereo channels and is the only configuration presently supported.
      The DAC is only powered up on audio_codec_start_output()/start().
      Set to 0 to leave the playback path disabled. The selection can be
      changed at runtime with tac5112_set_channels().
  reset-gpios:
    type: phandle-array
    description: |
      Optional hardware reset line. If present, it is driven inactive
      during driver init to release the codec from reset; software reset
      (SW_RESET register) is used for all subsequent resets regardless of
      whether this property is present.
  fault-gpios:
    type: phandle-array
    description: |
      Optional GPIO wired to a TAC5112 GPIO/GPO/DOUT pin configured (in
      the analog front end / board design) as the chip interrupt (IRQ)
      output. When present, the driver services it from system workqueue
      context and invokes any callback registered via
      audio_codec_register_error_callback(). When absent, applications
      must poll audio_codec_clear_errors() or the DEV_STS0/DEV_STS1
      registers themselves.
```

## dts/bindings/can/nordic,nrf-scan.yaml
```yaml
# Copyright (c) 2026 Nordic Semiconductor ASA
# SPDX-License-Identifier: LicenseRef-Nordic-5-Clause

description: Nordic Software Defined CAN (sCAN)

compatible: "nordic,nrf-scan"

include:
  - can-controller.yaml
  - memory-region.yaml
```

## dts/bindings/pulse_meas/nordic,pulse-meas.yaml
```yaml
# Copyright (c) 2026 Nordic Semiconductor ASA
# SPDX-License-Identifier: LicenseRef-Nordic-5-Clause

description: Nordic nRF pulse width measurement

compatible: "nordic,pulse-meas"

include: base.yaml

properties:

  timer-instance:
    required: true
    type: phandle
    description: TIMER instance used for pulse width capture.

  assert-gpios:
    type: phandle-array
    required: true
    description:
      GPIO for detectiong start of impulse.

  deassert-gpios:
    type: phandle-array
    required: true
    description:
      GPIO for detecting end of impulse.
```

## dts/bindings/radio_fem/skyworks,sky66409-11.yaml
```yaml
# Copyright (c) 2026 Nordic Semiconductor ASA
# SPDX-License-Identifier: LicenseRef-Nordic-5-Clause

description: |
  This is a representation of the Skyworks SKY66409-11 Radio Front-End module.
  It supplements the generic two-pin FEM binding with settling times and gain
  values appropriate for the SKY66409-11 device. It also supports TX and RX
  bypass using only the ctx-gpios and crx-gpios control pins, according to
  Table 6 of the SKY66409-11 data sheet (November 12, 2025).
  Use the tx-bypass and rx-bypass properties to enable bypass, both are
  disabled by default.

compatible: "skyworks,sky66409-11"

include: radio-fem-two-ctrl-pins.yaml

properties:
  ctx-settle-time-us:
    type: int
    default: 23
    description: |
      Settling time in microseconds from activation of CTX to transmit.

      The default value is based on the experimentally determined settle
      time, that was observed on SKY66112-11 device.

  crx-settle-time-us:
    type: int
    default: 5
    description: |
      Settling time in microseconds from activation of CRX to receive.

      The default value is based on the experimentally determined settle
      time, that was observed on SKY66112-11 device.

  tx-gain-db:
    type: int
    default: 12
    description: |
      TX gain of the PA amplifier of SKY66409-11 in dB.

      Default value is based on Table 5 of the SKY66409-11 data sheet
      (November 12, 2025). This is a fixed parameter of the device for
      3.3V supply voltage. The value can be changed if, instead of
      3.3V supply voltage, another supply voltage is used. Refer to the
      data sheet for the appropriate value.

  rx-gain-db:
    type: int
    default: 12
    description: |
      RX gain of the LNA amplifier of SKY66409-11 in dB.

      Default value is based on Table 5 of the SKY66409-11 data sheet
      (November 12, 2025). This is a fixed parameter of the device.

  bypass-gain-db:
    type: int
    default: -2
    description: |
      Gain of the Front End Module's bypass in dB. This parameter is
      usually negative to express attenuation.

      Default value is based on Table 5 of the SKY66409-11 data sheet
      (November 12, 2025). This is a fixed parameter of the device rounded
      to the nearest integer.

  tx-bypass:
    type: boolean
    description: |
      Enable the TX bypass of the SKY66409-11.

      When enabled, for transmission with power less than requested the
      transmission occurs through the bypass circuit. The ctx-gpios and
      crx-gpios are set to high for transmission.

  rx-bypass:
    type: boolean
    description: |
      Enable the RX bypass of the SKY66409-11.

      The bypass is used instead of the LNA when the RX is active.
      When enabled, both the ctx-gpios and crx-gpios are set to high
      for reception.
```

## dts/bindings/saadct/nordic,nrf-saadct.yaml
```yaml
# Copyright (c) 2026 Nordic Semiconductor ASA
# SPDX-License-Identifier: LicenseRef-Nordic-5-Clause

description: Nordic Semiconductor nRF SAADC sampled by TIMER (SAADCT)

compatible: "nordic,nrf-saadct"

include: nordic,nrf-saadc.yaml

properties:
  timer-instance:
    required: true
    type: phandle
    description: |
      Timer instance used to trigger SAADC sampling through GPPI.
```

## lib/nrf71_idle_power/Kconfig
```kconfig
#
# Copyright (c) 2026 Nordic Semiconductor
#
# SPDX-License-Identifier: LicenseRef-Nordic-5-Clause
#

menuconfig NRF71_IDLE_POWER
	bool "nRF71 idle power optimization helpers"
	depends on SOC_NRF7120_ENGA_CPUAPP
	# Idle current is dominated by devices (UART/console) keeping their
	# clocks requested; device PM is what lets them suspend during idle.
	imply PM
	imply PM_DEVICE
	imply PM_DEVICE_RUNTIME
	# Equivalent to the zephyr,pm-device-runtime-auto DT property: lets
	# devices such as the console UART suspend themselves while idle.
	imply PM_DEVICE_RUNTIME_DEFAULT_ENABLE
	imply TICKLESS_KERNEL
	imply SYSTEM_CLOCK_SLOPPY_IDLE
	help
	  Reusable helpers that lower nRF71 System ON idle current. Applies a
	  Kconfig-selected RAM retention level at boot (from a SYS_INIT hook,
	  so no application code changes are needed) and pulls in the device
	  power management knobs that let peripherals suspend while idle.

if NRF71_IDLE_POWER

choice NRF71_IDLE_POWER_RAM_RETAIN
	prompt "RAM retention level during System ON idle"
	default NRF71_IDLE_POWER_RAM_RETAIN_FULL
	help
	  Controls how much application RAM stays powered during System ON
	  idle, using the ram_pwrdn library (see
	  nrf/doc/nrf/libraries/others/ram_pwrdn.rst). Powering down RAM the
	  running image still uses corrupts live data, so the fixed-size tiers
	  only make sense for a trivial image that fits below the boundary.
	  NRF71_IDLE_POWER_RAM_RETAIN_UNUSED_ONLY has been observed to cause
	  issues on Wi-Fi builds; keep the default RAM_RETAIN_FULL tier there.

config NRF71_IDLE_POWER_RAM_RETAIN_FULL
	bool "Retain all RAM (default) -- nothing is powered down"
	help
	  No RAM power-down call is made. This keeps every byte of application
	  RAM retained and is the safe default.

config NRF71_IDLE_POWER_RAM_RETAIN_UNUSED_ONLY
	bool "Power down whatever this image itself does not use"
	select RAM_POWER_DOWN_LIBRARY
	help
	  Calls power_down_unused_ram() at boot. The ram_pwrdn library computes
	  the unused range itself, from the end of the running image to the end
	  of application RAM, so live image/stack/buffer memory is left powered.
	  Has been observed to cause issues on Wi-Fi builds; do not use it
	  there.

config NRF71_IDLE_POWER_RAM_RETAIN_64K
	bool "Retain only the first 64 KiB of RAM, power down the rest"
	select RAM_POWER_DOWN_LIBRARY
	help
	  Calls power_down_ram() at boot to power down everything past the first
	  64 KiB of application RAM. Only safe if the whole image fits below
	  64 KiB; a Wi-Fi build does not, so use this for controlled
	  measurements only.

config NRF71_IDLE_POWER_RAM_RETAIN_128K
	bool "Retain only the first 128 KiB of RAM, power down the rest"
	select RAM_POWER_DOWN_LIBRARY
	help
	  Calls power_down_ram() at boot to power down everything past the first
	  128 KiB of application RAM.

config NRF71_IDLE_POWER_RAM_RETAIN_256K
	bool "Retain only the first 256 KiB of RAM, power down the rest"
	select RAM_POWER_DOWN_LIBRARY
	help
	  Calls power_down_ram() at boot to power down everything past the first
	  256 KiB of application RAM.

config NRF71_IDLE_POWER_RAM_RETAIN_512K
	bool "Retain only the first 512 KiB of RAM, power down the rest"
	select RAM_POWER_DOWN_LIBRARY
	help
	  Calls power_down_ram() at boot to power down everything past the first
	  512 KiB of application RAM.

endchoice

config NRF71_IDLE_DIAGNOSTICS
	bool "Print power state snapshots for measurement"
	help
	  Enable the nrf71_idle_power_print_snapshot() helper, which dumps the
	  raw POWER, MEMCONF, GRTC and LFXO registers so they can be correlated
	  with a power analyzer trace. Also configures a GPIO idle-phase marker
	  from the "idle-phase" devicetree alias, when one is present.

module = NRF71_IDLE_POWER
module-str = nRF71 idle power helpers
source "$(ZEPHYR_BASE)/subsys/logging/Kconfig.template.log_config"

endif # NRF71_IDLE_POWER
```

## lib/nrf_modem_lib/trace_backends/Kconfig
```kconfig
# Copyright (c) 2022 Nordic Semiconductor
#
# SPDX-License-Identifier: LicenseRef-Nordic-5-Clause
#

choice NRF_MODEM_LIB_TRACE_BACKEND
	prompt "Trace backend"
endchoice

DT_CHOSEN_NORDIC_MODEM_TRACE_UART := nordic,modem-trace-uart

rsource "uart/Kconfig"
rsource "uart_nrfx/Kconfig"
rsource "flash/Kconfig"
rsource "rtt/Kconfig"
rsource "ram/Kconfig"

module = MODEM_TRACE_BACKEND
module-str = Modem trace backend
source "subsys/logging/Kconfig.template.log_config"
```

## lib/nrf_modem_lib/trace_backends/uart_nrfx/Kconfig
```kconfig
#
# Copyright (c) 2026 Nordic Semiconductor
#
# SPDX-License-Identifier: LicenseRef-Nordic-5-Clause
#

choice NRF_MODEM_LIB_TRACE_BACKEND

config NRF_MODEM_LIB_TRACE_BACKEND_UART_NRFX
	bool "UART (nrfx UARTE, DMA and IRQ driven)"
	depends on $(dt_chosen_has_compat,$(DT_CHOSEN_NORDIC_MODEM_TRACE_UART),$(DT_COMPAT_NORDIC_NRF_UARTE))
	select NRFX_UARTE
	select NRFX_UARTE_CONFIG_TX_LINK
	select PINCTRL
	help
	  Send modem traces over a UARTE instance that is driven directly through the nrfx UARTE
	  driver, bypassing the Zephyr UART driver.
	  Transfers are DMA and interrupt driven, and consecutive transfers are linked so that
	  the transmitter is kept busy without gaps. This allows using the high-speed UARTE
	  instances (for example UARTE120 on nRF9251) at baud rates of several Mbaud.

	  The UARTE instance is selected with the nordic,modem-trace-uart chosen node.
	  The node must have status "reserved" so that it is not claimed by the Zephyr UART
	  driver, and its baud rate is taken from the current-speed property.

endchoice # NRF_MODEM_LIB_TRACE_BACKEND

if NRF_MODEM_LIB_TRACE_BACKEND_UART_NRFX

config NRF_MODEM_LIB_TRACE_BACKEND_UART_NRFX_CHUNK_SZ
	int "Trace chunk size"
	default 4096
	range 1024 32767
	help
	  Trace data is sent in DMA transfers of at most this many bytes. Two transfers are kept
	  in flight, and the trace data is freed from the shared memory as each transfer completes.
	  The value must not exceed the EasyDMA MAXCNT of the selected UARTE instance.
	  The transmission time of one chunk must exceed the worst case thread latency,
	  since the next transfer is linked while the current one is in progress.

config NRF_MODEM_LIB_TRACE_BACKEND_UART_NRFX_BOUNCE_BUF_SZ
	int "Bounce buffer size"
	default 0
	range 0 32767
	help
	  Size of each of the two bounce buffers that are used when the trace data is located
	  in memory that is not accessible by the UARTE EasyDMA. Data is then copied to the
	  bounce buffers before it is sent. Set to 0 to disable bounce buffers, in which case
	  trace data that is not DMA accessible cannot be sent.
	  The bounce buffers are placed in the memory region given by the memory-regions
	  property of the UARTE node, if present.

config NRF_MODEM_LIB_TRACE_BACKEND_UART_NRFX_TX_TIMEOUT_MS
	int "TX timeout (ms)"
	default 1000
	help
	  Maximum time to wait for a DMA transfer to complete before aborting it.
	  Must exceed the transmission time of one trace chunk at the configured baud rate.

endif # NRF_MODEM_LIB_TRACE_BACKEND_UART_NRFX
```

## lib/wifi_kmu/Kconfig
```kconfig
#
# Copyright (c) 2026 Nordic Semiconductor
#
# SPDX-License-Identifier: LicenseRef-Nordic-5-Clause
#

config NRF_WIFI_KMU
	bool "Wi-Fi KMU key support"
	default y
	depends on SOC_SERIES_NRF71
	help
	  This library handles cryptographic keys for Wi-Fi security
	  using KMU (Key Management Unit) slots on nRF71 series devices.
	  The keys are pushed to the memory of an external core which is only
	  accessible via KMU.

if NRF_WIFI_KMU

config NRF_WIFI_KMU_SLOT_MIN
	int "Lowest KMU slot for Wi-Fi keys in nRF71 series devices"
	default 128
	help
	  This is the lowest KMU key slot of pushed Wi-Fi keys.
	  The default is set to the highest number of unreserved keys.

config NRF_WIFI_KMU_NUM_SLOTS
	int "Number of KMU slots for Wi-Fi keys in nRF71 series devices"
	default 52
	help
	  This is the number of KMU slots for Wi-Fi keys.
	  The value of NRF_WIFI_KMU_SLOT_MIN + this Kconfig must not overlap
	  with any reserved KMU slots.

endif # NRF_WIFI_KMU
```
