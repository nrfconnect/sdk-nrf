## modules/openthread/Kconfig.features.nrf
```kconfig
# SDK-nrf-specific OpenThread stack features for selection

# Copyright (c) 2025 Nordic Semiconductor ASA
# SPDX-License-Identifier: LicenseRef-Nordic-5-Clause

choice OPENTHREAD_PSA_NVM_BACKEND
	prompt "Backend to store persistent crypto materials"
	default OPENTHREAD_PSA_NVM_BACKEND_ITS
	depends on OPENTHREAD_CRYPTO_PSA

config OPENTHREAD_PSA_NVM_BACKEND_ITS
	bool "Use Internal Trusted Storage (ITS) for storing crypto materials."
	depends on OPENTHREAD_CRYPTO_PSA
	help
	  Store cryptographic materials in the PSA ITS.
	  The PSA ITS location depends on the ITS configuration.

config OPENTHREAD_PSA_NVM_BACKEND_KMU
	bool "Use CRACEN KMU driver for storing crypto materials [EXPERIMENTAL]."
	depends on PSA_NEED_CRACEN_KMU_DRIVER
	select EXPERIMENTAL
	help
	  Store cryptographic materials in the Key Management Unit space instead of PSA ITS.
	  The materials will be used by CRACEN driver.
	  KMU slots range is defined as <OPENTHREAD_KMU_SLOT_START, OPENTHREAD_KMU_SLOT_END).
	  Keys are not encrypted in KMU.

endchoice # OPENTHREAD_PSA_NVM_BACKEND

config OPENTHREAD_PSA_ITS_NVM_OFFSET
	hex "Offset of IDs for OpenThread keys stored in the PSA ITS."
	default 0x20000
	help
	  The offset value in the PSA ITS non-volatile space is dedicated to OpenThread
	  key reference IDs. This offset must not overwrite any other ranges already in
	  use within the PSA ITS non-volatile space.

config OPENTHREAD_PSA_ITS_NVM_MAX_KEYS
	int "Maximum ITS key reference amount to be assigned"
	default 20
	help
	  The maximum ITS key reference amount that can be assigned for OpenThread crypto
	  materials.

if OPENTHREAD_PSA_NVM_BACKEND_KMU

config OPENTHREAD_KMU_SLOT_START
	int "OpenThread crypto materials KMU slot range start"
	default 80
	help
	  The first KMU slot number under which the OpenThread crypto materials will be stored.
	  The range defined by OPENTHREAD_KMU_SLOT_START must not overlap any other KMU slot
	  range defined within the application. The slot amount dedicated for OpenThread is
	  defined in the crypto_psa_key_allocator and can be modified according to changes in
	  the OpenThread stack.

endif # OPENTHREAD_PSA_NVM_BACKEND_KMU

config OPENTHREAD_BORDER_AGENT_MESHCOP_SERVICE
	bool "Border agent MeshCoP service"
	default y
	depends on OPENTHREAD_MULTICAST_DNS
	help
	  Enable the Border Agent to manage registering/updating of the mDNS MeshCoP
	  service(s) on the infrastructure link.

config OPENTHREAD_BORDER_AGENT_TRACKER
	bool "Border agent tracker"
	depends on OPENTHREAD_BORDER_AGENT
	help
	  Enable tracking of border agents in the Thread network.

config OPENTHREAD_BORDER_AGENT_TXT_DATA_PARSER
	bool "Border agent TXT data parser"
	depends on OPENTHREAD_BORDER_AGENT
	help
	  Enable parsing of TXT record data for border agents.

config OPENTHREAD_BORDER_AGENT_SERVICE_NAME
	string "Border agent service base name"
	default "OpenThread BR [Nordic Semiconductor ASA]"
	depends on OPENTHREAD_BORDER_AGENT_MESHCOP_SERVICE
	help
	  Specifies the base name to construct the service instance name used
	  when advertising the mDNS _meshcop._udp service by the Border Agent.

config OPENTHREAD_BORDER_ROUTING_DHCP6_PD_CLIENT
	bool "DHCPv6-PD client"
	help
	  Enable the Border Router's built-in OpenThread DHCPv6 Prefix Delegation
	  (PD) client feature.

config OPENTHREAD_BORDER_ROUTING_DHCP6_PD_MIN_LIFETIME
	int "Minimum lifetime for DHCPv6-PD in seconds"
	default 1800 # 30 minutes
	depends on OPENTHREAD_BORDER_ROUTING_DHCP6_PD_CLIENT
	help
	  Set the minimum lifetime for DHCPv6 Prefix Delegation in seconds.

config OPENTHREAD_BORDER_ROUTING_MULTI_AIL_DETECTION
	bool "Multiple AIL detection for border routers"
	help
	  Enable detection of multiple Active Infrastructure Link (AIL)
	  interfaces for border routers.

config OPENTHREAD_CHANNEL_MONITOR_AUTO_START
	bool "Start channel monitor with interface"
	default y
	help
	  Start the Channel Monitor automatically when the Thread network interface is brought
	  upand stop it when it is brought down.

config OPENTHREAD_DNS_CLIENT_BIND_UDP_THREAD_NETIF
	bool "Bind DNS client socket to Thread netif"
	depends on OPENTHREAD_DNS_CLIENT
	help
	  Bind DNS client UDP socket to the internal Thread network interface.
	  When set to 0, the socket is bound to the unspecified network interface,
	  allowing it to send and receive DNS messages over any network interface.

config OPENTHREAD_MDNS_VERBOSE
	bool "mDNS verbose logging"
	help
	  Enable verbose logging for multicast DNS operations.
	  When this feature is enabled, verbose logging can be dynamically turned on or
	  off at run-time using `otMdnsSetVerboseLoggingEnabled()`

config OPENTHREAD_MDNS_VERBOSE_STATE
	bool "mDNS verbose state on start"
	depends on OPENTHREAD_MDNS_VERBOSE
	help
	  Defines the default run-time state of mDNS verbose logging (turned on/off) on startup.

config OPENTHREAD_PLATFORM_DNSSD
	bool "Platform DNS-SD"
	help
	  Enable platform-specific DNS-SD (Service Discovery) support.

config OPENTHREAD_SRP_SERVER_FAST_START_MODE
	bool "SRP server fast start mode"
	depends on OPENTHREAD_SRP_SERVER
	help
	  The Fast Start Mode is designed for scenarios where a device, often a mobile device,
	  needs to act as a provisional SRP server (e.g., functioning as a temporary Border Router).
	  The SRP server function is enabled only if no other Border Routers (BRs) are already
	  providing the SRP service within the Thread network. A common use case is a mobile
	  device joining a Thread network where it may be the first, or only, BR. Importantly,
	  Fast Start Mode allows the device to quickly start its SRP server functionality upon
	  joining the network, allowing other Thread devices to quickly connect and register
	  their services without the typical delays associated with standard Border Router
	  initialization (and SRP server startup).

config OPENTHREAD_STEERING_DATA
	bool "MeshCoP Steering Data APIs"
	help
	  Enable the MeshCoP Steering Data APIs for commissioner functionality.

config OPENTHREAD_TREL_MANAGE_DNSSD
	bool "TREL to manage DNS-SD and peer discovery"
	depends on OPENTHREAD_TREL
	help
	  Enable the OpenThread core TREL implementation to directly manage mDNS (DNS-SD)
	  service registration and peer discovery (browse and service/address resolution
	  of TREL service for TREL peer discovery).
	  When this feature is disabled, the mDNS (DNS-SD) functions are delegated to
	  the platform layer.

config OPENTHREAD_SPINEL_CP_RESET_FAIL_CALLBACK
	bool "CP reset failure callback"
	help
	  Enables Co-processor reset failure callback in Spinel driver

config OPENTHREAD_LOG_MAX_SIZE
	int "Maximum log string size"
	default 1024
	help
	  The maximum log string size (number of chars).

config OPENTHREAD_RCP_TIME_SYNC_INTERVAL
	int "Host-RCP time sync interval in microseconds"
	default 60000000 # 60 seconds
	help
	  This setting configures the interval (in units of microseconds) for host-rcp
	  time sync. The host will recalculate the time offset between host and RCP
	  every interval.

choice OPENTHREAD_WAKEUP_ROLE
	prompt "Thread Direct wake role"
	default OPENTHREAD_WAKEUP_ROLE_NONE
	help
	  Thread Direct (TD) wake features (OpenThread OT_WAKE_INITIATOR /
	  OT_WAKE_LISTENER). Do not use the legacy Zephyr options
	  OPENTHREAD_WAKEUP_COORDINATOR or OPENTHREAD_WAKEUP_END_DEVICE.

config OPENTHREAD_WAKEUP_ROLE_NONE
	bool "None"

config OPENTHREAD_WAKEUP_INITIATOR
	bool "Wake initiator"
	select OPENTHREAD_CSL_RECEIVER
	help
	  Maps to OpenThread OT_WAKE_INITIATOR
	  (OPENTHREAD_CONFIG_TD_WAKE_INITIATOR_ENABLE).

config OPENTHREAD_WAKE_LISTENER
	bool "Wake listener"
	select OPENTHREAD_CSL_RECEIVER
	help
	  Maps to OpenThread OT_WAKE_LISTENER
	  (OPENTHREAD_CONFIG_TD_WAKE_LISTENER_ENABLE).

endchoice
```

## modules/trusted-firmware-m/Kconfig.mbedtls_minimal.defconfig
```kconfig
#
# Copyright (c) 2019 Nordic Semiconductor ASA
#
# SPDX-License-Identifier: LicenseRef-Nordic-5-Clause
#

config MBEDTLS
	bool
	default n

config MBEDTLS_SSL_PROTO_TLS1_2
	default n

config MBEDTLS_PSA_CRYPTO_STORAGE_C
	default n
```

## modules/trusted-firmware-m/Kconfig.tfm_minimal.defconfig
```kconfig
#
# Copyright (c) 2019 Nordic Semiconductor ASA
#
# SPDX-License-Identifier: LicenseRef-Nordic-5-Clause
#

config TFM_MCUBOOT_IMAGE_NUMBER
	int
	default 1

config TFM_PARTITION_CRYPTO
	bool
	depends on PSA_CRYPTO_PROVIDER_TFM
	default y

if TFM_PARTITION_CRYPTO

config TFM_CRYPTO_RNG_MODULE_ENABLED
	bool
	default y

config TFM_CRYPTO_HASH_MODULE_ENABLED
	bool
	depends on PSA_HAS_HASH_SUPPORT
	default y

endif # TFM_PARTITION_CRYPTO

config TFM_PARTITION_PLATFORM
	bool
	default y
```

## samples/benchmarks/power_consumption/Kconfig
```kconfig
#
# Copyright (c) 2026 Nordic Semiconductor ASA
#
# SPDX-License-Identifier: LicenseRef-Nordic-5-Clause
#

mainmenu "nRF7120 System ON Idle power consumption benchmark"

config SAMPLE_POWER_CONSUMPTION_IDLE_SECONDS
	int "System ON idle duration in seconds"
	range 1 3600
	default 10
	help
	  Duration of the sleep period (through k_sleep(), on this SoC's default
	  GRTC-backed system timer) before waking up, printing the wake
	  counter, and sleeping again.

choice SAMPLE_POWER_CONSUMPTION_RAM_RETAIN
	prompt "RAM retention level during System ON Idle"
	default SAMPLE_POWER_CONSUMPTION_RAM_RETAIN_FULL
	help
	  Controls the amount of application RAM that remains powered during System ON
	  Idle, using the ram_pwrdn library (see
	  nrf/doc/nrf/libraries/others/ram_pwrdn.rst). Total amount of SRAM on
	  nrf7120dk/nrf7120/cpuapp is 1016 KiB, not 1024 KiB -- keep this in
	  mind when reading the option names below.

config SAMPLE_POWER_CONSUMPTION_RAM_RETAIN_64K
	bool "Retain only the first 64 KiB of application RAM, power down the rest"
	select RAM_POWER_DOWN_LIBRARY
	help
	  Calls power_down_ram() once at boot to power down everything past
	  the first 64 KiB of application RAM (out of 1016 KiB total).

config SAMPLE_POWER_CONSUMPTION_RAM_RETAIN_128K
	bool "Retain only the first 128 KiB of application RAM, power down the rest"
	select RAM_POWER_DOWN_LIBRARY
	help
	  Calls power_down_ram() once at boot to power down everything past
	  the first 128 KiB of application RAM (out of 1016 KiB total).

config SAMPLE_POWER_CONSUMPTION_RAM_RETAIN_256K
	bool "Retain only the first 256 KiB of application RAM, power down the rest"
	select RAM_POWER_DOWN_LIBRARY
	help
	  Calls power_down_ram() once at boot to power down everything past
	  the first 256 KiB of application RAM (out of 1016 KiB total).

config SAMPLE_POWER_CONSUMPTION_RAM_RETAIN_512K
	bool "Retain only the first 512 KiB of application RAM, power down the rest"
	select RAM_POWER_DOWN_LIBRARY
	help
	  Calls power_down_ram() once at boot to power down everything past
	  the first 512 KiB of application RAM (out of 1016 KiB total, so
	  this leaves slightly more than half of RAM powered down, not
	  exactly half).

config SAMPLE_POWER_CONSUMPTION_RAM_RETAIN_FULL
	bool "Retain all RAM (default) -- nothing is powered down"
	help
	  No RAM power-down call is made at all. This is the default: by
	  default, all RAM must stay retained.

config SAMPLE_POWER_CONSUMPTION_RAM_RETAIN_UNUSED_ONLY
	bool "Power down whatever this image itself does not use"
	select RAM_POWER_DOWN_LIBRARY
	help
	  Calls power_down_unused_ram() instead of a fixed KiB boundary --
	  the ram_pwrdn library computes the unused range itself, from the
	  end of the running image to the end of application RAM. Whichever
	  RAM section still holds live image/stack data is left powered,
	  same as every other tier above.

endchoice

source "Kconfig.zephyr"
```

## samples/bluetooth/central_nfc_pairing/sample.yaml
```yaml
sample:
  description: Bluetooth Low Energy Central NFC Pairing reference sample
  name: Bluetooth Low Energy Central NFC Pairing reference
tests:
  sample.bluetooth.central_nfc_pairing:
    sysbuild: true
    build_only: true
    integration_platforms:
      - nrf5340dk/nrf5340/cpuapp
    platform_allow:
      - nrf5340dk/nrf5340/cpuapp
    tags:
      - bluetooth
      - ci_build
      - sysbuild
      - ci_samples_bluetooth
```

## samples/bluetooth/central_smp_client/sample.yaml
```yaml
sample:
  description: Bluetooth Low Energy Central Device Firmware Update sample
  name: Bluetooth LE Central DFU SMP
tests:
  sample.bluetooth.central_dfu_smp:
    sysbuild: true
    integration_platforms:
      - nrf54l15dk/nrf54l05/cpuapp
      - nrf54l15dk/nrf54l15/cpuapp
      - nrf5340dk/nrf5340/cpuapp/ns
      - nrf54lm20dk/nrf54lm20b/cpuapp
    platform_allow:
      - nrf54l15dk/nrf54l05/cpuapp
      - nrf54l15dk/nrf54l10/cpuapp
      - nrf54l15dk/nrf54l15/cpuapp
      - nrf5340dk/nrf5340/cpuapp
      - nrf5340dk/nrf5340/cpuapp/ns
      - nrf54lm20dk/nrf54lm20a/cpuapp
      - nrf54lm20dk/nrf54lm20b/cpuapp
    tags:
      - bluetooth
      - ci_build
      - sysbuild
      - ci_samples_bluetooth
    harness: console
    harness_config:
      type: multi_line
      ordered: true
      regex:
        - "Starting Bluetooth Central SMP Client sample"
        - "Bluetooth initialized"
        - "Scanning successfully started"
    timeout: 15
```

## samples/bluetooth/direction_finding_connectionless_rx/sample.yaml
```yaml
sample:
  name: Direction Finding Connectionless Locator
  description: Sample application showing connectionless Direction Finding reception
common:
  tags:
    - bluetooth
    - sysbuild
    - ci_samples_bluetooth
tests:
  sample.bluetooth.direction_finding_connectionless_rx_nrf:
    sysbuild: true
    build_only: true
    platform_allow:
      - nrf5340dk/nrf5340/cpuapp
    integration_platforms:
      - nrf5340dk/nrf5340/cpuapp
  sample.bluetooth.direction_finding_connectionless_rx_nrf.aod:
    sysbuild: true
    extra_args: OVERLAY_CONFIG="overlay-aod.conf"
    build_only: true
    platform_allow:
      - nrf5340dk/nrf5340/cpuapp
    integration_platforms:
      - nrf5340dk/nrf5340/cpuapp
```

## samples/bluetooth/enocean/sample.yaml
```yaml
sample:
  description: Sample demonstrating basic usage of the EnOcean library
  name: EnOcean
tests:
  sample.bluetooth.enocean:
    sysbuild: true
    build_only: true
    integration_platforms:
      - nrf54l15dk/nrf54l15/cpuapp
    platform_allow:
      - nrf54l15dk/nrf54l15/cpuapp
    tags:
      - bluetooth
      - ci_build
      - sysbuild
      - ci_samples_bluetooth
```
