## dts/bindings/gpio/slm-gpio-pins.yaml
```yaml
description: GPIO pins to control Serial LTE Modem

compatible: "slm-gpio-pins"

properties:
  power-gpios:
    type: phandle-array
    required: true
    description: |
      Power pin.

  power-gpios-active-time-ms:
    type: int
    default: 100
    description: |
      Power pin active time in milliseconds.

  power-gpios-debounce-time-ms:
    type: int
    default: 50
    description: |
      Power pin debounce time in milliseconds.

  indicate-gpios:
    type: phandle-array
    description: |
      Indicate pin.

  indicate-gpios-active-time-ms:
    type: int
    default: 100
    description: |
      Indicate pin active time in milliseconds.
```

## dts/bindings/mfd/nordic,npm1300-eng-b.yaml
```yaml
# Copyright (c) 2022 Nordic Semiconductor ASA
# SPDX-License-Identifier: LicenseRef-Nordic-5-Clause

description: |
    This is a representation of the nPM1300 PMIC device.

compatible: "nordic,npm1300-eng-b"

include: i2c-device.yaml

properties:
  host-int-gpios:
    type: phandle-array
    required: true
    description: |
      Host GPIO pin used as interrupt input.
  pmic-int-pin:
    type: int
    required: true
    description: |
      nPM GPIO pin number used as interrupt output.
  host-pof-gpios:
    type: phandle-array
    description: |
      Host GPIO pin used as power loss warning input.
  pmic-pof-pin:
    type: int
    description: |
      nPM GPIO pin number used as power loss warning output.
  pmic-reset-pin:
    type: int
    description: |
      nPM GPIO pin number used as watchdog warning reset output.
```

## dts/bindings/misc/nordic,nrf-micr.yaml
```yaml
# Copyright (c) 2026 Nordic Semiconductor
# SPDX-License-Identifier: LicenseRef-Nordic-5-Clause

description: Nordic MICR (Module Information Configuration Registers)

compatible: "nordic,nrf-micr"

include: base.yaml

properties:
  reg:
    required: true
```

## dts/bindings/misc/nordic,ppi-seq-i2c.yaml
```yaml
#
# Copyright (c) 2026 Nordic Semiconductor ASA
#
# SPDX-License-Identifier: LicenseRef-Nordic-5-Clause
#

description: |
    The PPI sequencer using I2C to perform periodic transfers with CPU
    interrupt only when requested batch of transfers is completed.

compatible: "nordic,ppi-seq-i2c"

include: ["nordic,ppi-seq-i2c-spi-common.yaml", "nordic,nrf-twim.yaml"]
```

## dts/bindings/mpc/nordic,nrf-mpc.yaml
```yaml
description: Nordic, Memory Protection Controller (MPC)

compatible: "nordic,nrf-mpc"

include: base.yaml

properties:
  protection-region-size:
    type: int
    description: Region size for the Memory Protection Controller (MPC) in bytes.
```

## dts/bindings/mspi/nordic,hpf-mspi-controller.yaml
```yaml
# Copyright (c) 2024 Nordic Semiconductor ASA
# SPDX-License-Identifier: LicenseRef-Nordic-5-Clause

description: Nordic HPF MSPI controller

compatible: "nordic,hpf-mspi-controller"

include: [mspi-controller.yaml, pinctrl-device.yaml]
```

## dts/bindings/mspi/nordic,nrf-sqspi.yaml
```yaml
# Copyright (c) 2025 Nordic Semiconductor ASA
# SPDX-License-Identifier: LicenseRef-Nordic-5-Clause

description: Nordic Software Defined QSPI (sQSPI)

compatible: "nordic,nrf-sqspi"

include:
  - mspi-controller.yaml
  - memory-region.yaml
```

## dts/bindings/mspi/nordic,nrfe-mspi-controller.yaml
```yaml
# Copyright (c) 2024 Nordic Semiconductor ASA
# SPDX-License-Identifier: LicenseRef-Nordic-5-Clause

description: Nordic SDP MSPI controller

compatible: "nordic,nrfe-mspi-controller"

include: [mspi-controller.yaml, pinctrl-device.yaml]
```

## dts/bindings/net/nfc/st,st25r3911b.yaml
```yaml
# Copyright (c) 2020 Nordic Semiconductor ASA
# SPDX-License-Identifier: LicenseRef-Nordic-5-Clause

description: |
    STMicroelectronics ST25R3911B NFC Initiator / HF Reader

compatible: "st,st25r3911b"

include: spi-device.yaml

properties:
    irq-gpios:
      type: phandle-array
      required: true

    led-nfca-gpios:
      type: phandle-array
      required: false

    led-nfcb-gpios:
      type: phandle-array
      required: false

    led-nfcf-gpios:
      type: phandle-array
      required: false
```

## dts/bindings/net/segger,eth-rtt.yaml
```yaml
# Copyright (c) 2022 Nordic Semiconductor ASA
# SPDX-License-Identifier: LicenseRef-Nordic-5-Clause

description: Segger Ethernet RTT

compatible: "segger,eth-rtt"

include: base.yaml
```

## dts/bindings/npmx/nordic,npm1300.yaml
```yaml
#
# Copyright (c) 2022 Nordic Semiconductor ASA
#
# SPDX-License-Identifier: Apache-2.0
#

description: |
    This is a representation of the nPM1300 PMIC device

compatible: "nordic,npm1300"

include: i2c-device.yaml

properties:
    int-gpios:
      type: phandle-array
      required: true
```

## dts/bindings/nrf_pulse_meas/nordic,nrf-pulse-meas.yaml
```yaml
# Copyright (c) 2026 Nordic Semiconductor ASA
# SPDX-License-Identifier: LicenseRef-Nordic-5-Clause

description: Nordic Nrf Pulse Measurement

compatible: "nordic,nrf-pulse-meas"

include: base.yaml

properties:
  gpiote-instance:
    required: true
    type: phandle
    description: |
      GPIOTE instance.

  timer-instance:
    required: true
    type: phandle
    description: |
      Timer instance.

  rising-pin:
    type: int
    required: true

  falling-pin:
    type: int
    required: true
```

## dts/bindings/radio_coex/generic-radio-coex-one-wire.yaml
```yaml
# Copyright (c) 2021 Nordic Semiconductor ASA
# SPDX-License-Identifier: LicenseRef-Nordic-5-Clause

description: |
  This is a representation of an external radio coexistence setup that has a
  one-pin control interface (GRANT).

compatible: "generic-radio-coex-one-wire"

include: base.yaml

properties:
  concurrency-mode:
    type: int
    required: true
    description: |
      Concurrency mode with the external modem supported by 1-wire coexistence.
      The possible values are:
      0: 1-wire configuration to allow no concurrency with the external modem
        when the grant line is asserted.
      1: 1-wire configuration to allow RX mode concurrency
        with the external modem when the grant line is asserted.

  grant-gpios:
    type: phandle-array
    required: true
    description: |
      GPIO of the SOC connected to the PTA's GRANT pin.
```

## dts/bindings/radio_coex/generic-radio-coex-three-wire.yaml
```yaml
# Copyright (c) 2021 Nordic Semiconductor ASA
# SPDX-License-Identifier: LicenseRef-Nordic-5-Clause

description: |
    This is a representation of an external radio coexistence setup that has a
    three-pin control interface (REQUEST, GRANT, PRIORITY/DIRECTION).

compatible: "generic-radio-coex-three-wire"

include: base.yaml

properties:
    req-gpios:
        type: phandle-array
        required: true
        description: |
            GPIO of the SOC connected to the PTA's REQUEST pin.

    pri-dir-gpios:
        type: phandle-array
        required: true
        description: |
            GPIO of the SOC connected to the PTA's PRIORITY pin.
            This GPIO is also used to indicate direction (TX/RX).

    grant-gpios:
        type: phandle-array
        required: true
        description: |
            GPIO of the SOC connected to the PTA's GRANT pin.
```

## dts/bindings/radio_coex/sdc-radio-coex-one-wire.yaml
```yaml
# Copyright (c) 2021 Nordic Semiconductor ASA
# SPDX-License-Identifier: LicenseRef-Nordic-5-Clause

description: |
    This is a representation of an external radio coexistence setup that has a
    one-pin control interface (GRANT).

compatible: "sdc-radio-coex-one-wire"

include: generic-radio-coex-one-wire.yaml
```

## dts/bindings/radio_coex/sdc-radio-coex-three-wire.yaml
```yaml
# Copyright (c) 2021 Nordic Semiconductor ASA
# SPDX-License-Identifier: LicenseRef-Nordic-5-Clause

description: |
    This is a representation of an external radio coexistence setup that has a
    three-pin control interface (REQUEST, GRANT, PRIORITY/DIRECTION). This
    extends that interface with additional signal level settings and timing
    parameters.

compatible: "sdc-radio-coex-three-wire"

include: generic-radio-coex-three-wire.yaml

properties:
    is-rx-active-level:
        type: boolean
        description: |
            Property not present: TX direction is indicated by asserting the
            PRIORITY pin at the same level used for indicating a HIGH priority
            request.
            Property is present: RX direction is indicated by asserting the
            PRIORITY pin at the same level used for indicating a HIGH priority
            request.

    type-delay-us:
        type: int
        required: true
        description: |
            Delay in microseconds between the request pin being raised and the
            PRIORITY pin indicating the type of transaction (RX/TX).

    radio-delay-us:
        type: int
        required: true
        description: |
            Delay in microseconds between the PRIORITY pin indicating the type
            of transaction and the radio starting on-air activity.
```

## dts/bindings/radio_fem/generic-fem-two-ctrl-pins.yaml
```yaml
# Copyright (c) 2020 Nordic Semiconductor ASA
# SPDX-License-Identifier: LicenseRef-Nordic-5-Clause

description: |
    This is a representation of generic Radio Front-End module
    that has a two-pin control interface (CTX, CRX).

compatible: "generic-fem-two-ctrl-pins"

include: base.yaml

properties:
    ctx-gpios:
        type: phandle-array
        required: false
        description: |
            Gpio of the SOC controlling CTX pin of the FEM device.

    crx-gpios:
        type: phandle-array
        required: false
        description: |
            Gpio of the SOC controlling CRX pin of the FEM device.

    ctx-settle-time-us:
        type: int
        description: |
            Settling time in microseconds from activation of CTX to transmit.

    crx-settle-time-us:
        type: int
        description: |
            Settling time in microseconds from activation of CRX to receive.

    tx-gain-db:
        type: int
        description: |
            TX gain of the PA amplifier of the FEM device in dB.

    rx-gain-db:
        type: int
        description: |
            RX gain of the LNA amplifier of the FEM device in dB.
```

## dts/bindings/radio_fem/hot_potato-fem.yaml
```yaml
# Copyright (c) 2024, Nordic Semiconductor ASA
# All rights reserved.

# Redistribution and use in source and binary forms, with or without
# modification, are permitted provided that the following conditions are met:

#   1. Redistributions of source code must retain the above copyright notice, this
#      list of conditions and the following disclaimer.

#   2. Redistributions in binary form must reproduce the above copyright notice,
#      this list of conditions and the following disclaimer in the documentation
#      and/or other materials provided with the distribution.

#   3. Neither the name of Nordic Semiconductor ASA nor the names of its
#      contributors may be used to endorse or promote products derived from
#      this software without specific prior written permission.

# THIS SOFTWARE IS PROVIDED BY THE COPYRIGHT HOLDERS AND CONTRIBUTORS "AS IS"
# AND ANY EXPRESS OR IMPLIED WARRANTIES, INCLUDING, BUT NOT LIMITED TO, THE
# IMPLIED WARRANTIES OF MERCHANTABILITY AND FITNESS FOR A PARTICULAR PURPOSE ARE
# DISCLAIMED. IN NO EVENT SHALL THE COPYRIGHT HOLDER OR CONTRIBUTORS BE LIABLE
# FOR ANY DIRECT, INDIRECT, INCIDENTAL, SPECIAL, EXEMPLARY, OR CONSEQUENTIAL
# DAMAGES (INCLUDING, BUT NOT LIMITED TO, PROCUREMENT OF SUBSTITUTE GOODS OR
# SERVICES; LOSS OF USE, DATA, OR PROFITS; OR BUSINESS INTERRUPTION) HOWEVER
# CAUSED AND ON ANY THEORY OF LIABILITY, WHETHER IN CONTRACT, STRICT LIABILITY,
# OR TORT (INCLUDING NEGLIGENCE OR OTHERWISE) ARISING IN ANY WAY OUT OF THE USE
# OF THIS SOFTWARE, EVEN IF ADVISED OF THE POSSIBILITY OF SUCH DAMAGE.

description: |
    This is a representation of the HOT_POTATO Radio Front-End module.
    It is supplementing the generic representation of FEM with settling time and
    gain values appropriate for HOT_POTATO device.

compatible: "hot_potato"

include: generic-fem-two-ctrl-pins.yaml

properties:
  att0-gpios:
    type: phandle-array
    description: |
        SoC GPIO connected to the ATT0 input pin on the FEM device.

  att1-gpios:
    type: phandle-array
    description: |
        SoC GPIO connected to the ATT1 input pin on the FEM device.

  att2-gpios:
    type: phandle-array
    description: |
        SoC GPIO connected to the ATT2 input pin on the FEM device.

  att3-gpios:
    type: phandle-array
    description: |
        SoC GPIO connected to the ATT3 input pin on the FEM device.

  ctx-settle-time-us:
    type: int
    default: 23
    description: |
      Settling time in microseconds from activation of CTX to transmit.

      The default value is based on the experimentally determined settle
      time, that was observed on SKY66112-11 device.

  crx-settle-time-us:
    type: int
    default: 5
    description: |
      Settling time in microseconds from activation of CRX to receive.

      The default value is based on the experimentally determined settle
      time, that was observed on SKY66112-11 device.
```

## dts/bindings/radio_fem/nordic,nrf21540_gpio.yaml
```yaml
#
# Copyright (c) 2020 Nordic Semiconductor
#
# SPDX-License-Identifier: LicenseRef-BSD-5-Clause-Nordic
#


description: >
    This is a representation of the nRF21540 Radio Front-End module

compatible: "nordic,nrf21540_gpio"

include: base.yaml

properties:
    tx-en-pin:
        type: int
        description: >
            Pin number of the SOC controlling TX_EN pin of the nRF21540

    rx-en-pin:
        type: int
        description: >
            Pin number of the SOC controlling RX_EN pin of the nRFf21540

    pdn-pin:
        type: int
        description: >
            Pin number of the SOC controlling PDN pin of the nRF21540

    tx-en-settle-time-us:
        type: int
        default: 13
        description: >
            Settling time in microseconds from state PG to TX

    rx-en-settle-time-us:
        type: int
        default: 13
        description: >
            Settling time in microseconds from state PG to RX

    pdn-settle-time-us:
        type: int
        default: 18
        description: >
            Settling time in microseconds from state PD to PG

    trx-hold-time-us:
        type: int
        default: 5
        description: >
            Power-off time in microseconds when changing from RX or TX to PG

    tx-gain-db:
        type: int
        default: 20
        description: >
            TX gain of the nRF21540 PA amplifier in dB.

    rx-gain-db:
        type: int
        default: 20
        description: >
            RX gain of the nRF21540 LNA amplifier in dB.
```

## dts/bindings/radio_fem/nordic,nrf2220-fem-twi.yaml
```yaml
# Copyright (c) 2024 Nordic Semiconductor ASA
# SPDX-License-Identifier: LicenseRef-Nordic-5-Clause

description: |
    This is a TWI device interface to the nRF2220 Radio Front-End module

compatible: "nordic,nrf2220-fem-twi"

include: [i2c-device.yaml, nordic-nrf22xx-fem-twi-init-reg.yaml]
```
