## dts/bindings/radio_fem/nordic,nrf2220-fem.yaml
```yaml
# Copyright (c) 2024 Nordic Semiconductor ASA
# SPDX-License-Identifier: LicenseRef-Nordic-5-Clause

description: |
  This is a representation of the nRF2220 Radio Front-End module.

  See the "nordic,nrf2220-fem-twi" binding to configure the TWI (I2C)
  interface. The TWI interface should be configured as a child node
  of the TWI (I2C) bus you have connected to the FEM. Then you "connect"
  the FEM and TWI configurations using the twi-if property.

  Here is an example nRF2220 configuration with a TWI interface
  selected, using the TWIM0 peripheral found on several nRF5 SoCs:

  &i2c0 {
    status = "okay";

    my_twi_if: nrf2220_fem_twi@36 {
      compatible = "nordic,nrf2220-fem-twi";
      status = "okay";
      reg = <0x36>;
    };
  };

  nrf_radio_fem: nrf2220_fem {
    compatible = "nordic,nrf2220-fem";
    cs-gpios = <&gpio1 7 GPIO_ACTIVE_HIGH>;
    md-gpios = <&gpio1 11 GPIO_ACTIVE_HIGH>;
    twi-if = <&my_twi_if>;
    output-power-dbm = <10>;
    bypass-gain-db = <-1>;
    /* ... other nRF2220 properties go here ... */
  };

  &radio {
    fem = <&nrf_radio_fem>;
  };

  In the above example, the nRF2220 is configured for use with:

  - CS on P1.7 (from 'cs-gpios')
  - MD on P1.11 (from 'md-gpios')
  - TWI/I2C communication via TWIM0 (the bus, or parent node, of the 'my_twi_if' node)
  - Output power of 10dBm when using power amplifier
  - Bypass attenuation used for calculations of 1dB

  You must perform any additional required TWI/I2C pin configuration
  (nRF2220 CLK and DATA pins) within the TWIM bus node
  ('i2c0' in the above example). See your TWI/I2C node's binding for
  details on these pin mux properties. You can use any TWI/I2C node
  available in your SoC's devicetree.

compatible: "nordic,nrf2220-fem"

include: base.yaml

properties:
  cs-gpios:
    type: phandle-array
    required: true
    description:
      GPIO of the SoC controlling the CS pin of the nRF2220 family member device.

  md-gpios:
    type: phandle-array
    required: true
    description: |
      GPIO of the SoC controlling the MD pin of the nRF2220 family member device.

  output-power-dbm:
    type: int
    default: 10
    description: |
      Output power in dBm at FEM output, when the FEM is in Transmit state
      (power amplifier is used).

  bypass-gain-db:
    type: int
    default: -1
    description: |
      Gain of the Front End Module's bypass in dB. This parameter is usually negative
      to express attenuation.

  twi-if:
    type: phandle
    description: |
      Reference to the TWI/I2C bus interface.
      This must be present to support TWI control of the FEM.
```

## dts/bindings/radio_fem/nordic,nrf2240-fem-twi.yaml
```yaml
# Copyright (c) 2024 Nordic Semiconductor ASA
# SPDX-License-Identifier: LicenseRef-Nordic-5-Clause

description: |
    This is a TWI device interface to the nRF2240 Radio Front-End module

compatible: "nordic,nrf2240-fem-twi"

include: [i2c-device.yaml, nordic-nrf22xx-fem-twi-init-reg.yaml]
```

## dts/bindings/radio_fem/nordic-nrf22xx-fem-twi-init-reg.yaml
```yaml
# Copyright (c) 2024 Nordic Semiconductor ASA
# SPDX-License-Identifier: LicenseRef-Nordic-5-Clause

description: |
  This is an abstract device that represents TWI registers of nRF22xx Front-End Module
  to be written at boot-time.

  Here is an example configuration for nRF2240 Front-End Module TWI interface that defines
  initialization registers:

  nrf_radio_fem_twi: fem_twi@30 {
    /* Other properties related to this node go here, including "compatible" and "reg". */
    status = "okay";
      init-regs = <0x11 0xaa>, <0x22 0xbb>, <0x33 0xcc>;
  };

  The above configuration will cause the registers of given nRF22xx device with internal addresses
  0x11, 0x22 and 0x33 to be written with values 0xAA, 0xBB and 0xCC respectively.

  The property is optional. If it is not specified, no TWI registers to be written at boot-time
  are provided to the Front-End Module driver.

include: base.yaml

properties:
  init-regs:
    type: array
    description:
      Array that contains pairs of internal offsets of nRF22xx registers to be written at
      boot-time and the values of these registers.
```

## dts/bindings/radio_fem/skyworks,sky66112-11.yaml
```yaml
# Copyright (c) 2020 Nordic Semiconductor ASA
# SPDX-License-Identifier: LicenseRef-Nordic-5-Clause

description: |
    This is a representation of the Skyworks SKY66112-11 Radio Front-End module.
    It is supplementing the generic representation of FEM with settling time and
    gain values appropriate for SKY66112-11 device.

compatible: "skyworks,sky66112-11"

include: generic-fem-two-ctrl-pins.yaml

properties:
    ctx-settle-time-us:
        type: int
        default: 23
        description: |
            Settling time in microseconds from activation of CTX to transmit.

            The default value has been determined experimentally: it is the
            minimum time interval between asserting the CTX signal and starting
            the radio transmission, which does not generate unacceptable
            interference level on adjacent channels. The tests concerned a
            configuration in which nRF5x SoC controlling the SKY66112-11.
            The value can be adjusted for other tuned configurations.

    crx-settle-time-us:
        type: int
        default: 5
        description: |
            Settling time in microseconds from activation of CRX to receive.

            The default value has been determined experimentally: it is the
            minimum time interval between asserting the CRX signal and starting
            the radio reception, which does not degrade transmission quality
            indicators (compared to a constantly turned on FEM LNA). The tests
            concerned a configuration in which nRF5x SoC controlling
            the SKY66112-11. The value can be adjusted for other tuned
            configurations.

    tx-gain-db:
        type: int
        default: 22
        description: |
            TX gain of the PA amplifier of SKY66112-11 in dB.

            Default value is based on Table 5 of the SKY66112-11 data sheet
            (July 19, 2019). This is a fixed parameter of the device. The value
            can be changed if, instead of SKY66112-11, another device with
            different gain, but compatible with the control interface via the
            CTX, CRX pins is used.

    rx-gain-db:
        type: int
        default: 11
        description: |
            RX gain of the LNA amplifier of SKY66112-11 in dB.

            Default value is based on Table 5 of the SKY66112-11 data sheet
            (July 19, 2019). This is a fixed parameter of the device. The value
            can be changed if, instead of SKY66112-11, another device with
            different gain, but compatible with the control interface via the
            CTX, CRX pins is used.

    ant-sel-gpios:
        type: phandle-array
        required: false
        description: |
            Gpio of the SOC controlling ANT-SEL pin of the SKY66112-11 device.

    csd-gpios:
        type: phandle-array
        required: false
        description: |
            Gpio of the SOC controlling CSD pin of the SKY66112-11 device.

    cps-gpios:
        type: phandle-array
        required: false
        description: |
            Gpio of the SOC controlling CPS pin of the SKY66112-11 device.

    chl-gpios:
        type: phandle-array
        required: false
        description: |
            Gpio of the SOC controlling CHL pin of the SKY66112-11 device.
```

## dts/bindings/radio_fem/skyworks,sky66114-11.yaml
```yaml
# Copyright (c) 2021 Nordic Semiconductor ASA
# SPDX-License-Identifier: LicenseRef-Nordic-5-Clause

description: |
    This is a representation of the Skyworks SKY66114-11 Radio Front-End module.
    It is supplementing the generic representation of FEM with settling time and
    gain values appropriate for SKY66114-11 device.

include:
  - name: generic-fem-two-ctrl-pins.yaml
  - name: skyworks,sky66112-11.yaml
    property-blocklist:
      - ant-sel-gpios


compatible: "skyworks,sky66114-11"
```
