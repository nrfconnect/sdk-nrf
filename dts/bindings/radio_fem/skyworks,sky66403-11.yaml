## dts/bindings/radio_fem/skyworks,sky66403-11.yaml
```yaml
# Copyright (c) 2021 Nordic Semiconductor ASA
# SPDX-License-Identifier: LicenseRef-Nordic-5-Clause

description: |
    This is a representation of the Skyworks SKY66403-11 Radio Front-End module.
    It is supplementing the generic representation of FEM with settling time and
    gain values appropriate for SKY66403-11 device.

include:
  - name: generic-fem-two-ctrl-pins.yaml
  - name: skyworks,sky66112-11.yaml

compatible: "skyworks,sky66403-11"
```

## dts/bindings/radio_fem/skyworks,sky66407-11.yaml
```yaml
# Copyright (c) 2023 Panasonic Industrial Devices Europe GmbH
# SPDX-License-Identifier: LicenseRef-Nordic-5-Clause

description: |
  This is a representation of the Skyworks SKY66407-11 Radio Front-End module.
  It is supplementing the generic representation of FEM with settling time and
  gain values appropriate for SKY66407-11 device.

compatible: "skyworks,sky66407-11"

include: generic-fem-two-ctrl-pins.yaml

properties:
  ctx-settle-time-us:
    type: int
    default: 23
    description: |
      Settling time in microseconds from activation of CTX to transmit.

      The default value is based on the experimentally determined settle
      time, that was observed on SKY66112-11 device.

  crx-settle-time-us:
    type: int
    default: 5
    description: |
      Settling time in microseconds from activation of CRX to receive.

      The default value is based on the experimentally determined settle
      time, that was observed on SKY66112-11 device.

  tx-gain-db:
    type: int
    default: 12
    description: |
      TX gain of the PA amplifier of SKY66407-11 in dB.

      Default value is based on Table 5 of the SKY66407-11 data sheet
      (February 27, 2023). This is not a fixed parameter of the device.
      Table 7 lists the relationship between CTX voltage/current and
      bias resistance.

  rx-gain-db:
    type: int
    default: 0
    description: |
      RX gain of the LNA amplifier of SKY66407-11 in dB.

      Based on the data sheet (February 27, 2023) for SKY66407-11 has no
      receiving gain. This is a fixed parameter of the device. The
      value can be changed if, instead of SKY66407-11, another device
      with different gain, but compatible with the control interface
      via the CTX, CRX pins is used.
```

## dts/bindings/sdhc/nordic,nrf-semmc.yaml
```yaml
# Copyright (c) 2026 Nordic Semiconductor ASA
# SPDX-License-Identifier: LicenseRef-Nordic-5-Clause

description: Nordic Software Defined eMMC (sEMMC)

compatible: "nordic,nrf-semmc"

include:
  - sdhc.yaml
  - memory-region.yaml
```

## dts/bindings/sensor/nordic,ppi-seq-i2c-spi-common.yaml
```yaml
#
# Copyright (c) 2026 Nordic Semiconductor ASA
#
# SPDX-License-Identifier: LicenseRef-Nordic-5-Clause
#

properties:
  timer:
    type: phandle
    description: |
      TIMER instance used as the timing source. Using Timer is recommended for short periods
      where performance matters. If not provided the other source is used.
      If timer and rtc is not provided then GRTC channel with interval is used.

  rtc:
    type: phandle
    description: |
      RTC instance used as the timing source. Using RTC is recommended for lowest power consumption.
      Compare to GRTC it consumes less power because GRTC needs additional time to synchronize
      32 kHz clock with 1 MHz clock.
      If timer and rtc is not provided then GRTC channel with interval is used.

  timer_notifier:
    type: phandle
    description: |
      TIMER instance used to count events and notify about the batch completion. If TIMER is
      not provided then k_timer is used instead which is more power efficient than using the
      TIMER (adds few uA). Using TIMER is only recommended for short periods where as it is more
      accurate than k_timer.

  extra_transfers:
    type: array
    description:
      Array of offsets (in microseconds). For each item in the array an additional I2C/SPI transfer
      is triggered. Offset is given from the start of each period. When property is provided then
      it is required to use timer or rtc property. Maximum number of elements is limited. For TIMER,
      it is number of compare channels - 1. For RTC, it is number of compare channels - 2.
```

## dts/bindings/sensor/nordic,ppi-seq-spi.yaml
```yaml
#
# Copyright (c) 2026 Nordic Semiconductor ASA
#
# SPDX-License-Identifier: LicenseRef-Nordic-5-Clause
#

description: |
    The PPI sequencer using SPI to perform periodic transfers with CPU
    interrupt only when requested batch of transfers is completed.

compatible: "nordic,ppi-seq-spi"

include: ["nordic,nrf-spim.yaml", "nordic,ppi-seq-i2c-spi-common.yaml"]

properties:
  frequency:
    type: int
    required: true
    description: Clock frequency of device's SPI interface in Hz
  spi-cpol:
    type: boolean
    description: |
      SPI clock polarity which indicates the clock idle state.
      If it is used, the clock idle state is logic high; otherwise, low.
  spi-cpha:
    type: boolean
    description: |
      SPI clock phase that indicates on which edge data is sampled.
      If it is used, data is sampled on the second edge; otherwise, on the first edge.
  spi-lsb-first:
    type: boolean
    description: The device requires least significant bit first data mode.
  spi-cs-high:
    type: boolean
    description: The device requires the chip select to be active high.
  spi-cs-setup-delay-ns:
    type: int
    default: 1000
    description: |
      Delay in nanoseconds to be introduced by the controller after CS is asserted.
      Also known as enable lead time.
```

## dts/bindings/sensor/nordic,sensor-sim.yaml
```yaml
# Copyright (c) 2022 Nordic Semiconductor
#
# SPDX-License-Identifier: LicenseRef-Nordic-5-Clause

description: Sensor simulator

compatible: "nordic,sensor-sim"

include: base.yaml

properties:
    base-temperature:
      type: int
      default: 21
      description: |
        The sensor reports a base temperature value with a simulated noise.
        Value units are degrees Celsius. Defaults to 21 degrees, simulation
        default.

    base-humidity:
      type: int
      default: 52
      description: |
        The sensor reports a base humidity value with a simulated noise.
        Value is relative (%). Defaults to 52%, simulation default.

    base-pressure:
      type: int
      default: 98
      description: |
        The sensor reports a base pressure value with a simulated noise.
        Value units are kPa (kilopascal). Defaults to 98 kPa, simulation
        default.

    acc-signal:
      type: string
      required: true
      enum:
        - "toggle"
        - "wave"
      description: |
        When 'toggle' option is selected, a value is generated for acceleration
        signal toggling between two values on fetch. This is the default value.
        When 'wave' option is selected, simulated sensor uses wave signal
        generating library to generate acceleration readouts. By default a sine
        wave is generated.

    acc-toggle-amplitude:
      type: int
      default: 20
      description: |
        The amplitude of the acceleration signal when signal type is 'toggle'.
        Defaults to 20 (simulation default).

    acc-wave-type:
      type: string
      default: "sine"
      enum:
        - "sine"
        - "triangle"
        - "square"
        - "none"
      description: |
        The type of wave to generate for acceleration signal. Defaults to 'sine'
        (simulation default).

    acc-wave-amplitude:
      type: int
      default: 20
      description: |
        The amplitude of the wave to generate for acceleration signal. Defaults
        to 20 (simulation default).

    acc-wave-period:
      type: int
      default: 10000
      description: |
        The period of the wave in milliseconds to generate for acceleration
        signal. Defaults to 10000 (simulation default).

    trigger-gpios:
      type: phandle-array
      description: |
        Trigger GPIO. This parameter only has effect when
        CONFIG_SENSOR_SIM_TRIGGER is enabled. If not provided, trigger will work
        on a timeout basis as given by the trigger-timeout property.

    trigger-timeout:
      type: int
      default: 1000
      description: |
        Timeout in milliseconds for trigger. This parameter only has effect when
        CONFIG_SENSOR_SIM_TRIGGER is enabled. Defaults to 1000 (simulation
        default).
```

## dts/bindings/sensor/nordic,sensor-stub.yaml
```yaml
# Copyright (c) 2022 Nordic Semiconductor
#
# SPDX-License-Identifier: LicenseRef-Nordic-5-Clause

description: Simple sensor simulator

compatible: "nordic,sensor-stub"

include: base.yaml

properties:
    generator:
      type: string
      required: true
      description: |
        The name of the generator callback.
        Using prefix provided here 3 functions would be added to the configratuon:
        - <generator>_fetch - sensor fetch function of the type sensor_sample_fetch_t.
        - <generator>_get   - sensor channel get function of the type sensor_channel_get_t.
        - <generator>_init  - sensor initialization function,
                              that takes only device parameter and returns error code.
        All this functions are expected to have global linkeage.
```

## dts/bindings/sensor/pixart,paw3212.yaml
```yaml
#
# Copyright (c) 2019 Nordic Semiconductor
#
# SPDX-License-Identifier: LicenseRef-Nordic-5-Clause
#


description: |
    This is a representation of the PAW3212 optical motion sensor

compatible: "pixart,paw3212"

include: spi-device.yaml

properties:
    irq-gpios:
      type: phandle-array
      required: true
```

## dts/bindings/sensor/pixart,pmw3360.yaml
```yaml
#
# Copyright (c) 2019 Nordic Semiconductor
#
# SPDX-License-Identifier: LicenseRef-BSD-5-Clause-Nordic
#


description: >
    This is a representation of the PMW3360 optical motion sensor

compatible: "pixart,pmw3360"

include: spi-device.yaml

properties:
    irq-gpios:
      type: phandle-array
      required: true
```

## dts/bindings/sensor/rohm,bh1749.yaml
```yaml
#
# Copyright (c) 2019 Nordic Semiconductor ASA
#
# SPDX-License-Identifier: LicenseRef-BSD-5-Clause-Nordic
#

description: >
    This is a representation of the BH1749 sensor

compatible: "rohm,bh1749"

include: i2c-device.yaml

properties:
    int-gpios:
      type: phandle-array
      required: true
```

## dts/bindings/serial/nordic,nrf-ipc-uart.yaml
```yaml
# Copyright (c) 2022 Nordic Semiconductor ASA
# SPDX-License-Identifier: LicenseRef-Nordic-5-Clause

description: |
  This is binding for the UART over IPC.

include: [uart-controller.yaml, pinctrl-device.yaml]

compatible: "nordic,nrf-ipc-uart"

properties:
  ipc:
    type: phandle
    required: true
    description: IPC instance for sending UART data.
  ept-name:
    type: string
    required: true
    description: Remote IPC endpoint name
```

## dts/bindings/serial/nordic,nrf-spm-uart.yaml
```yaml
# Copyright (c) 2021 Nordic Semiconductor ASA
# SPDX-License-Identifier: LicenseRef-Nordic-5-Clause

description: |
    SPM UART

compatible: "nordic,nrf-spm-uart"

include: uart-device.yaml
```

## dts/bindings/serial/nordic,nrf-sw-dtr-uart.yaml
```yaml
# Copyright (c) 2025 Nordic Semiconductor ASA
# SPDX-License-Identifier: LicenseRef-Nordic-5-Clause

description: |
    DTR/RI UART

compatible: "nordic,nrf-sw-dtr-uart"

include: uart-device.yaml

properties:
  dte-role:
    type: boolean
    description: Data Terminal Equipment role

  dtr-pin:
    type: int
    description: Data Terminal Ready pin
    required: true

  dtr-pin-toggle:
    type: boolean
    description: DTR pin for DCE uses toggle on high-to-low, instead of level trigger

  dtr-pin-debounce:
    type: int
    description: DTR pin debounce time in milliseconds
    default: 0

  ri-pin:
    type: int
    description: Ring Indicator pin
    required: true
```

## dts/bindings/serial/nordic,nrf-sw-lpuart.yaml
```yaml
# Copyright (c) 2020 Nordic Semiconductor ASA
# SPDX-License-Identifier: LicenseRef-Nordic-5-Clause

description: |
    Low power UART

compatible: "nordic,nrf-sw-lpuart"

include: uart-device.yaml

properties:
  req-pin:
    type: int
    description: Request pin
    required: true

  rdy-pin:
    type: int
    description: Ready pin
    required: true
```

## dts/bindings/watchdog/nordic,nrf-gswdt.yaml
```yaml
# Copyright (c) 2026, Nordic Semiconductor ASA
# SPDX-License-Identifier: LicenseRef-Nordic-5-Clause

description: Nordic nRF global software watchdog timer (GSWDT) binding

compatible: "nordic,nrf-gswdt"

include: base.yaml

properties:
  mbox:
    type: phandle
    required: true
    description: phandle to the MBOX controller (TX)
```

## dts/bindings/wifi/nordic,nrf-wicr.yaml
```yaml
description: |
  Nordic WICR (Wi-Fi Information Configuration Registers)

compatible: "nordic,nrf-wicr"

include: base.yaml

properties:
  reg:
    type: array
    required: true
    description: Base address and size of the WICR register block.

child-binding:
  description: |
    Child nodes can be either:
      - Clusters (groups) containing register nodes
      - Individual register nodes
  properties:
    reg:
      type: array
      required: false
      description: Offset and size of the WICR field within the WICR block.
    value:
      type: int
      required: false
      description: Value for WICR field.

  # Allow clusters as child nodes
  child-binding:
    description: WICR fields/registers within a cluster
    properties:
      reg:
        type: array
        required: true
        description: Offset and size of the WICR field within the WICR block.
      value:
        type: int
        required: true
        description: Value for WICR field.
```

## dts/bindings/wifi/nordic,nrf7002-qspi.yaml
```yaml
# Copyright (c) 2022 Nordic Semiconductor ASA
# SPDX-License-Identifier: Apache-2.0


description: This is a representation of the nRF7002 Wi-Fi chip.

compatible: "nordic,nrf7002-qspi"

include: "nordic,nrf7002.yaml"

on-bus: qspi

properties:
  sck-frequency:
    type: int
    required: true
    description: |
      Maximum clock speed (in Hz) supported by the device.

  reg:
    required: true

  quad-mode:
    type: boolean
    required: false
    description: |
      If specified, Use QSPI in quad mode (4 IO lines) otherwise in SPI mode (2 IO lines - MOSI & MISO).

  rx-delay:
    type: int
    required: false
    description: |
      Number of clock cycles from the rising edge of the SPI clock
      until the input serial data is sampled.

  cpha:
    type: boolean
    required: false
    description: |
      Set to indicate phase starts with asserted half-phase (CPHA=1).
      The driver using this property must also use `cpol`.

  cpol:
    type: boolean
    required: false
    description: |
      Set to indicate that the clock leading edge is falling (CPOL=1).
      The driver using this property requires also use `cpha`.
```

## dts/bindings/wifi/nordic,nrf7002-spi.yaml
```yaml
# Copyright (c) 2022 Nordic Semiconductor ASA
# SPDX-License-Identifier: Apache-2.0


description: This is a representation of the nRF7002 Wi-Fi chip.

compatible: "nordic,nrf7002-spi"

include: ["nordic,nrf7002.yaml", "spi-device.yaml"]
```

## dts/bindings/wifi/nordic,nrf7002.yaml
```yaml
# Copyright (c) 2022 Nordic Semiconductor ASA
# SPDX-License-Identifier: Apache-2.0


# GPIO lines for controlling the nRF7002 Wi-Fi chip.
include: base.yaml

properties:
    iovdd-ctrl-gpios:
        type: phandle-array
        required: true
        description: |
            GPIO of the SOC controlling IO VDD Control pin of the nRF7002
    bucken-gpios:
        type: phandle-array
        required: true
        description: |
            GPIO of the SOC controlling BUCK_EN pin of the nRF7002
    host-irq-gpios:
        type: phandle-array
        required: true
        description: |
            GPIO of the SOC controlling the HOST IRQ pin of the nRF7002
```
