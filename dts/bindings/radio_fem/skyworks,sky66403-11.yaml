## dts/bindings/wifi/nordic,nrf700x-qspi.yaml
```yaml
# Copyright (c) 2022 Nordic Semiconductor ASA
# SPDX-License-Identifier: LicenseRef-Nordic-5-Clause


description: This is a representation of the nRF700x Wi-Fi chip.

compatible: "nordic,nrf700x-qspi"

include: "nordic,nrf700x.yaml"

on-bus: qspi

properties:
  sck-frequency:
    type: int
    required: true
    description: |
      Maximum clock speed (in Hz) supported by the device.

  reg:
    required: true

  quad-mode:
    type: boolean
    description: |
      If specified, Use QSPI in quad mode (4 IO lines) otherwise in
      SPI mode (2 IO lines - MOSI & MISO).

  rx-delay:
    type: int
    description: |
      Number of clock cycles from the rising edge of the SPI clock
      until the input serial data is sampled.

  cpha:
    type: boolean
    description: |
      Set to indicate phase starts with asserted half-phase (CPHA=1).
      The driver using this property must also use `cpol`.

  cpol:
    type: boolean
    description: |
      Set to indicate that the clock leading edge is falling (CPOL=1).
      The driver using this property requires also use `cpha`.
```

## dts/bindings/wifi/nordic,nrf700x-spi.yaml
```yaml
# Copyright (c) 2022 Nordic Semiconductor ASA
# SPDX-License-Identifier: LicenseRef-Nordic-5-Clause


description: This is a representation of the nRF700x Wi-Fi chip.

compatible: "nordic,nrf700x-spi"

include: ["nordic,nrf700x.yaml", "spi-device.yaml"]
```

## dts/bindings/wifi/nordic,nrf700x-tx-power.yaml
```yaml
# Copyright (c) 2023 Nordic Semiconductor ASA
# SPDX-License-Identifier: LicenseRef-Nordic-5-Clause

description: This is a representation of the nRF70 series transmit power ceilings
  i.e., maximum transmit power allowed.

compatible: "nordic,nrf700x-tx-power-ceiling"

include: base.yaml

properties:
  max-pwr-2g-dsss:
    type: int
    required: true
    description: 8-bit values for max tx power in 2.4GHz band for DSSS/CCK rates
  max-pwr-2g-mcs0:
    type: int
    required: true
    description: 8-bit values for max tx power in 2.4GHz band for MCS0
  max-pwr-2g-mcs7:
    type: int
    required: true
    description: 8-bit values for max tx power in 2.4GHz band for MCS7
  max-pwr-5g-low-mcs0:
    type: int
    required: true
    description: 8-bit values for max tx power in 5GHz band MCS0 low sub-band
  max-pwr-5g-low-mcs7:
    type: int
    required: true
    description: 8-bit values for max tx power in 5GHz band MCS7 low sub-band
  max-pwr-5g-mid-mcs0:
    type: int
    required: true
    description: 8-bit values for max tx power in 5GHz band MCS0 mid sub-band
  max-pwr-5g-mid-mcs7:
    type: int
    required: true
    description: 8-bit values for max tx power in 5GHz band MCS7 mid sub-band
  max-pwr-5g-high-mcs0:
    type: int
    required: true
    description: 8-bit values for max tx power in 5GHz band MCS0 high sub-band
  max-pwr-5g-high-mcs7:
    type: int
    required: true
    description: 8-bit values for max tx power in 5GHz band MCS7 high sub-band
```

## dts/bindings/wifi/nordic,nrf700x.yaml
```yaml
# Copyright (c) 2022 Nordic Semiconductor ASA
# SPDX-License-Identifier: LicenseRef-Nordic-5-Clause


# GPIO lines for controlling the nRF700x Wi-Fi chip.
include: base.yaml

properties:
  iovdd-ctrl-gpios:
    type: phandle-array
    required: true
    description: |
            GPIO of the SOC controlling IO VDD Control pin of the nRF700x
  bucken-gpios:
    type: phandle-array
    required: true
    description: |
            GPIO of the SOC controlling BUCK_EN pin of the nRF700x
  host-irq-gpios:
    type: phandle-array
    required: true
    description: |
            GPIO of the SOC controlling the HOST IRQ pin of the nRF700x
```

## dts/bindings/wifi/nordic,nrf71.yaml
```yaml
# Copyright (c) 2025 Nordic Semiconductor ASA
# SPDX-License-Identifier: LicenseRef-Nordic-5-Clause

description: >
  This is a representation of the Wi-Fi parts of the nRF71 Series Wi-Fi and
  Bluetooth chip SoC.

compatible: nordic,wifi71

include:
  - "wifi-tx-power-2g.yaml"
  - "wifi-tx-power-5g.yaml"
```
