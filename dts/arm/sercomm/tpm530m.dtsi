/*
 * Copyright (c) 2025 Nordic Semiconductor ASA
 *
 * SPDX-License-Identifier: LicenseRef-Nordic-5-Clause
 */

#include <mem.h>
#include <nordic/nrf91.dtsi>

&sram0 {
	reg = <0x20000000 DT_SIZE_K(256)>;
	ranges = <0x0 0x20000000 DT_SIZE_K(256)>;
};

/ {
	soc {
		compatible = "sercomm,tpm530m", "nordic,nrf9120",
			     "nordic,nrf91", "simple-bus";
	};
};
