## applications/asset_tracker_v2/src/cloud/Kconfig.azure_fota_patch
```kconfig
#
# Copyright (c) 2021 Nordic Semiconductor ASA
#
# SPDX-License-Identifier: LicenseRef-Nordic-5-Clause
#

# This Kconfig file contains redefinitions of Kconfig options that are used when Azure IoT Hub and
# Azure FOTA libraries are enabled.

config AZURE_FOTA_APP_VERSION
	default ASSET_TRACKER_V2_APP_VERSION if AZURE_IOT_HUB && AZURE_FOTA && !AZURE_FOTA_APP_VERSION_AUTO
	help
	  Kconfig redefinition that aligns the azure fota and application version strings.
	  When updating the application firmware the ASSET_TRACKER_V2_APP_VERSION option should be
	  used as it takes precedence over the AZURE_FOTA_APP_VERSION option.

config AZURE_FOTA_VERSION_MAX_LEN
	default ASSET_TRACKER_V2_APP_VERSION_MAX_LEN if AZURE_IOT_HUB && AZURE_FOTA && !AZURE_FOTA_APP_VERSION_AUTO
	help
	  Kconfig redefinition that aligns the azure fota and application version string length.
```

## applications/asset_tracker_v2/src/cloud/Kconfig.lwm2m_integration
```kconfig
#
# Copyright (c) 2022 Nordic Semiconductor
#
# SPDX-License-Identifier: LicenseRef-Nordic-5-Clause
#

module = LWM2M_INTEGRATION
module-prompt = "LwM2M integration [Experimental]"
osource "$(ZEPHYR_NRF_MODULE_DIR)/subsys/net/lib/Kconfig.cloud_$(CLOUD_SERVICE_SELECTOR)"

config $(module)
	bool
	select EXPERIMENTAL
	prompt "LwM2M integration layer" if !CLOUD_SERVICE_MUTUAL_EXCLUSIVE

if LWM2M_INTEGRATION

menu "LwM2M integration library"

if NRF_CLOUD_PGPS

config LWM2M_CLIENT_UTILS_LOCATION_ASSIST_PGPS
	default y

# Set the nRF Cloud P-GPS download transport to custom.
# With LwM2M, P-GPS data is transferred over the LwM2M transport and not via the internal HTTP
# transport of the nRF Cloud P-GPS library.
choice NRF_CLOUD_PGPS_DOWNLOAD_TRANSPORT
	default NRF_CLOUD_PGPS_DOWNLOAD_TRANSPORT_CUSTOM
endchoice

endif # NRF_CLOUD_PGPS

config LWM2M_INTEGRATION_ENDPOINT_PREFIX
	string "LwM2M endpoint prefix"
	default "urn:imei:"

config LWM2M_INTEGRATION_PROVISION_CREDENTIALS
	bool "Run-time provisioning of credentials"

config LWM2M_INTEGRATION_FLUSH_SESSION_CACHE
	bool "Flush DTLS session cache after boot"
	help
	  Flush the modems internal session cache prior to connection establishment. This is a
	  debug option to be able to successfully decode wireshark traffic for every run.
	  Wireshark needs the initial first handshake in order to do this. This is forced by
	  flushing the DTLS session cache after boot.

config LWM2M_INTEGRATION_MODEM_MODE_REQUEST_RETRY_SECONDS
	int "Modem functional mode request retry, in seconds"
	default 2
	help
	  Time in between each time the security object will request a modem
	  functional mode change.
	  The security object requests functional mode change before and
	  after provisioning the credentials to the modem.

if LWM2M_INTEGRATION_PROVISION_CREDENTIALS

config LWM2M_INTEGRATION_PSK
	string "LwM2M PSK"
	default "000102030405060708090a0b0c0d0e0f"
	help
	  If this Kconfig is defined to a value larger than 1, the modem is provisioned run-time
	  with this PSK. If bootstrap mode is enabled the PSK is provisioned to the security tag
	  given by CONFIG_LWM2M_CLIENT_UTILS_BOOTSTRAP_TLS_TAG.
	  If not CONFIG_LWM2M_CLIENT_UTILS_SERVER_TLS_TAG is used.
	  It is recommended not to use this default PSK value and rather use a new generated key.

endif # LWM2M_INTEGRATION_PROVISION_CREDENTIALS

config LWM2M_IPSO_PUSH_BUTTON_INSTANCE_COUNT
	int "Number of push button object instances"
	default 2 if BOARD_NRF9160DK_NRF9160_NS
	default 2 if BOARD_NRF9161DK_NRF9161_NS
	default 1

# Make AVsystem the default lwM2M server.
config LWM2M_CLIENT_UTILS_SERVER
	string "LwM2M server address"
	default "coaps://eu.iot.avsystem.cloud:5694" if LWM2M_RD_CLIENT_SUPPORT_BOOTSTRAP
	default "coaps://eu.iot.avsystem.cloud:5684"
	help
	  Kconfig redefinition, please see the help text of the original definition.

endmenu

endif # LWM2M_INTEGRATION
```

## applications/asset_tracker_v2/src/cloud/cloud_codec/Kconfig
```kconfig
#
# Copyright (c) 2021 Nordic Semiconductor
#
# SPDX-License-Identifier: LicenseRef-Nordic-5-Clause
#

menuconfig CLOUD_CODEC
	bool "Application cloud codec"
	default y

if CLOUD_CODEC

choice
	prompt "Application cloud codec backend"
	default CLOUD_CODEC_NRF_CLOUD if NRF_CLOUD_MQTT
	default CLOUD_CODEC_AWS_IOT if AWS_IOT
	default CLOUD_CODEC_AZURE_IOT_HUB if AZURE_IOT_HUB
	default CLOUD_CODEC_LWM2M if LWM2M_INTEGRATION

config CLOUD_CODEC_NRF_CLOUD
	bool "Enable nRF Cloud codec backend"
	help
	  The nRF Cloud codec backend uses the nRF Cloud cell position library to
	  generate a JSON cell position request based on neighbor cell measurements.

config CLOUD_CODEC_AWS_IOT
	bool "Enable AWS IoT codec backend"

config CLOUD_CODEC_AZURE_IOT_HUB
	bool "Enable Azure IoT Hub codec backend"

config CLOUD_CODEC_LWM2M
	bool "Enable lwM2M codec backend"

endchoice

config CLOUD_CODEC_LWM2M_PATH_LIST_ENTRIES_MAX
	int "Maximum size of path list"
	default LWM2M_COMPOSITE_PATH_LIST_SIZE if LWM2M
	default 1
	help
	  Maximum number of entries in the path list constructed when writing to objects.

config CLOUD_CODEC_LWM2M_PATH_ENTRY_SIZE_MAX
	int "Size of each path list entry"
	default 12 if LWM2M
	default 1
	help
	  Maximum size of a lwm2m path entry

config CLOUD_CODEC_APN_LEN_MAX
	int "Maximum length of APN"
	default 30
	help
	  Maximum length of APN (Access Point Name).

if CLOUD_CODEC_LWM2M

config CLOUD_CODEC_MANUFACTURER
	string "Manufacturer name"
	default "Nordic Semiconductor ASA"

config CLOUD_CODEC_LWM2M_THINGY91_SENSORS
	bool "Enable support for Thingy:91 sensors"
	default y if BOARD_THINGY91_NRF9160_NS
	select LWM2M_IPSO_PRESSURE_SENSOR
	select LWM2M_IPSO_HUMIDITY_SENSOR
	select LWM2M_IPSO_TEMP_SENSOR

# Set object v1.1 object versions for sensor objects.
if LWM2M_IPSO_PRESSURE_SENSOR
choice LWM2M_IPSO_PRESSURE_SENSOR_VERSION
	default LWM2M_IPSO_PRESSURE_SENSOR_VERSION_1_1
endchoice
endif # LWM2M_IPSO_PRESSURE_SENSOR

if LWM2M_IPSO_HUMIDITY_SENSOR
choice LWM2M_IPSO_HUMIDITY_SENSOR_VERSION
	default LWM2M_IPSO_HUMIDITY_SENSOR_VERSION_1_1
endchoice
endif # LWM2M_IPSO_HUMIDITY_SENSOR

if LWM2M_IPSO_TEMP_SENSOR
choice LWM2M_IPSO_TEMP_SENSOR_VERSION
	default LWM2M_IPSO_TEMP_SENSOR_VERSION_1_1
endchoice
endif # LWM2M_IPSO_TEMP_SENSOR

endif # CLOUD_CODEC_LWM2M

module = CLOUD_CODEC
module-str = Cloud codec
source "subsys/logging/Kconfig.template.log_config"

endif # CLOUD_CODEC #
```

## applications/asset_tracker_v2/src/events/Kconfig
```kconfig
#
# Copyright (c) 2021 Nordic Semiconductor
#
# SPDX-License-Identifier: LicenseRef-Nordic-5-Clause
#

menuconfig EVENTS
	bool "Event options"
	default y

if EVENTS

config APP_EVENTS_LOG
	bool "Enable logging for application module events"
	default y

config MODEM_EVENTS_LOG
	bool "Enable logging for modem module events"
	default y

config CLOUD_EVENTS_LOG
	bool "Enable logging for Cloud module events"
	default y

config SENSOR_EVENTS_LOG
	bool "Enable logging for sensor module events"
	default y

config UI_EVENTS_LOG
	bool "Enable logging for UI module events"
	default y

config UTIL_EVENTS_LOG
	bool "Enable logging for utility module events"
	default y

config GPS_EVENTS_LOG
	bool "Enable logging for GPS module events"
	default y

config DATA_EVENTS_LOG
	bool "Enable logging for data module events"
	default y

if PROFILER

choice
	prompt "Event type format for profiler"
	default PROFILER_EVENT_TYPE_INT

config PROFILER_EVENT_TYPE_STRING
	bool "Event type as string"

config PROFILER_EVENT_TYPE_INT
	bool "Event type as integer"

endchoice

endif # PROFILER

endif # EVENTS
```

## applications/asset_tracker_v2/src/ext_sensors/Kconfig
```kconfig
#
# Copyright (c) 2023 Nordic Semiconductor
#
# SPDX-License-Identifier: LicenseRef-Nordic-5-Clause
#

menuconfig EXTERNAL_SENSORS
	bool "External sensors"

if EXTERNAL_SENSORS

config EXTERNAL_SENSORS_LIGHT_THRESHOLD_TRIGGER_LUX
	int "Light sensor threshold"
	default 50
	help
	  Set the threshold for the light sensor. The value is in lux and will apply to all
	  supported colors (RGB).

config EXTERNAL_SENSORS_LIGHT_HYSTERESIS_TIMEOUT_SECONDS
	int "Light sensor threshold timeout"
	default 30
	help
	  Duration (in seconds) for which the light sensor remains suspended after exceeding
	  the configured threshold, preventing additional triggers during this period.

choice CONFIG_EXTERNAL_SENSORS_LIGHT_TRIGGER_COLOR
	prompt "Light sensor trigger color"
	default EXTERNAL_SENSORS_LIGHT_TRIGGER_COLOR_BLUE
	help
	  Color that the library enables threshold triggers for.
	  The BH1749 sensor only supports adding interrupt callback for one color at a time.

config EXTERNAL_SENSORS_LIGHT_TRIGGER_COLOR_RED
	bool "Red"
	help
	  Enable this option to use the red color channel for the light sensor trigger.

config EXTERNAL_SENSORS_LIGHT_TRIGGER_COLOR_GREEN
	bool "Green"
	help
	  Enable this option to use the green color channel for the light sensor trigger.

config EXTERNAL_SENSORS_LIGHT_TRIGGER_COLOR_BLUE
	bool "Blue"
	help
	  Enable this option to use the blue color channel for the light sensor trigger.

endchoice # CONFIG_EXTERNAL_SENSORS_LIGHT_TRIGGER_COLOR

config EXTERNAL_SENSORS_IMPACT_DETECTION
	bool "Impact detection"
	select ADXL372
	help
	  Enable this option to use the impact detection feature.
	  Please note that this increases power consumption.

if EXTERNAL_SENSORS_IMPACT_DETECTION

choice ADXL372_OP_MODE
	default ADXL372_PEAK_DETECT_MODE
endchoice

choice ADXL372_TRIGGER_MODE
	default ADXL372_TRIGGER_GLOBAL_THREAD
endchoice

endif # EXTERNAL_SENSORS_IMPACT_DETECTION

module = EXTERNAL_SENSORS
module-str = External sensors
source "subsys/logging/Kconfig.template.log_config"

endif # EXTERNAL_SENSORS
```

## applications/asset_tracker_v2/src/led/Kconfig
```kconfig
#
# Copyright (c) 2019-2021 Nordic Semiconductor ASA
#
# SPDX-License-Identifier: LicenseRef-Nordic-5-Clause
#

menuconfig LED_CONTROL
	bool "LED control library"
	default y if UI_MODULE

if LED_CONTROL

config LED_USE_PWM
	bool "Use PWM to control LEDs"
	default y if BOARD_THINGY91_NRF9160NS
	select PWM if BOARD_THINGY91_NRF9160NS
	select PWM_0 if BOARD_THINGY91_NRF9160NS

if LED_USE_PWM

config LED_PWM_DEV_NAME
	string "PWM device name for RGB LED"
	default "PWM_0" if BOARD_THINGY91_NRF9160NS

config LED_RED_PIN
	int "Red LED pin number"
	default 29 if BOARD_THINGY91_NRF9160NS

config LED_GREEN_PIN
	int "Green LED pin number"
	default 30 if BOARD_THINGY91_NRF9160NS

config LED_BLUE_PIN
	int "Blue LED pin number"
	default 31 if BOARD_THINGY91_NRF9160NS

endif # LED_USE_PWM

endif # LED_CONTROL

module = LED_CONTROL
module-str = LED control library
source "subsys/logging/Kconfig.template.log_config"
```

## applications/asset_tracker_v2/src/modules/Kconfig.app_module
```kconfig
#
# Copyright (c) 2021 Nordic Semiconductor
#
# SPDX-License-Identifier: LicenseRef-Nordic-5-Clause
#

menu "Application control module"

config APP_REQUEST_GNSS_WAIT_FOR_AGPS
	bool "Wait for A-GPS data before requesting sampling of GNSS data"
	default y
	select DATA_AGPS_REQUEST_ALL_UPON_CONNECTION
	depends on NRF_CLOUD_AGPS || NRF_CLOUD_PGPS
	help
	  If this option is enabled, the application module will wait a configured amount of
	  seconds set by APP_REQUEST_GNSS_WAIT_FOR_AGPS_THRESHOLD_SEC before requesting GNSS data,
	  unless A-GPS data has been processed.

config APP_REQUEST_GNSS_WAIT_FOR_AGPS_THRESHOLD_SEC
	int "Number of seconds to wait for A-GPS data"
	default 300
	range -1 2147483647
	help
	  Number of seconds that the application module will wait for A-GPS data to be processed
	  before requesting GNSS data. If set to -1, the application module will wait
	  until A-GPS data has been processed.

endmenu
```

## applications/asset_tracker_v2/src/modules/Kconfig.cloud_module
```kconfig
#
# Copyright (c) 2021 Nordic Semiconductor
#
# SPDX-License-Identifier: LicenseRef-Nordic-5-Clause
#

menuconfig CLOUD_MODULE
	bool "Cloud module"
	select QOS
	default y

if CLOUD_MODULE

# Only a single cloud MQTT service is supported at a time.
CLOUD_SERVICE_SELECTOR := choice

# nRF Cloud A-GPS is enabled by default when building for all supported cloud transport services.
# For LwM2M builds, A-GPS is disabled if P-GPS is enabled.
# This is because the two methods are currently mutually exclusive for LwM2M builds.
# For the other cloud configurations, A-GPS and P-GPS can coexist.
config NRF_CLOUD_AGPS
	depends on LOCATION_MODULE
	default n if NRF_CLOUD_PGPS && LWM2M_INTEGRATION
	default y

# Enable MQTT clean session by default. This is to ensure that the configured cloud MQTT service
# client library always subscribes to the necessary topics.
config MQTT_CLEAN_SESSION
	default y

# Kconfig options that are specific to the nRF Cloud MQTT transport service library.
if NRF_CLOUD_MQTT

config NRF_CLOUD_SEND_DEVICE_STATUS_SIM
	default y

config NRF_CLOUD_DEVICE_STATUS_ENCODE_VOLTAGE
	default n

choice NRF_CLOUD_SEND_SOCKET
	default NRF_CLOUD_SEND_TIMEOUT
endchoice

choice NRF_CLOUD_CLIENT_ID_SRC
	default NRF_CLOUD_CLIENT_ID_SRC_RUNTIME
endchoice

config NRF_CLOUD_LOCATION
	default y if !BOARD_QEMU_X86

endif # NRF_CLOUD_MQTT

config CLOUD_THREAD_STACK_SIZE
	int "Cloud module thread stack size"
	default 6144 if NRF_CLOUD_MQTT && DEBUG_MODULE_MEMFAULT_USE_EXTERNAL_TRANSPORT
	default 4096 if NRF_CLOUD_MQTT || DEBUG_MODULE_MEMFAULT_USE_EXTERNAL_TRANSPORT
	default 2688

config CLOUD_CLIENT_ID_IMEI_PREFIX
	string	"Cloud client ID IMEI prefix"
	depends on NRF_CLOUD_MQTT
	default "nrf-"
	help
	  Prefix used when passing in IMEI as the client ID. The default value "nrf-" is
	  expected when building for offical devices (e.g. nRF9160 DK and Thingy:91).
	  This only applies when configuring the application for nRF Cloud.

config CLOUD_CLIENT_ID_USE_CUSTOM
	bool "Use custom cloud client ID"
	help
	  By default the device's IMEI is used as the client ID
	  for the cloud connection. This allows to use a fixed
	  value instead. This is mostly useful when providing
	  firmware builds to continuous integration tests on
	  real hardware.
	  Note: you must only run this firmware build on one
	  device at a time.

config CLOUD_CLIENT_ID
	depends on CLOUD_CLIENT_ID_USE_CUSTOM
	string	"Cloud client ID"

config CLOUD_CONNECT_RETRIES
	int "Cloud reconnection attempts"
	default 10
	help
	  If the cloud module exceeds the number of reconnection attempts it will
	  send out an error event.

config CLOUD_USER_ASSOCIATION_TIMEOUT_SEC
	int "Cloud user association timeout, in seconds"
	default 300
	depends on NRF_CLOUD_MQTT
	help
	  If user associating to nRF Cloud is not completed within this amount of time an
	  irrecoverable error is reported by the module.

rsource "../cloud/Kconfig"

endif # CLOUD_MODULE

module = CLOUD_MODULE
module-str = Cloud module
source "subsys/logging/Kconfig.template.log_config"
```
