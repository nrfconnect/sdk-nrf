## applications/asset_tracker_v2/boards/thingy91x_nrf9151_ns.conf
```kconfig
#
# Copyright (c) 2024 Nordic Semiconductor ASA
#
# SPDX-License-Identifier: LicenseRef-Nordic-5-Clause
#

# Configuration file for Thingy:91 X.
# This file is merged with prj.conf in the application folder, and options
# set here will take precedence if they are present in both files.

# Configuration related to external sensors.
CONFIG_EXTERNAL_SENSORS=y

# BME680 - Temperature and humidity sensor.
CONFIG_BME680=y

# CAF - Common Application Framework
CONFIG_PWM=y
CONFIG_LED_GPIO=y

CONFIG_PM_PARTITION_REGION_SETTINGS_STORAGE_EXTERNAL=y

CONFIG_ADXL367=y
CONFIG_ADXL367_TRIGGER_GLOBAL_THREAD=y
CONFIG_ADXL367_REFERENCED_ACTIVITY_DETECTION_MODE=y
# Use a default of 0.25g
CONFIG_ADXL367_ACTIVITY_THRESHOLD=1000
# App does not set activity time, set to 0 to disable
CONFIG_ADXL367_ACTIVITY_TIME=0

# configs for Wi-Fi
CONFIG_WIFI=y
CONFIG_WIFI_NRF70=y
CONFIG_WIFI_NRF70_SKIP_LOCAL_ADMIN_MAC=y
# Align this with CONFIG_LOCATION_METHOD_WIFI_SCANNING_RESULTS_MAX_CNT
CONFIG_NRF_WIFI_SCAN_MAX_BSS_CNT=10

# Wi-Fi location
CONFIG_LOCATION_METHOD_WIFI=y
CONFIG_LOCATION_REQUEST_DEFAULT_METHOD_FIRST_GNSS=y
CONFIG_LOCATION_REQUEST_DEFAULT_METHOD_SECOND_WIFI=y
CONFIG_LOCATION_REQUEST_DEFAULT_METHOD_THIRD_CELLULAR=y

# Align this with CONFIG_NRF_WIFI_SCAN_MAX_BSS_CNT
CONFIG_LOCATION_METHOD_WIFI_SCANNING_RESULTS_MAX_CNT=10
CONFIG_LOCATION_WORKQUEUE_STACK_SIZE=8192

# Not for LTE throughput testing
CONFIG_NRF_MODEM_LIB_SHMEM_TX_SIZE=4096
CONFIG_NRF_MODEM_LIB_SHMEM_RX_SIZE=4096

# Scan only using offload API
CONFIG_WPA_SUPP=n

# For nRF9160 the default is socket interface
CONFIG_NET_DEFAULT_IF_ETHERNET=y
CONFIG_MBEDTLS=n
CONFIG_NORDIC_SECURITY_BACKEND=n

# Networking
CONFIG_NET_L2_ETHERNET=y
CONFIG_NET_NATIVE=y
CONFIG_NET_IPV4=y
CONFIG_NET_DHCPV4=y
CONFIG_NET_STATISTICS=y
CONFIG_NET_STATISTICS_WIFI=y
CONFIG_NET_STATISTICS_USER_API=y
CONFIG_NET_CONTEXT_SYNC_RECV=y

# Memory configurations
CONFIG_NET_BUF_RX_COUNT=8
CONFIG_NET_BUF_TX_COUNT=8
CONFIG_NET_PKT_RX_COUNT=1
CONFIG_NET_PKT_TX_COUNT=1
CONFIG_NET_TX_STACK_SIZE=4096
CONFIG_NET_RX_STACK_SIZE=4096
CONFIG_NET_TC_TX_COUNT=1
CONFIG_NET_MAX_CONTEXTS=5
CONFIG_NET_MGMT_EVENT_STACK_SIZE=1024

# Enable external flash
CONFIG_SPI_NOR_SFDP_DEVICETREE=y
CONFIG_PM_OVERRIDE_EXTERNAL_DRIVER_CHECK=y
```

## applications/asset_tracker_v2/sample.yaml
```yaml
sample:
  name: Asset Tracker v2 Application
tests:
  applications.asset_tracker_v2.nrf_cloud:
    sysbuild: true
    build_only: true
    build_on_all: true
    platform_allow:
      - nrf9160dk/nrf9160/ns
      - nrf9161dk/nrf9161/ns
      - nrf9151dk/nrf9151/ns
      - thingy91/nrf9160/ns
      - thingy91x/nrf9151/ns
      - native_sim
    integration_platforms:
      - nrf9160dk/nrf9160/ns
      - thingy91/nrf9160/ns
      - thingy91x/nrf9151/ns
      - native_sim
    tags: ci_build sysbuild ci_applications_asset_tracker_v2
  applications.asset_tracker_v2.nrf_cloud-pgps:
    sysbuild: true
    build_only: true
    build_on_all: true
    platform_allow:
      - nrf9160dk/nrf9160/ns
      - nrf9161dk/nrf9161/ns
      - nrf9151dk/nrf9151/ns
      - thingy91/nrf9160/ns
    integration_platforms:
      - nrf9160dk/nrf9160/ns
      - thingy91/nrf9160/ns
    extra_args: EXTRA_CONF_FILE=overlay-pgps.conf
    tags: ci_build sysbuild ci_applications_asset_tracker_v2
  applications.asset_tracker_v2.nrf_cloud-no-agnss:
    sysbuild: true
    build_only: true
    build_on_all: true
    platform_allow:
      - nrf9160dk/nrf9160/ns
      - nrf9161dk/nrf9161/ns
      - nrf9151dk/nrf9151/ns
      - thingy91/nrf9160/ns
      - thingy91x/nrf9151/ns
    integration_platforms:
      - nrf9160dk/nrf9160/ns
      - thingy91/nrf9160/ns
    extra_args: CONFIG_NRF_CLOUD_AGNSS=n
    tags: ci_build sysbuild ci_applications_asset_tracker_v2
  applications.asset_tracker_v2.aws:
    sysbuild: true
    build_only: true
    build_on_all: true
    platform_allow:
      - nrf9160dk/nrf9160/ns
      - nrf9161dk/nrf9161/ns
      - nrf9151dk/nrf9151/ns
      - thingy91/nrf9160/ns
      - thingy91x/nrf9151/ns
      - native_sim
    integration_platforms:
      - nrf9160dk/nrf9160/ns
      - thingy91/nrf9160/ns
      - native_sim
    extra_configs:
      - CONFIG_AWS_IOT_BROKER_HOST_NAME="example-hostname.aws.com"
    extra_args: EXTRA_CONF_FILE="overlay-aws.conf"
    tags: ci_build sysbuild ci_applications_asset_tracker_v2
  applications.asset_tracker_v2.aws-pgps:
    sysbuild: true
    build_only: true
    build_on_all: true
    platform_allow:
      - nrf9160dk/nrf9160/ns
      - nrf9161dk/nrf9161/ns
      - nrf9151dk/nrf9151/ns
      - thingy91/nrf9160/ns
      - thingy91x/nrf9151/ns
    integration_platforms:
      - nrf9160dk/nrf9160/ns
      - thingy91/nrf9160/ns
    extra_configs:
      - CONFIG_AWS_IOT_BROKER_HOST_NAME="example-hostname.aws.com"
    extra_args: EXTRA_CONF_FILE="overlay-aws.conf;overlay-pgps.conf"
    tags: ci_build sysbuild ci_applications_asset_tracker_v2
  applications.asset_tracker_v2.aws-all:
    sysbuild: true
    build_only: true
    build_on_all: true
    platform_allow:
      - nrf9160dk/nrf9160/ns
      - nrf9161dk/nrf9161/ns
      - nrf9151dk/nrf9151/ns
      - thingy91/nrf9160/ns
    integration_platforms:
      - nrf9160dk/nrf9160/ns
      - thingy91/nrf9160/ns
    extra_configs:
      - CONFIG_AWS_IOT_BROKER_HOST_NAME="example-hostname.aws.com"
      - CONFIG_MEMFAULT_NCS_PROJECT_KEY="PROJECTKEY"
    extra_args: >
      EXTRA_CONF_FILE="overlay-aws.conf;overlay-pgps.conf;overlay-debug.conf;overlay-memfault.conf"
    tags: ci_build sysbuild ci_applications_asset_tracker_v2
  applications.asset_tracker_v2.azure:
    sysbuild: true
    build_only: true
    build_on_all: true
    platform_allow:
      - nrf9160dk/nrf9160/ns
      - nrf9161dk/nrf9161/ns
      - nrf9151dk/nrf9151/ns
      - thingy91/nrf9160/ns
      - thingy91x/nrf9151/ns
      - native_sim
    integration_platforms:
      - nrf9160dk/nrf9160/ns
      - thingy91/nrf9160/ns
      - native_sim
    extra_configs:
      - CONFIG_AZURE_IOT_HUB_DPS_HOSTNAME="global.azure-devices-provisioning.net"
      - CONFIG_AZURE_IOT_HUB_DPS_ID_SCOPE="IDSCOPE"
    extra_args: EXTRA_CONF_FILE="overlay-azure.conf"
    tags: ci_build sysbuild ci_applications_asset_tracker_v2
  applications.asset_tracker_v2.debug:
    sysbuild: true
    build_only: true
    build_on_all: true
    platform_allow:
      - nrf9160dk/nrf9160/ns
      - nrf9161dk/nrf9161/ns
      - nrf9151dk/nrf9151/ns
      - thingy91/nrf9160/ns
      - thingy91x/nrf9151/ns
      - native_sim
    integration_platforms:
      - nrf9160dk/nrf9160/ns
      - thingy91/nrf9160/ns
      - native_sim
    extra_args: EXTRA_CONF_FILE=overlay-debug.conf
    tags: ci_build sysbuild ci_applications_asset_tracker_v2
  applications.asset_tracker_v2.debug-memfault:
    sysbuild: true
    build_only: true
    build_on_all: true
    platform_allow:
      - nrf9160dk/nrf9160/ns
      - nrf9161dk/nrf9161/ns
      - nrf9151dk/nrf9151/ns
      - thingy91/nrf9160/ns
      - thingy91x/nrf9151/ns
    integration_platforms:
      - nrf9160dk/nrf9160/ns
      - thingy91/nrf9160/ns
    extra_configs:
      - CONFIG_MEMFAULT_NCS_PROJECT_KEY="PROJECTKEY"
    extra_args: EXTRA_CONF_FILE="overlay-debug.conf;overlay-memfault.conf"
    tags: ci_build sysbuild ci_applications_asset_tracker_v2
  applications.asset_tracker_v2.memfault:
    sysbuild: true
    build_only: true
    build_on_all: true
    platform_allow:
      - nrf9160dk/nrf9160/ns
      - nrf9161dk/nrf9161/ns
      - nrf9151dk/nrf9151/ns
      - thingy91/nrf9160/ns
      - thingy91x/nrf9151/ns
    integration_platforms:
      - nrf9160dk/nrf9160/ns
      - thingy91/nrf9160/ns
    extra_configs:
      - CONFIG_MEMFAULT_NCS_PROJECT_KEY="PROJECTKEY"
    extra_args: EXTRA_CONF_FILE=overlay-memfault.conf
    tags: ci_build sysbuild ci_applications_asset_tracker_v2
  applications.asset_tracker_v2.low-power:
    sysbuild: true
    build_only: true
    build_on_all: true
    platform_allow:
      - nrf9160dk/nrf9160/ns
      - nrf9161dk/nrf9161/ns
      - nrf9151dk/nrf9151/ns
      - thingy91/nrf9160/ns
      - thingy91x/nrf9151/ns
    integration_platforms:
      - nrf9160dk/nrf9160/ns
      - thingy91/nrf9160/ns
    extra_args: EXTRA_CONF_FILE=overlay-low-power.conf
    tags: ci_build sysbuild ci_applications_asset_tracker_v2
  applications.asset_tracker_v2.carrier.nrf9160dk:
    sysbuild: true
    build_only: true
    build_on_all: true
    platform_allow:
      - nrf9160dk/nrf9160/ns
    integration_platforms:
      - nrf9160dk/nrf9160/ns
    extra_args: EXTRA_CONF_FILE=overlay-carrier.conf
    tags: ci_build sysbuild ci_applications_asset_tracker_v2
  applications.asset_tracker_v2.carrier.thingy91:
    sysbuild: true
    build_only: true
    build_on_all: true
    platform_allow:
      - thingy91/nrf9160/ns
    extra_args: EXTRA_CONF_FILE=overlay-carrier.conf
      SB_CONFIG_THINGY91_STATIC_PARTITIONS_LWM2M_CARRIER=y
    tags: ci_build sysbuild ci_applications_asset_tracker_v2
  applications.asset_tracker_v2.carrier.nrf9161dk:
    sysbuild: true
    build_only: true
    build_on_all: true
    platform_allow: nrf9161dk/nrf9161/ns
    integration_platforms:
      - nrf9161dk/nrf9161/ns
    extra_args: EXTRA_CONF_FILE=overlay-carrier.conf
    tags: ci_build sysbuild ci_applications_asset_tracker_v2
  applications.asset_tracker_v2.carrier.nrf9151dk:
    sysbuild: true
    build_only: true
    build_on_all: true
    platform_allow: nrf9151dk/nrf9151/ns
    integration_platforms:
      - nrf9151dk/nrf9151/ns
    extra_args: EXTRA_CONF_FILE=overlay-carrier.conf
    tags: ci_build sysbuild ci_applications_asset_tracker_v2
  applications.asset_tracker_v2.lwm2m.bootstrap-low_power:
    sysbuild: true
    build_only: true
    build_on_all: true
    platform_allow:
      - nrf9160dk/nrf9160/ns
      - nrf9161dk/nrf9161/ns
      - nrf9151dk/nrf9151/ns
      - thingy91/nrf9160/ns
      - thingy91x/nrf9151/ns
    integration_platforms:
      - nrf9160dk/nrf9160/ns
      - thingy91/nrf9160/ns
    extra_configs:
      - CONFIG_LWM2M_RD_CLIENT_SUPPORT_BOOTSTRAP=y
    extra_args: EXTRA_CONF_FILE="overlay-lwm2m.conf;overlay-low-power.conf"
    tags: ci_build sysbuild ci_applications_asset_tracker_v2
  applications.asset_tracker_v2.lwm2m.debug:
    sysbuild: true
    build_only: true
    build_on_all: true
    platform_allow:
      - nrf9160dk/nrf9160/ns
      - nrf9161dk/nrf9161/ns
      - nrf9151dk/nrf9151/ns
      - thingy91/nrf9160/ns
    integration_platforms:
      - nrf9160dk/nrf9160/ns
      - thingy91/nrf9160/ns
    extra_args: EXTRA_CONF_FILE="overlay-lwm2m.conf;overlay-debug.conf"
    tags: ci_build sysbuild ci_applications_asset_tracker_v2
  applications.asset_tracker_v2.lwm2m.debug-modem_trace:
    sysbuild: true
    build_only: true
    build_on_all: true
    platform_allow:
      - nrf9160dk/nrf9160/ns
      - nrf9161dk/nrf9161/ns
      - nrf9151dk/nrf9151/ns
    integration_platforms:
      - nrf9160dk/nrf9160/ns
    extra_args:
      EXTRA_CONF_FILE="overlay-lwm2m.conf;overlay-debug.conf"
      asset_tracker_v2_SNIPPET="nrf91-modem-trace-uart;tfm-enable-share-uart"
    tags: ci_build sysbuild ci_applications_asset_tracker_v2
  applications.asset_tracker_v2.lwm2m.modem_trace:
    sysbuild: true
    build_only: true
    build_on_all: true
    platform_allow:
      - nrf9160dk/nrf9160/ns
      - nrf9161dk/nrf9161/ns
      - nrf9151dk/nrf9151/ns
      - thingy91/nrf9160/ns
    integration_platforms:
      - nrf9160dk/nrf9160/ns
      - thingy91/nrf9160/ns
    extra_args:
      EXTRA_CONF_FILE="overlay-lwm2m.conf"
      asset_tracker_v2_SNIPPET="nrf91-modem-trace-uart;tfm-enable-share-uart"
    tags: ci_build sysbuild ci_applications_asset_tracker_v2
  applications.asset_tracker_v2.lwm2m.memfault:
    sysbuild: true
    build_only: true
    build_on_all: true
    platform_allow:
      - nrf9160dk/nrf9160/ns
      - nrf9161dk/nrf9161/ns
      - nrf9151dk/nrf9151/ns
      - thingy91/nrf9160/ns
    integration_platforms:
      - nrf9160dk/nrf9160/ns
      - nrf9161dk/nrf9161/ns
      - nrf9151dk/nrf9151/ns
      - thingy91/nrf9160/ns
    extra_configs:
      - CONFIG_MEMFAULT_NCS_PROJECT_KEY="PROJECTKEY"
    extra_args: EXTRA_CONF_FILE="overlay-lwm2m.conf;overlay-memfault.conf"
    tags: ci_build sysbuild ci_applications_asset_tracker_v2
  applications.asset_tracker_v2.memfault-low-power:
    sysbuild: true
    build_only: true
    build_on_all: true
    platform_allow:
      - nrf9160dk/nrf9160/ns
      - nrf9161dk/nrf9161/ns
      - nrf9151dk/nrf9151/ns
      - thingy91/nrf9160/ns
      - thingy91x/nrf9151/ns
    integration_platforms:
      - nrf9160dk/nrf9160/ns
      - nrf9161dk/nrf9161/ns
      - nrf9151dk/nrf9151/ns
      - thingy91/nrf9160/ns
    extra_configs:
      - CONFIG_MEMFAULT_NCS_PROJECT_KEY="PROJECTKEY"
    extra_args: EXTRA_CONF_FILE="overlay-low-power.conf;overlay-memfault.conf"
    tags: ci_build sysbuild ci_applications_asset_tracker_v2
  applications.asset_tracker_v2.nrf7002ek_wifi.nrf9160dk:
    sysbuild: true
    build_only: true
    integration_platforms:
      - nrf9160dk/nrf9160/ns
    platform_allow: nrf9160dk/nrf9160/ns
    extra_args: SHIELD=nrf7002ek_nrf7000 EXTRA_CONF_FILE=overlay-nrf7002ek-wifi-scan-only.conf
                SB_CONFIG_WIFI_NRF70=y SB_CONFIG_WIFI_NRF70_SCAN_ONLY=y
    tags: ci_build sysbuild ci_applications_asset_tracker_v2
  applications.asset_tracker_v2.nrf7002ek_wifi.nrf9161dk:
    sysbuild: true
    build_only: true
    integration_platforms:
      - nrf9161dk/nrf9161/ns
    platform_allow: nrf9161dk/nrf9161/ns
    extra_args: SHIELD=nrf7002ek_nrf7000 EXTRA_CONF_FILE=overlay-nrf7002ek-wifi-scan-only.conf
                SB_CONFIG_WIFI_NRF70=y SB_CONFIG_WIFI_NRF70_SCAN_ONLY=y
    tags: ci_build sysbuild ci_applications_asset_tracker_v2
  applications.asset_tracker_v2.nrf7002ek_wifi.nrf9151dk:
    sysbuild: true
    build_only: true
    integration_platforms:
      - nrf9151dk/nrf9151/ns
    platform_allow: nrf9151dk/nrf9151/ns
    extra_args: SHIELD=nrf7002ek_nrf7000 EXTRA_CONF_FILE=overlay-nrf7002ek-wifi-scan-only.conf
                SB_CONFIG_WIFI_NRF70=y SB_CONFIG_WIFI_NRF70_SCAN_ONLY=y
    tags: ci_build sysbuild ci_applications_asset_tracker_v2
  applications.asset_tracker_v2.nrf7002ek_wifi-debug:
    sysbuild: true
    build_only: true
    integration_platforms:
      - nrf9160dk/nrf9160/ns
      - nrf9161dk/nrf9161/ns
      - nrf9151dk/nrf9151/ns
    platform_allow:
      - nrf9160dk/nrf9160/ns
      - nrf9161dk/nrf9161/ns
      - nrf9151dk/nrf9151/ns
    extra_args: SHIELD=nrf7002ek_nrf7000
                EXTRA_CONF_FILE="overlay-nrf7002ek-wifi-scan-only.conf;overlay-debug.conf"
                SB_CONFIG_WIFI_NRF70=y SB_CONFIG_WIFI_NRF70_SCAN_ONLY=y
    tags: ci_build sysbuild ci_applications_asset_tracker_v2

  # Configuration which will be used by the positioning CI integration job to verify PRs
  applications.asset_tracker_v2.integration_config_positioning:
    sysbuild: true
    build_only: true
    extra_configs:
      - CONFIG_MODEM_ANTENNA_GNSS_EXTERNAL=y
      - CONFIG_LOCATION_LOG_LEVEL_DBG=y
      - CONFIG_LOG_BUFFER_SIZE=2048
    extra_args: asset_tracker_v2_SNIPPET="nrf91-modem-trace-uart"
    integration_platforms:
      - nrf9151dk/nrf9151/ns
    platform_allow:
      - nrf9151dk/nrf9151/ns
    tags: ci_build sysbuild ci_applications_asset_tracker_v2
```

## applications/asset_tracker_v2/src/cloud/Kconfig
```kconfig
#
# Copyright (c) 2021 Nordic Semiconductor
#
# SPDX-License-Identifier: LicenseRef-Nordic-5-Clause
#

if AZURE_IOT_HUB && AZURE_FOTA
rsource "Kconfig.azure_fota_patch"
endif

module = CLOUD_INTEGRATION
module-str = Cloud integration layer
source "subsys/logging/Kconfig.template.log_config"
```
