## applications/asset_tracker/sample.yaml
```yaml
sample:
  name: Asset Tracker Application
tests:
  applications.asset_tracker:
    build_only: true
    platform_allow: nrf9160dk_nrf9160_ns thingy91_nrf9160_ns qemu_x86
    integration_platforms:
      - nrf9160dk_nrf9160_ns
      - thingy91_nrf9160_ns
    tags: ci_build
```

## applications/asset_tracker/src/gps_controller/Kconfig
```kconfig
#
# Copyright (c) 2019 Nordic Semiconductor ASA
#
# SPDX-License-Identifier: LicenseRef-BSD-5-Clause-Nordic
#

menu "GPS_CONTROL"

config GPS_CONTROL
	bool "GPS controller module for nRF9160 GPS"
	default y if BOARD_NRF9160_PCA20035NS
	select NRF9160_GPS

config GPS_CONTROL_ON_LONG_PRESS
	bool "Control the GPS state with button"
	default y
	help
	  Control the GPS operation with long-press on the button.
	  Press for 5 seconds to enable, or 5 seconds to disable.

config GPS_CONTROL_PSM_ENABLE_ON_START
	bool "Enable PSM when starting GPS"
	default y
	help
	  The nRF9160 modem needs to be set in PSM mode for the GPS to start
	  searching for satellites. Enabling this option will do so
	  automatically, otherwise the application must handle it.

config GPS_CONTROL_PSM_DISABLE_ON_STOP
	bool "Disable PSM when stopping GPS"
	default y
	help
	  Selecting this option will disable PSM when the GPS is stopped.
	  During a PSM interval, the device is not reachable from the outside
	  until the interval times out, or the device itself attempts to
	  send data on the link.

config GPS_CONTROL_FIRST_FIX_CHECK_DELAY
	int "Time from Cloud conenction until first fix check"
	default 30
	help
	  The amount of time that should pass between successfully establishing
	  connection to cloud until first attempt to get position fix.
	  Attempting to get a fix means entering PSM mode, in which the device
	  is not reachable for the duration of the interval, or until the
	  device itself sends data and then for the duration for the set
	  active time thereafter.

config GPS_CONTROL_FIX_CHECK_INTERVAL
	int "Interval in seconds to between check for position fix"
	default 120
	help
	  The fix check interval gives the interval for how long it will go
	  between each retry to achieve position fix. The actual fix time will
	  vary with factors such as satellite coverage, surrounding buildings
	  and landscape, PSM interval and activty time requested and granted
	  by the network.

config GPS_CONTROL_FIX_CHECK_OVERDUE
	int "Longest allowed time in seconds between checks for position fix"
	default 900
	help
	  The fix check interval gives the interval for how long it will go
	  between each retry to achieve position fix, when GPS_START_ON_MOTION
	  enabled, even if no motion is detected.

config GPS_CONTROL_FIX_TRY_TIME
	int "Time in seconds to try to get fix"
	default 180
	help
	  Amount of time the device will attempt to get position fix. Note that
	  if the interval is interrupted by the device sending data, the timer
	  is not reset, and the actual try time will be shortened due to
	  the device not being in PSM mode all the time. If fix is not acquired
	  before it times out, the device will try to get fix again in
	  GPS_CONTROL_FIX_CHECK_INTERVAL seconds. If GPS_CONTROL_FIX_COUNT is reached
	  before the full GPS_CONTROL_FIX_TRY_TIME has passed, the GPS will be stopped.

config GPS_CONTROL_FIX_COUNT
	int "Number of position fix before stopping GPS"
	default 3
	help
	  The number of fixes to get before stopping the GPS, within the time
	  set in GPS_CONTROL_FIX_CHECK_INTERVAL.

config GPS_CONTROL_MAX_FAILED_FIX_ATTEMPTS
	int "Number of failed fix attempts before stopping GPS"
	default 3
	help
	  Number of retries to get fix before shutting down the GPS until user
	  input tells it to start retrying.

module = GPS_CONTROL
module-str = GPS controller
source "${ZEPHYR_BASE}/subsys/logging/Kconfig.template.log_config"

endmenu
```

## applications/asset_tracker/src/ui/Kconfig
```kconfig
#
# Copyright (c) 2019 Nordic Semiconductor ASA
#
# SPDX-License-Identifier: LicenseRef-Nordic-5-Clause
#

config USE_UI_MODULE
	bool "Enable UI module"
	default y
	help
		Enable the User Interface module for user interaction on
		development kit / Thingy91 hardware.

config UI_SELECT_PWM
	def_bool $(dt_alias_enabled,rgb-pwm) || \
			$(dt_alias_enabled,buzzer-pwm)
	depends on USE_UI_MODULE
	select PWM

module = UI
module-str = User Interface
source "${ZEPHYR_BASE}/subsys/logging/Kconfig.template.log_config"
```

## applications/asset_tracker_v2/Kconfig
```kconfig
#
# Copyright (c) 2021 Nordic Semiconductor ASA
#
# SPDX-License-Identifier: LicenseRef-Nordic-5-Clause
#

# Asset Tracker v2 requires UART_INTERRUPT_DRIVEN to be enabled when SERIAL is used in order to
# receive AT Commands.
config UART_INTERRUPT_DRIVEN
	default y if SERIAL

menu "Asset Tracker v2"

config ASSET_TRACKER_V2_APP_VERSION
	string "Asset Tracker application firmware version"
	default "0.0.0-development"

config ASSET_TRACKER_V2_APP_VERSION_MAX_LEN
	int "Maximum length of the application firmware version"
	default 150

config ASSET_TRACKER_V2_LTO
	bool "Enable link time optimization"
	default y if (SIZE_OPTIMIZATIONS && !NATIVE_LIBRARY)
	# not for NATIVE_LIBRARY as otherwise the native simulator build will produce a warning when
	# mixing lto and non lto code causing twister runs to fail
	help
	  Compile the Asset Tracker application code with link time optimization enabled. This
	  option is only applied for the application code and not the libraries and external modules
	  that are linked in.

rsource "src/modules/Kconfig.modules_common"
rsource "src/modules/Kconfig.cloud_module"
rsource "src/cloud/Kconfig.lwm2m_integration"
rsource "src/modules/Kconfig.data_module"
rsource "src/modules/Kconfig.location_module"
rsource "src/modules/Kconfig.modem_module"
rsource "src/modules/Kconfig.sensor_module"
rsource "src/modules/Kconfig.ui_module"
rsource "src/modules/Kconfig.util_module"
rsource "src/modules/Kconfig.led_module"
rsource "src/modules/Kconfig.debug_module"

rsource "src/cloud/cloud_codec/Kconfig"
rsource "src/watchdog/Kconfig"
rsource "src/events/Kconfig"

endmenu

menu "Zephyr Kernel"
source "Kconfig.zephyr"
endmenu

module = APPLICATION_MODULE
module-str = Application module
source "subsys/logging/Kconfig.template.log_config"
```

## applications/asset_tracker_v2/Kconfig.sysbuild
```kconfig
#
# Copyright (c) 2023 Nordic Semiconductor
#
# SPDX-License-Identifier: LicenseRef-Nordic-5-Clause
#

choice BOOTLOADER
	default BOOTLOADER_MCUBOOT if !BOARD_NATIVE_SIM
endchoice

config SECURE_BOOT_APPCORE
	default y if BOARD_NRF9160DK_NRF9160_NS \
		|| BOARD_NRF9151DK_NRF9151_NS \
		|| BOARD_NRF9161DK_NRF9161_NS

config WIFI_NRF70
	default y if BOARD_THINGY91X_NRF9151_NS

config PM_EXTERNAL_FLASH_MCUBOOT_SECONDARY
	default y if BOARD_NRF9151DK_NRF9151_NS || BOARD_NRF9161DK_NRF9161_NS
	default y if BOARD_NRF9160DK_NRF9160_NS \
		&& "${BOARD_REVISION}" != "0.1.0" \
		&& "${BOARD_REVISION}" != "0.7.0" \
		&& "${BOARD_REVISION}" != "0.7.1" \
		&& "${BOARD_REVISION}" != "0.8.0" \
		&& "${BOARD_REVISION}" != "0.8.2" \
		&& "${BOARD_REVISION}" != "0.8.3" \
		&& "${BOARD_REVISION}" != "0.8.5" \
		&& "${BOARD_REVISION}" != "0.9.0"

source "${ZEPHYR_BASE}/share/sysbuild/Kconfig"
```

## applications/asset_tracker_v2/boards/native_sim.conf
```kconfig
#
# Copyright (c) 2022 Nordic Semiconductor ASA
#
# SPDX-License-Identifier: LicenseRef-Nordic-5-Clause
#

# General config
CONFIG_RESET_ON_FATAL_ERROR=n

# Heap and stacks
CONFIG_INIT_STACKS=y
CONFIG_HEAP_MEM_POOL_SIZE=32768
CONFIG_MAIN_STACK_SIZE=8192
CONFIG_SYSTEM_WORKQUEUE_STACK_SIZE=8192
CONFIG_CLOUD_THREAD_STACK_SIZE=8192

# nRF modem library
CONFIG_NRF_MODEM_LIB=n
CONFIG_NRF_MODEM_LIB_ON_FAULT_APPLICATION_SPECIFIC=n

# AT Host library
CONFIG_AT_HOST_LIBRARY=n

# LTE link control
CONFIG_LTE_NETWORK_MODE_LTE_M_GPS=n

# Settings - Used to store real-time device configuration to flash.
CONFIG_FLASH=y
CONFIG_FLASH_MAP=y
CONFIG_FCB=y
CONFIG_SETTINGS=y
CONFIG_SETTINGS_FCB=y

# Watchdog
CONFIG_WATCHDOG_APPLICATION=n

# CAF - Common Application Framework
CONFIG_LED=n
CONFIG_CAF_LEDS=n

# Location related configuration
CONFIG_LOCATION=n
CONFIG_LOCATION_REQUEST_DEFAULT_METHOD_FIRST_GNSS=n
CONFIG_LOCATION_REQUEST_DEFAULT_METHOD_SECOND_CELLULAR=n
CONFIG_LOCATION_DATA_DETAILS=n

# Default cloud transport service
CONFIG_HW_ID_LIBRARY=n
CONFIG_HW_ID_LIBRARY_SOURCE_IMEI=n
CONFIG_NRF_CLOUD_FOTA=n
CONFIG_CLOUD_CLIENT_ID_USE_CUSTOM=y
CONFIG_CLOUD_CLIENT_ID="cloud-id"

# Disable unsupported application modules
CONFIG_LOCATION_MODULE=n
CONFIG_SENSOR_MODULE=n
CONFIG_MODEM_MODULE=n
CONFIG_UI_MODULE=n

# Running the application in native_sim emulator requires functionality
# that is present in the debug module
CONFIG_DEBUG_MODULE=y

# Networking config
CONFIG_NET_NATIVE=y
CONFIG_NET_TCP=y
CONFIG_NET_UDP=y
CONFIG_NET_SOCKETS_OFFLOAD=n
CONFIG_NET_SOCKETS_POSIX_NAMES=y
CONFIG_NET_SOCKETS_SOCKOPT_TLS=y
CONFIG_NET_PKT_RX_COUNT=32
CONFIG_NET_PKT_TX_COUNT=32
CONFIG_NET_BUF_RX_COUNT=32
CONFIG_NET_BUF_TX_COUNT=32
CONFIG_NET_IF_UNICAST_IPV6_ADDR_COUNT=3
CONFIG_NET_IF_MCAST_IPV6_ADDR_COUNT=4
CONFIG_NET_MAX_CONTEXTS=10
CONFIG_NET_L2_ETHERNET=y

CONFIG_ETH_NATIVE_POSIX=y
CONFIG_ETH_NATIVE_POSIX_RANDOM_MAC=y

# TLS configuration
CONFIG_MBEDTLS=y
CONFIG_MBEDTLS_BUILTIN=y
CONFIG_MBEDTLS_ENABLE_HEAP=y
CONFIG_MBEDTLS_HEAP_SIZE=40000
CONFIG_MBEDTLS_SSL_MAX_CONTENT_LEN=7168

# DNS
CONFIG_DNS_RESOLVER=y
CONFIG_DNS_SERVER_IP_ADDRESSES=y
## Use CloudFlare as default DNS server
CONFIG_DNS_SERVER1="1.1.1.1"

# Network address config
CONFIG_NET_CONFIG_SETTINGS=y
CONFIG_NET_CONFIG_NEED_IPV4=y
CONFIG_NET_CONFIG_MY_IPV4_ADDR="192.0.2.1"
CONFIG_NET_CONFIG_PEER_IPV4_ADDR="192.0.2.2"
CONFIG_NET_CONFIG_MY_IPV4_GW="192.0.2.2"

# FOTA
CONFIG_FOTA_DOWNLOAD=n
CONFIG_DFU_TARGET=n
CONFIG_DOWNLOAD_CLIENT=n
CONFIG_DOWNLOAD_CLIENT_HTTP_FRAG_SIZE_1024=n

# MCUBOOT
CONFIG_BOOTLOADER_MCUBOOT=n
CONFIG_IMG_MANAGER=n
CONFIG_MCUBOOT_IMG_MANAGER=n
CONFIG_IMG_ERASE_PROGRESSIVELY=n
CONFIG_SECURE_BOOT=n
CONFIG_BUILD_S1_VARIANT=n

# Watchdog
CONFIG_WATCHDOG_APPLICATION=n

# Cloud module certificates
CONFIG_MQTT_HELPER_CERTIFICATES_FOLDER="src/cloud-certs"
```

## applications/asset_tracker_v2/boards/nrf9160dk_nrf9160_ns_0_14_0.conf
```kconfig
#
# Copyright (c) 2023 Nordic Semiconductor ASA
#
# SPDX-License-Identifier: LicenseRef-Nordic-5-Clause
#

# Enable external flash
CONFIG_SPI=y
CONFIG_SPI_NOR=y
CONFIG_SPI_NOR_SFDP_DEVICETREE=y
CONFIG_PM_OVERRIDE_EXTERNAL_DRIVER_CHECK=y
```

## applications/asset_tracker_v2/boards/qemu_x86.conf
```kconfig
#
# Copyright (c) 2022 Nordic Semiconductor ASA
#
# SPDX-License-Identifier: LicenseRef-Nordic-5-Clause
#

# General config
CONFIG_RESET_ON_FATAL_ERROR=n
CONFIG_TEST_RANDOM_GENERATOR=y
CONFIG_SSE=y

# Heap and stacks
CONFIG_HEAP_MEM_POOL_SIZE=32768
CONFIG_MAIN_STACK_SIZE=1280
CONFIG_CLOUD_THREAD_STACK_SIZE=4096
CONFIG_HW_STACK_PROTECTION=y

# nRF modem library
CONFIG_NRF_MODEM_LIB=n
CONFIG_NRF_MODEM_LIB_ON_FAULT_APPLICATION_SPECIFIC=n

# AT Host library
CONFIG_AT_HOST_LIBRARY=n

# Settings - Used to store real-time device configuration to flash.
CONFIG_FLASH=y
CONFIG_FLASH_MAP=y
CONFIG_FCB=y
CONFIG_SETTINGS=y
CONFIG_SETTINGS_FCB=y

# Watchdog
CONFIG_WATCHDOG_APPLICATION=n

# Application Event Manager
CONFIG_APP_EVENT_MANAGER_EVENT_LOG_BUF_LEN=0

# CAF - Common Application Framework
CONFIG_CAF=y
CONFIG_LED=n
CONFIG_CAF_LEDS=n

# Default cloud transport service
CONFIG_NRF_CLOUD_FOTA=n
CONFIG_HW_ID_LIBRARY=n
CONFIG_HW_ID_LIBRARY_SOURCE_IMEI=n

# Set custom cloud client ID
CONFIG_CLOUD_CLIENT_ID_USE_CUSTOM=y
CONFIG_CLOUD_CLIENT_ID="test"

# Disable unsupported application modules
CONFIG_LOCATION_MODULE=n
CONFIG_SENSOR_MODULE=n
CONFIG_MODEM_MODULE=n
CONFIG_UI_MODULE=n

# Running the application in QEMU x86 emulator requires functionality
# that is present in the debug module
CONFIG_DEBUG_MODULE=y

# LTE link control
CONFIG_LTE_NETWORK_MODE_LTE_M_GPS=n

# Networking config
CONFIG_NET_NATIVE=y
CONFIG_NET_L2_ETHERNET=y
CONFIG_NET_TCP=y
CONFIG_NET_SOCKETS_OFFLOAD=n
CONFIG_NET_SOCKETS_POSIX_NAMES=y
CONFIG_NET_SOCKETS_SOCKOPT_TLS=y
CONFIG_NET_SOCKETS_TLS_MAX_CONTEXTS=3
CONFIG_NET_CONTEXT_SNDTIMEO=y

# Run Arm MBED TLS in the application
CONFIG_MBEDTLS=y
CONFIG_MBEDTLS_BUILTIN=y
CONFIG_MBEDTLS_ENABLE_HEAP=y
CONFIG_MBEDTLS_HEAP_SIZE=120000
CONFIG_MBEDTLS_SSL_MAX_CONTENT_LEN=16384
CONFIG_MBEDTLS_PEM_CERTIFICATE_FORMAT=y
CONFIG_MBEDTLS_KEY_EXCHANGE_RSA_ENABLED=y
CONFIG_MBEDTLS_MAC_SHA256_ENABLED=y
CONFIG_MBEDTLS_ECP_DP_SECP256R1_ENABLED=y
CONFIG_MBEDTLS_KEY_EXCHANGE_ECDHE_ECDSA_ENABLED=y

# DNS
CONFIG_DNS_RESOLVER=y
CONFIG_DNS_SERVER_IP_ADDRESSES=y
## Use CloudFlare as default DNS server
CONFIG_DNS_SERVER1="1.1.1.1"

# Network address config
CONFIG_NET_CONFIG_SETTINGS=y
CONFIG_NET_CONFIG_NEED_IPV4=y
CONFIG_NET_CONFIG_MY_IPV4_ADDR="192.0.2.1"
CONFIG_NET_CONFIG_PEER_IPV4_ADDR="192.0.2.2"
CONFIG_NET_CONFIG_MY_IPV4_GW="192.0.2.2"

# FOTA
CONFIG_FOTA_DOWNLOAD=n
CONFIG_DFU_TARGET=n
CONFIG_DOWNLOAD_CLIENT=n

# MCUBOOT
CONFIG_BOOTLOADER_MCUBOOT=n
CONFIG_IMG_MANAGER=n
CONFIG_MCUBOOT_IMG_MANAGER=n
CONFIG_IMG_ERASE_PROGRESSIVELY=n
CONFIG_SECURE_BOOT=n
CONFIG_BUILD_S1_VARIANT=n

# Watchdog
CONFIG_WATCHDOG_APPLICATION=n

# Location related configuration
CONFIG_LOCATION=n
CONFIG_LOCATION_REQUEST_DEFAULT_METHOD_FIRST_GNSS=n
CONFIG_LOCATION_REQUEST_DEFAULT_METHOD_SECOND_CELLULAR=n
CONFIG_LOCATION_DATA_DETAILS=n
```

## applications/asset_tracker_v2/boards/thingy91_nrf9160_ns.conf
```kconfig
#
# Copyright (c) 2021 Nordic Semiconductor ASA
#
# SPDX-License-Identifier: LicenseRef-Nordic-5-Clause
#

# Configuration file for Thingy:91.
# This file is merged with prj.conf in the application folder, and options
# set here will take precedence if they are present in both files.

# Configuration related to external sensors.
CONFIG_SENSOR=y
CONFIG_SPI=y

# ADXL362 - Low-Power accelerometer used for activity and inactivity detection.
CONFIG_ADXL362=y
CONFIG_ADXL362_TRIGGER_GLOBAL_THREAD=y
CONFIG_ADXL362_INTERRUPT_MODE=1
CONFIG_ADXL362_ABS_REF_MODE=1
CONFIG_ADXL362_ACCEL_RANGE_2G=y
CONFIG_ADXL362_ACCEL_ODR_400=y

# BME680 - Temperature and humidity sensor.
CONFIG_BME680=y

# CAF - Common Application Framework
CONFIG_PWM=y
CONFIG_LED_PWM=y

# Disable MCUboot DFU -- incompatible with static partitions
CONFIG_SECURE_BOOT=n
CONFIG_BUILD_S1_VARIANT=n

# Light Sensor - BH1749
CONFIG_BH1749=y
CONFIG_BH1749_TRIGGER=y
CONFIG_EXTERNAL_SENSORS_LIGHT_THRESHOLD_TRIGGER_LUX=50
CONFIG_EXTERNAL_SENSORS_LIGHT_HYSTERESIS_TIMEOUT_SECONDS=30

## Disable LEDs to not interfere with the light sensor
CONFIG_LED_CONTROL=n

## Device power management support to be able to suspend the sensor in between triggers to save power
CONFIG_PM_DEVICE=y
CONFIG_PM_DEVICE_RUNTIME=y
```

## applications/asset_tracker_v2/boards/thingy91_nrf9160ns.conf
```kconfig
#
# Copyright (c) 2021 Nordic Semiconductor ASA
#
# SPDX-License-Identifier: LicenseRef-Nordic-5-Clause
#

# Configuration file for Thingy:91.
# This file is merged with prj.conf in the application folder, and options
# set here will take precedence if they are present in both files.

# Configuration related to external sensors.
CONFIG_SENSOR=y
CONFIG_SPI=y

# ADXL362 - Accelerometer
CONFIG_ADXL362=y
CONFIG_ADXL362_TRIGGER_GLOBAL_THREAD=y
CONFIG_ADXL362_INTERRUPT_MODE=1
CONFIG_ADXL362_ABS_REF_MODE=1
CONFIG_ADXL362_ACCEL_RANGE_2G=y
CONFIG_ADXL362_ACCEL_ODR_12_5=y

# BME680 - Temperature and humidity sensor.
CONFIG_BME680=y
```
