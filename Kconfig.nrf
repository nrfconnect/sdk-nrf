## applications/asset_tracker_v2/src/modules/Kconfig.data_module
```kconfig
#
# Copyright (c) 2021 Nordic Semiconductor
#
# SPDX-License-Identifier: LicenseRef-Nordic-5-Clause
#

menuconfig DATA_MODULE
	bool "Data module"
	select DATE_TIME
	default y

if DATA_MODULE

config DATA_SEND_ALL_DEVICE_CONFIGURATIONS
	bool "Encode and send all device configurations regardless if they have changed or not"
	help
	  If this option is disabled the data module will only include device configuration values
	  that have changed from the last configuration update. This is to save costs related to
	  data transfers and to lower the device's overall current consumption due to less CPU and
	  radio-activity.

config DATA_THREAD_STACK_SIZE
	int "Data module thread stack size"
	default 5632 if NRF_CLOUD_AGPS || LOCATION_METHOD_WIFI
	default 3200

config DATA_GNSS_BUFFER_COUNT
	int "Number of GNSS data ringbuffer entries"
	range 1 100
	default 10
	help
	  Currently, the range for ringbuffer entries is limited to a minimum of 1 and a
	  maximum of 100. A minimum of 1 is set to make sure that the application builds with the
	  current implementation of the data module. The buffers are essentially arrays of a
	  certain data type and arrays cannot be compiled with a count of 0.
	  The Kconfig range statement requires that a maximum value is also set.
	  The maximum value of 100 is an arbitrary number that can be increased if desired.
	  Note that when increasing the maximum count of a buffer there is no guarantee beyond
	  using the default values that there is enough heap memory to successfully encode
	  enqueued entries into a JSON object string.

config DATA_SENSOR_BUFFER_COUNT
	int "Number of sensor data ringbuffer entries"
	range 1 100
	default 10

config DATA_MODEM_DYNAMIC_BUFFER_COUNT
	int "Number of dynamic modem data ringbuffer entries"
	range 1 100
	default 3

config DATA_UI_BUFFER_COUNT
	int "Number of UI data ringbuffer entries"
	range 1 100
	default 3

config DATA_IMPACT_BUFFER_COUNT
	int "Number of impact data ringbuffer entries"
	range 1 100
	default 1

config DATA_BATTERY_BUFFER_COUNT
	int "Number of battery data ringbuffer entries"
	range 1 100
	default 3

config DATA_GNSS_BUFFER_STORE
	bool "Store GNSS data received from the location module"
	default y

config DATA_SENSOR_BUFFER_STORE
	bool "Store environmental sensor data received from the sensor module"
	default y

config DATA_DYNAMIC_MODEM_BUFFER_STORE
	bool "Store dynamic modem data received from the modem module"
	default y

config DATA_BATTERY_BUFFER_STORE
	bool "Store battery data received from the modem module"
	default y

config DATA_UI_BUFFER_STORE
	bool "Store UI data received from the UI module"
	default y

choice DATA_DEVICE_MODE
	prompt "Device mode"
	default DATA_DEVICE_MODE_PASSIVE if BOARD_THINGY91_NRF9160_NS
	default DATA_DEVICE_MODE_ACTIVE
	help
	  The device can be in either active or passive mode.
	  In active mode the device samples and sends data at regular intervals set by
	  CONFIG_DATA_ACTIVE_TIMEOUT_SECONDS.
	  In passive mode the device samples and sends data only if movement has been detected and
	  the movement resolution timer set by CONFIG_DATA_MOVEMENT_RESOLUTION_SECONDS has
	  expired.

config DATA_DEVICE_MODE_ACTIVE
	bool "Active mode"

config DATA_DEVICE_MODE_PASSIVE
	bool "Passive mode"

endchoice # DATA_DEVICE_MODE #

config DATA_ACTIVE_TIMEOUT_SECONDS
	int "Default active wait timeout in seconds"
	default 120
	help
	  Number of seconds between sampling/publication in active mode.

config DATA_MOVEMENT_RESOLUTION_SECONDS
	int "Default movement resolution in seconds"
	default 120
	help
	  Number of seconds between each time movement can trigger sampling/publication in passive
	  mode.

config DATA_MOVEMENT_TIMEOUT_SECONDS
	int "Default movement timeout in seconds"
	default 3600
	help
	  Number of seconds between each sampling/publication in passive mode regardless of
	  movement. Used as a fail-safe to ensure updates even if the device is not moving for
	  longer durations.

config DATA_ACCELEROMETER_ACT_THRESHOLD
	int "Default accelerometer activity threshold in m/s²"
	default 4
	help
	  Minimum absolute value in m/s² that is considered movement in passive mode.

config DATA_ACCELEROMETER_INACT_THRESHOLD
	int "Default accelerometer inactivity threshold in m/s²"
	default 4
	help
	  Maximum absolute value in m/s² that is considered stillness in passive mode.

config DATA_ACCELEROMETER_INACT_TIMEOUT_SECONDS
	int "Default accelerometer inactivity timeout in seconds"
	default 60
	help
	  Minimum time for lack of movement to be considered stillness in passive mode.

config DATA_LOCATION_TIMEOUT_SECONDS
	int "Default location timeout"
	default 300
	help
	  Timeout for completing a location request. This value should be large enough
	  so that the location retrieval can find the location in various conditions.
	  This can be considered more of a safeguard rather than the deadline
	  when the operation must be completed. Hence this value can be larger than the
	  sampling interval.

config DATA_SAMPLE_GNSS_DEFAULT
	bool "Include GNSS in sample requests"
	default y
	help
	  If this configuration is enabled the application will by default include GNSS data in
	  sample requests sent to other modules. This configuration can be overwritten by changing
	  the application's real-time configuration using the cloud-side state.

config DATA_SAMPLE_NEIGHBOR_CELLS_DEFAULT
	bool "Include neighbor cells in sample requests"
	default y
	help
	  If this configuration is enabled the application will by default include neighbor cell
	  data in sample requests sent to other modules. This configuration can be overwritten by
	  changing the application's real-time configuration using the cloud-side state.

config DATA_GRANT_SEND_ON_CONNECTION_QUALITY
	bool "Grant or deny encoding and sending of data based on LTE connection quality"
	select EXPERIMENTAL
	help
	  If this option is enabled the module will hold off encoding and sending of data based
	  on an evaluation of the current LTE connection and estimated energy
	  consumed to send the data. This feature is individually supported for
	  neighbor cell measurements, regular updates, and batch updates to cloud.
	  The maximum number of times that a update can be held back is determined
	  by the CONFIG_DATA_SEND_ATTEMPTS_COUNT_MAX option.

if DATA_GRANT_SEND_ON_CONNECTION_QUALITY

choice DATA_NEIGHBOR_CELL_UPDATES_ENERGY_THRESHOLD_MIN
	prompt "Neighbor cell updates minimum energy threshold"
	default DATA_NEIGHBOR_CELL_UPDATES_ENERGY_THRESHOLD_NORMAL
	help
	  Minimum energy threshold that neighbor cell measurement updates will be encoded and sent.
	  These choices maps directly to the lte_lc_energy_estimate structure defined in
	  lte_lc.h.

config DATA_NEIGHBOR_CELL_UPDATES_ENERGY_THRESHOLD_EXCESSIVE
	bool "Neighbor cell updates threshold exessive"

config DATA_NEIGHBOR_CELL_UPDATES_ENERGY_THRESHOLD_INCREASED
	bool "Neighbor cell updates threshold increased"

config DATA_NEIGHBOR_CELL_UPDATES_ENERGY_THRESHOLD_NORMAL
	bool "Neighbor cell updates threshold normal"

config DATA_NEIGHBOR_CELL_UPDATES_ENERGY_THRESHOLD_REDUCED
	bool "Neighbor cell updates threshold reduced"

config DATA_NEIGHBOR_CELL_UPDATES_ENERGY_THRESHOLD_EFFICIENT
	bool "Neighbor cell updates threshold efficient"

endchoice # DATA_NEIGHBOR_CELL_UPDATES_ENERGY_THRESHOLD_MIN

choice DATA_GENERIC_UPDATES_ENERGY_THRESHOLD_MIN
	prompt "Generic updates minimum energy threshold"
	default DATA_GENERIC_UPDATES_ENERGY_THRESHOLD_NORMAL
	help
	  Minimum energy threshold that generic updates will be encoded and sent.
	  These choices maps directly to the lte_lc_energy_estimate structure defined in
	  lte_lc.h.

config DATA_GENERIC_UPDATES_ENERGY_THRESHOLD_EXCESSIVE
	bool "Generic updates threshold exessive"

config DATA_GENERIC_UPDATES_ENERGY_THRESHOLD_INCREASED
	bool "Generic updates threshold increased"

config DATA_GENERIC_UPDATES_ENERGY_THRESHOLD_NORMAL
	bool "Generic updates threshold normal"

config DATA_GENERIC_UPDATES_ENERGY_THRESHOLD_REDUCED
	bool "Generic updates threshold reduced"

config DATA_GENERIC_UPDATES_ENERGY_THRESHOLD_EFFICIENT
	bool "Generic updates threshold efficient"

endchoice # DATA_GENERIC_UPDATES_ENERGY_THRESHOLD_MIN

choice DATA_BATCH_UPDATES_ENERGY_THRESHOLD_MIN
	prompt "Batch updates minimum energy threshold"
	default DATA_BATCH_UPDATES_ENERGY_THRESHOLD_NORMAL if NRF_CLOUD_MQTT
	default DATA_BATCH_UPDATES_ENERGY_THRESHOLD_REDUCED
	help
	  Minimum energy threshold that batch updates will be encoded and sent.
	  These choices maps directly to the lte_lc_energy_estimate structure defined in
	  lte_lc.h.
	  The nRF Cloud integration uses batch data exclusively for regular data updates.
	  Due to this we lower the energy estimate requirement for batch data if configured for
	  nRF Cloud.

config DATA_BATCH_UPDATES_ENERGY_THRESHOLD_EXCESSIVE
	bool "Batch updates threshold exessive"

config DATA_BATCH_UPDATES_ENERGY_THRESHOLD_INCREASED
	bool "Batch updates threshold increased"

config DATA_BATCH_UPDATES_ENERGY_THRESHOLD_NORMAL
	bool "Batch updates threshold normal"

config DATA_BATCH_UPDATES_ENERGY_THRESHOLD_REDUCED
	bool "Batch updates threshold reduced"

config DATA_BATCH_UPDATES_ENERGY_THRESHOLD_EFFICIENT
	bool "Batch updates threshold efficient"

endchoice # DATA_BATCH_UPDATES_ENERGY_THRESHOLD_MIN

config DATA_SEND_ATTEMPTS_COUNT_MAX
	int "Maximum number of denied send attempts"
	default 3
	help
	  Maximum number of times sending can be denied due to connection
	  quality before the data is sent regardless.

endif # DATA_GRANT_SEND_ON_CONNECTION_QUALITY

endif # DATA_MODULE

module = DATA_MODULE
module-str = Data module
source "subsys/logging/Kconfig.template.log_config"
```

## applications/asset_tracker_v2/src/modules/Kconfig.debug_module
```kconfig
#
# Copyright (c) 2021 Nordic Semiconductor
#
# SPDX-License-Identifier: LicenseRef-Nordic-5-Clause
#

menuconfig DEBUG_MODULE
	bool "Debug module"

if DEBUG_MODULE && MEMFAULT

config DEBUG_MODULE_MEMFAULT_CHUNK_SIZE_MAX
	int "Fragment size of data transmitted to memfault"
	default 2048
	help
	  Decreasing this value, will in case of a core-dump, produce more events carrying
	  Memfault data to the cloud module. This increases the possibility of an overfilled
	  cloud module message queue depending on how fast the cloud module thread can handle
	  incoming queue messages. An overfilled message queue is in general considered a fatal
	  error that can cause undefined behaviour. To reduce the likelihood of this issue
	  occurring, this value should be kept reasonably high, within the modem firmware's
	  documented limitations.

config DEBUG_MODULE_MEMFAULT_USE_EXTERNAL_TRANSPORT
	bool "Use external transport when sending memfault data"
	default y if AWS_IOT
	help
	  If enabled, the debug module will forward captured Memfault data via events of type
	  DEBUG_EVT_MEMFAULT_DATA_READY. The data will be forwarded via the configured cloud
	  to Memfault. If this option is disabled, the debug module will use Memfault firwmare SDKs
	  own internal HTTP transport. Transporting Memfault data over an already pre-established
	  transport can save data associated with maintaining multiple connections.
	  The AWS IoT configuration of the application is the only implementation that currently
	  supports this option.

config DEBUG_MODULE_MEMFAULT_HEARTBEAT_INTERVAL_SEC
	int "Memfault heartbeat interval in seconds"
	default 1800
	help
	  Configuration that sets how often Memfault captures and prepares data that will be sent
	  to Memfault cloud. Reduce this interval to get more frequent updates to Memfault.
	  Note that data transmitted to Memfault cloud is still dependent on how often the
	  application sends data, which can be manipulated by setting the application's real-time
	  configurations.

config DEBUG_MODULE_MEMFAULT_WATCHDOG_DELTA_MS
	int "Memfault software watchdog delta"
	default 5000
	help
	  Time before the actual watchdog timeout that the Memfault software watchdog will trigger.

config DEBUG_MODULE_MEMFAULT_THREAD_STACK_SIZE
	int "Debug module Memfault thread stack size"
	default 4096

config DEBUG_MODULE_MEMFAULT_UPDATES_MIN_INTERVAL_SEC
	int "Minimum time between Memfault metric updates, in seconds"
	default 900

endif # DEBUG_MODULE && MEMFAULT

module = DEBUG_MODULE
module-str = Debug module
source "subsys/logging/Kconfig.template.log_config"
```
