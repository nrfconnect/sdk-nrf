## Kconfig.nrf
```kconfig
#
# Copyright (c) 2018-2023 Nordic Semiconductor
#
# SPDX-License-Identifier: LicenseRef-Nordic-5-Clause
#

orsource "./cmake/toolchain/$(ZEPHYR_TOOLCHAIN_VARIANT)/Kconfig.defconfig"

rsource "subsys/net/openthread/Kconfig.defconfig"

if !TFM_PROFILE_TYPE_MINIMAL
rsource "modules/trusted-firmware-m/Kconfig.mbedtls.defconfig"
endif # ! TFM_PROFILE_TYPE_MINIMAL

if TFM_PROFILE_TYPE_MINIMAL
rsource "modules/trusted-firmware-m/Kconfig.mbedtls_minimal.defconfig"
rsource "modules/trusted-firmware-m/Kconfig.tfm_minimal.defconfig"
endif # TFM_PROFILE_TYPE_MINIMAL

if BUILD_WITH_TFM
rsource "modules/trusted-firmware-m/Kconfig.psa.defconfig"
endif # BUILD_WITH_TFM

menu "Nordic nRF Connect"

# Override configuration from zephyr which sets this to 0x200 if MCUboot is
# enabled (CONFIG_BOOTLOADER_MCUBOOT), since NCS use partition_manager to
# get this offset intsead.
config ROM_START_OFFSET
	default 0 if PARTITION_MANAGER_ENABLED

# nRF Connect SDK default experimental warnings to on.
config WARN_EXPERIMENTAL
	default y

# Zephyr default is newlib and not newlib-nano for consistency between architectures.
# To reduce FLASH footprint, newlib-nano is preferred default in NCS when newlib is selected.
config NEWLIB_LIBC_NANO
	default y if SOC_FAMILY_NORDIC_NRF
	depends on NEWLIB_LIBC && HAS_NEWLIB_LIBC_NANO

# This is a temporary solution to whitelist
# BOARD_THINGY91_NRF9160_NS in compliance
config BOARD_THINGY91_NRF9160_NS
	bool

# memfault depends on the now removed NET_SOCKETS_OFFLOAD_TLS symbol.
# Until an updated memfault sdk is released, we define this as a promptless
# symbol here.
config NET_SOCKETS_OFFLOAD_TLS
	bool

# nRF Connect SDK needs a larger default stacks in certain configurations
#  - For running tests.
#  - For CC3XX RNG
#  - For Cracen RNG
#  - For bt_enable() when using the SoftDevice Controller
config MAIN_STACK_SIZE
	default 4096 if PSA_NEED_CRACEN_CTR_DRBG_DRIVER && !BUILD_WITH_TFM && TRUSTED_STORAGE
	default 3584 if PSA_NEED_CRACEN_CTR_DRBG_DRIVER && !BUILD_WITH_TFM
	default 3584 if (SOC_NRF54H20_CPUAPP || SOC_NRF54H20_CPURAD)
	default 2048 if PSA_NEED_OBERON_CTR_DRBG_DRIVER && !BUILD_WITH_TFM
	default 2048 if ZTEST
	default 2048 if ENTROPY_CC3XX && !BUILD_WITH_TFM
	default 1128 if BT_LL_SOFTDEVICE

config ZTEST_STACK_SIZE
	default 2048 if ZTEST

config PRIVILEGED_STACK_SIZE
	default 2048 if ZTEST

# nRF Connect SDK needs larger mcumgr buffers when supporting multi-image DFU
# or when the Bluetooth Reassembly feature is enabled.
config MCUMGR_TRANSPORT_NETBUF_SIZE
	default 2475 if MCUMGR_TRANSPORT_BT_REASSEMBLY
	default 1024 if UPDATEABLE_IMAGE_NUMBER > 1

config INIT_ARCH_HW_AT_BOOT
	default y
	help
	  The image will be booted directly by an unknown image which might not
	  leave the system in a clean state, so it is necessary to perform
	  architecture specific hardware initialization.

DT_COMPAT_NORDIC_QSPI_NOR := nordic,qspi-nor
config NORDIC_QSPI_NOR
	default y if $(dt_compat_on_bus,$(DT_COMPAT_NORDIC_QSPI_NOR),qspi) && PM_EXTERNAL_FLASH_MCUBOOT_SECONDARY && !SPI_NOR

DT_ZEPHYR_FLASH := zephyr,flash
DT_CHOSEN_ZEPHYR_FLASH := $(dt_chosen_path,$(DT_ZEPHYR_FLASH))
config NORDIC_QSPI_NOR_FLASH_LAYOUT_PAGE_SIZE
	default $(dt_node_int_prop_int,$(DT_CHOSEN_ZEPHYR_FLASH),erase-block-size)
	help
	  Set the flash layout page size equal to the erase block size of the
	  chosen Zephyr flash devicetree node to ensure that swapping can be
	  performed.

# Temporary hack to be able to build samples and tests on the nRF51L15/nRF54L09 Eng A/nRF54LM20A Eng A/nRF7120 FLPR core
config FLASH_BASE_ADDRESS
	hex
	depends on PARTITION_MANAGER_ENABLED
	depends on SOC_NRF54L15_CPUFLPR || SOC_NRF54LM20A_ENGA_CPUFLPR || SOC_NRF54LV10A_ENGA_CPUFLPR|| SOC_NRF7120_ENGA_CPUFLPR
	default 0x0 if SOC_NRF54L15_CPUFLPR || SOC_NRF54LM20A_ENGA_CPUFLPR || SOC_NRF54LV10A_ENGA_CPUFLPR
	default 0x2C0000 if SOC_NRF7120_ENGA_CPUFLPR

config FLASH_SIZE
	int
	depends on PARTITION_MANAGER_ENABLED
	depends on SOC_NRF54L15_CPUFLPR || SOC_NRF54LM20A_ENGA_CPUFLPR || SOC_NRF54LV10A_ENGA_CPUFLPR || SOC_NRF7120_ENGA_CPUFLPR
	default 1012 if SOC_NRF54LV10A_ENGA_CPUFLPR
	default 1524 if SOC_NRF54L15_CPUFLPR
	default 2036 if SOC_NRF54LM20A_ENGA_CPUFLPR
	default 128 if SOC_NRF7120_ENGA_CPUFLPR

config NRF_SECURITY_ENABLER
	def_bool y
	imply NRF_SECURITY if BT_CRYPTO || BT_HOST_CRYPTO || BT_MESH_CRYPTO_LIB || BT_FAST_PAIR_CRYPTO_PSA
	imply ENTROPY_GENERATOR if BOARD_NATIVE_SIM || BT_HOST_CRYPTO_PRNG || BT_ECC || BT_GATT_CACHING
	imply PSA_WANT_GENERATE_RANDOM if BT_HOST_CRYPTO_PRNG || BT_ECC || BT_GATT_CACHING || BT_MESH_CRYPTO_LIB
	imply MBEDTLS_ENABLE_HEAP if BT_HOST_CRYPTO_PRNG || BT_ECC || BT_GATT_CACHING || BT_CRYPTO || BT_MESH_CRYPTO_LIB
	depends on !SOC_NRF5340_CPUNET

# Bluetooth TX processor thread stack Thread Analyzer measurements
# Apply SoC-specific defaults here to avoid touching upstream Zephyr files.
# Applications can still override via prj.conf.
configdefault BT_TX_PROCESSOR_STACK_SIZE
	# nRF52 variants
	default 768 if SOC_NRF52840
	default 696 if SOC_NRF52832
	default 969 if SOC_NRF52833
	# nRF53 (application core)
	default 688 if SOC_NRF5340_CPUAPP
	# nRF54H20 (application core)
	default 624 if SOC_NRF54H20_CPUAPP
	# nRF54L15 (application core)
	default 900 if SOC_NRF54L15_CPUAPP
	# nRF54L V10A / LM20A (currently application core EngA variants are used)
	default 900 if SOC_NRF54LV10A_ENGA_CPUAPP
	default 900 if SOC_NRF54LM20A_ENGA_CPUAPP

if SOC_SERIES_BSIM_NRFXX && ENTROPY_GENERATOR
config MBEDTLS_HEAP_SIZE
	int
	default 2048
endif

rsource "samples/Kconfig"
rsource "subsys/Kconfig"
rsource "modules/Kconfig"
rsource "lib/Kconfig"
rsource "drivers/Kconfig"
rsource "ext/Kconfig"
rsource "tests/Kconfig"

endmenu
```

## applications/asset_tracker/Kconfig
```kconfig
#
# Copyright (c) 2018 Nordic Semiconductor ASA
#
# SPDX-License-Identifier: LicenseRef-BSD-5-Clause-Nordic
#

menu "Asset tracker"

rsource "src/ui/Kconfig"

config APPLICATION_WORKQUEUE_STACK_SIZE
	int "Application workqueue stack size"
	default 4096

config APPLICATION_WORKQUEUE_PRIORITY
	int "Application workqueue priority"
	default SYSTEM_WORKQUEUE_PRIORITY

menu "GPS"

choice
	prompt "GPS device"
	default GPS_USE_SIM
	help
	  Select from which device GPS data will be fetched.

config GPS_USE_SIM
	bool "Use GPS simulator"
	select GPS_SIM
	select GPS_SIM_TRIGGER
	help
	  Use simulated GPS data.

config GPS_USE_EXTERNAL
	bool "User provided GPS device"
	help
	  Provide a GPS device that location data will be fetched from and
	  sent to nRF Cloud

endchoice

config GPS_DEV_NAME
	string "GPS device name"
	default GPS_SIM_DEV_NAME if GPS_USE_SIM
	help
	  GPS device from which location data will be fetched and sent
	  to nRF Cloud.

config GPS_CONTROL_ON_LONG_PRESS
	bool "Control the GPS state with button"
	default y
	help
	  Control the GPS operation with long-press on the button.
	  Press for 5 seconds to enable, or 5 seconds to disable.

config GPS_CONTROL_PSM_ENABLE_ON_START
	bool "Enable PSM when starting GPS"
	help
	  The nRF9160 modem needs to be set in PSM mode for the GPS to start
	  searching for satellites. Enabling this option will do so
	  automatically, otherwise the application must handle it.

config GPS_CONTROL_PSM_DISABLE_ON_STOP
	bool "Disable PSM when stopping GPS"
	help
	  Selecting this option will disable PSM when the GPS is stopped.
	  During a PSM interval, the device is not reachable from the outside
	  until the interval times out, or the device itself attempts to
	  send data on the link.

config GPS_CONTROL_FIRST_FIX_CHECK_DELAY
	int "Time from Cloud conenction until first fix check"
	default 30
	help
	  The amount of time that should pass between successfully establishing
	  connection to cloud until first attempt to get position fix.
	  Attempting to get a fix means entering PSM mode, in which the device
	  is not reachable for the duration of the interval, or until the
	  device itself sends data and then for the duration for the set
	  active time thereafter.

config GPS_CONTROL_FIX_CHECK_INTERVAL
	int "Interval in seconds to between check for position fix"
	default 120
	help
	  The fix check interval gives the interval for how long it will go
	  between each retry to achieve position fix. The actual fix time will
	  vary with factors such as satellite coverage, surrounding buildings
	  and landscape, PSM interval and activity time requested and granted
	  by the network.

config GPS_CONTROL_FIX_TRY_TIME
	int "Time in seconds to try to get fix"
	default 180
	help
	  Amount of time the device will attempt to get position fix. Note that
	  if the interval is interrupted by the device sending data, the timer
	  is not reset, and the actual try time will be shortened due to
	  the device not being in PSM mode all the time. If fix is not acquired
	  before it times out, the device will try to get fix again in
	  GPS_CONTROL_FIX_CHECK_INTERVAL seconds. If GPS_CONTROL_FIX_COUNT is reached
	  before the full GPS_CONTROL_FIX_TRY_TIME has passed, the GPS will be stopped.

config GPS_CONTROL_FIX_COUNT
	int "Number of position fix before stopping GPS"
	default 3
	help
	  The number of fixes to get before stopping the GPS, within the time
	  set in GPS_CONTROL_FIX_CHECK_INTERVAL.

config GPS_CONTROL_MAX_FAILED_FIX_ATTEMPTS
	int "Number of failed fix attempts before stopping GPS"
	default 3
	help
	  Number of retries to get fix before shutting down the GPS until user
	  input tells it to start retrying.

config GPS_START_ON_MOTION
	bool "Motion triggered GPS update"
	default n
	help
	  When accelerometer detects movement, and GPS is enabled, update GPS
	  position, but if no movement, wait a longer delay between updates
	  to conserve power.

endmenu # GPS

menu "Device and modem"

config POWER_OPTIMIZATION_ENABLE
	bool "Enable power optimization"
	default y
	select LTE_EDRX_REQ

if MODEM_INFO

config HOLD_TIME_RSRP
	int "Minimum time [s] between RSRP subscription messages"
	default 60
	help
	  The minimum time in seconds where the modem
	  informer is allowed to submit RSRP data to the cloud.

endif

endmenu # Device

menu "Motion"

choice
	prompt "Accelerometer device"
	default ACCEL_USE_SIM
	help
	  Select which device will provide accelerometer data.

config ACCEL_USE_SIM
	bool "Use simulated accelerometer data"
	select SENSOR
	select SENSOR_SIM
	select SENSOR_SIM_TRIGGER
	select SENSOR_SIM_STATIC_VALUES
	help
	  Use sensor simulator to generate accelerometer data for
	  flip detection data sent to nRF Cloud.

config ACCEL_USE_EXTERNAL
	bool "User provided accelerometer device"
	help
	  The user will provide an accelerometer device that will
	  be used for flip detection.

endchoice

if ACCEL_USE_SIM
config ACCEL_DEV_NAME
	string
	default SENSOR_SIM_DEV_NAME

config ACCEL_TRIGGER
	bool
	default SENSOR_SIM_TRIGGER

config FLIP_INPUT
	int "Button or switch number to simulate flip"
	range 1 4 if BOARD_NRF9160_PCA10090NS
	range 1 1 if BOARD_NRF9160_PCA20035NS
	default 3 if BOARD_NRF9160_PCA10090NS
	default 1 if BOARD_NRF9160_PCA20035NS
	help
	  Button or switch number to use for simulating
	  a board flip event.
	  1 - Button 1
	  2 - Button 2
	  3 - Switch 1
	  4 - Switch 2
endif

if ACCEL_USE_EXTERNAL

config ACCEL_DEV_NAME
	string "Accelerometer device name"
	help
	  Device from which accelerometer data will be fetched and used
	  for orientation detection and sent to nRF Cloud.

endif

config ACCEL_INVERTED
	bool "Accelerometer inverted"
	default y if BOARD_NRF9160_PCA20035NS
	help
	  Enable if the accelerometer is mounted with the top side facing
	  down when the board itself is in normal position.

endmenu # Motion

menu "Cloud"

config MQTT_KEEPALIVE
	int
	default 1200

config CLOUD_BUTTON
	bool "Enable button sensor"
	default y

config CLOUD_BUTTON_INPUT
	int "Set button sensor button number"
	range 1 4 if BOARD_NRF9160_PCA10090NS
	range 1 1 if BOARD_NRF9160_PCA20035NS
	default 1

config CLOUD_WAIT_DURATION
	int "Cloud connection acknowledge wait duration"
	default 30
	help
	  How long the device should wait for a CONNACK
	  event from the cloud.

config CLOUD_FOTA_APP
	bool "Enable firmware over-the-air upgrades for application"
	depends on AWS_FOTA
	depends on DFU_TARGET_MCUBOOT
	default y

config CLOUD_FOTA_MODEM
	bool "Enable firmware over-the-air upgrades for modem"
	depends on AWS_FOTA
	depends on DFU_TARGET_MODEM
	default y

config CLOUD_CONNECT_ERR_REBOOT_S
	int "Seconds to wait before rebooting when a cloud connect error occurs"
	default 300

endmenu # Cloud

menu "Environment sensors"

config USE_BME680_BSEC
	bool "Use Bosch BME680 BSEC lib"
	default n
	help
	  Enable use of Bosch BSEC library. The library itself is not a part of
	  NCS and must be downloaded from Bosch Sensortec.

config BOSCH_BSEC_LIBRARY_PATH
	string "Path to Bosch BSEC library folder"
	default "$(ZEPHYR_BASE)/../nrf/ext/BSEC_1.4.7.4_Generic_Release"
	help
	  Path to the folder where the Bosch BSEC library is placed.

config ENVIRONMENT_DATA_SEND_INTERVAL
	int "Interval in seconds for sending environment data"
	default 30
	help
	  Interval between each sampling and sending of environment sensor data.
	  If the GPS is active, sensor data will not be sent before it is
	  stopped. The unit is seconds.

config ENVIRONMENT_DATA_BACKOFF_TIME
	int "Time to delay sending environment data if GPS active"
	default 20
	help
	  Time in seconds before retrying to send environment sensor data if
	  the GPS is active.

choice
	prompt "Temperature measurement device"
	default TEMP_USE_SIM
	help
	  Select which device will provide temperature data.

config TEMP_USE_SIM
	bool "Use simulated temperature data"
	select SENSOR
	select SENSOR_SIM
	help
	  Use sensor simulator to generate temperature data to send to
	  nRF Cloud.

config TEMP_USE_EXTERNAL
	bool "User provided temperature device"
	help
	  The user provides a temperature device that is
	  used for temperature measurement.

endchoice

if TEMP_USE_SIM
config TEMP_DEV_NAME
	string
	default SENSOR_SIM_DEV_NAME

config TEMP_TRIGGER
	bool
	default SENSOR_SIM_TRIGGER

config TEMP_SIM_BUTTON
	int "Button or switch to trigger 'data ready' event"
	range 1 4 if BOARD_NRF9160_PCA10090NS
	range 1 1 if BOARD_NRF9160_PCA20035NS
	default 3 if BOARD_NRF9160_PCA10090NS
	default 1 if BOARD_NRF9160_PCA20035NS
	help
	  Button or switch number to use for triggering
	  a 'data ready' event.
	  1 - Button 1
	  2 - Button 2
	  3 - Switch 1
	  4 - Switch 2
endif

if TEMP_USE_EXTERNAL

config TEMP_DEV_NAME
	string "Temperature device name"
	help
	  Device from which temperature data will be fetched and
	  sent to nRF Cloud.

endif

endmenu # Environment sensors

menuconfig LIGHT_SENSOR
	bool "Light sensor"
	select BH1749 if BOARD_NRF9160_PCA20035NS
	default y if BOARD_NRF9160_PCA20035NS

if LIGHT_SENSOR

config LIGHT_SENSOR_DEV_NAME
	string "Light sensor device name"
	default "BH1749" if BOARD_NRF9160_PCA20035NS

config LIGHT_SENSOR_DATA_SEND_INTERVAL
	int "Interval in seconds for sending light sensor data"
	default 60
	help
	  Interval between each sampling and sending of light sensor data.
	  If the GPS is active, sensor data will not be sent before it is
	  stopped. The unit is seconds.

endif # LIGHT_SENSOR

config GPS_START_AFTER_CLOUD_EVT_READY
	bool "Automatic start of GPS on CLOUD_EVT_READY event after reset"
	default n
	help
	  Enabling this will make the GPS automatically start after a reset.
	  Useful when operating as a GPS tracker outdoors for a longer period
	  of time.

config ASSET_TRACKER_WATCHDOG_TIMEOUT_MSEC
	int "Watchdog timeout in milliseconds"
	default 10000

config USE_AT_HOST
	bool "Enable AT commands"
	default y
	select AT_HOST_LIBRARY
	help
	  Enable the AT host library so that AT commands can be sent to and
	  received from a serial terminal.

endmenu

menu "Zephyr Kernel"
source "Kconfig.zephyr"
endmenu

module = ASSET_TRACKER
module-str = Asset Tracker
source "${ZEPHYR_BASE}/subsys/logging/Kconfig.template.log_config"
```
