/*
 * Copyright (c) 2026 Nordic Semiconductor ASA
 *
 * SPDX-License-Identifier: LicenseRef-Nordic-5-Clause
 */

&uart132 {
	status = "reserved";
	interrupt-parent = <&cpuflpr_clic>;
};

&cpuapp_dma_region {
	status = "okay";
};
