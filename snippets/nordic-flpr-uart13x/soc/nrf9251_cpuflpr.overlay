/*
 * Copyright (c) 2026 Nordic Semiconductor ASA
 *
 * SPDX-License-Identifier: LicenseRef-Nordic-5-Clause
 */

/ {
	chosen {
		zephyr,console = &uart132;
	};
};

&uart132 {
	status = "okay";
	current-speed = <115200>;
	pinctrl-0 = <&uart132_default>;
	pinctrl-1 = <&uart132_sleep>;
	pinctrl-names = "default", "sleep";
	memory-regions = <&cpuapp_dma_region>;
};

&cpuapp_dma_region {
	status = "okay";
};
