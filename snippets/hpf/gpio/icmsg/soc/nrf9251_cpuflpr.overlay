/*
 * Copyright (c) 2026 Nordic Semiconductor ASA
 *
 * SPDX-License-Identifier: LicenseRef-Nordic-5-Clause
 */

#include "../../hpf-gpio-app.overlay"

ipc0: &cpuapp_cpuflpr_ipc {
	status = "okay";
};
