/*
 * Copyright (c) 2024 Nordic Semiconductor ASA
 *
 * SPDX-License-Identifier: LicenseRef-Nordic-5-Clause
 */

&cpuflpr_vpr {
	status = "okay";

	hpf_mspi: hpf_mspi {
		compatible = "nordic,hpf-mspi-controller";
		software-multiperipheral;
		#address-cells = <1>;
		#size-cells = <0>;
	};
};

/* TIMER peripheral as a watchdog for HPF FW */
fault_timer: &timer20 {
	status = "okay";
	prescaler = <4>;
};
