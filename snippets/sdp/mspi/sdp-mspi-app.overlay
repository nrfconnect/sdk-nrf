/*
 * Copyright (c) 2024 Nordic Semiconductor ASA
 *
 * SPDX-License-Identifier: LicenseRef-Nordic-5-Clause
 */

&cpuflpr_vpr {
	status = "okay";

	sdp_mspi: sdp_mspi {
		compatible = "nordic,nrfe-mspi-controller";
		software-multiperipheral;
		#address-cells = <1>;
		#size-cells = <0>;
	};
};

/* TIMER peripheral as a watchdog for SDP FW */
fault_timer: &timer20 {
	status = "okay";
	prescaler = <4>;
};
