/*
 * Copyright (c) 2024 Nordic Semiconductor
 * SPDX-License-Identifier: LicenseRef-Nordic-5-Clause
 */

&mram1x {
	partitions {
		/* Note: the location here has been kept the same as before the introduction of
		 * IronSide on nrf54h20, which has brought with it an updated memory map.
		 * It will likely need to be updated as the MRAM memory map is not yet final.
		 */
		cpurad_storage_partition: partition@1e3000 {
			reg = <0x1e3000 DT_SIZE_K(24)>;
		};
	};
};
