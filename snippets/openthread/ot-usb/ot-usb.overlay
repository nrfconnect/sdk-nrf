/*
 * Copyright (c) 2026 Nordic Semiconductor ASA
 *
 * SPDX-License-Identifier: LicenseRef-Nordic-5-Clause
 */

/ {
	chosen {
		zephyr,shell-uart = &snippet_cdc_acm_uart;
		zephyr,console = &snippet_cdc_acm_uart;
	};
};

&zephyr_udc0 {
	snippet_cdc_acm_uart: snippet_cdc_acm_uart {
		compatible = "zephyr,cdc-acm-uart";
	};
};
