/* Copyright (c) 2026 Nordic Semiconductor ASA
 *
 * SPDX-License-Identifier: LicenseRef-Nordic-5-Clause
 */

/ {
	openthread_config: openthread {
		compatible = "openthread,config";
		diag-gpios = <&gpio0 13 GPIO_ACTIVE_LOW>,		    // LED 1
			     <&gpio0 14 GPIO_ACTIVE_LOW>,		    // LED 2
			     <&gpio0 15 GPIO_ACTIVE_LOW>,		    // LED 3
			     <&gpio0 16 GPIO_ACTIVE_LOW>,		    // LED 4
			     <&gpio0 11 (GPIO_PULL_UP | GPIO_ACTIVE_LOW)>,  // Button 1
			     <&gpio0 12 (GPIO_PULL_UP | GPIO_ACTIVE_LOW)>,  // Button 2
			     <&gpio0 24 (GPIO_PULL_UP | GPIO_ACTIVE_LOW)>,  // Button 3
			     <&gpio0 25 (GPIO_PULL_UP | GPIO_ACTIVE_LOW)>;  // Button 4
	};
};
