/*
 * Copyright (c) 2024 Nordic Semiconductor ASA
 *
 * SPDX-License-Identifier: LicenseRef-Nordic-5-Clause
 */

/* Shrink by 160 KB */
/delete-node/ &cpurad_slot0_partition;
&mram1x {
	partitions {
		cpurad_slot0_partition: partition@BA000 {
			reg = <0xBA000 DT_SIZE_K(168)>;
		};
	};
};
