/*
 * Copyright (c) 2025 Nordic Semiconductor
 * SPDX-License-Identifier: LicenseRef-Nordic-5-Clause
 */

&cpuapp_ram0x_region {
	reg = <0x2f010000 DT_SIZE_K(260)>;
	ranges = <0x0 0x2f010000 0x41000>;
};

&cpurad_ram0x_region {
	reg = <0x2f051000 DT_SIZE_K(4)>;
	ranges = <0x0 0x2f051000 0x1000>;
};
