/*
 * Copyright (c) 2024 Nordic Semiconductor ASA
 *
 * SPDX-License-Identifier: LicenseRef-Nordic-5-Clause
 */

/* Enable uart1 for dumping stored modem traces */
&uart1 {
	status = "okay";
	current-speed = < 1000000 >;
};

/ {
	chosen {
		nordic,modem-trace-uart = &uart1;
	};
};
