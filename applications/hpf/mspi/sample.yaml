## applications/machine_learning/sample.yaml
```yaml
sample:
  name: nRF Machine Learning
  description: Machine learning application reference design
tests:
  applications.machine_learning.zdebug:
    sysbuild: true
    build_only: true
    platform_allow:
      - nrf52840dk/nrf52840
      - thingy53/nrf5340/cpuapp
      - nrf5340dk/nrf5340/cpuapp
      - nrf54l15dk/nrf54l15/cpuapp
    integration_platforms:
      - nrf52840dk/nrf52840
      - thingy53/nrf5340/cpuapp
      - nrf5340dk/nrf5340/cpuapp
      - nrf54l15dk/nrf54l15/cpuapp
    tags:
      - ci_build
      - sysbuild
      - ci_applications_machine_learning
  applications.machine_learning.zdebug_nus:
    sysbuild: true
    build_only: true
    platform_allow:
      - nrf52840dk/nrf52840
    integration_platforms:
      - nrf52840dk/nrf52840
    tags:
      - ci_build
      - sysbuild
      - ci_applications_machine_learning
    extra_args: FILE_SUFFIX=nus
  applications.machine_learning.zdebug_rtt:
    sysbuild: true
    build_only: true
    platform_allow:
      - thingy53/nrf5340/cpuapp
    integration_platforms:
      - thingy53/nrf5340/cpuapp
    tags:
      - ci_build
      - sysbuild
      - ci_applications_machine_learning
    extra_args: FILE_SUFFIX=rtt
  applications.machine_learning.zrelease:
    sysbuild: true
    build_only: true
    platform_allow:
      - nrf52840dk/nrf52840
      - thingy53/nrf5340/cpuapp
    integration_platforms:
      - nrf52840dk/nrf52840
      - thingy53/nrf5340/cpuapp
    tags:
      - ci_build
      - sysbuild
      - ci_applications_machine_learning
    extra_args: FILE_SUFFIX=release
  applications.machine_learning.sensor_hub.zrelease.singlecore:
    build_only: true
    sysbuild: true
    platform_allow:
      - nrf54h20dk/nrf54h20/cpuapp
    integration_platforms:
      - nrf54h20dk/nrf54h20/cpuapp
    tags:
      - ci_build
      - sysbuild
      - ci_applications_machine_learning
    extra_args:
      - machine_learning_SHIELD=pca63566
      - FILE_SUFFIX="release_singlecore"
  applications.machine_learning.sensor_hub.zdebug.singlecore:
    build_only: true
    sysbuild: true
    platform_allow:
      - nrf54h20dk/nrf54h20/cpuapp
    integration_platforms:
      - nrf54h20dk/nrf54h20/cpuapp
    tags:
      - ci_build
      - sysbuild
      - ci_applications_machine_learning
    extra_args:
      - machine_learning_SHIELD=pca63566
      - FILE_SUFFIX="singlecore"
  applications.machine_learning.sensor_hub.zdebug:
    build_only: true
    sysbuild: true
    platform_allow:
      - nrf54h20dk/nrf54h20/cpuapp
    integration_platforms:
      - nrf54h20dk/nrf54h20/cpuapp
    tags:
      - ci_build
      - sysbuild
      - ci_applications_machine_learning
    extra_args:
      - SB_CONFIG_PPRCORE_REMOTE=y
      - machine_learning_SNIPPET=nordic-ppr
      - machine_learning_SHIELD=pca63566_fwd
      - remote_SHIELD=pca63566
  applications.machine_learning.sensor_hub.zdebug.singlecore.power_consumption_test:
    build_only: true
    sysbuild: true
    platform_allow:
      - nrf54h20dk/nrf54h20/cpuapp
    integration_platforms:
      - nrf54h20dk/nrf54h20/cpuapp
    tags:
      - ci_build
      - sysbuild
      - ci_applications_machine_learning
    extra_args:
      - machine_learning_SHIELD=pca63566
      - FILE_SUFFIX="singlecore"
      - CONFIG_PM=y
```

## applications/machine_learning/src/Kconfig.ml_app
```kconfig
#
# Copyright (c) 2022 Nordic Semiconductor ASA
#
# SPDX-License-Identifier: LicenseRef-Nordic-5-Clause
#

menu "Application options"

config ML_APP_SENSOR_EVENT_DESCR
	string "Description of handled sensor event"
	default ""
	help
	  The application handles sensor events with predefined description.
	  Other sensor events are ignored.

endmenu
```

## applications/machine_learning/src/events/Kconfig
```kconfig
#
# Copyright (c) 2021 Nordic Semiconductor
#
# SPDX-License-Identifier: LicenseRef-Nordic-5-Clause
#

menu "Event options"

config ML_APP_EI_DATA_FORWARDER_EVENTS
	bool "Enable EI data forwarder events"

config ML_APP_INIT_LOG_EI_DATA_FORWARDER_EVENTS
	bool "Log EI data forwarder events"
	depends on ML_APP_EI_DATA_FORWARDER_EVENTS
	depends on LOG
	default y

config ML_APP_ML_RESULT_EVENTS
	bool "Enable machine learning result events"

config ML_APP_INIT_LOG_ML_RESULT_EVENTS
	bool "Log machine learning result events"
	depends on ML_APP_ML_RESULT_EVENTS
	depends on LOG
	default y

config ML_APP_MODE_EVENTS
	bool "Enable machine learning mode events"

config ML_APP_INIT_LOG_ML_APP_MODE_EVENTS
	bool "Log machine learning mode events"
	depends on ML_APP_MODE_EVENTS
	depends on LOG
	default y

config ML_APP_SENSOR_SIM_EVENTS
	bool "Enable simulated sensor events"

config ML_APP_INIT_LOG_SENSOR_SIM_EVENTS
	bool "Log simulated sensor events"
	depends on ML_APP_SENSOR_SIM_EVENTS
	depends on LOG
	default y

endmenu
```

## applications/machine_learning/src/modules/Kconfig
```kconfig
#
# Copyright (c) 2021 Nordic Semiconductor
#
# SPDX-License-Identifier: LicenseRef-Nordic-5-Clause
#

menu "Application modules"

rsource "Kconfig.ei_data_forwarder"
rsource "Kconfig.led_state"
rsource "Kconfig.ml_app_mode"
rsource "Kconfig.ml_runner"
rsource "Kconfig.usb_state"
rsource "Kconfig.sensor_sim_ctrl"
rsource "Kconfig.ei_result_nsms"

config APP_SENSOR_SLEEP_TO
	int "Sensor default time in seconds before sensor goes to sleep"
	default 10
	help
	  The number of seconds of inactivity before sensor goes into sleep mode.
	  This configuration is used only for physical sensors that have triggers configured.
	  It is ignored for simulated sensors.

endmenu
```

## applications/machine_learning/src/modules/Kconfig.cpu_boost
```kconfig
#
# Copyright (c) 2022 Nordic Semiconductor
#
# SPDX-License-Identifier: LicenseRef-Nordic-5-Clause
#

menuconfig ML_APP_CPU_BOOST
	bool "CPU BOOST"
	depends on SOC_NRF5340_CPUAPP

if ML_APP_CPU_BOOST

module = ML_APP_CPU_BOOST
module-str = CPU boost
source "subsys/logging/Kconfig.template.log_config"

endif # ML_APP_CPU_BOOST
```

## applications/machine_learning/src/modules/Kconfig.data_aggregator_release
```kconfig
#
# Copyright (c) 2024 Nordic Semiconductor
#
# SPDX-License-Identifier: LicenseRef-Nordic-5-Clause
#

menuconfig ML_APP_DATA_AGGREGATOR_RELEASE
	bool "Data aggregator buffer automatic release"
	depends on CAF_SENSOR_DATA_AGGREGATOR_EVENTS
	default y if ML_APP_EI_DATA_FORWARDER
	help
	  The module registers as a last listener for data aggregator event
	  and automatically request the buffer release.

if ML_APP_DATA_AGGREGATOR_RELEASE

module = ML_APP_DATA_AGGREGATOR_RELEASE
module-str = Data aggregator release
source "subsys/logging/Kconfig.template.log_config"

endif # ML_APP_DATA_AGGREGATOR_RELEASE
```

## applications/machine_learning/src/modules/Kconfig.ei_data_forwarder
```kconfig
#
# Copyright (c) 2021 Nordic Semiconductor
#
# SPDX-License-Identifier: LicenseRef-Nordic-5-Clause
#

menuconfig ML_APP_EI_DATA_FORWARDER
	bool "Edge Impulse data forwarder"
	depends on NEWLIB_LIBC
	depends on NEWLIB_LIBC_FLOAT_PRINTF
	depends on CAF_SENSOR_EVENTS

if ML_APP_EI_DATA_FORWARDER

choice
	prompt "Select data forwarder interface"
	default ML_APP_EI_DATA_FORWARDER_UART

config ML_APP_EI_DATA_FORWARDER_UART
	bool "UART"
	depends on UART_ASYNC_API
	select ML_APP_EI_DATA_FORWARDER_EVENTS

config ML_APP_EI_DATA_FORWARDER_BT_NUS
	bool "Nordic UART Service (NUS)"
	depends on BT_NUS
	depends on BT_GAP_AUTO_UPDATE_CONN_PARAMS
	select ML_APP_EI_DATA_FORWARDER_EVENTS

endchoice

config ML_APP_EI_DATA_FORWARDER_SENSOR_EVENT_DESCR
	string "Description of forwarded sensor event"
	default ML_APP_SENSOR_EVENT_DESCR
	help
	  The module forwards data related to sensor events with predefined description.
	  Other sensor events are ignored.

config ML_APP_EI_DATA_FORWARDER_BUF_SIZE
	int "Data buffer size"
	default 256 if ML_APP_EI_DATA_FORWARDER_UART && CAF_SENSOR_DATA_AGGREGATOR_EVENTS
	default 64
	range 6 4096
	help
	  Size of the buffer used to temporarily store forwarded data.
	  The buffer must be big enough to store a single line of forwarded data.

config ML_APP_EI_DATA_FORWARDER_PIPELINE_COUNT
	int "Number of samples pipelined in the Bluetooth stack"
	depends on ML_APP_EI_DATA_FORWARDER_BT_NUS
	default 2
	range 1 BT_CONN_TX_MAX
	help
	  Number of sensor samples pipelined in the Bluetooth stack. Pipelining samples in the
	  Bluetooth stack reduces latency related to delivering subsequent sensor samples to
	  the stack.

config ML_APP_EI_DATA_FORWARDER_BUF_COUNT
	int "Data buffer count"
	depends on ML_APP_EI_DATA_FORWARDER_BT_NUS
	default 10 if CAF_SENSOR_DATA_AGGREGATOR_EVENTS
	default 3
	range 0 16
	help
	  Up to CONFIG_ML_APP_EI_DATA_FORWARDER_PIPELINE_COUNT sensor samples are pipelined in the
	  Bluetooth stack. In case the pipeline is full, additional samples are buffered by the
	  application module. This Kconfig option specifies number of sensor samples temporarily
	  stored by the application module.

module = ML_APP_EI_DATA_FORWARDER
module-str = EI data forwarder
source "subsys/logging/Kconfig.template.log_config"

endif # ML_APP_EI_DATA_FORWARDER
```

## applications/machine_learning/src/modules/Kconfig.ei_result_nsms
```kconfig
#
# Copyright (c) 2023 Nordic Semiconductor
#
# SPDX-License-Identifier: LicenseRef-Nordic-5-Clause
#

config ML_APP_EI_RESULT_NSMS
	bool "Enable ML result via NSMS"
	default y
	depends on BT_GAP_AUTO_UPDATE_CONN_PARAMS
	select BT_NSMS
	help
	  Enable instance of Nordic Status Message Service carrying result
	  of gesture recognition.

choice
	prompt "Security level"
	default ML_APP_EI_RESULT_SECURITY_LEVEL_NONE
	depends on ML_APP_EI_RESULT_NSMS
	help
	  Sets security level used by NSMS instance:
		NONE		- access without any restrictions,
		ENCRYPTION	- enables encryption,
		AUTHENTICATION	- enables encryption and authentication. This will fail
				  if devices are lacking capabilities to display/enter
				  passkey.

config ML_APP_EI_RESULT_SECURITY_LEVEL_NONE
	bool "None"

config ML_APP_EI_RESULT_SECURITY_LEVEL_ENCRYPT
	bool "Encryption"

config ML_APP_EI_RESULT_SECURITY_LEVEL_AUTHEN
	bool "Authentication"
	depends on BT_SMP
	depends on BT_SETTINGS
	depends on FLASH
	depends on FLASH_PAGE_LAYOUT
	depends on FLASH_MAP
	depends on NVS
	depends on SETTINGS

endchoice

config ML_APP_EI_RESULT_SECURITY_LEVEL
	int
	range 0 2
	depends on ML_APP_EI_RESULT_NSMS
	default 0 if ML_APP_EI_RESULT_SECURITY_LEVEL_NONE
	default 1 if ML_APP_EI_RESULT_SECURITY_LEVEL_ENCRYPT
	default 2 if ML_APP_EI_RESULT_SECURITY_LEVEL_AUTHEN
```

## applications/machine_learning/src/modules/Kconfig.ext_mem
```kconfig
#
# Copyright (c) 2022 Nordic Semiconductor
#
# SPDX-License-Identifier: LicenseRef-Nordic-5-Clause
#

menuconfig ML_APP_EXT_MEM
	bool "Execute Edge Impulse library from external memory"
	depends on SOC_NRF5340_CPUAPP && NRFX_QSPI
    select HAVE_CUSTOM_LINKER_SCRIPT

if ML_APP_EXT_MEM

    config ML_APP_EXT_MEM_FREQ
    int "QSPI external memory clock frequency"
    default 96
    range 32 96

module = ML_APP_EXT_MEM
module-str = External memory
source "subsys/logging/Kconfig.template.log_config"

endif # ML_APP_EXT_MEM
```

## applications/machine_learning/src/modules/Kconfig.led_state
```kconfig
#
# Copyright (c) 2021 Nordic Semiconductor
#
# SPDX-License-Identifier: LicenseRef-Nordic-5-Clause
#

menuconfig ML_APP_LED_STATE
	bool "LED state"
	depends on CAF_LED_EVENTS
	depends on ML_APP_MODE_EVENTS

if ML_APP_LED_STATE

config ML_APP_LED_STATE_ANOMALY_THRESH
	int "Anomaly threshold [in 0.001 units]"
	default 600
	help
	  If anomaly value reported by the machine learning model is greater than the defined
	  anomaly threshold, the result is marked as anomaly and label assigned by the model is
	  ignored.

config ML_APP_LED_STATE_VALUE_THRESH
	int "Value threshold [in 0.001 units]"
	default 800
	help
	  If value reported by the machine learning model is smaller than the defined threshold,
	  the result is ignored.

config ML_APP_LED_STATE_PREDICTION_STREAK_THRESH
	int "Number of subsequent predictions required to report result"
	default 2
	help
	  LED state module displays result reported by the machine learning model if the same label
	  is observed for the predefined number of times in a row.

module = ML_APP_LED_STATE
module-str = LED state
source "subsys/logging/Kconfig.template.log_config"

endif # ML_APP_LED_STATE
```

## applications/machine_learning/src/modules/Kconfig.ml_app_mode
```kconfig
#
# Copyright (c) 2021 Nordic Semiconductor ASA
#
# SPDX-License-Identifier: LicenseRef-Nordic-5-Clause
#

menuconfig ML_APP_MODE
	bool "Machine learning application mode"
	depends on ML_APP_ML_RUNNER || ML_APP_EI_DATA_FORWARDER
	depends on CAF_CLICK_EVENTS
	select ML_APP_MODE_EVENTS

if ML_APP_MODE

config ML_APP_MODE_CONTROL_BUTTON_ID
	hex "Key ID of button used to control machine learning state"
	range 0x0000 0xffff
	depends on ML_APP_ML_RUNNER && ML_APP_EI_DATA_FORWARDER

module = ML_APP_MODE
module-str = machine learning state
source "subsys/logging/Kconfig.template.log_config"

endif # ML_APP_MODE
```
