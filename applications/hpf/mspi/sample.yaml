## applications/hpf/mspi/sample.yaml
```yaml
sample:
  name: HPF mSPI application
  description: HPF mSPI application
common:
  integration_platforms:
    - nrf54l15dk/nrf54l15/cpuflpr
tests:
  applications.hpf.mspi:
    build_only: true
    sysbuild: true
    platform_allow: nrf54l15dk/nrf54l15/cpuflpr
    tags:
      - ci_build
      - sysbuild
      - mspi
      - ci_applications_hpf
```

## applications/installer/Kconfig
```kconfig
#
# Copyright (c) 2026 Nordic Semiconductor
#
# SPDX-License-Identifier: LicenseRef-Nordic-5-Clause
#

module = INSTALLER
module-str = installer
source "subsys/logging/Kconfig.template.log_config"

choice INSTALLER_FW_LOADER_ENTRANCE_METHOD
	prompt "Firmware loader entrance method"
	default INSTALLER_FW_LOADER_ENTRANCE_SELF_INVALIDATE_BY_ERASE
	help
	  Select the method which the installer uses to request firmware loader entrance.

config INSTALLER_FW_LOADER_ENTRANCE_SELF_INVALIDATE_BY_ERASE
	bool "Erase start of the installer package"
	help
	  If this method is used, the installer will erase the start of the installer package
	  if it detects the need to request firmware loader entrance.
	  The amount of bytes to erase is equal to the erase block size.
	  The memory area where the installer code resides must be writable
	  by the installer image for this method to work.

config INSTALLER_FW_LOADER_ENTRANCE_BOOT_MODE
	bool "Boot mode"
	depends on RETENTION_BOOT_MODE
	help
	  If this method is selected, the installer will use a retained memory
	  boot mode mechanism to request entrance into the firmware loader. This
	  involves setting a specific flag in retained memory, which is
	  checked upon reboot by MCUboot to determine whether to enter the firmware loader.
	  Requirements for this method include both retained memory support
	  and a compatible MCUboot bootloader.

config INSTALLER_FW_LOADER_ENTRANCE_BOOT_REQ
	bool "Boot request"
	depends on (RETENTION || SOC_NRF54H20) && NRF_MCUBOOT_BOOT_REQUEST && IMG_MANAGER
	help
	  Selecting this method causes the installer to utilize the bootloader
	  "boot request" feature, which typically triggers the firmware loader
	  through MCUboot's boot request mechanism. Requirements for this method
	  include a compatible MCUboot bootloader and retained memory support.
	  For nRF54H20 devices the retained memory support is mocked
	  by using the NVM backend.

config INSTALLER_FW_LOADER_ENTRANCE_METHOD_NONE
	bool "No actions"
	help
	  In some of the cases the installer should not perform any actions
	  to request firmware loader entrance.
	  Currently these include:
	  - Firmware loader entrance requested by gpio
	  - Firmware loader entrance requested by reset pin

endchoice

config INSTALLER_REBOOT
	bool "Reboot the device after requesting firmware loader entrance"
	depends on !INSTALLER_FW_LOADER_ENTRANCE_METHOD_NONE
	depends on REBOOT
	default y if INSTALLER_FW_LOADER_ENTRANCE_SELF_INVALIDATE_BY_ERASE
	default y if INSTALLER_FW_LOADER_ENTRANCE_BOOT_REQ
	default y if INSTALLER_FW_LOADER_ENTRANCE_BOOT_MODE

config INSTALLER_PACKAGE_BUILD_SIGNED_HEX
	bool "Build the .signed.hex file with the installer package"
	help
	  This option will cause the build system to generate
	  fw_loader_installer.signed.hex containing the installer application
	  and the firmware loader image.

source "Kconfig.zephyr"
```

## applications/ipc_radio/sample.yaml
```yaml
sample:
  name: IPC radio firmware
  description: IPC radio firmware application
tests:
  applications.ipc_radio:
    sysbuild: true
    build_only: true
    platform_allow: nrf5340dk/nrf5340/cpunet thingy53/nrf5340/cpunet nrf54h20dk/nrf54h20/cpurad
    tags: bluetooth ci_build sysbuild
    integration_platforms:
      - nrf5340dk/nrf5340/cpunet
      - thingy53/nrf5340/cpunet
      - nrf54h20dk/nrf54h20/cpurad
  applications.ipc_radio.hci:
    sysbuild: true
    build_only: true
    platform_allow: nrf5340dk/nrf5340/cpunet thingy53/nrf5340/cpunet nrf54h20dk/nrf54h20/cpurad
    tags: bluetooth ci_build sysbuild
    integration_platforms:
      - nrf5340dk/nrf5340/cpunet
      - thingy53/nrf5340/cpunet
      - nrf54h20dk/nrf54h20/cpurad
    extra_args: FILE_SUFFIX=bt_hci_ipc
  applications.ipc_radio.hci.debug:
    sysbuild: true
    build_only: true
    platform_allow: nrf5340dk/nrf5340/cpunet thingy53/nrf5340/cpunet nrf54h20dk/nrf54h20/cpurad
    tags: bluetooth ci_build sysbuild
    integration_platforms:
      - nrf5340dk/nrf5340/cpunet
      - thingy53/nrf5340/cpunet
      - nrf54h20dk/nrf54h20/cpurad
    extra_args: FILE_SUFFIX=bt_hci_ipc_debug
  applications.ipc_radio.rpc:
    sysbuild: true
    build_only: true
    platform_allow: nrf5340dk/nrf5340/cpunet thingy53/nrf5340/cpunet nrf54h20dk/nrf54h20/cpurad
    tags: bluetooth ci_build sysbuild
    integration_platforms:
      - nrf5340dk/nrf5340/cpunet
      - thingy53/nrf5340/cpunet
      - nrf54h20dk/nrf54h20/cpurad
    extra_args:
      - FILE_SUFFIX=bt_rpc
      - SNIPPET=nordic-bt-rpc
  applications.ipc_radio.rpc.debug:
    sysbuild: true
    build_only: true
    platform_allow: nrf5340dk/nrf5340/cpunet thingy53/nrf5340/cpunet nrf54h20dk/nrf54h20/cpurad
    tags: bluetooth ci_build sysbuild
    integration_platforms:
      - nrf5340dk/nrf5340/cpunet
      - thingy53/nrf5340/cpunet
      - nrf54h20dk/nrf54h20/cpurad
    extra_args:
      - FILE_SUFFIX=bt_rpc_debug
      - SNIPPET=nordic-bt-rpc
  applications.ipc_radio.802154:
    sysbuild: true
    build_only: true
    platform_allow: nrf5340dk/nrf5340/cpunet thingy53/nrf5340/cpunet
    tags: ci_build sysbuild
    integration_platforms:
      - nrf5340dk/nrf5340/cpunet
      - thingy53/nrf5340/cpunet
    extra_args: FILE_SUFFIX=802154
  applications.ipc_radio.802154.debug:
    sysbuild: true
    build_only: true
    platform_allow: nrf5340dk/nrf5340/cpunet thingy53/nrf5340/cpunet
    tags: ci_build sysbuild
    integration_platforms:
      - nrf5340dk/nrf5340/cpunet
      - thingy53/nrf5340/cpunet
    extra_args: FILE_SUFFIX=802154_debug
  applications.ipc_radio.hci802154:
    sysbuild: true
    build_only: true
    platform_allow: nrf5340dk/nrf5340/cpunet thingy53/nrf5340/cpunet
    tags: bluetooth ci_build sysbuild
    integration_platforms:
      - nrf5340dk/nrf5340/cpunet
      - thingy53/nrf5340/cpunet
    extra_args: FILE_SUFFIX=bt_hci_ipc_802154
  applications.ipc_radio.hci802154.debug:
    sysbuild: true
    build_only: true
    platform_allow: nrf5340dk/nrf5340/cpunet thingy53/nrf5340/cpunet
    tags: bluetooth ci_build sysbuild
    integration_platforms:
      - nrf5340dk/nrf5340/cpunet
      - thingy53/nrf5340/cpunet
    extra_args: FILE_SUFFIX=bt_hci_ipc_802154_debug
```

## applications/machine_learning/Kconfig
```kconfig
#
# Copyright (c) 2021 Nordic Semiconductor ASA
#
# SPDX-License-Identifier: LicenseRef-Nordic-5-Clause
#

menu "Machine learning application"
rsource "common/Kconfig"
rsource "src/events/Kconfig"
rsource "src/modules/Kconfig"
rsource "src/util/Kconfig"
endmenu

menu "Zephyr Kernel"
source "Kconfig.zephyr"
endmenu
```

## applications/machine_learning/Kconfig.sysbuild
```kconfig
#
# Copyright (c) 2023 Nordic Semiconductor
#
# SPDX-License-Identifier: LicenseRef-Nordic-5-Clause
#

choice BOOTLOADER
	default BOOTLOADER_MCUBOOT if BOARD_NRF5340DK_NRF5340_CPUAPP || BOARD_THINGY53_NRF5340_CPUAPP || BOARD_THINGY53_NRF5340_CPUAPP_NS
endchoice

choice MCUBOOT_MODE
	default MCUBOOT_MODE_OVERWRITE_ONLY if SOC_SERIES_NRF53
endchoice

config NRF_DEFAULT_IPC_RADIO
	default y if BOARD_NRF5340DK_NRF5340_CPUAPP || BOARD_THINGY53_NRF5340_CPUAPP || BOARD_THINGY53_NRF5340_CPUAPP_NS || BOARD_NRF54H20DK_NRF54H20_CPUAPP

config SECURE_BOOT_NETCORE
	default y if BOARD_NRF5340DK_NRF5340_CPUAPP || BOARD_THINGY53_NRF5340_CPUAPP || BOARD_THINGY53_NRF5340_CPUAPP_NS

config NETCORE_APP_UPDATE
	default y if BOARD_NRF5340DK_NRF5340_CPUAPP || BOARD_THINGY53_NRF5340_CPUAPP || BOARD_THINGY53_NRF5340_CPUAPP_NS

config PM_EXTERNAL_FLASH_MCUBOOT_SECONDARY
	default y if BOARD_NRF5340DK_NRF5340_CPUAPP

if SUPPORT_PPRCORE

config SUPPORT_PPRCORE_REMOTE
	bool
	default y

choice PPRCORE

config PPRCORE_REMOTE
	bool "Remote"
	depends on SUPPORT_PPRCORE_REMOTE
	help
	  Include remote image as the PPR core image to use.

endchoice

if !PPRCORE_NONE

config PPRCORE_IMAGE_NAME
	default "remote" if PPRCORE_REMOTE

config PPRCORE_IMAGE_PATH
	default "$(APP_DIR)/remote" if PPRCORE_REMOTE

endif # !PPRCORE_NONE

endif # SUPPORT_PPRCORE

source "share/sysbuild/Kconfig"
```

## applications/machine_learning/common/Kconfig
```kconfig
#
# Copyright (c) 2024 Nordic Semiconductor ASA
#
# SPDX-License-Identifier: LicenseRef-Nordic-5-Clause
#

menu "Common"

rsource "src/Kconfig.ml_app"
rsource "src/modules/Kconfig"

config APP_SENSOR_SLEEP_TO
	int "Sensor default time in seconds before sensor goes to sleep"
	default 10
	help
	  The number of seconds of inactivity before sensor goes into sleep mode.
	  This configuration is used only for physical sensors that have triggers configured.
	  It is ignored for simulated sensors.

endmenu
```

## applications/machine_learning/common/src/events/Kconfig
```kconfig
#
# Copyright (c) 2024 Nordic Semiconductor
#
# SPDX-License-Identifier: LicenseRef-Nordic-5-Clause
#

if LOG

menu "Event options"

comment "Initially logged events"

config ML_APP_INIT_LOG_BATTERY_LEVEL_EVENT
	bool "Log battery level events"
	default y
	help
	  Log battery level events in ML application.

endmenu

endif
```

## applications/machine_learning/common/src/hw_interface/Kconfig
```kconfig
#
# Copyright (c) 2024 Nordic Semiconductor
#
# SPDX-License-Identifier: LicenseRef-Nordic-5-Clause
#

menu "Hardware interface modules"

rsource "Kconfig.bat_meas"

endmenu
```

## applications/machine_learning/common/src/hw_interface/Kconfig.bat_meas
```kconfig
#
# Copyright (c) 2024 Nordic Semiconductor
#
# SPDX-License-Identifier: LicenseRef-Nordic-5-Clause
#

menuconfig ML_APP_BATTERY_MEAS
	bool "Enable battery measurement circuit"
	help
	  If selected, battery measurement is enabled.

if ML_APP_BATTERY_MEAS

config ML_APP_BATTERY_MEAS_MIN_LEVEL
	int "Minimum battery voltage [mV] that corresponds to 0% level"
	default 0
	help
	  This option specifies battery voltage [mV] that corresponds to 0% battery level.

config ML_APP_BATTERY_MEAS_MAX_LEVEL
	int "Maximum battery voltage [mV] that corresponds to 100% level"
	default 1650
	help
	  This option specifies battery voltage [mV] that corresponds to 100% battery level.

config ML_APP_BATTERY_MEAS_VOLTAGE_TO_SOC_DELTA
	int "Difference between adjacent elements in conversion LUT [mV]"
	default 10
	range 1 100
	help
	  Value used to convert battery voltage [mV] to State of Charge [%].

config ML_APP_BATTERY_MEAS_POLL_INTERVAL_MS
	int "Time between the subsequent battery measurements [ms]"
	default 10000
	range 500 120000
	help
	  Time interval between the subsequent battery measurements [ms].


module = ML_APP_BATTERY_MEAS
module-str = batery measurement module
source "subsys/logging/Kconfig.template.log_config"

endif # ML_APP_BATTERY_MEAS
```

## applications/machine_learning/common/src/modules/Kconfig
```kconfig
#
# Copyright (c) 2024 Nordic Semiconductor ASA
#
# SPDX-License-Identifier: LicenseRef-Nordic-5-Clause
#

menu "Common modules"

rsource "Kconfig.event_proxy"
rsource "Kconfig.sensor_stub_gen"

endmenu
```

## applications/machine_learning/common/src/modules/Kconfig.event_proxy
```kconfig
#
# Copyright (c) 2024 Nordic Semiconductor ASA
#
# SPDX-License-Identifier: LicenseRef-Nordic-5-Clause
#

menuconfig ML_APP_EVENT_PROXY
	bool "Event proxy module"
	depends on SOC_SERIES_NRF54HX
	depends on EVENT_MANAGER_PROXY
	select APP_EVENT_MANAGER_POSTINIT_HOOK
	help
	  Enable and initialize event manager proxy subsystem on application
	  start. Subscription to events is done based on configuration file.

if ML_APP_EVENT_PROXY

config ML_APP_REMOTE_CORE_INITIALIZATION_TIMEOUT
	int "Remote core initialization timeout [ms]"
	range 10 10000
	default 2000
	help
	  The time to wait for remote cores to report its readiness. The time is
	  given in milliseconds.

module = ML_APP_EVENT_PROXY
module-str = event proxy module
source "subsys/logging/Kconfig.template.log_config"

endif
```

## applications/machine_learning/common/src/modules/Kconfig.sensor_stub_gen
```kconfig
#
# Copyright (c) 2024 Nordic Semiconductor ASA
#
# SPDX-License-Identifier: LicenseRef-Nordic-5-Clause
#

menuconfig ML_APP_SENSOR_STUB_GEN
	bool "Sensor stub data generator"

if ML_APP_SENSOR_STUB_GEN

config ML_APP_SENSOR_STUB_GEN_TRIG_TIMEOUT_MS
	int "Wave signal change timeout [ms]"
	default 1000
	help
	  The timeout triggers selecting next simulated wave signal.

module = ML_APP_SENSOR_STUB_GEN
module-str = sensor stub gen
source "subsys/logging/Kconfig.template.log_config"

endif # ML_APP_SENSOR_STUB_GEN
```

## applications/machine_learning/remote/Kconfig
```kconfig
#
# Copyright (c) 2024 Nordic Semiconductor ASA
#
# SPDX-License-Identifier: LicenseRef-Nordic-5-Clause
#

menu "Machine learning application (remote core)"

rsource "../common/Kconfig"

endmenu

menu "Zephyr Kernel"
source "Kconfig.zephyr"
endmenu
```

## applications/machine_learning/remote/boards/nrf54h20dk_nrf54h20_cpuppr.conf
```kconfig
#
# Copyright (c) 2024 Nordic Semiconductor ASA
#
# SPDX-License-Identifier: LicenseRef-Nordic-5-Clause
#
################################################################################
# Application configuration

CONFIG_ML_APP_SENSOR_EVENT_DESCR="accel_xyz"

CONFIG_ML_APP_EVENT_PROXY=y
CONFIG_ML_APP_REMOTE_CORE_INITIALIZATION_TIMEOUT=10000

CONFIG_SIZE_OPTIMIZATIONS=y

################################################################################
# System configuration

CONFIG_TIMESLICING=n

# LIBC minimal configuration
CONFIG_MINIMAL_LIBC=y
CONFIG_MINIMAL_LIBC_TIME=n
CONFIG_COMMON_LIBC_MALLOC=n
CONFIG_MINIMAL_LIBC_NON_REENTRANT_FUNCTIONS=n

CONFIG_HEAP_MEM_POOL_SIZE=512
CONFIG_EVENT_MANAGER_PROXY=y
# Higher timouts are required.
CONFIG_EVENT_MANAGER_PROXY_BIND_TIMEOUT_MS=4000

CONFIG_GPIO=y

CONFIG_SUIT_MPI_GENERATE=n

################################################################################
# Debug configuration
CONFIG_LOG=y
CONFIG_LOG_MODE_MINIMAL=y

CONFIG_ASSERT=n
CONFIG_ASSERT_VERBOSE=n
CONFIG_BOOT_BANNER=n
CONFIG_NCS_BOOT_BANNER=n

CONFIG_DEBUG=n
CONFIG_PRINTK=y

CONFIG_MAIN_STACK_SIZE=1024
CONFIG_IDLE_STACK_SIZE=128
CONFIG_ISR_STACK_SIZE=1024

# Interrupts
CONFIG_DYNAMIC_INTERRUPTS=n
CONFIG_IRQ_OFFLOAD=n

# Memory protection
CONFIG_HW_STACK_PROTECTION=n
CONFIG_THREAD_STACK_INFO=n
CONFIG_THREAD_CUSTOM_DATA=n
CONFIG_FPU=n

# ADXXL362 sensor configuration
CONFIG_ADXL362=y
CONFIG_ADXL362_ACCEL_RANGE_8G=y
CONFIG_ADXL362_ACCEL_ODR_100=y
CONFIG_ADXL362_TRIGGER_GLOBAL_THREAD=y
CONFIG_ADXL362_INACTIVITY_THRESHOLD=0
CONFIG_ADXL362_ACTIVITY_THRESHOLD=110
CONFIG_ADXL362_ABS_REF_MODE=1
```
