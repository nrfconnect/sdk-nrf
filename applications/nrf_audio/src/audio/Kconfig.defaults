## applications/nrf_desktop/dts/bindings/battery-charger.yaml
```yaml
# Copyright (c) 2022 Nordic Semiconductor ASA
# SPDX-License-Identifier: LicenseRef-Nordic-5-Clause

description: Battery charger

compatible: "battery-charger"

include: base.yaml

properties:
  cso-gpios:
    type: phandle-array
    required: true
    description: CSO (Charge Status Output) GPIOs

  cso-switching-freq:
    type: int
    required: true
    description: |
      A frequency with which CSO (Charge Status Output) pin switches state when
      charging error occurs.

  enable-gpios:
    type: phandle-array
    required: true
    description: Enable GPIOs
```

## applications/nrf_desktop/images/gpio_expander/boards/nrf54h20dk_nrf54h20_cpuppr.conf
```kconfig
#
# Copyright (c) 2024 Nordic Semiconductor ASA
#
# SPDX-License-Identifier: LicenseRef-Nordic-5-Clause
#

CONFIG_CAF_BUTTONS_POLARITY_INVERSED=y
CONFIG_LED_GPIO=y
```

## applications/nrf_desktop/images/sysbuild/Kconfig
```kconfig
#
# Copyright (c) 2024 Nordic Semiconductor ASA
#
# SPDX-License-Identifier: LicenseRef-Nordic-5-Clause
#

config DESKTOP_GPIO_EXPANDER
	bool "Use separate core to control GPIOs"
	help
	  Delegate GPIO control (e. g. controlling LEDs and handling hardware
	  buttons) to a separate core.

config DESKTOP_GPIO_EXPANDER_BOARD
	string "GPIO expander board name"
	depends on DESKTOP_GPIO_EXPANDER
	default "nrf54h20dk/nrf54h20/cpuppr" if BOARD_NRF54H20DK_NRF54H20_CPUAPP
	help
	  Board name used for GPIO expander image.
```

## applications/nrf_desktop/src/events/Kconfig
```kconfig
#
# Copyright (c) 2025 Nordic Semiconductor ASA
#
# SPDX-License-Identifier: LicenseRef-Nordic-5-Clause
#

menu "Application events"

config DESKTOP_HID_REPORT_PROVIDER_EVENT
	bool "HID report provider events"
	help
	  Enable HID report provider events in nRF Desktop application.

rsource "Kconfig.log"

endmenu
```

## applications/nrf_desktop/src/hw_interface/Kconfig
```kconfig
#
# Copyright (c) 2018 Nordic Semiconductor
#
# SPDX-License-Identifier: LicenseRef-Nordic-5-Clause
#

menu "Hardware interface modules"

rsource "Kconfig.board"
rsource "Kconfig.motion"
rsource "Kconfig.buttons_sim"
rsource "Kconfig.selector"
rsource "Kconfig.wheel"
rsource "Kconfig.battery_charger"
rsource "Kconfig.battery_meas"
rsource "Kconfig.passkey"

endmenu
```

## applications/nrf_desktop/src/hw_interface/Kconfig.battery_charger
```kconfig
#
# Copyright (c) 2019 Nordic Semiconductor
#
# SPDX-License-Identifier: LicenseRef-Nordic-5-Clause
#

menu "Battery charger configuration"

choice
	prompt "Select battery charging interface"
	default DESKTOP_BATTERY_CHARGER_NONE

config DESKTOP_BATTERY_CHARGER_NONE
	bool "No battery charging"
	help
	  If selected, battery charging is disabled.

config DESKTOP_BATTERY_CHARGER_DISCRETE
	bool "Discrete battery charger"
	help
	  If selected, battery charging is enabled.

endchoice

if DESKTOP_BATTERY_CHARGER_DISCRETE
module = DESKTOP_BATTERY_CHARGER
module-str = battery charger module
source "subsys/logging/Kconfig.template.log_config"
endif

endmenu
```

## applications/nrf_desktop/src/hw_interface/Kconfig.battery_meas
```kconfig
#
# Copyright (c) 2019 Nordic Semiconductor
#
# SPDX-License-Identifier: LicenseRef-Nordic-5-Clause
#

menu "Battery measurement configuration"

choice
	prompt "Select battery measurement"
	default DESKTOP_BATTERY_MEAS_NONE

config DESKTOP_BATTERY_MEAS_NONE
	bool "No battery measurement"
	help
	  If selected, battery measurement is disabled.

config DESKTOP_BATTERY_MEAS
	bool "Enable battery measurement circuit"
	help
	  If selected, battery measurement is enabled.

endchoice

config DESKTOP_BATTERY_MEAS_MIN_LEVEL
	int "Minimum battery voltage [mV] that corresponds to 0% level"
	depends on DESKTOP_BATTERY_MEAS
	default 3100
	help
	  This option specifies battery voltage [mV] that corresponds to 0% battery level.

config DESKTOP_BATTERY_MEAS_MAX_LEVEL
	int "Maximum battery voltage [mV] that corresponds to 100% level"
	depends on DESKTOP_BATTERY_MEAS
	default 4180
	help
	  This option specifies battery voltage [mV] that corresponds to 100% battery level.

config DESKTOP_BATTERY_MEAS_HAS_VOLTAGE_DIVIDER
	bool "Use voltage divider for battery measurement"
	depends on DESKTOP_BATTERY_MEAS
	help
	  Enable if voltage divider is used for battery measurement.

config DESKTOP_BATTERY_MEAS_VOLTAGE_DIVIDER_UPPER
	int "Upper resistor in battery measurement voltage divider [kOhm]"
	depends on DESKTOP_BATTERY_MEAS_HAS_VOLTAGE_DIVIDER
	help
	  Upper resistor value [kOhm]. Output voltage is measured on the lower resistor.

config DESKTOP_BATTERY_MEAS_VOLTAGE_DIVIDER_LOWER
	int "Lower resistor in battery measurement voltage divider [kOhm]"
	depends on DESKTOP_BATTERY_MEAS_HAS_VOLTAGE_DIVIDER
	help
	  Lower resistor value [kOhm]. Output voltage is measured on the lower resistor.

config DESKTOP_VOLTAGE_TO_SOC_DELTA
	int "Difference between adjacent elements in conversion LUT [mV]"
	depends on DESKTOP_BATTERY_MEAS
	default 10
	range 1 100
	help
	  Value used to convert battery voltage [mV] to State of Charge [%].

config DESKTOP_BATTERY_MEAS_POLL_INTERVAL_MS
	int "Time between the subsequent battery measurements [ms]"
	depends on DESKTOP_BATTERY_MEAS
	default 10000
	range 500 120000
	help
	  Time interval between the subsequent battery measurements [ms].

config DESKTOP_BATTERY_MEAS_HAS_ENABLE_PIN
	bool "Use pin for enabling battery measurement"
	depends on DESKTOP_BATTERY_MEAS
	help
	  Enable if dedicated gpio0 pin is used for enabling battery measurement circuit.
	  Pin number is configurable by CONFIG_DESKTOP_BATTERY_MEAS_ENABLE_PIN

config DESKTOP_BATTERY_MEAS_ENABLE_PIN
	int "Battery monitoring enable pin"
	depends on DESKTOP_BATTERY_MEAS
	default 255 if !DESKTOP_BATTERY_MEAS_HAS_ENABLE_PIN
	help
	  A pin which enables the battery measurement circuit.

if DESKTOP_BATTERY_MEAS
module = DESKTOP_BATTERY_MEAS
module-str = battery measurement module
source "subsys/logging/Kconfig.template.log_config"
endif

endmenu
```

## applications/nrf_desktop/src/hw_interface/Kconfig.board
```kconfig
#
# Copyright (c) 2023 Nordic Semiconductor
#
# SPDX-License-Identifier: LicenseRef-Nordic-5-Clause
#

menu "Board configuration"

config DESKTOP_BOARD_PM_EVENTS
	bool "Power management events support"
	depends on CAF_PM_EVENTS
	default y
	help
	  React on power management events in board module.

module = DESKTOP_BOARD
module-str = board module
source "subsys/logging/Kconfig.template.log_config"

endmenu
```

## applications/nrf_desktop/src/hw_interface/Kconfig.buttons
```kconfig
#
# Copyright (c) 2019 Nordic Semiconductor
#
# SPDX-License-Identifier: LicenseRef-BSD-5-Clause-Nordic
#

menu "Buttons configuration"

choice
	prompt "Select buttons interface"
	default DESKTOP_BUTTONS_NONE

config DESKTOP_BUTTONS_NONE
	bool "Disable buttons"

config DESKTOP_BUTTONS_ENABLE
	bool "Buttons scanned from key matrix or directly connected GPIO"

endchoice

config DESKTOP_BUTTONS_SCAN_INTERVAL
	int "Buttons scan interval in ms"
	depends on DESKTOP_BUTTONS_ENABLE
	default 2
	help
	  Interval at which key matrix is scanned.

config DESKTOP_BUTTONS_DEBOUNCE_INTERVAL
	int "Interval before first button scan in ms"
	depends on DESKTOP_BUTTONS_ENABLE
	default 2
	help
	  Interval before first scan. Introduced for debouncing reasons.

config DESKTOP_BUTTONS_POLARITY_INVERSED
	bool "Inverse buttons polarity"
	depends on DESKTOP_BUTTONS_ENABLE
	help
	  When this option is enabled, button is pressed when the GPIO state
	  is low.

config DESKTOP_BUTTONS_EVENT_LIMIT
	int "Number of button events in single scan loop"
	depends on DESKTOP_BUTTONS_ENABLE
	default 4
	range 0 255
	help
	  This option specifies the number of button events generated during
	  a single scanning loop. If more keys change state between scanning
	  intervals, subsequent changes will be ignored and picked up during
	  the next scanning.

config DESKTOP_BUTTONS_SIM_ENABLE
	bool "Enable simulated button presses generator"
	depends on !DESKTOP_BUTTONS_NONE

config DESKTOP_BUTTONS_SIM_INTERVAL
	int "Interval between subsequent simulated button presses [ms]"
	depends on DESKTOP_BUTTONS_SIM_ENABLE
	default 1000
	range 1 60000

config DESKTOP_BUTTONS_SIM_LOOP_FOREVER
	bool "Generate buttons in infinite loop"
	depends on DESKTOP_BUTTONS_SIM_ENABLE
	help
	  When this option is disabled sequence of buttons is generated once.
	  Enabling this option makes the sequence start from the beginning
	  after it ends.

config DESKTOP_BUTTONS_SIM_TRIGGER_KEY_ID
	hex "Button used to start/stop generating button presses"
	depends on DESKTOP_BUTTONS_SIM_ENABLE
	default 0x0000

if !DESKTOP_BUTTONS_NONE
module = DESKTOP_BUTTONS
module-str = buttons module
source "subsys/logging/Kconfig.template.log_config"
endif

endmenu
```

## applications/nrf_desktop/src/hw_interface/Kconfig.buttons_sim
```kconfig
#
# Copyright (c) 2019-2021 Nordic Semiconductor ASA
#
# SPDX-License-Identifier: LicenseRef-Nordic-5-Clause
#

menu "Buttons simulation configuration"

config DESKTOP_BUTTONS_SIM_ENABLE
	bool "Enable simulated button presses generator"
	depends on CAF_BUTTON_EVENTS
	help
	  This option enables simulated button presses in nRF Desktop application.
	  Could be used for debugging purposes.

if DESKTOP_BUTTONS_SIM_ENABLE

config DESKTOP_BUTTONS_SIM_INTERVAL
	int "Interval between subsequent simulated button presses [ms]"
	default 1000
	range 1 60000
	help
	  Time interval between the subsequent simulated button presses [ms].

config DESKTOP_BUTTONS_SIM_LOOP_FOREVER
	bool "Generate buttons in infinite loop"
	help
	  When this option is disabled sequence of buttons is generated once.
	  Enabling this option makes the sequence start from the beginning
	  after it ends.

config DESKTOP_BUTTONS_SIM_TRIGGER_KEY_ID
	hex "Button used to start/stop generating button presses"
	default 0x0000
	help
	  This option defines KEY ID of the button used to start/stop generation of simulated
	  button presses in the nRF Desktop application.

module = DESKTOP_BUTTONS_SIM
module-str = buttons sim module
source "subsys/logging/Kconfig.template.log_config"
endif

endmenu
```
