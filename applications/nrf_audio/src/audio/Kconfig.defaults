## applications/nrf_desktop/Kconfig.debug
```kconfig
#
# Copyright (c) 2023 Nordic Semiconductor ASA
#
# SPDX-License-Identifier: LicenseRef-Nordic-5-Clause
#

menu "Debug configuration"

config DESKTOP_LOG
	bool "nRF Desktop logging"
	select LOG
	help
	  The option slightly modifies the default configuration of the logging
	  subsystem to tailor it to the application needs. The nRF Desktop
	  logging is based on RTT by default, but it can be configured to use
	  UART backend.

if DESKTOP_LOG

config DESKTOP_LOG_RTT
	bool "RTT logging backend"
	default y if !DESKTOP_SHELL
	select LOG_BACKEND_RTT
	select USE_SEGGER_RTT
	help
	  Emit debug logs over RTT.

	  The nRF Desktop application by default uses RTT for logging. The RTT
	  log backend is disabled when shell subsystem is enabled as the shell
	  is used to emit logs in that case.

configdefault LOG_BACKEND_RTT
	default n
	help
	  If nRF Desktop logging is enabled, an application-specific Kconfig
	  option is used to control enabling of the RTT logging backend
	  together with dependencies of the backend.

config DESKTOP_LOG_UART
	bool "UART logging backend"
	select LOG_BACKEND_UART
	select SERIAL
	select CONSOLE
	select UART_CONSOLE
	help
	  Emit debug logs over UART.

configdefault LOG_BACKEND_UART
	default n
	help
	  If nRF Desktop logging is enabled, an application-specific Kconfig
	  option is used to control enabling of the UART logging backend
	  together with dependencies of the backend.

choice LOG_MODE
	default LOG_MODE_DEFERRED
	help
	  nRF Desktop logging uses the deferred logging mode to minimize the
	  impact of the debug tools on the application.

endchoice

configdefault LOG_MODE_OVERFLOW
	default y
	help
	  nRF Desktop logging configuration drops the oldest logs if there is
	  no more space left in the buffers.

configdefault LOG_BUFFER_SIZE
	default 4096
	help
	  nRF Desktop logging configuration increases the default buffer
	  size in the logging subsystem to prevent logs from dropping.

configdefault LOG_PROCESS_THREAD_STACK_SIZE
	default 1024
	help
	  nRF Desktop logging configuration increases the default stack size
	  for the log processing thread to prevent stack overflows.

configdefault LOG_BACKEND_SHOW_COLOR
	default y if SHELL_LOG_BACKEND
	default n
	help
	  nRF Desktop logging configuration disables colors in the logging
	  subsystem backends unless shell is used to emit logs.

configdefault LOG_BACKEND_FORMAT_TIMESTAMP
	default n
	help
	  nRF Desktop logging configuration disables formatting of timestamps
	  in the logging subsystem backends.

if DESKTOP_LOG_RTT

choice LOG_BACKEND_RTT_MODE
	default LOG_BACKEND_RTT_MODE_BLOCK if LOG_MODE_DEFERRED
	help
	  nRF Desktop logging configuration blocks the logger thread if data
	  cannot be passed to the RTT buffer.

endchoice

configdefault LOG_BACKEND_RTT_OUTPUT_BUFFER_SIZE
	default 128
	help
	  nRF Desktop increases size of the buffer to improve performance of
	  the RTT log output.

endif # DESKTOP_LOG_RTT

endif # DESKTOP_LOG

config DESKTOP_SHELL
	bool "nRF Desktop shell"
	help
	  The option enables support for the nRF Desktop Shell.
	  By default, the nRF Desktop Shell uses the RTT backend and
	  slightly modifies the default configuration of the Shell
	  subsystem to tailor it to the application needs.

if DESKTOP_SHELL

config SHELL
	default y
	help
	  nRF Desktop Shell configuration enables the Shell subsystem that
	  is required for this functionality.

config SHELL_BACKEND_SERIAL
	default n
	help
	  nRF Desktop Shell configuration disables the Shell Serial backend
	  as nRF Desktop targets do not use a Serial interface for debug
	  information.

config SHELL_BACKEND_RTT
	default y
	help
	  nRF Desktop Shell configuration enables the Shell RTT backend
	  as nRF Desktop targets use RTT for debug information.

config USE_SEGGER_RTT
	default y
	help
	  nRF Desktop Shell uses RTT as a default backend.

if SHELL_BACKEND_RTT

config SHELL_PROMPT_RTT
	default "nrf_desktop:~$ "
	help
	  nRF Desktop Shell configuration sets a custom prompt.

endif # SHELL_BACKEND_RTT

config DEVICE_SHELL
	default y
	help
	  nRF Desktop Shell configuration enables access to basic device data.

config KERNEL_SHELL
	default y
	help
	  nRF Desktop Shell configuration enables access to basic kernel data.

config INIT_STACKS
	default y
	help
	  nRF Desktop Shell configuration enables stack area initialization
	  with a fixed value to easily calculate stack usage.

config THREAD_MONITOR
	default y
	help
	  nRF Desktop Shell configuration enables the monitoring option to
	  inspect all running threads in runtime.

config THREAD_NAME
	default y
	help
	  nRF Desktop Shell configuration enables an option to set a name
	  for a thread.

endif # DESKTOP_SHELL

configdefault SEGGER_RTT_BUFFER_SIZE_UP
	default 4096 if ((DESKTOP_SHELL && SHELL_BACKEND_RTT) || DESKTOP_LOG_RTT)
	help
	  nRF Desktop RTT configuration increases the default buffer size
	  in the SEGGER J-Link RTT libraries to enhance logging capacity.

endmenu
```

## applications/nrf_desktop/Kconfig.defaults
```kconfig
#
# Copyright (c) 2022 Nordic Semiconductor ASA
#
# SPDX-License-Identifier: LicenseRef-Nordic-5-Clause
#

config DESKTOP_COMMON
	bool
	default y
	select APP_EVENT_MANAGER
	select CAF

config DESKTOP_COMMON_MODULES
	bool
	default y
	imply DESKTOP_SETTINGS_LOADER
	imply DESKTOP_POWER_MANAGER

config DESKTOP_LTO_DEFAULTS
	bool
	default y
	imply LTO
	imply ISR_TABLES_LOCAL_DECLARATION
	help
	  nRF Desktop enables LTO to limit memory usage and improve performance.

config DESKTOP_MCUBOOT_RAM_LOAD_MCUBOOT_RAM_START_ADDR
	hex
	depends on MCUBOOT_BOOTLOADER_MODE_RAM_LOAD
	depends on $(dt_nodelabel_exists,cpuapp_sram_mcuboot_ram_region)
	default $(dt_nodelabel_reg_addr_hex,cpuapp_sram_mcuboot_ram_region)
	help
	  The start address of the MCUboot RAM region. The Kconfig option is used to validate
	  if the executable RAM region of the application image (also called the ROM section)
	  does not overlap with the RAM region of the MCUboot image. The validation process
	  assumes a specific RAM layout in DTS - you can refer to the following file as an example:
	  ./configuration/nrf54lm20dk_nrf54lm20a_cpuapp/memory_map_ram_load.dtsi

config APP_EVENT_MANAGER_MAX_EVENT_CNT
	default 64
	help
	  nRF Desktop increases the maximum number of Application Event Manager
	  event types to ensure that more complex configurations fit in the
	  limit.
```

## applications/nrf_desktop/Kconfig.hid
```kconfig
#
# Copyright (c) 2022 Nordic Semiconductor ASA
#
# SPDX-License-Identifier: LicenseRef-Nordic-5-Clause
#

menu "HID configuration"

choice DESKTOP_ROLE
	prompt "Select nRF Desktop device role"
	default DESKTOP_ROLE_HID_PERIPHERAL

config DESKTOP_ROLE_HID_PERIPHERAL
	bool "HID peripheral"
	imply DESKTOP_HID_STATE_ENABLE
	help
	  The option enables support for the nRF Desktop HID peripheral role.
	  The peripheral uses HID state module to generate HID reports based
	  on user input. All of the generated HID reports must be supported by
	  the peripheral.

config DESKTOP_ROLE_HID_DONGLE
	bool "HID dongle"
	imply DESKTOP_USB_ENABLE
	help
	  The option enables support for the nRF Desktop HID dongle role. The
	  dongle forwards HID reports from the HID peripherals to the host
	  connected over USB. The dongle does not generate HID reports by
	  itself.

endchoice # DESKTOP_ROLE

if DESKTOP_ROLE_HID_DONGLE

config DESKTOP_HID_DONGLE_BOND_COUNT
	int "Supported number of HID peripherals"
	default 2
	help
	  Supported number of HID peripherals bonded to the dongle. By default
	  dongle supports two HID peripherals - mouse and keyboard.

config DESKTOP_HID_DONGLE_CONN_COUNT
	int "Supported number of simultaneously connected HID peripherals"
	default 2
	help
	  Supported number of HID peripherals simultaneously connected to the
	  dongle. By default dongle can handle up to two HID peripherals at the
	  same time - mouse and keyboard.

endif # DESKTOP_ROLE_HID_DONGLE

config DESKTOP_HID_DONGLE_ENABLED_REPORTS
	bool
	default y if DESKTOP_ROLE_HID_DONGLE
	imply DESKTOP_HID_REPORT_MOUSE_SUPPORT
	imply DESKTOP_HID_REPORT_KEYBOARD_SUPPORT
	imply DESKTOP_HID_REPORT_SYSTEM_CTRL_SUPPORT
	imply DESKTOP_HID_REPORT_CONSUMER_CTRL_SUPPORT
	help
	  The dongle must support all of the forwarded HID reports.

choice DESKTOP_PERIPHERAL_TYPE
	prompt "Select nRF Desktop peripheral type"
	depends on DESKTOP_ROLE_HID_PERIPHERAL
	default DESKTOP_PERIPHERAL_TYPE_OTHER
	help
	  The selected peripheral type by default enables support for used HID
	  reports.

config DESKTOP_PERIPHERAL_TYPE_MOUSE
	bool "Mouse"
	imply DESKTOP_HID_REPORT_MOUSE_SUPPORT
	help
	  The option by default enables support for HID mouse report.

config DESKTOP_PERIPHERAL_TYPE_KEYBOARD
	bool "Keyboard"
	imply DESKTOP_HID_REPORT_KEYBOARD_SUPPORT
	imply DESKTOP_HID_REPORT_SYSTEM_CTRL_SUPPORT
	imply DESKTOP_HID_REPORT_CONSUMER_CTRL_SUPPORT
	help
	  The option by default enables support for HID keyboard reports, HID
	  system control report and HID consumer control report.

config DESKTOP_PERIPHERAL_TYPE_OTHER
	bool "Other"
	help
	  The option does not enable support for any of the HID reports.
	  The used HID reports must be explicitly specified.

endchoice # DESKTOP_PERIPHERAL_TYPE

menu "HID Reports"

config DESKTOP_USE_DEFAULT_REPORT_DESCR
	bool "Use default HID report descriptor"
	default y
	help
	  By default, nRF Desktop uses predefined HID report descriptor shared
	  among all of the devices. Disable this option to provide custom HID
	  report descriptor.

if DESKTOP_USE_DEFAULT_REPORT_DESCR

config DESKTOP_HID_REPORT_DESC
	string
	default "configuration/common/hid_report_desc.c"

endif

if !DESKTOP_USE_DEFAULT_REPORT_DESCR

config DESKTOP_HID_REPORT_DESC
	string "HID report descriptor"
	default ""
	help
	  This option specifies a path to the HID report descriptor file.

endif

config DESKTOP_HID_REPORT_MOUSE_SUPPORT
	bool "HID mouse report support"
	help
	  The option enables support for HID mouse input report.

	  If default HID report descriptor is used, the HID mouse report with
	  predefined format is automatically added to the HID report
	  descriptor. Otherwise, make sure to add the HID mouse report to the
	  used report descriptor.

config DESKTOP_HID_REPORT_KEYBOARD_SUPPORT
	bool "HID keyboard reports support"
	help
	  The option enables support for HID keyboard input report and HID
	  keyboard LEDs output report.

	  If default HID report descriptor is used, the HID keyboard reports
	  with predefined formats are automatically added to the HID report
	  descriptor. Otherwise, make sure to add the HID keyboard reports to
	  the used report descriptor.

config DESKTOP_HID_REPORT_SYSTEM_CTRL_SUPPORT
	bool "HID system control report support"
	help
	  The option enables support for HID system control input report.

	  If default HID report descriptor is used, the HID system control
	  report with predefined format is automatically added to the HID report
	  descriptor. Otherwise, make sure to add the HID system control report
	  to the used report descriptor.

config DESKTOP_HID_REPORT_CONSUMER_CTRL_SUPPORT
	bool "HID consumer control report support"
	help
	  The option enables support for HID consumer control input report.

	  If default HID report descriptor is used, the HID consumer control
	  report with predefined format is automatically added to the HID report
	  descriptor. Otherwise, make sure to add the HID consumer control
	  report to the used report descriptor.

choice
	prompt "Select boot protocol interface"
	default DESKTOP_HID_BOOT_INTERFACE_DISABLED

config DESKTOP_HID_BOOT_INTERFACE_DISABLED
	bool "None"

config DESKTOP_HID_BOOT_INTERFACE_MOUSE
	bool "Mouse"
	depends on DESKTOP_HID_REPORT_MOUSE_SUPPORT

config DESKTOP_HID_BOOT_INTERFACE_KEYBOARD
	bool "Keyboard"
	depends on DESKTOP_HID_REPORT_KEYBOARD_SUPPORT

endchoice

endmenu

menu "HID device identification"

config DESKTOP_DEVICE_PRODUCT
	string "Product name"
	default "Dongle nRF52 Desktop" if DESKTOP_ROLE_HID_DONGLE
	default "Mouse nRF52 Desktop" if DESKTOP_PERIPHERAL_TYPE_MOUSE
	default "Keyboard nRF52 Desktop" if DESKTOP_PERIPHERAL_TYPE_KEYBOARD
	default "HID nRF52 Desktop"
	help
	  Product name used for both GATT Device Information Service and USB
	  device. By default, name is determined by nRF Desktop device role and
	  nRF Desktop peripheral type.

config DESKTOP_DEVICE_MANUFACTURER
	string "Manufacturer"
	default "Nordic Semiconductor ASA"
	help
	  Device manufacturer used for both GATT Device Information Service and
	  USB device. By default, device manufacturer is set to Nordic
	  Semiconductor ASA.

config DESKTOP_DEVICE_VID
	hex "Vendor ID"
	range 0 0XFFFF
	default 0x1915
	help
	  Device Vendor ID used for GATT Device Information Service, USB device
	  and configuration channel. By default, Vendor ID of Nordic
	  Semiconductor ASA is used.

config DESKTOP_DEVICE_PID
	hex "Product ID"
	range 0 0XFFFF
	default 0
	help
	  Device Product ID used for GATT Device Information Service, USB device
	  and configuration channel. Product ID is used to distinguish products
	  made by the given vendor. Value must be configured in the application
	  configuration.

config DESKTOP_DEVICE_GENERATION
	string "Device generation"
	default "default"
	help
	  The Kconfig option is used to specify device generation. The option
	  allows to distinguish configurations that use the same board and
	  bootloader, but are not interoperable.

endmenu

endmenu
```

## applications/nrf_desktop/Kconfig.sysbuild
```kconfig
#
# Copyright (c) 2024 Nordic Semiconductor ASA
#
# SPDX-License-Identifier: LicenseRef-Nordic-5-Clause
#

# Add application-specific sysbuild images configuration.
rsource "images/sysbuild/Kconfig"

source "${ZEPHYR_BASE}/share/sysbuild/Kconfig"
```

## applications/nrf_desktop/build_pca20041/Kconfig.modules
```kconfig
osource "C:/ncs.sojkk/nrf/Kconfig.nrf"

osource "C:/ncs.sojkk/mcuboot/zephyr/Kconfig"

osource "C:/ncs.sojkk/nrfxlib/Kconfig.nrfxlib"
```

## applications/nrf_desktop/configuration/nrf54l15pdk_nrf54l15_cpuapp/boards/nrf54l15pdk_nrf54l15_cpuapp_0_2_1_keyboard.conf
```kconfig
#
# Copyright (c) 2024 Nordic Semiconductor ASA
#
# SPDX-License-Identifier: LicenseRef-Nordic-5-Clause
#
################################################################################


# GPIOs assigned to Button 3 and Button 4 on the PDK v0.2.1 do not support interrupts.
# Because of this, the GPIOs are not supported by the CAF buttons module and cannot be used to
# generate keypresses.
CONFIG_CAF_BUTTONS_DEF_PATH="buttons_def_0_2_1.h"
CONFIG_DESKTOP_HID_STATE_HID_KEYMAP_DEF_PATH="hid_keymap_def_keyboard_0_2_1.h"
CONFIG_DESKTOP_BUTTONS_SIM_TRIGGER_KEY_ID=0x01
```

## applications/nrf_desktop/configuration/nrf54l15pdk_nrf54l15_cpuapp/boards/nrf54l15pdk_nrf54l15_cpuapp_0_2_1_release.conf
```kconfig
#
# Copyright (c) 2024 Nordic Semiconductor ASA
#
# SPDX-License-Identifier: LicenseRef-Nordic-5-Clause
#
################################################################################

# GPIOs assigned to Button 3 and Button 4 on the PDK v0.2.1 do not support interrupts.
# Because of this, the GPIOs are not supported by the CAF buttons module and cannot be used to
# generate motion.
CONFIG_CAF_BUTTONS_DEF_PATH="buttons_def_0_2_1.h"
CONFIG_DESKTOP_MOTION_BUTTONS_LEFT_KEY_ID=0
CONFIG_DESKTOP_MOTION_BUTTONS_RIGHT_KEY_ID=1
CONFIG_DESKTOP_MOTION_BUTTONS_UP_KEY_ID=2
CONFIG_DESKTOP_MOTION_BUTTONS_DOWN_KEY_ID=3
```
