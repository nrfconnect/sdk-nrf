## drivers/saadct/Kconfig
```kconfig
#
# Copyright (c) 2026 Nordic Semiconductor
#
# SPDX-License-Identifier: LicenseRef-Nordic-5-Clause
#

DT_COMPAT_NORDIC_NRF_SAADCT := nordic,nrf-saadct

config SAADCT
	bool "SAADCT NRFX driver (SAADC sampled by TIMER)"
	default y
	depends on DT_HAS_NORDIC_NRF_SAADCT_ENABLED
	select NRFX_TIMER
	select NRFX_GPPI
	select NRFX_SAADC
	help
	  Enable the SAADCT shim that uses an external TIMER and GPPI to trigger
	  SAADC sampling at a configured rate.

if SAADCT

config SAADCT_INIT_PRIORITY
	int "SAADCT driver init priority"
	default 50
	help
	  Device driver initialization priority.

module = SAADCT
module-str = saadct
source "subsys/logging/Kconfig.template.log_config"

endif
```
