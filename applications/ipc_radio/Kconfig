## applications/nrf_desktop/src/modules/Kconfig.ble_conn_params
```kconfig
#
# Copyright (c) 2023 Nordic Semiconductor ASA
#
# SPDX-License-Identifier: LicenseRef-Nordic-5-Clause
#

menuconfig DESKTOP_BLE_CONN_PARAMS_ENABLE
	bool "BLE connection parameters module"
	depends on DESKTOP_BT_CENTRAL
	help
	  The module updates the Bluetooth connection parameters after the
	  peripheral discovery, handles connection parameter update requests
	  from the connected peripherals and reduces power consumption while
	  USB is suspended. This is done by increasing the Bluetooth connection
	  interval for non-HID SCI connections, or by switching HID SCI
	  connections to the LOW_POWER mode.

if DESKTOP_BLE_CONN_PARAMS_ENABLE

config DESKTOP_BLE_USB_MANAGED_CI
	bool "Manage BLE connection parameters on USB state change"
	default y
	depends on DESKTOP_USB_ENABLE
	help
	  Manage BLE connection parameters depending on the USB state. Allows
	  reduced power consumption of the USB dongle device while the USB
	  enters suspended state. For standard (non-SCI) connections, the module
	  sets a larger connection interval and non-zero peripheral latency.
	  For HID SCI connections, the module requests the LOW_POWER HID SCI
	  mode instead. After the USB resumes normal operation, the module
	  restores the previous connection parameters or requests the FAST
	  HID SCI mode, respectively.

config DESKTOP_BLE_USB_MANAGED_CI_VALUE
	int "BLE connection interval when USB is suspended"
	default 100
	depends on DESKTOP_BLE_USB_MANAGED_CI
	range 10 100
	help
	  Connection interval used for standard (non-SCI) connections while the
	  USB is in suspended state. This option does not apply to HID SCI
	  connections.

config DESKTOP_BLE_USB_MANAGED_LATENCY_VALUE
	int "BLE peripheral latency when USB is suspended"
	default 1
	depends on DESKTOP_BLE_USB_MANAGED_CI
	range 1 10
	help
	  Peripheral latency used for standard (non-SCI) connections while the
	  USB is in suspended state. This option does not apply to HID SCI
	  connections.

if !DESKTOP_BLE_USB_MANAGED_CI

config DESKTOP_BLE_USB_MANAGED_CI_VALUE
	int
	default 0

config DESKTOP_BLE_USB_MANAGED_LATENCY_VALUE
	int
	default 0

endif # !DESKTOP_BLE_USB_MANAGED_CI

config DESKTOP_BLE_CONN_PARAMS_HID_SCI_ENABLE
	bool
	depends on DESKTOP_HID_FORWARD_HID_SCI_ENABLE
	default y

if DESKTOP_BLE_CONN_PARAMS_HID_SCI_ENABLE

rsource "Kconfig.ble_conn_params.sci"

endif # DESKTOP_BLE_CONN_PARAMS_HID_SCI_ENABLE

module = DESKTOP_BLE_CONN_PARAMS
module-str = BLE connection parameters
source "subsys/logging/Kconfig.template.log_config"

endif # DESKTOP_BLE_CONN_PARAMS_ENABLE
```

## applications/nrf_desktop/src/util/Kconfig.adv_prov
```kconfig
#
# Copyright (c) 2025 Nordic Semiconductor ASA
#
# SPDX-License-Identifier: LicenseRef-Nordic-5-Clause
#

config DESKTOP_ADV_PROV_UUID16_ALL
	bool "UUID16 advertising provider"
	depends on BT_ADV_PROV
	depends on (DESKTOP_HIDS_ENABLE || DESKTOP_BAS_ENABLE)
	help
	  Adds all UUID16 to the advertising payload if used Bluetooth local
	  identity has no bond.

if DESKTOP_ADV_PROV_UUID16_ALL
config DESKTOP_ADV_PROV_UUID16_ALL_SD
	bool "Move UUID16 to scan response"
	default y
	help
	  Adds all UUID16 to scan response data. If this option is
	  disabled, the UUID16 is included in the advertising data.
endif
```

## boards/nordic/nrf54lc10dk/board.yml
```yaml
board:
  name: nrf54lc10dk
  full_name: nRF54LC10 DK
  vendor: nordic
  socs:
    - name: nrf54lc10a
      variants:
        - name: ns
          cpucluster: cpuapp
  revision:
    format: major.minor.patch
    default: "0.8.0"
    revisions:
      - name: "0.8.0"
runners:
  run_once:
    '--recover':
      - runners:
          - nrfutil
        run: first
        groups:
          - boards:
              - nrf54lc10dk@0.8.0/nrf54lc10a/cpuapp
              - nrf54lc10dk@0.8.0/nrf54lc10a/cpuapp/ns
              - nrf54lc10dk@0.8.0/nrf54lc10a/cpuflpr
    '--erase':
      - runners:
          - jlink
          - nrfutil
        run: first
        groups:
          - boards:
              - nrf54lc10dk@0.8.0/nrf54lc10a/cpuapp
              - nrf54lc10dk@0.8.0/nrf54lc10a/cpuapp/ns
              - nrf54lc10dk@0.8.0/nrf54lc10a/cpuflpr
    '--reset':
      - runners:
          - jlink
          - nrfutil
        run: last
        groups:
          - boards:
              - nrf54lc10dk@0.8.0/nrf54lc10a/cpuapp
              - nrf54lc10dk@0.8.0/nrf54lc10a/cpuapp/ns
              - nrf54lc10dk@0.8.0/nrf54lc10a/cpuflpr
```

## boards/nordic/nrf54lv10dk/board.yml
```yaml
board:
  name: nrf54lv10dk
  full_name: nRF54LV10 DK
  vendor: nordic
  socs:
    - name: nrf54lv10a
      variants:
        - name: ns
          cpucluster: cpuapp
  revision:
    format: major.minor.patch
    default: "0.7.0"
    revisions:
      - name: "0.7.0"
runners:
  run_once:
    '--recover':
      - runners:
          - nrfutil
        run: first
        groups:
          - boards:
              - nrf54lv10dk@0.7.0/nrf54lv10a/cpuapp
              - nrf54lv10dk@0.7.0/nrf54lv10a/cpuapp/ns
              - nrf54lv10dk@0.7.0/nrf54lv10a/cpuflpr
    '--erase':
      - runners:
          - jlink
          - nrfutil
        run: first
        groups:
          - boards:
              - nrf54lv10dk@0.7.0/nrf54lv10a/cpuapp
              - nrf54lv10dk@0.7.0/nrf54lv10a/cpuapp/ns
              - nrf54lv10dk@0.7.0/nrf54lv10a/cpuflpr
    '--reset':
      - runners:
          - jlink
          - nrfutil
        run: last
        groups:
          - boards:
              - nrf54lv10dk@0.7.0/nrf54lv10a/cpuapp
              - nrf54lv10dk@0.7.0/nrf54lv10a/cpuapp/ns
              - nrf54lv10dk@0.7.0/nrf54lv10a/cpuflpr
```

## boards/nordic/nrf9251dk/Kconfig.defconfig
```kconfig
# Copyright (c) 2026 Nordic Semiconductor ASA
# SPDX-License-Identifier: LicenseRef-Nordic-5-Clause

config HW_STACK_PROTECTION
	default ARCH_HAS_STACK_PROTECTION

if BOARD_NRF9251DK_NRF9251_CPUAPP

config USE_DT_CODE_PARTITION
	default y

endif # BOARD_NRF9251DK_NRF9251_CPUAPP
```

## boards/nordic/thingy91/Kconfig.sysbuild
```kconfig
#
# Copyright (c) 2024 Nordic Semiconductor ASA
#
# SPDX-License-Identifier: LicenseRef-Nordic-5-Clause
#

choice BOOTLOADER
	default BOOTLOADER_MCUBOOT
endchoice
```

## boards/nordic/thingy91x/Kconfig
```kconfig
# Copyright (c) 2024 Nordic Semiconductor
# SPDX-License-Identifier: LicenseRef-Nordic-5-Clause

module=BOARD
module-str=board
source "$(ZEPHYR_BASE)/subsys/logging/Kconfig.template.log_config"

if BOARD_THINGY91X_NRF5340_CPUNET

config BT_ECC
	default y if BT

endif # BOARD_THINGY91X_NRF5340_CPUNET
```

## boards/shields/nrf_audio_eb/Kconfig.shield
```kconfig
#
# Copyright (c) 2026 Nordic Semiconductor ASA
#
# SPDX-License-Identifier: LicenseRef-Nordic-5-Clause
#

config SHIELD_NRF_AUDIO_EB
	def_bool $(shields_list_contains,nrf_audio_eb)
```

## drivers/audio/Kconfig
```kconfig
#
# Copyright (c) 2026 Nordic Semiconductor ASA
#
# SPDX-License-Identifier: LicenseRef-Nordic-5-Clause

if AUDIO_CODEC

rsource "Kconfig.tac5112"

endif # AUDIO_CODEC
```

## drivers/audio/Kconfig.tac5112
```kconfig
# Texas Instruments TAC5112 low-power stereo audio codec
#
# Copyright (c) 2026 Nordic Semiconductor ASA
#
# SPDX-License-Identifier: LicenseRef-Nordic-5-Clause
#

config AUDIO_TAC5112
	bool "TAC5112 stereo audio codec support"
	default y
	depends on DT_HAS_TI_TAC5112_ENABLED
	select I2C
	depends on GPIO
	help
	  Enable the driver for the Texas Instruments TAC5112 low-power
	  stereo audio codec, controlled over I2C with the audio data path
	  carried over I2S/TDM (the codec operating as the I2S bus target).

config AUDIO_TAC5112_EMUL
	bool "TAC5112 I2C emulator (test only)"
	depends on AUDIO_TAC5112
	depends on EMUL
	help
	  Enable the I2C emulator used by tests/drivers/audio/tac5112 to
	  exercise the TAC5112 driver on native_sim without hardware. Not
	  intended for production images.
```

## drivers/can/Kconfig
```kconfig
#
# Copyright (c) 2026 Nordic Semiconductor
#
# SPDX-License-Identifier: LicenseRef-Nordic-5-Clause
#

if CAN

rsource "Kconfig.nrf_scan"

endif # CAN
```

## drivers/can/Kconfig.nrf_scan
```kconfig
#
# Copyright (c) 2026 Nordic Semiconductor
#
# SPDX-License-Identifier: LicenseRef-Nordic-5-Clause
#

config CAN_NRF_SCAN
	bool "nRF sCAN device driver"
	default y
	depends on DT_HAS_NORDIC_NRF_SCAN_ENABLED
	select PINCTRL
```

## drivers/dect/dect_mdm/Kconfig.rx
```kconfig
# Copyright (c) 2025 Nordic Semiconductor ASA
#
# SPDX-License-Identifier: LicenseRef-Nordic-5-Clause

config DECT_MDM_NRF_RX_EVENT_POOL_COUNT
	int "DECT RX event pool size"
	default 100
	help
	  Number of RX event structures that can be allocated simultaneously.
	  Each block is sized for struct dect_mdm_ctrl_dlc_rx_data_with_pkt_ptr.
	  Increase if you see allocation failure messages under high load.

config DECT_MDM_NRF_RX_THREAD_STACK_SIZE
	int "Driver's internal RX thread stack size"
	default 3072
	help
	  This option sets the driver's stack size for its internal RX thread.

config DECT_MDM_NRF_RX_MSGQ_SIZE
	int "Driver's internal RX message queue size"
	default 100
	help
	  This option sets the driver's internal RX message queue size.

config DECT_MDM_RX_PRIVATE_POOL
	bool "Use a DECT-private net_pkt/net_buf pool for RX"
	help
	  Allocate DECT RX net_pkt and net_buf from a DECT-only pool, isolated
	  from the global Zephyr RX pools. Prevents other interfaces (e.g. Ethernet)
	  from starving DECT RX under heavy uplink load. When CONFIG_SHELL is also
	  enabled, adds a "dect_mdm rx_pool" shell command to print pool usage.

if DECT_MDM_RX_PRIVATE_POOL

config DECT_MDM_RX_PRIVATE_PKT_COUNT
	int "DECT-private RX net_pkt count"
	default 8
	range 1 256
	help
	  Maximum simultaneous in-flight DECT RX packets allocated from the
	  private slab.

config DECT_MDM_RX_PRIVATE_BUF_COUNT
	int "DECT-private RX net_buf count"
	default 16
	range 1 1024
	help
	  Number of payload fragments in the DECT-private buffer pool. A max-MTU
	  packet uses ceil(MTU / DECT_MDM_RX_PRIVATE_BUF_SIZE) fragments.

config DECT_MDM_RX_PRIVATE_BUF_SIZE
	int "DECT-private RX net_buf fragment size (bytes)"
	default 256
	range 64 1500
	help
	  Size of each DECT-private RX buffer fragment. Smaller values are more
	  efficient for short DECT frames; larger values reduce fragment count
	  for max-MTU frames.

endif # DECT_MDM_RX_PRIVATE_POOL
```

## drivers/nrf71_sr_coex/Kconfig
```kconfig
#
# Copyright (c) 2026 Nordic Semiconductor ASA
#
# SPDX-License-Identifier: LicenseRef-Nordic-5-Clause
#

menuconfig NRF71_SR_COEX_DRIVER
	bool "nRF71 Wi-Fi / Short-Range coexistence driver"
	depends on NRF71_WIFI
	help
	  Standalone coexistence coordination driver for the nRF71 combo SoC.

	  The driver configures the on-chip Coexistence Controller (COEXC),
	  forwards CD2CM commands to the Coexistence Manager over the Wi-Fi FMAC
	  control path, and coordinates with the Wi-Fi and Short-Range drivers.

	  The CD<->CM messaging is carried over the Wi-Fi host<->RPU path, so this
	  depends on the nRF71 Wi-Fi driver (NRF71_WIFI). The Coexistence Manager
	  is configured every time Wi-Fi comes up.

if NRF71_SR_COEX_DRIVER

config NRF71_SR_COEX_DRIVER_INIT_PRIORITY
	int "Coexistence driver init priority"
	default 90
	help
	  Initialisation priority of the coexistence driver within the
	  APPLICATION init level. The driver learns the Wi-Fi state through the
	  Wi-Fi driver's state notifier, which replays the current state on
	  registration, so the order against the Wi-Fi driver doesn't matter.

config NRF71_SR_COEX_CM_EVENT_WAIT_MS
	int "CM2CD event wait timeout (ms)"
	range 1 60000
	default 5000
	help
	  Maximum time to wait for a CM2CD completion event after posting a
	  CD2CM command. Increase on slow FPGA targets if commands are timing out.

config NRF71_SR_COEX_CM_RETRY_MAX
	int "Retries of a failed CM configuration"
	range 0 10
	default 3
	help
	  Number of times the CM configuration is repeated after it fails,
	  spaced by NRF71_SR_COEX_CM_RETRY_INTERVAL_MS. Retries stop at the first
	  success or when Wi-Fi goes down. A CM that doesn't answer the first
	  command at all is not retried.

config NRF71_SR_COEX_CM_RETRY_INTERVAL_MS
	int "Delay between CM configuration retries (ms)"
	range 100 60000
	default 1000

config NRF71_SR_COEX_WQ_STACK_SIZE
	int "Stack size of the coexistence work queue"
	default 1536
	help
	  The work queue runs the CD2CM/CM2CD transactions that configure the
	  Coexistence Manager.

config NRF71_SR_COEX_WQ_PRIORITY
	int "Priority of the coexistence work queue"
	default 10

config NRF71_SR_COEX_WAIT_FOR_APP_INIT
	bool "Configure the CM only after the application configuration"
	help
	  Don't configure the Coexistence Manager until the application has
	  called nrf71_sr_coex_init(), so the built-in defaults are never
	  applied first. Without it, the defaults are applied as soon as Wi-Fi
	  is up and replaced once the application configuration arrives.

menuconfig NRF71_SR_COEX_BLE_CHAN_MAP
	bool "Keep BLE off the Wi-Fi channel"
	depends on BT_CENTRAL || BT_BROADCASTER
	help
	  While the Wi-Fi station is connected on 2.4 GHz, mark the BLE data
	  channels under the Wi-Fi channel as bad through bt_le_set_chan_map(),
	  and restore the default map on disconnect and Wi-Fi down.

	  With this enabled the coexistence driver owns the BLE host channel
	  classification and overwrites any map the application sets. Leave it
	  disabled if the application manages the channel map itself.

if NRF71_SR_COEX_BLE_CHAN_MAP

config NRF71_SR_COEX_BLE_GUARD_BAND_MHZ
	int "Guard band either side of the Wi-Fi channel (MHz)"
	range 0 3
	default 3

config NRF71_SR_COEX_BLE_WORKQ_STACK_SIZE
	int "Stack size of the BLE channel map work queue"
	range 1024 8192
	default 2048
	help
	  bt_le_set_chan_map() ends in a blocking HCI command, so the driver
	  applies BLE channel maps from its own work queue rather than from the
	  Wi-Fi driver's context or the system work queue.

config NRF71_SR_COEX_BLE_CHAN_MAP_RETRIES
	int "Retries of a rejected BLE channel map"
	range 0 10
	default 1
	help
	  bt_le_set_chan_map() fails, for example, when the Bluetooth stack is
	  not enabled yet at the time Wi-Fi connects. When the call fails the
	  driver repeats it this many times,
	  NRF71_SR_COEX_BLE_CHAN_MAP_RETRY_DELAY_MS apart, unless a newer map has
	  been queued. Set to 0 to disable the retries.

config NRF71_SR_COEX_BLE_CHAN_MAP_RETRY_DELAY_MS
	int "Delay between BLE channel map retries (ms)"
	range 1000 60000
	default 2000
	help
	  The lower limit is the minimum interval the Bluetooth host requires
	  between two channel map updates.

endif # NRF71_SR_COEX_BLE_CHAN_MAP

config NRF71_SR_COEX_SHELL
	bool "Coexistence driver shell"
	depends on SHELL
	help
	  Shell commands to show the Coexistence Manager configuration state
	  and to read its statistics.

module = NRF71_SR_COEX_DRIVER
module-str = Log level for the nRF71 SR coexistence driver
source "subsys/logging/Kconfig.template.log_config"

endif # NRF71_SR_COEX_DRIVER
```

## drivers/pulse_meas/Kconfig
```kconfig
#
# Copyright (c) 2026 Nordic Semiconductor
#
# SPDX-License-Identifier: LicenseRef-Nordic-5-Clause
#

DT_COMPAT_NORDIC_PULSE_MEAS := nordic,pulse-meas

config PULSE_MEAS
	bool "nRF pulse width measurement driver"
	default y
	depends on DT_HAS_NORDIC_PULSE_MEAS_ENABLED
	select NRFX_GPIOTE
	select NRFX_TIMER
	select NRFX_GPPI
	help
	  Enable the pulse width measurement shim that uses GPIOTE, TIMER, and
	  GPPI to measure pulse widths on two GPIO inputs.

if PULSE_MEAS

config PULSE_MEAS_INIT_PRIORITY
	int "Pulse width measurement driver init priority"
	default 50
	help
	  Device driver initialization priority.

config PULSE_MEAS_USE_HFCLK
	bool "Use HFCLK for pulse measurement"
	help
	  Use HFCLK for pulse measurement.

module = PULSE_MEAS
module-str = pulse measurement
source "subsys/logging/Kconfig.template.log_config"

endif
```
