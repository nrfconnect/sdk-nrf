## applications/nrf_desktop/sample.yaml
```yaml
sample:
  name: nRF Desktop - HID reference design
  description: The nRF Desktop is an HID reference design application. It can be configured
    to function as a mouse, keyboard or USB dongle bridging radio connected HID peripheral.
common:
  sysbuild: true
  tags:
    - ci_build
    - sysbuild
    - ci_applications_nrf_desktop
  harness_config:
    type: multi_line
    ordered: false
    regex:
      - "app_event_manager: e:module_state_event module:main state:READY"
      - "ble_state: Bluetooth initialized"
      - "settings_loader: Settings loaded"
      - "ble_bond: Selected Bluetooth LE peers"
      - "(ble_adv: Advertising started)|(ble_scan: Scan started)"
tests:
  applications.nrf_desktop.zdebug.uart:
    extra_configs:
      - CONFIG_CLOCK_CONTROL_NRF=n
    platform_allow:
      - nrf54h20dk/nrf54h20/cpuapp
      - nrf54l15dk/nrf54l05/cpuapp
      - nrf54l15dk/nrf54l10/cpuapp
      - nrf54l15dk/nrf54l15/cpuapp
      - nrf54lm20dk/nrf54lm20a/cpuapp
      - nrf54lm20dk/nrf54lm20b/cpuapp
      - nrf54ls05dk/nrf54ls05a/cpuapp
      - nrf54ls05dk/nrf54ls05b/cpuapp
      - nrf54lc10dk/nrf54lc10a/cpuapp
    integration_platforms:
      - nrf54h20dk/nrf54h20/cpuapp
      - nrf54l15dk/nrf54l05/cpuapp
      - nrf54l15dk/nrf54l10/cpuapp
      - nrf54l15dk/nrf54l15/cpuapp
      - nrf54lm20dk/nrf54lm20a/cpuapp
      - nrf54lm20dk/nrf54lm20b/cpuapp
      - nrf54ls05dk/nrf54ls05a/cpuapp
      - nrf54ls05dk/nrf54ls05b/cpuapp
      - nrf54lc10dk/nrf54lc10a/cpuapp
    harness: console
  applications.nrf_desktop.zdebug:
    build_only: true
    extra_configs:
      - CONFIG_CLOCK_CONTROL_NRF=n
    platform_allow:
      - nrf5340dk/nrf5340/cpuapp
    integration_platforms:
      - nrf5340dk/nrf5340/cpuapp
  applications.nrf_desktop.zdebug_fast_pair.gmouse.uart:
    extra_configs:
      - CONFIG_CLOCK_CONTROL_NRF=n
    platform_allow:
      - nrf54l15dk/nrf54l10/cpuapp
      - nrf54l15dk/nrf54l15/cpuapp
    integration_platforms:
      - nrf54l15dk/nrf54l10/cpuapp
      - nrf54l15dk/nrf54l15/cpuapp
    extra_args:
      - FILE_SUFFIX=fast_pair
    harness: console
  applications.nrf_desktop.zdebug_hid_sci.uart:
    platform_allow:
      - nrf54l15dk/nrf54l15/cpuapp
    integration_platforms:
      - nrf54l15dk/nrf54l15/cpuapp
    extra_args: FILE_SUFFIX=hid_sci
    harness: console
  applications.nrf_desktop.zrelease_hid_sci:
    build_only: true
    platform_allow:
      - nrf54l15dk/nrf54l15/cpuapp
    integration_platforms:
      - nrf54l15dk/nrf54l15/cpuapp
    extra_args: FILE_SUFFIX=release_hid_sci
  applications.nrf_desktop.zdebug_dongle_4llpmconn.uart:
    platform_allow:
      - nrf54lm20dk/nrf54lm20a/cpuapp
      - nrf54lm20dk/nrf54lm20b/cpuapp
    extra_configs:
      - CONFIG_CLOCK_CONTROL_NRF=n
    integration_platforms:
      - nrf54lm20dk/nrf54lm20b/cpuapp
    harness: console
    extra_args: FILE_SUFFIX=dongle_4llpmconn
  applications.nrf_desktop.zdebug_dongle.uart:
    extra_configs:
      - CONFIG_CLOCK_CONTROL_NRF=n
    platform_allow:
      - nrf54h20dk/nrf54h20/cpuapp
      - nrf54lm20dk/nrf54lm20a/cpuapp
      - nrf54lm20dk/nrf54lm20b/cpuapp
    integration_platforms:
      - nrf54h20dk/nrf54h20/cpuapp
      - nrf54lm20dk/nrf54lm20b/cpuapp
    harness: console
    extra_args: FILE_SUFFIX=dongle
  applications.nrf_desktop.zrelease_dongle:
    build_only: true
    extra_configs:
      - CONFIG_CLOCK_CONTROL_NRF=n
    platform_allow:
      - nrf54h20dk/nrf54h20/cpuapp
      - nrf54lm20dk/nrf54lm20a/cpuapp
      - nrf54lm20dk/nrf54lm20b/cpuapp
    integration_platforms:
      - nrf54h20dk/nrf54h20/cpuapp
      - nrf54lm20dk/nrf54lm20b/cpuapp
    extra_args: FILE_SUFFIX=release_dongle
  applications.nrf_desktop.zdebug_hid_sci_dongle.uart:
    platform_allow:
      - nrf54lm20dk/nrf54lm20a/cpuapp
      - nrf54lm20dk/nrf54lm20b/cpuapp
    integration_platforms:
      - nrf54lm20dk/nrf54lm20b/cpuapp
    extra_args: FILE_SUFFIX=hid_sci_dongle
    harness: console
  applications.nrf_desktop.zrelease_hid_sci_dongle:
    build_only: true
    platform_allow:
      - nrf54lm20dk/nrf54lm20a/cpuapp
      - nrf54lm20dk/nrf54lm20b/cpuapp
    integration_platforms:
      - nrf54lm20dk/nrf54lm20b/cpuapp
    extra_args: FILE_SUFFIX=release_hid_sci_dongle
  applications.nrf_desktop.zdebug_keyboard.uart:
    extra_configs:
      - CONFIG_CLOCK_CONTROL_NRF=n
    platform_allow:
      - nrf54l15dk/nrf54l10/cpuapp
      - nrf54l15dk/nrf54l15/cpuapp
      - nrf54ls05dk/nrf54ls05a/cpuapp
      - nrf54ls05dk/nrf54ls05b/cpuapp
    integration_platforms:
      - nrf54l15dk/nrf54l10/cpuapp
      - nrf54l15dk/nrf54l15/cpuapp
      - nrf54ls05dk/nrf54ls05a/cpuapp
      - nrf54ls05dk/nrf54ls05b/cpuapp
    extra_args: FILE_SUFFIX=keyboard
    harness: console
  applications.nrf_desktop.zrelease_keyboard:
    build_only: true
    extra_configs:
      - CONFIG_CLOCK_CONTROL_NRF=n
    platform_allow:
      - nrf54l15dk/nrf54l05/cpuapp
      - nrf54ls05dk/nrf54ls05a/cpuapp
      - nrf54ls05dk/nrf54ls05b/cpuapp
    integration_platforms:
      - nrf54l15dk/nrf54l05/cpuapp
      - nrf54ls05dk/nrf54ls05a/cpuapp
      - nrf54ls05dk/nrf54ls05b/cpuapp
    extra_args: FILE_SUFFIX=release_keyboard
  applications.nrf_desktop.zdebug_nrf21540ek_multicore:
    build_only: true
    platform_allow: nrf5340dk/nrf5340/cpuapp
    integration_platforms:
      - nrf5340dk/nrf5340/cpuapp
    extra_args:
      - SHIELD=nrf21540ek
      - ipc_radio_SHIELD=nrf21540ek
    extra_configs:
      - CONFIG_CLOCK_CONTROL_NRF=n
      - CONFIG_CAF_BLE_USE_LLPM=n
  applications.nrf_desktop.zrelease:
    build_only: true
    extra_configs:
      - CONFIG_CLOCK_CONTROL_NRF=n
    platform_allow:
      - nrf5340dk/nrf5340/cpuapp
      - nrf54h20dk/nrf54h20/cpuapp
      - nrf54l15dk/nrf54l05/cpuapp
      - nrf54l15dk/nrf54l10/cpuapp
      - nrf54l15dk/nrf54l15/cpuapp
      - nrf54lm20dk/nrf54lm20a/cpuapp
      - nrf54lm20dk/nrf54lm20b/cpuapp
      - nrf54ls05dk/nrf54ls05a/cpuapp
      - nrf54ls05dk/nrf54ls05b/cpuapp
      - nrf54lc10dk/nrf54lc10a/cpuapp
    integration_platforms:
      - nrf5340dk/nrf5340/cpuapp
      - nrf54h20dk/nrf54h20/cpuapp
      - nrf54l15dk/nrf54l15/cpuapp
      - nrf54lm20dk/nrf54lm20a/cpuapp
      - nrf54lm20dk/nrf54lm20b/cpuapp
      - nrf54ls05dk/nrf54ls05a/cpuapp
      - nrf54ls05dk/nrf54ls05b/cpuapp
      - nrf54lc10dk/nrf54lc10a/cpuapp
    extra_args: FILE_SUFFIX=release
  applications.nrf_desktop.zrelease_fast_pair.gmouse:
    build_only: true
    extra_configs:
      - CONFIG_CLOCK_CONTROL_NRF=n
    platform_allow:
      - nrf54l15dk/nrf54l05/cpuapp
      - nrf54ls05dk/nrf54ls05a/cpuapp
      - nrf54ls05dk/nrf54ls05b/cpuapp
    integration_platforms:
      - nrf54l15dk/nrf54l05/cpuapp
      - nrf54ls05dk/nrf54ls05a/cpuapp
    extra_args:
      - FILE_SUFFIX=release_fast_pair
  applications.nrf_desktop.zrelease_dongle_4llpmconn:
    build_only: true
    extra_configs:
      - CONFIG_CLOCK_CONTROL_NRF=n
    platform_allow:
      - nrf54lm20dk/nrf54lm20a/cpuapp
      - nrf54lm20dk/nrf54lm20b/cpuapp
    integration_platforms:
      - nrf54lm20dk/nrf54lm20b/cpuapp
    extra_args: FILE_SUFFIX=release_dongle_4llpmconn
  applications.nrf_desktop.zdebug.llvm.uart:
    toolchain_allow: llvm
    extra_configs:
      - CONFIG_CLOCK_CONTROL_NRF=n
    integration_platforms:
      - nrf54lm20dk/nrf54lm20a/cpuapp
      - nrf54lm20dk/nrf54lm20b/cpuapp
    platform_allow:
      - nrf54lm20dk/nrf54lm20a/cpuapp
      - nrf54lm20dk/nrf54lm20b/cpuapp
    extra_args: FILE_SUFFIX=llvm
    harness: console
  applications.nrf_desktop.zdebug_ram_load.uart:
    extra_configs:
      - CONFIG_CLOCK_CONTROL_NRF=n
    platform_allow:
      - nrf54lm20dk/nrf54lm20a/cpuapp
      - nrf54lm20dk/nrf54lm20b/cpuapp
    integration_platforms:
      - nrf54lm20dk/nrf54lm20a/cpuapp
      - nrf54lm20dk/nrf54lm20b/cpuapp
    extra_args: FILE_SUFFIX=ram_load
    harness: console
  applications.nrf_desktop.zrelease_ram_load:
    build_only: true
    extra_configs:
      - CONFIG_CLOCK_CONTROL_NRF=n
    platform_allow:
      - nrf54lm20dk/nrf54lm20a/cpuapp
    integration_platforms:
      - nrf54lm20dk/nrf54lm20a/cpuapp
    extra_args: FILE_SUFFIX=release_ram_load
  applications.nrf_desktop.zdebug.uart.legacy:
    extra_configs:
      - CONFIG_CLOCK_CONTROL_NRF=y
      - CONFIG_DEPRECATION_TEST=y
    platform_allow:
      - nrf54h20dk/nrf54h20/cpuapp
      - nrf54l15dk/nrf54l05/cpuapp
      - nrf54l15dk/nrf54l10/cpuapp
      - nrf54l15dk/nrf54l15/cpuapp
      - nrf54lm20dk/nrf54lm20a/cpuapp
      - nrf54ls05dk/nrf54ls05b/cpuapp
    integration_platforms:
      - nrf54h20dk/nrf54h20/cpuapp
      - nrf54l15dk/nrf54l05/cpuapp
      - nrf54l15dk/nrf54l10/cpuapp
      - nrf54l15dk/nrf54l15/cpuapp
      - nrf54lm20dk/nrf54lm20a/cpuapp
      - nrf54ls05dk/nrf54ls05b/cpuapp
    harness: console
  applications.nrf_desktop.zdebug.legacy:
    build_only: true
    extra_configs:
      - CONFIG_CLOCK_CONTROL_NRF=y
      - CONFIG_DEPRECATION_TEST=y
    platform_allow:
      - nrf5340dk/nrf5340/cpuapp
    integration_platforms:
      - nrf5340dk/nrf5340/cpuapp
  applications.nrf_desktop.zdebug_fast_pair.gmouse.uart.legacy:
    extra_configs:
      - CONFIG_CLOCK_CONTROL_NRF=y
      - CONFIG_DEPRECATION_TEST=y
    platform_allow:
      - nrf54l15dk/nrf54l10/cpuapp
      - nrf54l15dk/nrf54l15/cpuapp
    integration_platforms:
      - nrf54l15dk/nrf54l10/cpuapp
      - nrf54l15dk/nrf54l15/cpuapp
    extra_args:
      - FILE_SUFFIX=fast_pair
    harness: console
  applications.nrf_desktop.zdebug_dongle.uart.legacy:
    extra_configs:
      - CONFIG_CLOCK_CONTROL_NRF=y
      - CONFIG_DEPRECATION_TEST=y
    platform_allow:
      - nrf54h20dk/nrf54h20/cpuapp
    integration_platforms:
      - nrf54h20dk/nrf54h20/cpuapp
    harness: console
    extra_args: FILE_SUFFIX=dongle
  applications.nrf_desktop.zrelease_dongle.legacy:
    build_only: true
    extra_configs:
      - CONFIG_CLOCK_CONTROL_NRF=y
      - CONFIG_DEPRECATION_TEST=y
    platform_allow:
      - nrf54h20dk/nrf54h20/cpuapp
    integration_platforms:
      - nrf54h20dk/nrf54h20/cpuapp
    extra_args: FILE_SUFFIX=release_dongle
  applications.nrf_desktop.zdebug_keyboard.uart.legacy:
    extra_configs:
      - CONFIG_CLOCK_CONTROL_NRF=y
      - CONFIG_DEPRECATION_TEST=y
    platform_allow:
      - nrf54l15dk/nrf54l10/cpuapp
      - nrf54l15dk/nrf54l15/cpuapp
      - nrf54ls05dk/nrf54ls05b/cpuapp
    integration_platforms:
      - nrf54l15dk/nrf54l10/cpuapp
      - nrf54l15dk/nrf54l15/cpuapp
      - nrf54ls05dk/nrf54ls05b/cpuapp
    extra_args: FILE_SUFFIX=keyboard
    harness: console
  applications.nrf_desktop.zrelease_keyboard.legacy:
    build_only: true
    extra_configs:
      - CONFIG_CLOCK_CONTROL_NRF=y
      - CONFIG_DEPRECATION_TEST=y
    platform_allow:
      - nrf54l15dk/nrf54l05/cpuapp
      - nrf54ls05dk/nrf54ls05b/cpuapp
    integration_platforms:
      - nrf54l15dk/nrf54l05/cpuapp
      - nrf54ls05dk/nrf54ls05b/cpuapp
    extra_args: FILE_SUFFIX=release_keyboard
  applications.nrf_desktop.zdebug_nrf21540ek_multicore.legacy:
    build_only: true
    platform_allow: nrf5340dk/nrf5340/cpuapp
    integration_platforms:
      - nrf5340dk/nrf5340/cpuapp
    extra_args:
      - SHIELD=nrf21540ek
      - ipc_radio_SHIELD=nrf21540ek
    extra_configs:
      - CONFIG_CLOCK_CONTROL_NRF=y
      - CONFIG_DEPRECATION_TEST=y
      - CONFIG_CAF_BLE_USE_LLPM=n
  applications.nrf_desktop.zrelease.legacy:
    build_only: true
    extra_configs:
      - CONFIG_CLOCK_CONTROL_NRF=y
      - CONFIG_DEPRECATION_TEST=y
    platform_allow:
      - nrf5340dk/nrf5340/cpuapp
      - nrf54h20dk/nrf54h20/cpuapp
      - nrf54l15dk/nrf54l05/cpuapp
      - nrf54l15dk/nrf54l10/cpuapp
      - nrf54l15dk/nrf54l15/cpuapp
      - nrf54lm20dk/nrf54lm20a/cpuapp
      - nrf54ls05dk/nrf54ls05b/cpuapp
    integration_platforms:
      - nrf5340dk/nrf5340/cpuapp
      - nrf54h20dk/nrf54h20/cpuapp
      - nrf54l15dk/nrf54l15/cpuapp
      - nrf54lm20dk/nrf54lm20a/cpuapp
      - nrf54ls05dk/nrf54ls05b/cpuapp
    extra_args: FILE_SUFFIX=release
  applications.nrf_desktop.zrelease_fast_pair.gmouse.legacy:
    build_only: true
    extra_configs:
      - CONFIG_CLOCK_CONTROL_NRF=y
      - CONFIG_DEPRECATION_TEST=y
    platform_allow:
      - nrf54l15dk/nrf54l05/cpuapp
    integration_platforms:
      - nrf54l15dk/nrf54l05/cpuapp
    extra_args:
      - FILE_SUFFIX=release_fast_pair
  applications.nrf_desktop.zdebug.llvm.uart.legacy:
    toolchain_allow: llvm
    extra_configs:
      - CONFIG_CLOCK_CONTROL_NRF=y
      - CONFIG_DEPRECATION_TEST=y
    integration_platforms:
      - nrf54lm20dk/nrf54lm20a/cpuapp
    platform_allow:
      - nrf54lm20dk/nrf54lm20a/cpuapp
    extra_args: FILE_SUFFIX=llvm
    harness: console
  applications.nrf_desktop.zdebug_ram_load.uart.legacy:
    extra_configs:
      - CONFIG_CLOCK_CONTROL_NRF=y
      - CONFIG_DEPRECATION_TEST=y
    platform_allow:
      - nrf54lm20dk/nrf54lm20a/cpuapp
    integration_platforms:
      - nrf54lm20dk/nrf54lm20a/cpuapp
    extra_args: FILE_SUFFIX=ram_load
    harness: console
  applications.nrf_desktop.zrelease_ram_load.legacy:
    build_only: true
    extra_configs:
      - CONFIG_CLOCK_CONTROL_NRF=y
      - CONFIG_DEPRECATION_TEST=y
    platform_allow:
      - nrf54lm20dk/nrf54lm20a/cpuapp
      - nrf54lm20dk/nrf54lm20b/cpuapp
    integration_platforms:
      - nrf54lm20dk/nrf54lm20a/cpuapp
      - nrf54lm20dk/nrf54lm20b/cpuapp
    extra_args: FILE_SUFFIX=release_ram_load
```
