## applications/ipc_radio/Kconfig
```kconfig
#
# Copyright (c) 2023 Nordic Semiconductor
#
# SPDX-License-Identifier: LicenseRef-Nordic-5-Clause
#

mainmenu "Nordic ipc_radio firmware"

config IPC_RADIO_802154
	bool "IPC IEEE 802.15.4 radio"
	select NRF_802154_SER_RADIO
	help
	  Enable the IPC IEEE 802.15.4 radio serialization.

config IPC_RADIO_BT
	bool "IPC Bluetooth"
	help
	  Enable the IPC Bluetooth radio serialization.

if IPC_RADIO_BT

choice IPC_RADIO_BT_SER
	default IPC_RADIO_BT_HCI_IPC
	prompt "Bluetooth serialization type"
	help
	  Type of the IPC Bluetooth radio serialization used.

config IPC_RADIO_BT_HCI_IPC
	bool "Bluetooth HCI serialization"
	depends on IPC_SERVICE
	depends on IPC_SERVICE_BACKEND_ICBMSG || IPC_SERVICE_BACKEND_RPMSG
	depends on BT_HCI_RAW
	help
	  Use Bluetooth HCI serialization over ipc_service.

config IPC_RADIO_BT_RPC
	bool "Bluetooth host API serialization over RPC"
	depends on BT_RPC_HOST
	help
	  Use nRF RPC serialization for Bluetooth.

endchoice # IPC_RADIO_BT_SER

if IPC_RADIO_BT_HCI_IPC

config QUEUE_THREAD_STACK_SIZE
	int "Queue thread stack size"
	default 512
	help
	  Stack size for the queue thread.

config QUEUE_THREAD_PRIO
	int "Queue thread priority"
	default 7
	help
	  Priority for the queue thread.

config IPC_RADIO_FATAL_ERROR_TEST_HOOK
	bool "Fatal error test hook"
	depends on IRQ_OFFLOAD
	help
	  Implement a Vendor Specific HCI command that raises a fatal error in the requested
	  execution context. It is meant for the tests of the fatal error reporting and must
	  never be enabled in a production image. Raising the fatal error from an interrupt
	  context relies on irq_offload(), so the image also has to be marked as a test with
	  the TEST Kconfig option.

if IPC_RADIO_FATAL_ERROR_TEST_HOOK

config IPC_RADIO_FATAL_ERROR_TEST_HOOK_ZLI
	bool "Fatal error test hook zero latency interrupt context"
	default y
	depends on ZERO_LATENCY_IRQS
	depends on SOC_COMPATIBLE_NRF53X || SOC_SERIES_NRF54H
	help
	  Allow injecting the fatal error from a zero-latency interrupt context.

config IPC_RADIO_FATAL_ERROR_TEST_HOOK_ZLI_IRQN
	int "Zero latency interrupt line used by the fatal error test hook"
	depends on IPC_RADIO_FATAL_ERROR_TEST_HOOK_ZLI
	default 27 if SOC_COMPATIBLE_NRF53X # SWI1
	default 89 if SOC_SERIES_NRF54H # SWI1
	help
	  Software interrupt line used to raise the fatal error from a zero-latency interrupt
	  context. It must not be used by any other component, in particular not by the
	  MPSL_LOW_PRIO_IRQN interrupt line.

endif # IPC_RADIO_FATAL_ERROR_TEST_HOOK

endif # IPC_RADIO_BT_HCI_IPC

config SETTINGS
	imply ZMS if SOC_FLASH_NRF_MRAM
	imply NVS if !SOC_FLASH_NRF_MRAM

config BT_MAX_CONN
	default 4 if IPC_RADIO_802154
	default 16 if !IPC_RADIO_802154

endif # IPC_RADIO_BT

module = IPC_RADIO
module-str = "ipc_radio"
source "$(ZEPHYR_BASE)/subsys/logging/Kconfig.template.log_config"

source "Kconfig.zephyr"
```

## applications/nrf_audio/Kconfig
```kconfig
#
# Copyright (c) 2018 Nordic Semiconductor ASA
#
# SPDX-License-Identifier: LicenseRef-Nordic-5-Clause
#

menuconfig NRF_AUDIO_APP
	 bool "nRF Audio [EXPERIMENTAL]"
	 select EXPERIMENTAL

config NRF_AUDIO_CUSTOM_BROADCASTER
	bool "Allow custom broadcasters"
	help
	  Incomplete feature for now, but will introduce support for multiple BIGs and subgroups.

config NRF_AUDIO_DEV
	int "Select which device type to compile for. 1=HEADSET or 2=GATEWAY"
	range 1 2
	default 1
	help
	  Setting this variable to 1 selects that the project is compiled
	  as a HEADSET device.
	  Setting to 2 will compile as a GATEWAY.

choice NRF_AUDIO_TRANSPORT_MODE
	prompt "Choose BIS or CIS for ISO transport"
	default NRF_AUDIO_TRANSPORT_CIS if NRF_AUDIO_WALKIE_TALKIE_DEMO
	default NRF_AUDIO_TRANSPORT_CIS

config NRF_AUDIO_TRANSPORT_BIS
	bool "Use BIS (Broadcast Isochronous Stream)"

config NRF_AUDIO_TRANSPORT_CIS
	bool "Use CIS (Connected Isochronous Stream)"

endchoice

#----------------------------------------------------------------------------#
rsource "Kconfig.defaults"
rsource "src/audio/Kconfig"
rsource "src/bluetooth/Kconfig"
rsource "src/drivers/Kconfig"
rsource "src/modules/Kconfig"
rsource "src/utils/Kconfig"

#----------------------------------------------------------------------------#
menu "Logging"

module = NRF_AUDIO_MAIN
module-str = main
source "subsys/logging/Kconfig.template.log_config"

config NRF_AUDIO_PRINT_STACK_USAGE_MS
	depends on THREAD_ANALYZER && INIT_STACKS
	int "Print stack usage every x milliseconds"
	default 5000

endmenu # Log levels

#----------------------------------------------------------------------------#

source "Kconfig.zephyr"
```

## applications/nrf_audio/src/bluetooth/Kconfig
```kconfig
#
# Copyright (c) 2022 Nordic Semiconductor ASA
#
# SPDX-License-Identifier: LicenseRef-Nordic-5-Clause
#

rsource "Kconfig.defaults"

menu "Bluetooth"

rsource "bt_management/Kconfig"

#----------------------------------------------------------------------------#
menu "Bluetooth audio"

if NRF_AUDIO_TRANSPORT_BIS

rsource "bt_stream/broadcast/Kconfig"

endif # NRF_AUDIO_TRANSPORT_BIS

if NRF_AUDIO_TRANSPORT_CIS

rsource "bt_stream/unicast/Kconfig"

endif # NRF_AUDIO_TRANSPORT_CIS

rsource "bt_stream/bt_le_audio_tx/Kconfig"

config NRF_AUDIO_PACKING_INTERLEAVED
	bool "Interleaved packing"
	help
	  ISO channels can either be interleaved or sequentially packed; sequential is the default one.

config NRF_AUDIO_CONCURRENT_RX_STREAMS_MAX
	int "Max number of concurrent streams"
	range 1 32
	default 1
	help
	  The maximum number of concurrent streams supported in the RX direction.
	  This is the maximum number of streams that can be active at the same time.

config NRF_AUDIO_CONCURRENT_TX_STREAMS_MAX
	int "Max number of concurrent streams"
	range 1 32
	default 1
	help
	  The maximum number of concurrent streams supported in the TX direction.
	  This is the maximum number of streams that can be active at the same time.

config NRF_AUDIO_PREF_SINK_SAMPLE_RATE_VALUE
	hex
	default 0x03 if NRF_AUDIO_PREF_SINK_SAMPLE_RATE_16KHZ
	default 0x05 if NRF_AUDIO_PREF_SINK_SAMPLE_RATE_24KHZ
	default 0x08 if NRF_AUDIO_PREF_SINK_SAMPLE_RATE_48KHZ

choice NRF_AUDIO_PREF_SINK_SAMPLE_RATE
	prompt "Preferred BT audio sink sample rate"
	default NRF_AUDIO_PREF_SINK_SAMPLE_RATE_16KHZ if NRF_AUDIO_BAP_BROADCAST_16_2_1
	default NRF_AUDIO_PREF_SINK_SAMPLE_RATE_16KHZ if NRF_AUDIO_BAP_BROADCAST_16_2_2
	default NRF_AUDIO_PREF_SINK_SAMPLE_RATE_16KHZ if NRF_AUDIO_BAP_UNICAST_16_2_1
	default NRF_AUDIO_PREF_SINK_SAMPLE_RATE_24KHZ if NRF_AUDIO_STREAM_BIDIRECTIONAL
	default NRF_AUDIO_PREF_SINK_SAMPLE_RATE_24KHZ if NRF_AUDIO_BAP_BROADCAST_24_2_1
	default NRF_AUDIO_PREF_SINK_SAMPLE_RATE_24KHZ if NRF_AUDIO_BAP_BROADCAST_24_2_2
	default NRF_AUDIO_PREF_SINK_SAMPLE_RATE_24KHZ if NRF_AUDIO_BAP_UNICAST_24_2_1
	default NRF_AUDIO_PREF_SINK_SAMPLE_RATE_48KHZ
	help
	  Select the preferred sample rate to stream if there are more than one to choose from.
	  Only valid when used by unicast_client if CONFIG_SAMPLE_RATE_CONVERTER=y and
	  CONFIG_NRF_AUDIO_SAMPLE_RATE_48000_HZ=y, meaning 16, 24, and 48kHz are supported.

config NRF_AUDIO_PREF_SINK_SAMPLE_RATE_48KHZ
	bool "48 kHz"
	help
	  Select 48000 Hz as the preferred sink sample rate.

config NRF_AUDIO_PREF_SINK_SAMPLE_RATE_24KHZ
	bool "24 kHz"
	help
	  Select 24000 Hz as the preferred sink sample rate.

config NRF_AUDIO_PREF_SINK_SAMPLE_RATE_16KHZ
	bool "16 kHz"
	help
	  Select 16000 Hz as the preferred sink sample rate.
endchoice

config NRF_AUDIO_PREF_SOURCE_SAMPLE_RATE_VALUE
	hex
	default 0x03 if NRF_AUDIO_PREF_SOURCE_SAMPLE_RATE_16KHZ
	default 0x05 if NRF_AUDIO_PREF_SOURCE_SAMPLE_RATE_24KHZ
	default 0x08 if NRF_AUDIO_PREF_SOURCE_SAMPLE_RATE_48KHZ

choice NRF_AUDIO_PREF_SOURCE_SAMPLE_RATE
	prompt "Preferred BT audio source sample rate"
	default NRF_AUDIO_PREF_SOURCE_SAMPLE_RATE_16KHZ if NRF_AUDIO_BAP_UNICAST_16_2_1
	default NRF_AUDIO_PREF_SOURCE_SAMPLE_RATE_24KHZ if NRF_AUDIO_STREAM_BIDIRECTIONAL
	default NRF_AUDIO_PREF_SOURCE_SAMPLE_RATE_24KHZ if NRF_AUDIO_BAP_UNICAST_24_2_1
	default NRF_AUDIO_PREF_SOURCE_SAMPLE_RATE_48KHZ
	help
	  Select the preferred sample rate to stream if there are more than one to choose from.
	  Only valid when used by unicast_client if CONFIG_SAMPLE_RATE_CONVERTER=y and
	  CONFIG_NRF_AUDIO_SAMPLE_RATE_48000_HZ=y, meaning 16, 24, and 48kHz are supported.

config NRF_AUDIO_PREF_SOURCE_SAMPLE_RATE_48KHZ
	bool "48 kHz"
	help
	  Select 48000 Hz as the preferred source sample rate.

config NRF_AUDIO_PREF_SOURCE_SAMPLE_RATE_24KHZ
	bool "24 kHz"
	help
	  Select 24000 Hz as the preferred source sample rate.

config NRF_AUDIO_PREF_SOURCE_SAMPLE_RATE_16KHZ
	bool "16 kHz"
	help
	  Select 16000 Hz as the preferred source sample rate.
endchoice

#----------------------------------------------------------------------------#
menu "QoS"

config NRF_AUDIO_PRESENTATION_DELAY_US
	int "Presentation delay"
	range NRF_AUDIO_MIN_PRES_DLY_US NRF_AUDIO_MAX_PRES_DLY_US
	default NRF_AUDIO_MIN_PRES_DLY_US
	help
	  The audio source/client defined presentation delay if within
	  NRF_AUDIO_MIN_PRES_DLY_US and NRF_AUDIO_MAX_PRES_DLY_US range. This will
	  override the audio receivers presentation delay as long as it
	  is in range of the max and min supported by the audio receivers.
	  If it is outside this range, then it will revert to the closest
	  supported value.

config NRF_AUDIO_MAX_TRANSPORT_LATENCY_MS
	int "Max transport latency"
	range 5 4000
	default 10
	help
	  Max transport latency for the ISO link.

config NRF_AUDIO_RETRANSMITS
	int "Number of re-transmits"
	range 0 30
	default 2
	help
	  Number of re-transmits for the ISO link. 2 re-transmits means a total
	  of 3 packets sent per stream.

endmenu # QoS
endmenu # Bluetooth audio

rsource "bt_rendering_and_capture/Kconfig"
rsource "bt_content_control/Kconfig"

#----------------------------------------------------------------------------#
menu "Log levels"

module = NRF_AUDIO_BLE
module-str = ble
source "subsys/logging/Kconfig.template.log_config"

module = NRF_AUDIO_TX
module-str = bt_le_audio_tx
source "subsys/logging/Kconfig.template.log_config"

endmenu # Log levels

#----------------------------------------------------------------------------#
menu "Testing"

config NRF_AUDIO_TESTING_BLE_ADDRESS_RANDOM
	bool "Random address and bonding clear on every restart [EXPERIMENTAL]"
	select EXPERIMENTAL
	help
	  If enabled the system will generate a new address on every
	  restart (i.e. reset, re-flash). Any bonding information will
	  be cleared. This is only for testing purposes.

endmenu # Testing
endmenu # Bluetooth
```

## applications/nrf_audio/src/modules/Kconfig.defaults
```kconfig
#
# Copyright (c) 2022 Nordic Semiconductor ASA
#
# SPDX-License-Identifier: LicenseRef-Nordic-5-Clause
#

# GATEWAY
if NRF_AUDIO_DEV = 2

if NRF_AUDIO_SOURCE_USB

config UDC_NRF_THREAD_STACK_SIZE
	default 1024

config USBD_THREAD_STACK_SIZE
	default 4096

config UDC_BUF_POOL_SIZE
	default 2048

config NRF_USBD_COMMON_LOG_LEVEL
	default 2

config USBC_LOG_LEVEL
	default 2

config USBD_LOG_LEVEL
	default 2

config USBD_UAC2_LOG_LEVEL
	default 2

config UDC_DRIVER_LOG_LEVEL
	default 2

config USBD_MAX_SPEED
	default 0 # FULL

endif # NRF_AUDIO_SOURCE_USB

endif # NRF_AUDIO_DEV = 2 (GATEWAY)
```
