/*
 * Copyright (c) 2021 Nordic Semiconductor ASA
 *
 * SPDX-License-Identifier: LicenseRef-Nordic-5-Clause
 */

/ {
	chosen {
		ncs,ml-app-ei-data-forwarder-uart = &uart0;
	};

	leds {
		status = "okay";
	};
};
