## applications/matter_weather_station/Kconfig.sysbuild
```kconfig
#
# Copyright (c) 2023 Nordic Semiconductor ASA
#
# SPDX-License-Identifier: LicenseRef-Nordic-5-Clause
#

if BOARD_THINGY53
#### Radio core
config NRF_DEFAULT_IPC_RADIO
	default y

# Enable IEEE802.15.4 serialization to network core
# This config automatically pulls in the `overlay-802154.conf` in the ipc_radio image
config NETCORE_IPC_RADIO_IEEE802154
	default y if !WIFI_NRF70

# Enable Bluetooth serialization to network core
# This config automatically pulls in the `overlay-bt_hci_ipc.conf` in the ipc_radio image
config NETCORE_IPC_RADIO_BT_HCI_IPC
	default y

config SECURE_BOOT_NETCORE
	default y

config NETCORE_APP_UPDATE
	default y

config DFU_MULTI_IMAGE_PACKAGE_NET
	default y

config PM_EXTERNAL_FLASH_MCUBOOT_SECONDARY
	default y

endif

#### DFU multi-image support
config DFU_MULTI_IMAGE_PACKAGE_BUILD
	default y

config DFU_MULTI_IMAGE_PACKAGE_APP
	default y

# Internal flash only for nRF54L15 tag with compression
if BOARD_NRF54L15TAG

config PM_OVERRIDE_EXTERNAL_DRIVER_CHECK
	default y

config MCUBOOT_COMPRESSED_IMAGE_SUPPORT
	default y

endif

choice BOOTLOADER
	default BOOTLOADER_MCUBOOT
endchoice

#### Bootloader
choice MCUBOOT_MODE
	default MCUBOOT_MODE_OVERWRITE_ONLY
endchoice

choice BOOT_SIGNATURE_TYPE
	default BOOT_SIGNATURE_TYPE_RSA
endchoice


source "share/sysbuild/Kconfig"
```

## applications/matter_weather_station/boards/nrf54l15tag_nrf54l15_cpuapp.conf
```kconfig
#
# Copyright (c) 2026 Nordic Semiconductor ASA
#
# SPDX-License-Identifier: LicenseRef-Nordic-5-Clause
#

# Console and logs over RTT (tag has no UART)
CONFIG_USE_SEGGER_RTT=y
CONFIG_CONSOLE=y
CONFIG_RTT_CONSOLE=y
CONFIG_UART_CONSOLE=n
CONFIG_LOG_BACKEND_RTT=y

# No NFC hardware (NFCT pins used as GPIO)
CONFIG_CHIP_NFC_ONBOARDING_PAYLOAD=n

# No diagnostic log retention on this board
CONFIG_NCS_SAMPLE_MATTER_DIAGNOSTIC_LOGS=n

# Watchdog
CONFIG_NCS_SAMPLE_MATTER_WATCHDOG=y

# Size optimization
CONFIG_LTO=y
CONFIG_ISR_TABLES_LOCAL_DECLARATION=y

# Mock value
CONFIG_AVERAGE_CURRENT_CONSUMPTION=1000
```

## applications/matter_weather_station/boards/thingy53_nrf5340_cpuapp.conf
```kconfig
#
# Copyright (c) 2026 Nordic Semiconductor ASA
#
# SPDX-License-Identifier: LicenseRef-Nordic-5-Clause
#

# Buzzer (PWM)
CONFIG_PWM=y

# Battery measurement (ADC)
CONFIG_ADC=y

# Power profiling
CONFIG_AVERAGE_CURRENT_CONSUMPTION=10000

# UART console and shell
CONFIG_SHELL_LOG_BACKEND=y
CONFIG_SHELL_BACKEND_SERIAL_INIT_PRIORITY=51
CONFIG_LOG_MODE_DEFERRED=y
CONFIG_LOG_PROCESS_THREAD_STACK_SIZE=1024
CONFIG_LOG_BUFFER_SIZE=8192
CONFIG_LOG_FUNC_NAME_PREFIX_DBG=n

# USB CDC ACM
CONFIG_USB_DEVICE_STACK_NEXT=y
CONFIG_CDC_ACM_SERIAL_MANUFACTURER_STRING="Nordic Semiconductor ASA"
CONFIG_CDC_ACM_SERIAL_PRODUCT_STRING="Thingy:53 Matter Weather"
CONFIG_CDC_ACM_SERIAL_VID=0x1915
CONFIG_CDC_ACM_SERIAL_PID=0x530D
CONFIG_UART_LINE_CTRL=y

# Diagnostic logs
CONFIG_NCS_SAMPLE_MATTER_DIAGNOSTIC_LOGS=y
CONFIG_NCS_SAMPLE_MATTER_DIAGNOSTIC_LOGS_CRASH_LOGS=y
CONFIG_NCS_SAMPLE_MATTER_DIAGNOSTIC_LOGS_REMOVE_CRASH_AFTER_READ=y
CONFIG_NCS_SAMPLE_MATTER_DIAGNOSTIC_LOGS_END_USER_LOGS=y
CONFIG_NCS_SAMPLE_MATTER_DIAGNOSTIC_LOGS_NETWORK_LOGS=y
CONFIG_NCS_SAMPLE_MATTER_DIAGNOSTIC_LOGS_TEST=y

# NVS settings: storage partition is 48 KiB (0xc000); 12 × 4 KiB sectors.
CONFIG_SETTINGS_NVS_SECTOR_COUNT=12
```

## applications/matter_weather_station/sample.yaml
```yaml
sample:
  name: Matter Weather Station
  description: Matter Weather Station application
tests:
  # This configuration is used for performing DFU over BLE between different NCS
  # applications on Thingy53.
  applications.matter_weather_station.debug.no_fd:
    sysbuild: true
    build_only: true
    platform_allow: thingy53/nrf5340/cpuapp
    platform_exclude: thingy53/nrf5340/cpuapp/ns
    integration_platforms:
      - thingy53/nrf5340/cpuapp
    tags: sysbuild ci_applications_matter
  applications.matter_weather_station.debug:
    sysbuild: true
    build_only: true
    extra_args: OVERLAY_CONFIG=overlay-factory_data.conf
      FILE_SUFFIX=factory_data
      CONFIG_CHIP_FACTORY_DATA=y SB_CONFIG_MATTER_FACTORY_DATA_GENERATE=y
    platform_allow: thingy53/nrf5340/cpuapp
    platform_exclude: thingy53/nrf5340/cpuapp/ns
    integration_platforms:
      - thingy53/nrf5340/cpuapp
    tags: sysbuild ci_applications_matter
  applications.matter_weather_station.release:
    sysbuild: true
    build_only: true
    extra_args: OVERLAY_CONFIG=overlay-factory_data.conf CONF_FILE=prj_release.conf
      FILE_SUFFIX=factory_data CONFIG_CHIP_FACTORY_DATA=y
      SB_CONFIG_MATTER_FACTORY_DATA_GENERATE=y
    platform_allow: thingy53/nrf5340/cpuapp
    platform_exclude: thingy53/nrf5340/cpuapp/ns
    integration_platforms:
      - thingy53/nrf5340/cpuapp
    tags: sysbuild ci_applications_matter
  applications.matter_weather_station.lto:
    sysbuild: true
    build_only: true
    extra_args: OVERLAY_CONFIG=overlay-factory_data.conf
      FILE_SUFFIX=factory_data CONFIG_CHIP_FACTORY_DATA=y
      SB_CONFIG_MATTER_FACTORY_DATA_GENERATE=y
      CONFIG_LTO=y CONFIG_ISR_TABLES_LOCAL_DECLARATION=y
    platform_allow: thingy53/nrf5340/cpuapp
    platform_exclude: thingy53/nrf5340/cpuapp/ns
    integration_platforms:
      - thingy53/nrf5340/cpuapp
    tags: sysbuild ci_applications_matter
  applications.matter_weather_station.nrf7002eb:
    sysbuild: true
    build_only: true
    extra_args: matter_weather_station_SHIELD=nrf7002eb FILE_SUFFIX=release
                SB_CONFIG_WIFI_NRF70=y CONFIG_CHIP_WIFI=y
    platform_allow: thingy53/nrf5340/cpuapp
    platform_exclude: thingy53/nrf5340/cpuapp/ns
    integration_platforms:
      - thingy53/nrf5340/cpuapp
    tags: sysbuild ci_applications_matter
```

## applications/matter_weather_station/sysbuild/ipc_radio/Kconfig
```kconfig
#
# Copyright (c) 2024 Nordic Semiconductor
#
# SPDX-License-Identifier: LicenseRef-Nordic-5-Clause
#

# NRF_802154_ENCRYPTION is not enabled by default in the `overlay-802154.conf` file
# that is pulled in by NETCORE_IPC_RADIO_IEEE802154 in application's Kconfig.sysbuild.
config NRF_802154_ENCRYPTION
	default y if IPC_RADIO_802154
```
