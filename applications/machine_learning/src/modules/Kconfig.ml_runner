## applications/matter_bridge/sample.yaml
```yaml
sample:
  description: Matter Bridge
  name: Matter Bridge application
common:
  tags:
    - sysbuild
    - ci_applications_matter
tests:
  applications.matter_bridge.release:
    sysbuild: true
    build_only: true
    extra_args:
      - FILE_SUFFIX=release
      - CONFIG_BRIDGE_GENERIC_SWITCH_BRIDGED_DEVICE=n
      - CONFIG_BRIDGE_ONOFF_LIGHT_SWITCH_BRIDGED_DEVICE=y
    integration_platforms:
      - nrf7002dk/nrf5340/cpuapp
      - nrf5340dk/nrf5340/cpuapp
      - nrf54lm20dk/nrf54lm20a/cpuapp
    platform_allow:
      - nrf7002dk/nrf5340/cpuapp
      - nrf5340dk/nrf5340/cpuapp
      - nrf54lm20dk/nrf54lm20a/cpuapp
  applications.matter_bridge.nrf7002eb2.release:
    sysbuild: true
    build_only: true
    extra_args:
      - FILE_SUFFIX=release
      - CONFIG_BRIDGE_GENERIC_SWITCH_BRIDGED_DEVICE=n
      - CONFIG_BRIDGE_ONOFF_LIGHT_SWITCH_BRIDGED_DEVICE=y
      - matter_bridge_SHIELD=nrf7002eb2
      - SB_CONFIG_WIFI_NRF70=y
    integration_platforms:
      - nrf54lm20dk/nrf54lm20a/cpuapp
    platform_allow:
      - nrf54lm20dk/nrf54lm20a/cpuapp
  applications.matter_bridge.debug:
    sysbuild: true
    build_only: true
    extra_args:
      - CONFIG_BRIDGE_GENERIC_SWITCH_BRIDGED_DEVICE=n
      - CONFIG_BRIDGE_ONOFF_LIGHT_SWITCH_BRIDGED_DEVICE=y
    integration_platforms:
      - nrf7002dk/nrf5340/cpuapp
      - nrf5340dk/nrf5340/cpuapp
      - nrf54lm20dk/nrf54lm20a/cpuapp
    platform_allow:
      - nrf7002dk/nrf5340/cpuapp
      - nrf5340dk/nrf5340/cpuapp
      - nrf54lm20dk/nrf54lm20a/cpuapp
  applications.matter_bridge.nrf7002eb2.debug:
    sysbuild: true
    build_only: true
    extra_args:
      - CONFIG_BRIDGE_GENERIC_SWITCH_BRIDGED_DEVICE=n
      - CONFIG_BRIDGE_ONOFF_LIGHT_SWITCH_BRIDGED_DEVICE=y
      - matter_bridge_SHIELD=nrf7002eb2
      - SB_CONFIG_WIFI_NRF70=y
    integration_platforms:
      - nrf54lm20dk/nrf54lm20a/cpuapp
    platform_allow:
      - nrf54lm20dk/nrf54lm20a/cpuapp
  applications.matter_bridge.br_ble:
    sysbuild: true
    build_only: true
    extra_args:
      - CONFIG_BRIDGED_DEVICE_BT=y
      - CONFIG_BRIDGE_GENERIC_SWITCH_BRIDGED_DEVICE=n
      - CONFIG_BRIDGE_ONOFF_LIGHT_SWITCH_BRIDGED_DEVICE=y
    integration_platforms:
      - nrf7002dk/nrf5340/cpuapp
      - nrf5340dk/nrf5340/cpuapp
      - nrf54lm20dk/nrf54lm20a/cpuapp
    platform_allow:
      - nrf7002dk/nrf5340/cpuapp
      - nrf5340dk/nrf5340/cpuapp
      - nrf54lm20dk/nrf54lm20a/cpuapp
  applications.matter_bridge.nrf7002eb2.br_ble:
    sysbuild: true
    build_only: true
    extra_args:
      - CONFIG_BRIDGED_DEVICE_BT=y
      - CONFIG_BRIDGE_GENERIC_SWITCH_BRIDGED_DEVICE=n
      - CONFIG_BRIDGE_ONOFF_LIGHT_SWITCH_BRIDGED_DEVICE=y
      - matter_bridge_SHIELD=nrf7002eb2
      - SB_CONFIG_WIFI_NRF70=y
    integration_platforms:
      - nrf54lm20dk/nrf54lm20a/cpuapp
    platform_allow:
      - nrf54lm20dk/nrf54lm20a/cpuapp
  applications.matter_bridge.release.br_ble:
    sysbuild: true
    build_only: true
    extra_args:
      - FILE_SUFFIX=release
      - CONFIG_BRIDGED_DEVICE_BT=y
      - CONFIG_BRIDGE_GENERIC_SWITCH_BRIDGED_DEVICE=n
      - CONFIG_BRIDGE_ONOFF_LIGHT_SWITCH_BRIDGED_DEVICE=y
    integration_platforms:
      - nrf7002dk/nrf5340/cpuapp
      - nrf5340dk/nrf5340/cpuapp
      - nrf54lm20dk/nrf54lm20a/cpuapp
    platform_allow:
      - nrf7002dk/nrf5340/cpuapp
      - nrf5340dk/nrf5340/cpuapp
      - nrf54lm20dk/nrf54lm20a/cpuapp
  applications.matter_bridge.nrf7002eb2.release.br_ble:
    sysbuild: true
    build_only: true
    extra_args:
      - FILE_SUFFIX=release
      - CONFIG_BRIDGED_DEVICE_BT=y
      - CONFIG_BRIDGE_GENERIC_SWITCH_BRIDGED_DEVICE=n
      - CONFIG_BRIDGE_ONOFF_LIGHT_SWITCH_BRIDGED_DEVICE=y
      - matter_bridge_SHIELD=nrf7002eb2
      - SB_CONFIG_WIFI_NRF70=y
    integration_platforms:
      - nrf54lm20dk/nrf54lm20a/cpuapp
    platform_allow:
      - nrf54lm20dk/nrf54lm20a/cpuapp
  applications.matter_bridge.br_ble.smp_dfu:
    sysbuild: true
    build_only: true
    extra_args:
      - CONFIG_CHIP_DFU_OVER_BT_SMP=y
      - CONFIG_BRIDGED_DEVICE_BT=y
      - CONFIG_BRIDGE_GENERIC_SWITCH_BRIDGED_DEVICE=n
      - CONFIG_BRIDGE_ONOFF_LIGHT_SWITCH_BRIDGED_DEVICE=y
    integration_platforms:
      - nrf7002dk/nrf5340/cpuapp
      - nrf54lm20dk/nrf54lm20a/cpuapp
    platform_allow:
      - nrf7002dk/nrf5340/cpuapp
      - nrf54lm20dk/nrf54lm20a/cpuapp
  applications.matter_bridge.nrf7002eb2.br_ble.smp_dfu:
    sysbuild: true
    build_only: true
    extra_args:
      - CONFIG_CHIP_DFU_OVER_BT_SMP=y
      - CONFIG_BRIDGED_DEVICE_BT=y
      - CONFIG_BRIDGE_GENERIC_SWITCH_BRIDGED_DEVICE=n
      - CONFIG_BRIDGE_ONOFF_LIGHT_SWITCH_BRIDGED_DEVICE=y
      - matter_bridge_SHIELD=nrf7002eb2
      - SB_CONFIG_WIFI_NRF70=y
    integration_platforms:
      - nrf54lm20dk/nrf54lm20a/cpuapp
    platform_allow:
      - nrf54lm20dk/nrf54lm20a/cpuapp
  applications.matter_bridge.nrf5340.wifi:
    sysbuild: true
    build_only: true
    extra_args:
      - matter_bridge_SHIELD=nrf7002ek
      - SB_CONFIG_WIFI_PATCHES_EXT_FLASH_STORE=y
      - mcuboot_CONFIG_UPDATEABLE_IMAGE_NUMBER=3
      - SB_CONFIG_WIFI_NRF70=y
      - SB_CONFIG_DFU_MULTI_IMAGE_PACKAGE_WIFI_FW_PATCH=y
      - CONFIG_CHIP_DFU_OVER_BT_SMP=y
      - FILE_SUFFIX=nrf70ek
    integration_platforms:
      - nrf5340dk/nrf5340/cpuapp
    platform_allow: nrf5340dk/nrf5340/cpuapp
  applications.matter_bridge.br_ble.memory_profiling:
    sysbuild: true
    build_only: true
    extra_args:
      - CONFIG_BRIDGE_GENERIC_SWITCH_BRIDGED_DEVICE=n
      - CONFIG_BRIDGE_ONOFF_LIGHT_SWITCH_BRIDGED_DEVICE=y
      - CONFIG_CHIP_MEMORY_PROFILING=y
      - CONFIG_BRIDGED_DEVICE_BT=y
      - CONFIG_BRIDGE_MIGRATE_VERSION_1=n
    integration_platforms:
      - nrf5340dk/nrf5340/cpuapp
      - nrf54lm20dk/nrf54lm20a/cpuapp
    platform_allow:
      - nrf5340dk/nrf5340/cpuapp
      - nrf54lm20dk/nrf54lm20a/cpuapp
  applications.matter_bridge.memory_profiling:
    sysbuild: true
    build_only: true
    extra_args:
      - CONFIG_BRIDGE_GENERIC_SWITCH_BRIDGED_DEVICE=n
      - CONFIG_BRIDGE_ONOFF_LIGHT_SWITCH_BRIDGED_DEVICE=y
      - CONFIG_CHIP_MEMORY_PROFILING=y
    integration_platforms:
      - nrf7002dk/nrf5340/cpuapp
    platform_allow:
      - nrf7002dk/nrf5340/cpuapp
  applications.matter_bridge.smart_plug:
    sysbuild: true
    build_only: true
    extra_args:
      - EXTRA_CONF_FILE=onoff_plug.conf
    integration_platforms:
      - nrf5340dk/nrf5340/cpuapp
    platform_allow: nrf5340dk/nrf5340/cpuapp
```

## applications/matter_bridge/src/core/Kconfig
```kconfig
#
# Copyright (c) 2023 Nordic Semiconductor
#
# SPDX-License-Identifier: LicenseRef-Nordic-5-Clause
#

menu "Bridge configuration"

config BRIDGE_MAX_DYNAMIC_ENDPOINTS_NUMBER
	int "Maximum dynamic endpoints"
	default 16
	help
	  Maximum number of endpoints supported by the bridge.

config BRIDGE_MAX_BRIDGED_DEVICES_NUMBER
	int "Maximum bridged devices"
	default 16
	help
	  Maximum number of physical non-Matter devices supported by the bridge.

config BRIDGE_MAX_BRIDGED_DEVICES_NUMBER_PER_PROVIDER
	int "Maximum endpoints per provider"
	default 2
	help
	  Maximum number of endpoints paired to one non-Matter provider device.

config BRIDGE_AGGREGATOR_ENDPOINT_ID
	int "Aggregator endpoint ID"
	default 1
	help
	  ID of the endpoint implementing Aggregator device type functionality.

menu "Migration options"

config BRIDGE_MIGRATE_PRE_2_7_0
	bool "Migrate pre-2.7.0 data"
	help
	  Enable migration of bridged device data stored in the old scheme (pre-nRF SDK 2.7.0).

config BRIDGE_MIGRATE_VERSION_1
	bool "Migrate version 1 data"
	default y
	help
	  Enable migration of bridged device data stored in version 1 of the new scheme.

endmenu

if BRIDGED_DEVICE_BT

menu "Bluetooth bridge configuration"

config BRIDGE_BT_RECOVERY_MAX_INTERVAL
	int "Recovery interval (s)"
	default 300
	help
	  Maximum time (in seconds) between recovery attempts when a Bluetooth LE connection is lost.

config BRIDGE_BT_RECOVERY_SCAN_TIMEOUT_MS
	int "Recovery scan timeout (ms)"
	default 2000
	help
	  Time (in milliseconds) to attempt reconnection to a lost Bluetooth LE device.

config BRIDGE_BT_MAX_SCANNED_DEVICES
	int "Maximum scanned devices"
	default 16
	help
	  Maximum number of Bluetooth devices that can be scanned at once.

config BRIDGE_BT_SCAN_TIMEOUT_MS
	int "Scan timeout (ms)"
	default 10000
	help
	  Bluetooth scan timeout in milliseconds.

config BRIDGE_BT_MINIMUM_SECURITY_LEVEL
	int "Minimum security level"
	default 2
	range 2 4
	depends on BT_SMP
	help
	  The minimum Bluetooth security level means that the bridged devices using this or a higher level will be
	  allowed to connect to the bridge. The level cannot be set to a value smaller than 2, as it would mean that
	  the communication with the connected devices will not be encrypted, what is not considered to be secure.

config BRIDGE_BT_SCAN_WINDOW
	int "Scan window"
	default 40  if OPENTHREAD # It is necessary to decrease Bluetooth LE activity to leave some radio time to Thread
	default 48
	help
	  Duration of active scanning per interval (x0.625 ms).
	  Default: 40 (25 ms).
	  Longer windows improve discovery speed but increase power use.

config BRIDGE_BT_SCAN_INTERVAL
	int "Scan interval"
	default 160 if OPENTHREAD # It is necessary to decrease Bluetooth LE activity to leave some radio time to Thread
	default 96
	help
	  Time between consecutive scan windows (x0.625 ms).
	  Default: 160 (100 ms).
	  Must be ≥ scan window.
	  Shorter intervals speed discovery but increase power use.

config BRIDGE_BT_CONNECTION_INTERVAL_MIN
	int "Minimum connection interval"
	range 6 3200
	default 80 if OPENTHREAD # It is necessary to decrease Bluetooth LE activity to leave some radio time to Thread
	default 24
	help
	  Minimum time between connection events (x1.25 ms).
	  Default: 80 (100 ms).
	  Shorter intervals reduce latency but increase power consumption.

config BRIDGE_BT_CONNECTION_INTERVAL_MAX
	int "Maximum connection interval"
	range 6 3200
	default 80 if OPENTHREAD # It is necessary to decrease Bluetooth LE activity to leave some radio time to Thread
	default 40
	help
	  Maximum time between connection events (x1.25 ms).
	  Default: 80 (100 ms).
	  Must be ≥ minimum interval.

config BRIDGE_BT_CONNECTION_TIMEOUT
	int "Connection timeout"
	default 400
	help
	  Time until connection is considered lost (x10 ms).
	  Default: 400 (4 sec).
	  Must be > (1 + latency) x interval_max x 2.

config BRIDGE_BT_CONNECTION_LATENCY
	int "Connection latency"
	default 0
	help
	  Number of connection events peripheral can skip when idle.
	  Default: 0.
	  Higher values save power but increase latency.

config BRIDGE_FORCE_BT_CONNECTION_PARAMS
	bool "Force connection parameters"
	default y
	help
	  Enforce bridge-defined connection parameters instead of accepting the peripheral's preferred values.
	  Enable for guaranteed timing, disable for peripheral optimization.

endmenu

endif

endmenu
```

## applications/matter_bridge/sysbuild/ipc_radio/boards/nrf5340dk_nrf5340_cpunet.conf
```kconfig
#
# Copyright (c) 2024 Nordic Semiconductor ASA
#
# SPDX-License-Identifier: LicenseRef-Nordic-5-Clause
#

# Set 10 BLE connections, as it is an upper limit supported caused by RAM usage due to using Thread and BLE at same time.
CONFIG_BT_MAX_CONN=10

# Set ACL RX count to CONFIG_BT_MAX_CONN + 1, as it is expected that CONFIG_BT_BUF_ACL_RX_COUNT > CONFIG_BT_MAX_CONN.
CONFIG_BT_BUF_ACL_RX_COUNT=11

# Decrease stack and buffer sizes to free some RAM and support 10 BLE connections
CONFIG_MAIN_STACK_SIZE=512
CONFIG_SYSTEM_WORKQUEUE_STACK_SIZE=512
CONFIG_BT_BUF_ACL_RX_SIZE=69
CONFIG_BT_BUF_ACL_TX_SIZE=69
CONFIG_BT_CTLR_DATA_LENGTH_MAX=69
# 15.4 RX buffers were decreased to save RAM
CONFIG_NRF_802154_RX_BUFFERS=14

# NRF_802154_ENCRYPTION is not enabled by default in the `overlay-802154.conf` file
# that is pulled in by NETCORE_IPC_RADIO_IEEE802154 in application's Kconfig.sysbuild.
# For Wi-Fi builds, this option will not get applied anyway.
CONFIG_NRF_802154_ENCRYPTION=y
```

## applications/matter_bridge/sysbuild/ipc_radio/boards/nrf54h20dk_nrf54h20_cpurad.conf
```kconfig
 #
# Copyright (c) 2024 Nordic Semiconductor ASA
#
# SPDX-License-Identifier: LicenseRef-Nordic-5-Clause
#

# Use common SUIT envelope templates prepared for Matter purpose
CONFIG_SUIT_ENVELOPE_TEMPLATE="${ZEPHYR_NRF_MODULE_DIR}/samples/matter/common/suit_templates/rad_envelope.yaml.jinja2"

# NRF_802154_ENCRYPTION is not enabled by default in the `overlay-802154.conf` file
# that is pulled in by NETCORE_IPC_RADIO_IEEE802154 in application's Kconfig.sysbuild.
# For Wi-Fi builds, this option will not get applied anyway.
CONFIG_NRF_802154_ENCRYPTION=y
```

## applications/matter_bridge/sysbuild/mcuboot/boards/nrf5340dk_nrf5340_cpuapp.conf
```kconfig
#
# Copyright (c) 2023 Nordic Semiconductor ASA
#
# SPDX-License-Identifier: LicenseRef-Nordic-5-Clause
#

CONFIG_NORDIC_QSPI_NOR=y
CONFIG_NORDIC_QSPI_NOR_FLASH_LAYOUT_PAGE_SIZE=4096
CONFIG_NORDIC_QSPI_NOR_STACK_WRITE_BUFFER_SIZE=16

# The following configurations are required to support simultaneous multi image update
CONFIG_PCD_APP=y
CONFIG_UPDATEABLE_IMAGE_NUMBER=2

CONFIG_BOOT_SWAP_USING_MOVE=n
# Multi-image updates do not support image swapping yet.
CONFIG_BOOT_UPGRADE_ONLY=y

# The network core cannot access external flash directly. The flash simulator must be used to
# provide a memory region that is used to forward the new firmware to the network core.
CONFIG_FLASH_SIMULATOR=y
CONFIG_FLASH_SIMULATOR_DOUBLE_WRITES=y
CONFIG_FLASH_SIMULATOR_STATS=n

CONFIG_ZCBOR=y
```

## applications/matter_factory_data/Kconfig
```kconfig
#
# Copyright (c) 2025 Nordic Semiconductor ASA
#
# SPDX-License-Identifier: LicenseRef-Nordic-5-Clause
#

config APPLICATION_NAME
	string "Application name (informative only, do not change)"

config PARTITION_MANAGER_ENABLED
	bool "Partition manager is enabled (informative only, do not change)"

config BUILD_OUTPUT_BIN
	bool "Build a binary in BIN format (informative only, do not change)"

config BUILD_OUTPUT_HEX
	bool "Build a binary in HEX format (informative only, do not change)"
	default y
```

## applications/matter_weather_station/Kconfig
```kconfig
#
# Copyright (c) 2021 Nordic Semiconductor
#
# SPDX-License-Identifier: LicenseRef-Nordic-5-Clause
#

mainmenu "Matter weather station application"

config AVERAGE_CURRENT_CONSUMPTION
	int "Average device current consumption in microamperes"
	default 0
	help
	  The predicted average current consumption of the Matter weather station
	  device, used to estimate the remaining battery time.

# Application configuration used for Thread networking
if OPENTHREAD

choice OPENTHREAD_NORDIC_LIBRARY_CONFIGURATION
	default OPENTHREAD_NORDIC_LIBRARY_MTD
endchoice

choice OPENTHREAD_DEVICE_TYPE
	default OPENTHREAD_MTD
endchoice

config IEEE802154_NRF5_RX_STACK_SIZE
	default 8192

config CHIP_ENABLE_ICD_SUPPORT
	default y

endif # OPENTHREAD

if SHIELD_NRF7002EB

config CHIP_WIFI
	default y
	select DEPRECATED if SOC_SERIES_NRF53

config NRF_WIFI_LOW_POWER
	default y

endif # SHIELD_NRF7002EB

source "$(ZEPHYR_CONNECTEDHOMEIP_MODULE_DIR)/config/nrfconnect/chip-module/Kconfig.features"
source "$(ZEPHYR_CONNECTEDHOMEIP_MODULE_DIR)/config/nrfconnect/chip-module/Kconfig.defaults"
source "$(ZEPHYR_NRF_MODULE_DIR)/samples/matter/common/src/Kconfig"
source "Kconfig.zephyr"
```
