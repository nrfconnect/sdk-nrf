## applications/machine_learning/src/modules/Kconfig.ml_runner
```kconfig
#
# Copyright (c) 2021 Nordic Semiconductor
#
# SPDX-License-Identifier: LicenseRef-Nordic-5-Clause
#

menuconfig ML_APP_ML_RUNNER
	bool "Machine learning model runner"
	depends on EI_WRAPPER
	depends on CAF_SENSOR_EVENTS
	select ML_APP_ML_RESULT_EVENTS

if ML_APP_ML_RUNNER

config ML_APP_ML_RUNNER_SENSOR_EVENT_DESCR
	string "Description of handled sensor event"
	default ML_APP_SENSOR_EVENT_DESCR
	help
	  The module handles data related to sensor events with predefined description.
	  Other sensor events are ignored.

config ML_APP_ML_RUNNER_WINDOW_SHIFT
	int "Prediction window shift [windows]"
	range 0 4096
	default 1
	help
	  Number of windows the prediction window is shifted between predictions.

config ML_APP_ML_RUNNER_FRAME_SHIFT
	int "Prediction window shift [frames]"
	range 0 4096
	default 0
	help
	  Number of frames the prediction window is shifted between predictions.

module = ML_APP_ML_RUNNER
module-str = machine learning model runner
source "subsys/logging/Kconfig.template.log_config"

endif # ML_APP_ML_RUNNER
```

## applications/machine_learning/src/modules/Kconfig.ml_state
```kconfig
#
# Copyright (c) 2021 Nordic Semiconductor
#
# SPDX-License-Identifier: LicenseRef-Nordic-5-Clause
#

menuconfig ML_APP_ML_STATE
	bool "Machine learning state"
	depends on ML_APP_ML_RUNNER || ML_APP_EI_DATA_FORWARDER
	depends on CAF_BUTTON_EVENTS
	select ML_APP_ML_STATE_EVENTS

if ML_APP_ML_STATE

config ML_APP_ML_STATE_CONTROL_BUTTON_ID
	hex "Key ID of button used to control machine learning state"
	range 0x0000 0xffff
	depends on ML_APP_ML_RUNNER && ML_APP_EI_DATA_FORWARDER

module = ML_APP_ML_STATE
module-str = machine learning state
source "subsys/logging/Kconfig.template.log_config"

endif # ML_APP_ML_STATE
```

## applications/machine_learning/src/modules/Kconfig.sensor_sim_ctrl
```kconfig
#
# Copyright (c) 2021 Nordic Semiconductor ASA
#
# SPDX-License-Identifier: LicenseRef-Nordic-5-Clause
#

menuconfig ML_APP_SENSOR_SIM_CTRL
	bool "Simulated sensor controller"
	select ML_APP_SENSOR_SIM_EVENTS

if ML_APP_SENSOR_SIM_CTRL

choice
	prompt "Select wave signal change trigger"
	default ML_APP_SENSOR_SIM_CTRL_TRIG_TIMEOUT

config ML_APP_SENSOR_SIM_CTRL_TRIG_TIMEOUT
	bool "Timeout"

config ML_APP_SENSOR_SIM_CTRL_TRIG_BUTTON
	bool "Button press"
	depends on CAF_BUTTONS

endchoice

config ML_APP_SENSOR_SIM_CTRL_TRIG_TIMEOUT_MS
	int "Wave signal change timeout [ms]"
	default 1000
	depends on ML_APP_SENSOR_SIM_CTRL_TRIG_TIMEOUT
	help
	  The timeout triggers selecting next simulated wave signal.

config ML_APP_SENSOR_SIM_CTRL_TRIG_BUTTON_ID
	hex "ID of button used to change wave signal"
	range 0x0000 0xffff
	default 0xffff
	depends on ML_APP_SENSOR_SIM_CTRL_TRIG_BUTTON
	help
	  Pressing the button triggers selecting next simulated wave signal.

module = ML_APP_SENSOR_SIM_CTRL
module-str = sensor sim controller
source "subsys/logging/Kconfig.template.log_config"

endif # ML_APP_SENSOR_SIM_CTRL
```

## applications/machine_learning/src/modules/Kconfig.usb_state
```kconfig
#
# Copyright (c) 2021 Nordic Semiconductor ASA
#
# SPDX-License-Identifier: LicenseRef-Nordic-5-Clause
#

menuconfig ML_APP_USB_STATE
	bool "USB module"
	depends on USB_DEVICE_STACK
	depends on CAF_POWER_MANAGER
	select CAF_FORCE_POWER_DOWN_EVENTS
	help
	  Enable USB subsystem on application start.

if ML_APP_USB_STATE

config USB_DEVICE_INITIALIZE_AT_BOOT
	default n
	help
	  Leave USB device initialization to the USB module.

endif # ML_APP_USB_STATE

module = ML_APP_USB_STATE
module-str = usb state module
source "subsys/logging/Kconfig.template.log_config"
```

## applications/machine_learning/src/util/Kconfig
```kconfig
#
# Copyright (c) 2022 Nordic Semiconductor
#
# SPDX-License-Identifier: LicenseRef-Nordic-5-Clause
#

menu "Utilities"

if BT_ADV_PROV

config BT_ADV_PROV_FLAGS
	default y

config BT_ADV_PROV_DEVICE_NAME
	default y

config ML_APP_ADV_PROV_UUID128_ALL
	bool "UUID128 advertising provider"
	depends on BT_NUS
	default y
	help
	  Adds UUID128 of Nordic UART Service (NUS) to the scan response data
	  if used Bluetooth local identity has no bond.

endif # BT_ADV_PROV

endmenu
```

## applications/machine_learning/sysbuild/ipc_radio/boards/nrf5340dk_nrf5340_cpunet.conf
```kconfig
#
# Copyright (c) 2024 Nordic Semiconductor
#
# SPDX-License-Identifier: LicenseRef-Nordic-5-Clause
#

# Increase maximum data length of PDU supported in the Controller
CONFIG_BT_CTLR_DATA_LENGTH_MAX=251
CONFIG_BT_BUF_ACL_TX_SIZE=251
CONFIG_BT_BUF_ACL_RX_SIZE=502

CONFIG_BT_MAX_CONN=6

CONFIG_ASSERT=y
CONFIG_DEBUG_INFO=y
CONFIG_EXCEPTION_STACK_TRACE=y

# Improve debugging experience by disabling reset on fatal error
CONFIG_RESET_ON_FATAL_ERROR=n
```

## applications/machine_learning/sysbuild/ipc_radio/boards/nrf54h20dk_nrf54h20_cpurad.conf
```kconfig
#
# Copyright (c) 2024 Nordic Semiconductor
#
# SPDX-License-Identifier: LicenseRef-Nordic-5-Clause
#

# Increase maximum data length of PDU supported in the Controller
CONFIG_BT_CTLR_DATA_LENGTH_MAX=251
CONFIG_BT_BUF_ACL_TX_SIZE=251
CONFIG_BT_BUF_ACL_RX_SIZE=502

CONFIG_SERIAL=n
CONFIG_UART_CONSOLE=n
CONFIG_LOG=n
```

## applications/machine_learning/sysbuild/ipc_radio/boards/thingy53_nrf5340_cpunet_ns.conf
```kconfig
#
# Copyright (c) 2024 Nordic Semiconductor
#
# SPDX-License-Identifier: LicenseRef-Nordic-5-Clause
#

CONFIG_ASSERT=y
CONFIG_DEBUG_INFO=y
CONFIG_EXCEPTION_STACK_TRACE=y

# Improve debugging experience by disabling reset on fatal error
CONFIG_RESET_ON_FATAL_ERROR=n
```

## applications/matter_bridge/Kconfig
```kconfig
#
# Copyright (c) 2023 Nordic Semiconductor
#
# SPDX-License-Identifier: LicenseRef-Nordic-5-Clause
#
mainmenu "Matter nRF Connect Bridge Example Application"

config BRIDGE_ONOFF_LIGHT_BRIDGED_DEVICE
	bool "Support for OnOff Light bridged device"
	default y

config BRIDGE_TEMPERATURE_SENSOR_BRIDGED_DEVICE
	bool "Support for Temperature Sensor bridged device"
	default y

config BRIDGE_HUMIDITY_SENSOR_BRIDGED_DEVICE
	bool "Support for Humidity Sensor bridged device"
	default y

choice BRIDGE_SWITCH_BRIDGED_DEVICE
	prompt "Bridged device switch implementation"
	default BRIDGE_GENERIC_SWITCH_BRIDGED_DEVICE

config BRIDGE_GENERIC_SWITCH_BRIDGED_DEVICE
	bool "Support for Generic Switch bridged device"

config BRIDGE_ONOFF_LIGHT_SWITCH_BRIDGED_DEVICE
	bool "Support for OnOff Light Switch bridged device"

endchoice

choice BRIDGED_DEVICE_IMPLEMENTATION
	prompt "Bridged Device implementation"
	default BRIDGED_DEVICE_SIMULATED

	config BRIDGED_DEVICE_SIMULATED
		bool "Simulated Bridged Device"
		help
		  Enables using simulated bridged devices that do not perform
		  real operations, but emulate exemplary data to imitate the real
		  device behavior.

	config BRIDGED_DEVICE_BT
		bool "Bluetooth LE Bridged Device"
		help
		  Enables using real bridged devices that communicate with the Matter bridge device
		  over Bluetooth LE.

endchoice

if BRIDGED_DEVICE_SIMULATED

choice BRIDGED_DEVICE_SIMULATED_ONOFF_IMPLEMENTATION
	prompt "Simulated bridged onoff device implementation"
	default BRIDGED_DEVICE_SIMULATED_ONOFF_SHELL

	config BRIDGED_DEVICE_SIMULATED_ONOFF_AUTOMATIC
		bool "Automatically simulated bridged onoff device"
		help
		  Enables using simulated bridged onoff device that
		  automatically changes its state periodically.

	config BRIDGED_DEVICE_SIMULATED_ONOFF_SHELL
		bool "Shell controlled simulated bridged onoff device"
		help
		  Enables using simulated bridged onoff device that is
		  controlled by shell commands.

endchoice

endif

if BRIDGED_DEVICE_BT

config BT_CENTRAL
	default y

config BT_SCAN
	default y

# Configure how many Bluetooth LE devices the Matter bridge can support (the final number is given value - 1, as 1 connection is used for the Matter Bluetooth LE service).
config BT_MAX_CONN
	default 3

config BT_SCAN_FILTER_ENABLE
	default y

# Configure how many Bluetooth LE service UUIDs the Matter bridge can scan.
config BT_SCAN_UUID_CNT
	default 2

config BT_SCAN_ADDRESS_CNT
	default 1

config BT_GATT_CLIENT
	default y

config BT_GATT_DM
	default y

config BT_EXT_ADV
	default y

config BT_SMP
	default y

if BT_SMP

config BT_SETTINGS
	default y

# Configure how many Bluetooth LE devices will be paired with Matter bridge. Assuming it will be only bridged devices, it should be set to BT_MAX_CONN - 1.
config BT_MAX_PAIRED
	default 2

# Use two Bluetooth LE identities. The first one is used by the peripheral for Matter service advertising purposes, and the other is used by the Matter bridge central.
config BT_ID_MAX
	default 2

config BT_EXT_ADV_LEGACY_SUPPORT
	default y

endif

config BRIDGE_BLE_DEVICE_POLLING_INTERVAL
	int "BLE humidity measurement readout polling interval in ms"
	default 3000

endif

if BRIDGE_TEMPERATURE_SENSOR_BRIDGED_DEVICE

config BRIDGE_TEMPERATURE_SENSOR_MIN_MEASURED_VALUE
	int "Default minimum measured value allowed by the bridged temperature sensor device"
	default -20

config BRIDGE_TEMPERATURE_SENSOR_MAX_MEASURED_VALUE
	int "Default maximum measured value allowed by the bridged temperature sensor device"
	default 60

endif

if BRIDGE_HUMIDITY_SENSOR_BRIDGED_DEVICE

config BRIDGE_HUMIDITY_SENSOR_MIN_MEASURED_VALUE
	int "Default minimum measured value allowed by the bridged humidity sensor device"
	default 0

config BRIDGE_HUMIDITY_SENSOR_MAX_MEASURED_VALUE
	int "Default maximum measured value allowed by the bridged humidity sensor device"
	default 100

endif

# Enable Read Client functionality for all build configurations.
config CHIP_ENABLE_READ_CLIENT
	default y

config NCS_SAMPLE_MATTER_PERSISTENT_STORAGE
	default y

config BRIDGE_SMART_PLUG_SUPPORT
	bool "Enables additional endpoint implementing Matter smart plug functionality"
	default n

# Sample configuration used for Thread networking
if NET_L2_OPENTHREAD

choice OPENTHREAD_NORDIC_LIBRARY_CONFIGURATION
	default OPENTHREAD_NORDIC_LIBRARY_FTD
endchoice

choice OPENTHREAD_DEVICE_TYPE
	default OPENTHREAD_FTD
endchoice

endif # NET_L2_OPENTHREAD

source "${ZEPHYR_CONNECTEDHOMEIP_MODULE_DIR}/config/nrfconnect/chip-module/Kconfig.features"
source "${ZEPHYR_CONNECTEDHOMEIP_MODULE_DIR}/config/nrfconnect/chip-module/Kconfig.defaults"
source "${ZEPHYR_NRF_MODULE_DIR}/samples/matter/common/src/bridge/Kconfig"
source "${ZEPHYR_NRF_MODULE_DIR}/samples/matter/common/src/Kconfig"
source "Kconfig.zephyr"
```

## applications/matter_bridge/Kconfig.sysbuild
```kconfig
#
# Copyright (c) 2023 Nordic Semiconductor ASA
#
# SPDX-License-Identifier: LicenseRef-Nordic-5-Clause
#

# This config has to be enabled manually for variants with shields, because sysbuild does not support it.
config WIFI_NRF70
	default y if BOARD_NRF7002DK

#### Radio core
config NRF_DEFAULT_IPC_RADIO
	default y

# Enable Bluetooth serialization to network core
config NETCORE_IPC_RADIO_BT_HCI_IPC
	default y

#### Bootloader
choice BOOTLOADER
	default BOOTLOADER_MCUBOOT
endchoice

# Enable IEEE802.15.4 serialization to network core
# This config automatically pulls in the `overlay-802154.conf` in the ipc_radio image
config NETCORE_IPC_RADIO_IEEE802154
	default y if SOC_SERIES_NRF53 && !WIFI_NRF70

if BOOTLOADER_MCUBOOT

#### DFU multi-image support
config DFU_MULTI_IMAGE_PACKAGE_BUILD
	default y

config DFU_MULTI_IMAGE_PACKAGE_APP
	default y

config PM_EXTERNAL_FLASH_MCUBOOT_SECONDARY
	default y

#### DFU network core configuration
if SOC_SERIES_NRF53

choice MCUBOOT_MODE
	default MCUBOOT_MODE_OVERWRITE_ONLY
endchoice

choice BOOT_SIGNATURE_TYPE
	default BOOT_SIGNATURE_TYPE_RSA
endchoice

config SECURE_BOOT_NETCORE
	default y

config NETCORE_APP_UPDATE
	default y

config DFU_MULTI_IMAGE_PACKAGE_NET
	default y

endif # SOC_SERIES_NRF53

if BOARD_NRF54LM20DK

# Disable checking the external drivers for nRF54LM20 DK.
config PM_OVERRIDE_EXTERNAL_DRIVER_CHECK
	default y

endif # BOARD_NRF54LM20DK

endif # BOOTLOADER_MCUBOOT

# Store the Wi-Fi firmware patch on external flash by default for nRF5340 with nRF7002
if WIFI_NRF70 && SOC_NRF5340_CPUAPP

choice WIFI_PATCHES_EXT_FLASH_SUPPORT
	default WIFI_PATCHES_EXT_FLASH_STORE

endchoice

config DFU_MULTI_IMAGE_PACKAGE_WIFI_FW_PATCH
	default y

endif # WIFI_NRF70

#### Enable generating factory data
config MATTER_FACTORY_DATA_GENERATE
	default y

source "share/sysbuild/Kconfig"
```

## applications/matter_bridge/boards/nrf5340dk_nrf5340_cpuapp.conf
```kconfig
#
# Copyright (c) 2023 Nordic Semiconductor ASA
#
# SPDX-License-Identifier: LicenseRef-Nordic-5-Clause
#

# Set 10 BLE connections, as it is an upper limit supported caused by RAM usage due to using Thread and BLE at same time.
CONFIG_BT_MAX_CONN=10

# Set ACL RX count to CONFIG_BT_MAX_CONN + 1, as it is expected that CONFIG_BT_BUF_ACL_RX_COUNT > CONFIG_BT_MAX_CONN.
CONFIG_BT_BUF_ACL_RX_COUNT=11

# Set buffer sizes in a consistent way with the ones used by the network core.
#id if oncomment it there is an error that rx buffer is out of range (minimal value is 69)
CONFIG_BT_BUF_ACL_RX_SIZE=69
CONFIG_BT_BUF_ACL_TX_SIZE=69

# Set MTU size to fit in the single buffer and avoid fragmentation (BUF_SIZE = MTU_SIZE + 4 B of L2CAP header).
CONFIG_BT_L2CAP_TX_MTU=65

# Set max number of bridged BLE devices, which is CONFIG_BT_MAX_CONN-1, as 1 connection is reserved for Matter.
CONFIG_BRIDGE_MAX_BRIDGED_DEVICES_NUMBER=9
CONFIG_BT_MAX_PAIRED=9

# Assume that every bridged device uses 2 endpoints, however it can be increased if specific use case requires it.
CONFIG_BRIDGE_MAX_DYNAMIC_ENDPOINTS_NUMBER=18
# 15.4 RX buffers were decreased to save RAM
CONFIG_NRF_802154_RX_BUFFERS=14
```

## applications/matter_bridge/boards/nrf54h20dk_nrf54h20_cpuapp.conf
```kconfig
#
# Copyright (c) 2024 Nordic Semiconductor ASA
#
# SPDX-License-Identifier: LicenseRef-Nordic-5-Clause
#

CONFIG_MPU_STACK_GUARD=n

# Enable PSA crypto from SSF client
CONFIG_PSA_SSF_CRYPTO_CLIENT=y
CONFIG_SSF_PSA_CRYPTO_SERVICE_ENABLED=y

# Disable Data Cache
CONFIG_DCACHE=n

# Workaround required as Zephyr L2 implies usage of NVS backend for settings.
# It should be removed once the proper fix will be applied in Zephyr.
CONFIG_NVS=n

# TODO: Enable DAC key migration once it is supported.
# Currently ITS does not work properly.
CONFIG_CHIP_FACTORY_DATA_WRITE_PROTECT=n

# Disable GPD
CONFIG_SOC_NRF54H20_GPD=n
```

## applications/matter_bridge/boards/nrf54lm20dk_nrf54lm20a_cpuapp.conf
```kconfig
#
# Copyright (c) 2025 Nordic Semiconductor ASA
#
# SPDX-License-Identifier: LicenseRef-Nordic-5-Clause
#

# Set 10 BLE connections, as it is an upper limit supported caused by RAM usage due to using Thread and BLE at same time.
CONFIG_BT_MAX_CONN=10

# Decrease BT buffer sizes to free some RAM and support 10 Bluetooth LE connections
CONFIG_BT_BUF_ACL_RX_SIZE=69
CONFIG_BT_BUF_ACL_TX_SIZE=69

# Set MTU size to fit in the single buffer and avoid fragmentation (BUF_SIZE = MTU_SIZE + 4 B of L2CAP header).
CONFIG_BT_L2CAP_TX_MTU=65

# Increase BT RX stack size due to BT security usage
CONFIG_BT_RX_STACK_SIZE=2560

# Set max number of bridged Bluetooth LE devices, which is CONFIG_BT_MAX_CONN-1, as 1 connection is reserved for Matter.
CONFIG_BRIDGE_MAX_BRIDGED_DEVICES_NUMBER=9
CONFIG_BT_MAX_PAIRED=9

# Assume that every bridged device uses two endpoints, however it can be increased if specific use case requires it.
CONFIG_BRIDGE_MAX_DYNAMIC_ENDPOINTS_NUMBER=18
```
