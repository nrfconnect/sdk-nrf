/*
 * Copyright (c) 2023 Nordic Semiconductor ASA
 *
 * SPDX-License-Identifier: LicenseRef-Nordic-5-Clause
 */

/* Enable external flash */
&arduino_spi {
	mx25r64: mx25r6435f@1 {
		status = "okay";
	};
};
