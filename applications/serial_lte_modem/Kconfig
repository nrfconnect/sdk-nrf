## applications/serial_lte_modem/src/nrf52_dfu/Kconfig
```kconfig
#
# Copyright (c) 2021 Nordic Semiconductor ASA
#
# SPDX-License-Identifier: LicenseRef-Nordic-5-Clause

config SLM_NRF52_DFU
	bool "NRF52 DFU support in SLM"
	select DOWNLOAD_CLIENT

if (SLM_NRF52_DFU)

config SLM_DFU_SOCKET_RETRIES
	int "Number of retries for socket-related download issues"
	default 2

config SLM_DFU_INIT_PACKET_SZ
	int "Size of buffer used for store init packet"
	default 512

config SLM_DFU_FLASH_BUF_SZ
	int "Size of buffer used for flash write operations"
	default 512
	help
	  Buffer size must be aligned to the minimal flash write block size

endif # SLM_NRF52_DFU
```

## applications/serial_lte_modem/src/tcpip_proxy/Kconfig
```kconfig
#
# Copyright (c) 2020 Nordic Semiconductor ASA
#
# SPDX-License-Identifier: LicenseRef-BSD-5-Clause-Nordic
#
config SLM_TCP_PROXY
	bool "Stateful connection-oriented TCP client/server"

config SLM_TCP_POLL_TIME
	int "Poll timeout in seconds for TCP connection"
	default 10

config SLM_TCP_CONN_TIME
	int "Connection timeout in seconds for TCP server"
	default 60

config SLM_UDP_PROXY
	bool "Stateful connection-oriented UDP client/server"
```

## applications/serial_lte_modem/src/twi/Kconfig
```kconfig
#
# Copyright (c) 2021 Nordic Semiconductor ASA
#
# SPDX-License-Identifier: LicenseRef-Nordic-5-Clause

config SLM_TWI
	bool "Access TWI interface with SLM AT command"
	select I2C
	default y if "$(dt_nodelabel_enabled,i2c0)" || \
		     "$(dt_nodelabel_enabled,i2c1)" || \
		     "$(dt_nodelabel_enabled,i2c2)" || \
		     "$(dt_nodelabel_enabled,i2c3)"
```

## applications/serial_lte_modem/sysbuild/mcuboot/boards/thingy91x_nrf9151.conf
```kconfig
# MCUBoot settings
CONFIG_BOOT_MAX_IMG_SECTORS=512

CONFIG_SPI=y
CONFIG_SPI_NOR=y
CONFIG_SPI_NOR_FLASH_LAYOUT_PAGE_SIZE=4096
CONFIG_SPI_NOR_SFDP_DEVICETREE=y
CONFIG_MULTITHREADING=y

# Disable Zephyr console and use UART for MCUboot serial recovery instead
CONFIG_CONSOLE=n
CONFIG_CONSOLE_HANDLER=n
CONFIG_UART_CONSOLE=n
CONFIG_MCUBOOT_SERIAL=y
CONFIG_MCUBOOT_SERIAL_DIRECT_IMAGE_UPLOAD=y
CONFIG_BOOT_SERIAL_IMG_GRP_IMAGE_STATE=y

CONFIG_PM_EXTERNAL_FLASH_MCUBOOT_SECONDARY=y
CONFIG_PM_OVERRIDE_EXTERNAL_DRIVER_CHECK=y

CONFIG_FW_INFO_FIRMWARE_VERSION=2
```

## applications/sw_io_devices/gpio/sample.yaml
```yaml
sample:
  name: eGPIO application
  description: SW-defined GPIO application
common:
  integration_platforms:
    - nrf54l15pdk/nrf54l15/cpuflpr
tests:
  applications.sw_io_devices.egpio:
    sysbuild: true
    build_only: true
    platform_allow: nrf54l15pdk/nrf54l15/cpuflpr
    tags: ci_build sysbuild
```

## applications/zigbee_weather_station/Kconfig
```kconfig
#
# Copyright (c) 2022 Nordic Semiconductor
#
# SPDX-License-Identifier: LicenseRef-Nordic-5-Clause
#

if USB
config USB_DEVICE_PID
	default 0x53A0
endif

# How often sensor data is read
config WEATHER_CHECK_PERIOD_SECONDS
	int
	default 60

# Delay after app initialization
config FIRST_WEATHER_CHECK_DELAY_SECONDS
	int
	default 5

source "Kconfig.zephyr"

module = ZIGBEE_WEATHER_STATION
module-str = Zigbee weather station
source "subsys/logging/Kconfig.template.log_config"
```

## applications/zigbee_weather_station/sample.yaml
```yaml
sample:
  name: Zigbee Weather Station
  description: Zigbee Weather Station application
tests:
  applications.zigbee_weather_station:
    sysbuild: true
    build_only: true
    platform_allow: thingy53/nrf5340/cpuapp
    tags: ci_build sysbuild
    extra_args: FILE_SUFFIX=release
    integration_platforms:
      - thingy53/nrf5340/cpuapp
  applications.zigbee_weather_station.debug:
    sysbuild: true
    build_only: true
    platform_allow: thingy53/nrf5340/cpuapp
    tags: ci_build debug sysbuild
```

## boards/arm/gl_nrf52840_dev_board/Kconfig
```kconfig
if BOARD_GL_THREAD_DEV_BOARD

config BOARD_ENABLE_DCDC
	bool "DCDC mode"
	select SOC_DCDC_NRF52X
	default y

config BOARD_ENABLE_DCDC_HV
	bool "High Voltage DCDC converter"
	select SOC_DCDC_NRF52X_HV
	default y

endif # BOARD_NRF52840DK_NRF52840
```
