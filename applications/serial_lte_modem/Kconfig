## applications/serial_lte_modem/sample.yaml
```yaml
sample:
  name: Serial LTE Modem
tests:
  applications.serial_lte_modem:
    sysbuild: true
    build_only: true
    platform_allow:
      - nrf9160dk/nrf9160/ns
      - nrf9161dk/nrf9161/ns
      - nrf9151dk/nrf9151/ns
      - nrf9131ek/nrf9131/ns
      - thingy91/nrf9160/ns
      - thingy91x/nrf9151/ns
    integration_platforms:
      - nrf9160dk/nrf9160/ns
      - nrf9161dk/nrf9161/ns
      - nrf9151dk/nrf9151/ns
      - nrf9131ek/nrf9131/ns
      - thingy91/nrf9160/ns
      - thingy91x/nrf9151/ns
    tags:
      - ci_build
      - sysbuild
      - ci_applications_serial_lte_modem
  applications.serial_lte_modem_no_power_indicate:
    sysbuild: true
    build_only: true
    extra_configs:
      - CONFIG_SLM_POWER_PIN=-1
      - CONFIG_SLM_INDICATE_PIN=-1
    platform_allow:
      - nrf9151dk/nrf9151/ns
    integration_platforms:
      - nrf9151dk/nrf9151/ns
    tags:
      - ci_build
      - sysbuild
      - ci_applications_serial_lte_modem
  applications.serial_lte_modem_no_power:
    sysbuild: true
    build_only: true
    extra_configs:
      - CONFIG_SLM_POWER_PIN=-1
    platform_allow:
      - nrf9151dk/nrf9151/ns
    integration_platforms:
      - nrf9151dk/nrf9151/ns
    tags:
      - ci_build
      - sysbuild
      - ci_applications_serial_lte_modem
  applications.serial_lte_modem_no_indicate:
    sysbuild: true
    build_only: true
    extra_configs:
      - CONFIG_SLM_INDICATE_PIN=-1
    platform_allow:
      - nrf9151dk/nrf9151/ns
    integration_platforms:
      - nrf9151dk/nrf9151/ns
    tags:
      - ci_build
      - sysbuild
      - ci_applications_serial_lte_modem
  applications.serial_lte_modem.extmcu:
    sysbuild: true
    build_only: true
    extra_args:
      - EXTRA_DTC_OVERLAY_FILE="overlay-external-mcu.overlay"
    extra_configs:
      - CONFIG_SLM_POWER_PIN=31
      - CONFIG_SLM_INDICATE_PIN=30
    platform_allow:
      - nrf9160dk/nrf9160/ns
      - nrf9161dk/nrf9161/ns
      - nrf9151dk/nrf9151/ns
    integration_platforms:
      - nrf9151dk/nrf9151/ns
    tags:
      - ci_build
      - sysbuild
      - ci_applications_serial_lte_modem
  applications.serial_lte_modem.ppp_without_cmux:
    sysbuild: true
    build_only: true
    extra_args:
      - EXTRA_CONF_FILE="overlay-ppp.conf"
      - EXTRA_DTC_OVERLAY_FILE="overlay-ppp-without-cmux.overlay"
    platform_allow:
      - nrf9160dk/nrf9160/ns
      - nrf9161dk/nrf9161/ns
      - nrf9151dk/nrf9151/ns
      - nrf9131ek/nrf9131/ns
      - thingy91/nrf9160/ns
      - thingy91x/nrf9151/ns
    integration_platforms:
      - nrf9151dk/nrf9151/ns
    tags:
      - ci_build
      - sysbuild
      - ci_applications_serial_lte_modem
  applications.serial_lte_modem.ppp_without_cmux_power_indicate_pin:
    sysbuild: true
    build_only: true
    extra_args:
      - EXTRA_CONF_FILE="overlay-ppp.conf"
      - EXTRA_DTC_OVERLAY_FILE="overlay-ppp-without-cmux.overlay"
    extra_configs:
      - CONFIG_SLM_POWER_PIN=31
      - CONFIG_SLM_INDICATE_PIN=30
    platform_allow:
      - nrf9160dk/nrf9160/ns
      - nrf9161dk/nrf9161/ns
      - nrf9151dk/nrf9151/ns
      - nrf9131ek/nrf9131/ns
      - thingy91/nrf9160/ns
      - thingy91x/nrf9151/ns
    integration_platforms:
      - nrf9151dk/nrf9151/ns
    tags:
      - ci_build
      - sysbuild
      - ci_applications_serial_lte_modem
  applications.serial_lte_modem.ppp_cmux_linux:
    sysbuild: true
    build_only: true
    extra_args:
      - EXTRA_CONF_FILE="overlay-ppp-cmux-linux.conf"
    platform_allow:
      - nrf9160dk/nrf9160/ns
      - nrf9161dk/nrf9161/ns
      - nrf9151dk/nrf9151/ns
      - nrf9131ek/nrf9131/ns
      - thingy91/nrf9160/ns
      - thingy91x/nrf9151/ns
    integration_platforms:
      - nrf9151dk/nrf9151/ns
    tags:
      - ci_build
      - sysbuild
      - ci_applications_serial_lte_modem
  applications.serial_lte_modem.ppp_cmux_linux_power_indicate_pin:
    sysbuild: true
    build_only: true
    extra_args:
      - EXTRA_CONF_FILE="overlay-ppp-cmux-linux.conf"
    extra_configs:
      - CONFIG_SLM_POWER_PIN=31
      - CONFIG_SLM_INDICATE_PIN=30
    platform_allow:
      - nrf9160dk/nrf9160/ns
      - nrf9161dk/nrf9161/ns
      - nrf9151dk/nrf9151/ns
      - nrf9131ek/nrf9131/ns
      - thingy91/nrf9160/ns
      - thingy91x/nrf9151/ns
    integration_platforms:
      - nrf9151dk/nrf9151/ns
    tags:
      - ci_build
      - sysbuild
      - ci_applications_serial_lte_modem
  applications.serial_lte_modem.ppp_cmux_zephyr_with_extmcu:
    sysbuild: true
    build_only: true
    extra_args:
      - EXTRA_CONF_FILE="overlay-cmux.conf;overlay-ppp.conf;overlay-zephyr-modem.conf"
      - EXTRA_DTC_OVERLAY_FILE="overlay-external-mcu.overlay"
    platform_allow:
      - nrf9160dk/nrf9160/ns
      - nrf9161dk/nrf9161/ns
      - nrf9151dk/nrf9151/ns
    integration_platforms:
      - nrf9151dk/nrf9151/ns
    tags:
      - ci_build
      - sysbuild
      - ci_applications_serial_lte_modem
  applications.serial_lte_modem.ppp_cmux_zephyr_with_nrf52840_on_nrf9160dk:
    sysbuild: true
    build_only: true
    extra_args:
      - EXTRA_CONF_FILE="overlay-cmux.conf;overlay-ppp.conf;overlay-zephyr-modem.conf;overlay-zephyr-modem-nrf9160dk-nrf52840.conf"
      - EXTRA_DTC_OVERLAY_FILE="overlay-zephyr-modem-nrf9160dk-nrf52840.overlay"
    platform_allow:
      - nrf9160dk/nrf9160/ns
    integration_platforms:
      - nrf9160dk/nrf9160/ns
    tags:
      - ci_build
      - sysbuild
      - ci_applications_serial_lte_modem
  applications.serial_lte_modem.memfault:
    sysbuild: true
    build_only: true
    extra_args:
      - EXTRA_CONF_FILE=overlay-memfault.conf
    extra_configs:
      - CONFIG_MEMFAULT_NCS_PROJECT_KEY="dummy-key"
    platform_allow:
      - nrf9160dk/nrf9160/ns
      - nrf9161dk/nrf9161/ns
      - nrf9151dk/nrf9151/ns
      - nrf9131ek/nrf9131/ns
      - thingy91x/nrf9151/ns
    integration_platforms:
      - nrf9151dk/nrf9151/ns
    tags:
      - ci_build
      - sysbuild
      - ci_applications_serial_lte_modem
  applications.serial_lte_modem.native_tls:
    sysbuild: true
    build_only: true
    extra_args: EXTRA_CONF_FILE=overlay-native_tls.conf
    platform_allow:
      - nrf9160dk/nrf9160/ns
      - nrf9161dk/nrf9161/ns
      - nrf9151dk/nrf9151/ns
      - nrf9131ek/nrf9131/ns
      - thingy91x/nrf9151/ns
    integration_platforms:
      - nrf9151dk/nrf9151/ns
    tags:
      - ci_build
      - sysbuild
      - ci_applications_serial_lte_modem
  applications.serial_lte_modem.lwm2m_carrier:
    sysbuild: true
    build_only: true
    extra_args: EXTRA_CONF_FILE=overlay-carrier.conf
    platform_allow:
      - nrf9160dk/nrf9160/ns
      - nrf9161dk/nrf9161/ns
      - nrf9151dk/nrf9151/ns
      - nrf9131ek/nrf9131/ns
      - thingy91x/nrf9151/ns
    integration_platforms:
      - nrf9151dk/nrf9151/ns
    tags:
      - ci_build
      - sysbuild
      - ci_applications_serial_lte_modem
  applications.serial_lte_modem.lwm2m_carrier.softbank:
    sysbuild: true
    build_only: true
    extra_args:
      - EXTRA_CONF_FILE="overlay-carrier.conf;overlay-carrier-softbank.conf"
      - SB_EXTRA_CONF_FILE=sysbuild-softbank.conf
    platform_allow:
      - nrf9160dk/nrf9160/ns
      - nrf9151dk/nrf9151/ns
    integration_platforms:
      - nrf9160dk/nrf9160/ns
    tags:
      - ci_build
      - sysbuild
      - ci_applications_serial_lte_modem
  applications.serial_lte_modem.lwm2m_carrier.lgu:
    sysbuild: true
    build_only: true
    extra_args: EXTRA_CONF_FILE="overlay-carrier.conf;overlay-carrier-lgu.conf"
    platform_allow:
      - nrf9151dk/nrf9151/ns
    integration_platforms:
      - nrf9151dk/nrf9151/ns
    tags:
      - ci_build
      - sysbuild
      - ci_applications_serial_lte_modem
  applications.serial_lte_modem.lwm2m_carrier.thingy91:
    sysbuild: true
    build_only: true
    extra_args:
      - EXTRA_CONF_FILE=overlay-carrier.conf
      - SB_CONFIG_THINGY91_STATIC_PARTITIONS_LWM2M_CARRIER=y
    platform_allow:
      - thingy91/nrf9160/ns
    integration_platforms:
      - thingy91/nrf9160/ns
    tags:
      - ci_build
      - sysbuild
      - ci_applications_serial_lte_modem
  applications.serial_lte_modem.tracing:
    sysbuild: true
    build_only: true
    platform_allow:
      - nrf9151dk/nrf9151/ns
      - nrf9160dk/nrf9160/ns
      - nrf9161dk/nrf9161/ns
      - thingy91/nrf9160/ns
      - thingy91x/nrf9151/ns
    integration_platforms:
      - nrf9151dk/nrf9151/ns
      - nrf9160dk/nrf9160/ns
      - nrf9161dk/nrf9161/ns
      - thingy91/nrf9160/ns
      - thingy91x/nrf9151/ns
    tags:
      - ci_build
      - sysbuild
      - ci_applications_serial_lte_modem
    extra_args:
      - serial_lte_modem_SNIPPET=nrf91-modem-trace-uart
```

## applications/serial_lte_modem/src/dfu/Kconfig
```kconfig
#
# Copyright (c) 2022 Nordic Semiconductor ASA
#
# SPDX-License-Identifier: LicenseRef-Nordic-5-Clause

config SLM_NRF52_DFU
	bool "NRF52 DFU support"
	help
	  NRF52 DFU support in SLM

if (SLM_NRF52_DFU)

config SLM_DFU_SOCKET_RETRIES
	int "Number of retries of download"
	default 2
	help
	  Number of retries for socket-related download issues

config SLM_DFU_FLASH_BUF_SZ
	int "Buffer size for flash write operations"
	default 512
	help
	  Buffer size must be aligned to the minimal flash write block size

config SLM_NRF52_DFU_LEGACY
	bool "Legacy NRF52 DFU support"
	help
	  Legacy NRF52 DFU support in SLM

if SLM_NRF52_DFU_LEGACY

config SLM_DFU_INIT_PACKET_SZ
	int "Buffer size for init packet"
	default 512
	help
	  Size of buffer used for store init packet
endif # SLM_NRF52_DFU_LEGACY

endif # SLM_NRF52_DFU
```

## applications/serial_lte_modem/src/ftp_c/Kconfig
```kconfig
#
# Copyright (c) 2020 Nordic Semiconductor ASA
#
# SPDX-License-Identifier: LicenseRef-Nordic-5-Clause

config SLM_FTPC
	bool "FTP client support in SLM"
	default y
	select FTP_CLIENT

config SLM_TFTPC
	bool "TFTP client support in SLM"
	default y
	select TFTP_LIB
```

## applications/serial_lte_modem/src/gnss/Kconfig
```kconfig
#
# Copyright (c) 2023 Nordic Semiconductor ASA
#
# SPDX-License-Identifier: LicenseRef-Nordic-5-Clause

config SLM_GNSS_OUTPUT_NMEA_ON_CMUX_CHANNEL
	bool "Output NMEA messages on a dedicated CMUX channel"
	depends on SLM_CMUX

config SLM_GNSS_OUTPUT_NMEA_SATELLITES
	bool "Output NMEA satellite messages (GSV, GSA)"
	default y if SLM_LOG_LEVEL_DBG
	depends on SLM_LOG_LEVEL_DBG || SLM_GNSS_OUTPUT_NMEA_ON_CMUX_CHANNEL
	help
	  If enabled, NMEA messages that pertain to the satellites will be output
	  along with the other NMEA messages. Those are output in debug logs, and
	  can also be output to a dedicated CMUX channel.

config SLM_PGPS_INJECT_FIX_DATA
	bool "Inject the data obtained when acquiring a fix"
	default y
	depends on SLM_GNSS
	depends on SLM_NRF_CLOUD
	depends on NRF_CLOUD_PGPS
	help
	  If enabled, when a fix is acquired the current location and time will
	  be passed to the P-GPS subsystem.
	  It allows to speed up the time it takes to acquire the next fix when
	  A-GNSS is disabled or unavailable.
	  This can be detrimental to short TTFF if the device is expected to move
	  distances longer than a few dozen kilometers between fix attempts.
	  In that case this option should be disabled.
```

## applications/serial_lte_modem/src/gpio/Kconfig
```kconfig
#
# Copyright (c) 2021 Nordic Semiconductor ASA
#
# SPDX-License-Identifier: LicenseRef-Nordic-5-Clause

config SLM_GPIO
	bool "GPIO support in SLM"
	default y
	depends on GPIO
```

## applications/serial_lte_modem/src/gps/Kconfig
```kconfig
#
# Copyright (c) 2020 Nordic Semiconductor ASA
#
# SPDX-License-Identifier: LicenseRef-Nordic-5-Clause

config SLM_GPS
	bool "GPS support in SLM"

if SLM_GPS

config SLM_SUPL_SERVER
	string "SUPL server"
	default "supl.google.com"

config SLM_SUPL_PORT
	int "SUPL server port"
	default 7276

endif
```

## applications/serial_lte_modem/src/http_c/Kconfig
```kconfig
#
# Copyright (c) 2020 Nordic Semiconductor ASA
#
# SPDX-License-Identifier: LicenseRef-Nordic-5-Clause

config SLM_HTTPC
	bool "HTTP client support in SLM"
	select HTTP_CLIENT
```

## applications/serial_lte_modem/src/lwm2m/Kconfig
```kconfig
#
# Copyright (c) 2024 Nordic Semiconductor ASA
#
# SPDX-License-Identifier: LicenseRef-Nordic-5-Clause
#

config SLM_LWM2M
	bool "LwM2M support in SLM"
	depends on LWM2M

if SLM_LWM2M

config SLM_LWM2M_AUTO_STARTUP
	bool "Enable automatic startup on boot"
	help
	  Enable automatic startup of the LwM2M client on device boot. If this configuration is
	  disabled, automatic startup is controlled through a dedicated AT command.

config SLM_LWM2M_PSK
	string "LwM2M pre-shared key"
	help
	  Pre-shared key must be identical to the PSK registered with the device on the LwM2M server.
	  Use the hexadecimal representation.

endif # SLM_LWM2M
```

## applications/serial_lte_modem/src/lwm2m_carrier/Kconfig
```kconfig
#
# Copyright (c) 2023 Nordic Semiconductor ASA
#
# SPDX-License-Identifier: LicenseRef-Nordic-5-Clause

config SLM_CARRIER
	bool "LwM2M Carrier support in SLM"
	default n
	depends on LWM2M_CARRIER

if SLM_CARRIER

config SLM_CARRIER_APP_DATA_BUFFER_LEN
	int "Size of the buffer for setting application data in hexadecimal string format"
	default 1537
	range 128 1537
	help
	  Specifies maximum application data size (in hexadecimal string format) to be set in the
	  App Data Container, the Binary App Data Container or the Event Log objects.

config SLM_CARRIER_AUTO_STARTUP
	bool "Enable automatic startup on boot"
	depends on LWM2M_CARRIER_SETTINGS
	help
	  Enable automatic startup of the library on device boot. If this configuration is
	  disabled, automatic startup is controlled through a dedicated AT command.

config SLM_CARRIER_AUTO_CONTROL
	bool "Automatic handling of LwM2M requests"
	depends on SLM_AUTO_CONNECT
	default y
	help
	  Enable automatic power off, reboot, link up or link down when requested by the LwM2M
	  stack. If this is disabled, the host MCU must perform these operations via AT commands
	  when requested.

endif # SLM_CARRIER
```

## applications/serial_lte_modem/src/mqtt_c/Kconfig
```kconfig
#
# Copyright (c) 2020 Nordic Semiconductor ASA
#
# SPDX-License-Identifier: LicenseRef-Nordic-5-Clause

config SLM_MQTTC
	bool "MQTT client support in SLM"
	default y
	select MQTT_LIB
	select MQTT_LIB_TLS

if SLM_MQTTC

config SLM_MQTTC_MESSAGE_BUFFER_LEN
	int "Size of the buffer for MQTT library"
	default 512
	help
	  Specifies maximum message size can be transmitted/received through
	  MQTT (excluding MQTT PUBLISH payload).

endif # SLM_MQTTC
```

## applications/serial_lte_modem/src/nativetls/Kconfig
```kconfig
#
# Copyright (c) 2024 Nordic Semiconductor ASA
#
# SPDX-License-Identifier: LicenseRef-Nordic-5-Clause

config SLM_NATIVE_TLS
	bool "Use Zephyr's Mbed TLS for TLS connections"

config SLM_NATIVE_TLS_CREDENTIAL_BUFFER_SIZE
	int "Buffer space reserved for loading credentials"
	default 4096
	help
	  Buffer space available for a single sec_tag when loading credentials for Mbed TLS.

config SLM_NATIVE_TLS_CREDENTIAL_BUFFER_COUNT
	int "Amount of buffers for loading credentials"
	default 1
	range 1 2
	help
	  Amount of buffers available for loading sec_tag credentials for Mbed TLS.
	  TLS client needs the buffer only when connecting whereas TLS server needs the buffer as long as it is running.
	  Increase the value, if you need TLS client and server running simultaneously with different sec_tags.
```
