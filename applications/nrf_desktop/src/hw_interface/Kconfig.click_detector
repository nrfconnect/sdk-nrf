## applications/nrf_desktop/src/modules/Kconfig.ble
```kconfig
#
# Copyright (c) 2018-2021 Nordic Semiconductor ASA
#
# SPDX-License-Identifier: LicenseRef-Nordic-5-Clause
#

menu "BLE"

comment "BLE Passkey"

config DESKTOP_BLE_ENABLE_PASSKEY
	bool "Enable passkey based pairing"
	depends on !DESKTOP_PASSKEY_NONE
	depends on BT_PERIPHERAL
	help
	  Enable passkey based pairing for increased security.

if DESKTOP_BLE_ENABLE_PASSKEY

module = DESKTOP_BLE_PASSKEY
module-str = BLE passkey
source "subsys/logging/Kconfig.template.log_config"

endif

comment "BLE Bond"

config DESKTOP_BLE_BOND_ENABLE
	bool "Enable BLE bond module"
	depends on BT_BONDABLE
	depends on BT_SETTINGS
	depends on CAF_SETTINGS_LOADER
	depends on CAF_BLE_COMMON_EVENTS
	select CAF_BLE_BOND_SUPPORTED
	help
	  Enable app-specific implementation of Bluetooth LE bond module.
	  The module is used to control Bluetooth peers.

	  The module selects the CAF_BLE_BOND_SUPPORTED option to inform CAF that BLE bond module is
	  supported by the application.

config DESKTOP_BLE_USE_DEFAULT_ID
	bool "Use default Bluetooth local identity"
	depends on BT_PERIPHERAL
	help
	  Bluetooth default local identity is used as ID 0. This identity
	  cannot be reset. After bond for the default identity is removed,
	  it is no longer used.

config DESKTOP_BLE_PEER_CONTROL
	bool "Enable interaction with peer configuration"
	depends on CAF_BUTTON_EVENTS
	help
	  Let user control Bluetooth peers by pressing a dedicated button.

if DESKTOP_BLE_PEER_CONTROL

config DESKTOP_BLE_PEER_CONTROL_BUTTON
	hex "Key ID of button used to control peers"
	range 0x0000 0xffff
	help
	  Button which should be used to control bonded Bluetooth peers.

config DESKTOP_BLE_PEER_SELECT
	bool "Enable switching between peers"
	depends on BT_PERIPHERAL
	help
	  Short click to switch peer. Double click to accept choice.

config DESKTOP_BLE_NEW_PEER_SCAN_REQUEST
	bool "Enable scanning on request"
	depends on BT_CENTRAL
	help
	  Short click to start new peer scanning. When enabled the device will
	  look for non-bonded devices only when requested.
	  When disabled the device always search for non-bonded devices while
	  scanning.
	  Regardless of the choice made the device scans periodically for
	  already bonded peers.

config DESKTOP_BLE_NEW_PEER_SCAN_ON_BOOT
	bool "Look for peers after boot"
	depends on DESKTOP_BLE_NEW_PEER_SCAN_REQUEST
	help
	  When enabled the device will look for new peers also after it was
	  booted.

config DESKTOP_BLE_PEER_ERASE
	bool "Enable peer erase"
	help
	  Long click to start erase. Double click to confirm.

config DESKTOP_BLE_PEER_ERASE_ON_START
	bool "Enable peer erase (on system start)"
	depends on BT_PERIPHERAL
	help
	  Hold dedicated button during system start to start erase advertising.
endif

if !DESKTOP_BLE_PEER_CONTROL

config DESKTOP_BLE_PEER_CONTROL_BUTTON
	hex
	default 0x0000

endif

config DESKTOP_BLE_DONGLE_PEER_ENABLE
	bool "Enable dongle peer"
	depends on BT_PERIPHERAL
	help
	  Enable additional peer to connect with dongle.

if DESKTOP_BLE_DONGLE_PEER_ENABLE

config DESKTOP_BLE_DONGLE_PEER_SELECTOR_ID
	int "Dongle peer selector ID"
	range 0 255
	default 0
	help
	  ID of the hardware selector used to select the dongle peer.

config DESKTOP_BLE_DONGLE_PEER_SELECTOR_POS
	int "Dongle peer selector position"
	range 0 255
	default 0
	help
	  If the selector is set to this position, the dongle peer is selected.
	  If the selector is set to any other position, other Bluetooth LE
	  peers are selected.

config DESKTOP_BLE_DONGLE_PEER_ERASE_BOND_BUTTON
	bool "Allow erasing dongle peer using button"

config DESKTOP_BLE_DONGLE_PEER_ERASE_BOND_CONF_CHANNEL
	bool "Allow erasing dongle peer using config channel"
	depends on  DESKTOP_CONFIG_CHANNEL_ENABLE

endif

if !DESKTOP_BLE_DONGLE_PEER_ENABLE

config DESKTOP_BLE_DONGLE_PEER_SELECTOR_ID
	int
	default 0

config DESKTOP_BLE_DONGLE_PEER_SELECTOR_POS
	int
	default 0

endif

if DESKTOP_BLE_BOND_ENABLE

module = DESKTOP_BLE_BOND
module-str = BLE bonds
source "subsys/logging/Kconfig.template.log_config"

endif

comment "BLE Scanning"

config DESKTOP_BLE_SCANNING_ENABLE
	bool "Enable BLE scanning"
	default n
	depends on BT_CENTRAL
	help
	  Enable device to scan for peripheral devices.

config DESKTOP_BLE_SCAN_START_TIMEOUT_S
	int "Scan start timeout [s]"
	default 5
	depends on DESKTOP_BLE_SCANNING_ENABLE
	help
	  After disabled, scanning is re-enabled after defined time of connected
	  peripherals inactivity (scanning has negative impact on user
	  experience - e.g. may cause mouse pointer lags).

config DESKTOP_BLE_SCAN_DURATION_S
	int "Scan duration [s]"
	default 5
	depends on DESKTOP_BLE_SCANNING_ENABLE
	help
	  After this time scan is disabled if any peripheral is connected.

config DESKTOP_BLE_SCAN_MOUSE_LIMIT
	int "Maximum number of bonded mice"
	default 1
	range 0 255
	depends on DESKTOP_BLE_SCANNING_ENABLE

config DESKTOP_BLE_SCAN_KEYBOARD_LIMIT
	int "Maximum number of bonded keyboards"
	default 1
	range 0 255
	depends on DESKTOP_BLE_SCANNING_ENABLE

config DESKTOP_BLE_SCAN_PM_EVENTS
	bool "Stop and block scanning in the power down mode"
	default y
	depends on DESKTOP_BLE_SCANNING_ENABLE
	depends on CAF_PM_EVENTS
	help
	  Stop and block scanning for peers if the central switched to the power down mode
	  to reduce power consumption.

if DESKTOP_BLE_SCANNING_ENABLE

module = DESKTOP_BLE_SCANNING
module-str = BLE scanning
source "subsys/logging/Kconfig.template.log_config"

endif


comment "BLE Discovery"

config DESKTOP_BLE_DISCOVERY_ENABLE
	bool "Enable BLE discovery"
	depends on DESKTOP_BLE_SCANNING_ENABLE
	help
	  Enable device to read device description (custom GATT Service),
	  Device Information Service and discover HIDS.

if DESKTOP_BLE_DISCOVERY_ENABLE

module = DESKTOP_BLE_DISCOVERY
module-str = BLE discovery
source "subsys/logging/Kconfig.template.log_config"

endif

comment "BLE connection parameters"

if BT_PERIPHERAL

config DESKTOP_BLE_SECURITY_FAIL_TIMEOUT_S
	int "Security fail timeout [s]"
	default 10
	help
	  After this time peripheral device disconnects if security is not
	  established.

config DESKTOP_BLE_LOW_LATENCY_LOCK
	bool "Keep the slave latency low for LLPM connections"
	depends on BT_LL_SOFTDEVICE
	help
	  When this option is selected, the slave latency is kept low
	  for the LLPM connection unless device is in low power mode. This
	  speeds up sending the first HID report after not sending a report for
	  some connection intervals. Enabling this option increases the power
	  consumption of the device.

module = DESKTOP_BLE_LATENCY
module-str = BLE latency
source "subsys/logging/Kconfig.template.log_config"

endif

if BT_CENTRAL

config DESKTOP_BLE_USB_MANAGED_CI
	bool "Manage connection intervals on the USB state change"
	default y
	depends on DESKTOP_HID_DONGLE
	depends on DESKTOP_USB_ENABLE
	help
	  Manage BLE connection intervals depending on the USB state.
	  Allows reduced power consumption of the USB dongle device by
	  setting a larger connection intervals while the USB
	  enters suspended state.
	  After the USB resumes normal operation, connection interval is set to
	  the previous value.

config DESKTOP_BLE_USB_MANAGED_CI_VALUE
	int "BLE connection interval when USB is suspended"
	default 100
	depends on DESKTOP_BLE_USB_MANAGED_CI
	range 10 100
	help
	  Connection interval used for all connected peers while the USB is
	  in suspended state.

if !DESKTOP_BLE_USB_MANAGED_CI

config DESKTOP_BLE_USB_MANAGED_CI_VALUE
	int
	default 0

endif

module = DESKTOP_BLE_CONN_PARAMS
module-str = BLE connection parameters
source "subsys/logging/Kconfig.template.log_config"

endif

comment "BLE QoS management"

config DESKTOP_BLE_QOS_ENABLE
	bool "Enable BLE channel map management"
	depends on BT_LL_SOFTDEVICE
	depends on CPU_CORTEX_M4
	select BT_HCI_VS_EVT_USER
	help
	  Enable device to avoid congested RF channels.

config DESKTOP_BLE_QOS_INTERVAL
	int "Processing interval for QoS thread [ms]"
	default 1000
	depends on DESKTOP_BLE_QOS_ENABLE
	help
	  Configure processing interval for QoS algorithm.
	  Longer intervals means more time to accumulate CRC stats,
	  and vice versa.

config DESKTOP_BLE_QOS_STACK_SIZE
	int "Base stack size for QoS thread"
	default 512
	depends on DESKTOP_BLE_QOS_ENABLE
	help
	  Configure base stack size for QoS processing thread.

config DESKTOP_BLE_QOS_STATS_PRINTOUT_ENABLE
	bool "Enable BLE QoS statistics printout"
	depends on DESKTOP_BLE_QOS_ENABLE
	depends on USB_DEVICE_STACK
	select USB_COMPOSITE_DEVICE
	select USB_CDC_ACM
	select SERIAL
	select UART_LINE_CTRL
	select UART_INTERRUPT_DRIVEN
	help
	  Enable to get real-time QoS information printouts via CDC ACM.

config DESKTOP_BLE_QOS_STATS_PRINT_STACK_SIZE
	int "Stack size addition for QoS printout"
	default 784
	depends on DESKTOP_BLE_QOS_STATS_PRINTOUT_ENABLE
	help
	  This size increase is added to the QoS base stack size
	  to facilitate statistics printout.

if DESKTOP_BLE_QOS_ENABLE

module = DESKTOP_BLE_QOS
module-str = BLE channel map management
source "subsys/logging/Kconfig.template.log_config"

endif

endmenu
```

## applications/nrf_desktop/src/modules/Kconfig.ble_adv_ctrl
```kconfig
#
# Copyright (c) 2025 Nordic Semiconductor ASA
#
# SPDX-License-Identifier: LicenseRef-Nordic-5-Clause
#

menuconfig DESKTOP_BLE_ADV_CTRL_ENABLE
	bool "Bluetooth LE advertising control module"
	depends on CAF_BLE_ADV
	select CAF_MODULE_SUSPEND_EVENTS
	help
	  The module controls suspend/resume of CAF Bluetooth LE advertising
	  module.

if DESKTOP_BLE_ADV_CTRL_ENABLE

config DESKTOP_BLE_ADV_CTRL_SUSPEND_ON_USB
	bool "Suspend Bluetooth LE advertising when USB is connected"
	depends on DESKTOP_USB_ENABLE
	help
	  Suspend CAF Bluetooth LE advertising module while HID USB is active.

module = DESKTOP_BLE_ADV_CTRL
module-str = BLE advertising control
source "subsys/logging/Kconfig.template.log_config"

endif # DESKTOP_BLE_ADV_CTRL_ENABLE
```

## applications/nrf_desktop/src/modules/Kconfig.ble_bond
```kconfig
#
# Copyright (c) 2023 Nordic Semiconductor ASA
#
# SPDX-License-Identifier: LicenseRef-Nordic-5-Clause
#

menuconfig DESKTOP_BLE_BOND_ENABLE
	bool "BLE bond module"
	depends on BT_BONDABLE
	depends on BT_SETTINGS
	depends on CAF_SETTINGS_LOADER
	depends on CAF_BLE_COMMON_EVENTS
	select CAF_BLE_BOND_SUPPORTED
	help
	  Enable app-specific implementation of Bluetooth LE bond module.
	  The module is used to control Bluetooth peers.

	  The module selects the CAF_BLE_BOND_SUPPORTED option to inform CAF that BLE bond module is
	  supported by the application.

if DESKTOP_BLE_BOND_ENABLE

config DESKTOP_BLE_USE_DEFAULT_ID
	bool "Use default Bluetooth local identity"
	depends on DESKTOP_BT_PERIPHERAL
	help
	  Bluetooth default local identity is used as ID 0. This identity
	  cannot be reset. After bond for the default identity is removed,
	  it is no longer used.

config DESKTOP_BLE_PEER_CONTROL
	bool "Enable interaction with peer configuration"
	depends on CAF_BUTTON_EVENTS
	help
	  Let user control Bluetooth peers by pressing a dedicated button.

if DESKTOP_BLE_PEER_CONTROL

config DESKTOP_BLE_PEER_CONTROL_BUTTON
	hex "Key ID of button used to control peers"
	range 0x0000 0xffff
	help
	  Button which should be used to control bonded Bluetooth peers.

config DESKTOP_BLE_PEER_SELECT
	bool "Enable switching between peers"
	depends on DESKTOP_BT_PERIPHERAL
	help
	  Short click to switch peer. Double click to accept choice.

config DESKTOP_BLE_NEW_PEER_SCAN_REQUEST
	bool "Enable scanning on request"
	depends on DESKTOP_BT_CENTRAL
	help
	  Short click to start new peer scanning. When enabled the device will
	  look for non-bonded devices only when requested.
	  When disabled the device always search for non-bonded devices while
	  scanning.
	  Regardless of the choice made the device scans periodically for
	  already bonded peers.

config DESKTOP_BLE_PEER_ERASE
	bool "Enable peer erase"
	help
	  Long click to start erase. Double click to confirm.

config DESKTOP_BLE_PEER_ERASE_ON_START
	bool "Enable peer erase (on system start)"
	depends on DESKTOP_BT_PERIPHERAL
	help
	  Hold dedicated button during system start to start erase advertising.

endif # DESKTOP_BLE_PEER_CONTROL

if !DESKTOP_BLE_PEER_CONTROL

config DESKTOP_BLE_PEER_CONTROL_BUTTON
	hex
	default 0x0000

endif # !DESKTOP_BLE_PEER_CONTROL

config DESKTOP_BLE_DONGLE_PEER_ENABLE
	bool "Enable dongle peer"
	depends on DESKTOP_BT_PERIPHERAL
	help
	  Enable additional peer to connect with dongle.

if DESKTOP_BLE_DONGLE_PEER_ENABLE

config DESKTOP_BLE_DONGLE_PEER_SELECTOR_ID
	int "Dongle peer selector ID"
	range 0 255
	default 0
	help
	  ID of the hardware selector used to select the dongle peer.

config DESKTOP_BLE_DONGLE_PEER_SELECTOR_POS
	int "Dongle peer selector position"
	range 0 255
	default 0
	help
	  If the selector is set to this position, the dongle peer is selected.
	  If the selector is set to any other position, other Bluetooth LE
	  peers are selected.

config DESKTOP_BLE_DONGLE_PEER_ERASE_BOND_BUTTON
	bool "Allow erasing dongle peer using button"
	depends on DESKTOP_BLE_PEER_ERASE

config DESKTOP_BLE_DONGLE_PEER_ERASE_BOND_CONF_CHANNEL
	bool "Allow erasing dongle peer using config channel"
	depends on DESKTOP_CONFIG_CHANNEL_ENABLE

config DESKTOP_BLE_DONGLE_PEER_ID_INFO
	bool "Enable the Dongle Peer ID information event"
	help
	  This option enables the event that broadcasts information about
	  the dongle peer application identity. The Bluetooth LE bond module
	  submits the event during initialization.

endif # DESKTOP_BLE_DONGLE_PEER_ENABLE

if !DESKTOP_BLE_DONGLE_PEER_ENABLE

config DESKTOP_BLE_DONGLE_PEER_SELECTOR_ID
	int
	default 0

config DESKTOP_BLE_DONGLE_PEER_SELECTOR_POS
	int
	default 0

endif # !DESKTOP_BLE_DONGLE_PEER_ENABLE

module = DESKTOP_BLE_BOND
module-str = BLE bonds
source "subsys/logging/Kconfig.template.log_config"

endif # DESKTOP_BLE_BOND_ENABLE
```

## applications/nrf_desktop/src/modules/Kconfig.ble_discovery
```kconfig
#
# Copyright (c) 2022 Nordic Semiconductor ASA
#
# SPDX-License-Identifier: LicenseRef-Nordic-5-Clause
#

menuconfig DESKTOP_BLE_DISCOVERY_ENABLE
	bool "Bluetooth LE discovery module"
	depends on DESKTOP_BLE_SCAN_ENABLE
	select BT_GATT_DM
	help
	  Enable device to read device description (custom GATT Service),
	  Device Information Service and discover HIDS.

if DESKTOP_BLE_DISCOVERY_ENABLE

module = DESKTOP_BLE_DISCOVERY
module-str = BLE discovery
source "subsys/logging/Kconfig.template.log_config"

endif # DESKTOP_BLE_DISCOVERY_ENABLE
```
