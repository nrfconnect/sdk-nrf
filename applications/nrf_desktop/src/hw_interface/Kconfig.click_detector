## applications/nrf_desktop/src/modules/Kconfig.config_channel
```kconfig
#
# Copyright (c) 2018 - 2019 Nordic Semiconductor
#
# SPDX-License-Identifier: LicenseRef-Nordic-5-Clause
#

menu "User configuration channel"

config DESKTOP_CONFIG_CHANNEL_ENABLE
	bool "Enable user configuration channel"
	select DESKTOP_HWID
	help
	  Enables user to change firmware parameters at runtime over the
	  configuration channel.

config DESKTOP_CONFIG_CHANNEL_OUT_REPORT
	bool "Enable additional HID output report"
	depends on DESKTOP_CONFIG_CHANNEL_ENABLE
	depends on DESKTOP_ROLE_HID_PERIPHERAL
	help
	  Use additional HID output report for configuration channel data
	  transfer. The HID output report is used only by nRF Desktop dongle,
	  other hosts use the HID feature report.

	  For HID output reports, the dongle can use write without response.
	  In that case LLPM peripheral does not have to respond instead of
	  providing HID notification during one connection event.

	  Using HID output report prevents report rate drops when forwarding
	  configuration channel data, but it increases memory consumption of
	  the peripheral.

	  The config channel HID output report is handled in a dedicated way.
	  It does not use the same infrastructure as other HID output reports.

config DESKTOP_CONFIG_CHANNEL_TIMEOUT
	int "Transaction timeout on configuration channel in seconds"
	depends on DESKTOP_CONFIG_CHANNEL_ENABLE
	default 10
	help
	  Timeout [s] after which config channel transaction is dropped.

if DESKTOP_CONFIG_CHANNEL_ENABLE

module = DESKTOP_CONFIG_CHANNEL
module-str = Config channel
source "subsys/logging/Kconfig.template.log_config"

module = DESKTOP_INFO
module-str = Info
source "subsys/logging/Kconfig.template.log_config"

endif

comment "DFU"

config DESKTOP_CONFIG_CHANNEL_DFU_ENABLE
	bool "DFU over the config channel"
	depends on DESKTOP_CONFIG_CHANNEL_ENABLE
	help
	  This option enables DFU over the config channel.

if DESKTOP_CONFIG_CHANNEL_DFU_ENABLE

config DESKTOP_CONFIG_CHANNEL_DFU_SYNC_BUFFER_SIZE
	int "Size (in words) of sync buffer"
	range 1 16383
	default 128
	help
	  Number of words DFU data synchronization buffer will use. The new
	  image data is first transmitted to this RAM located buffer. When host
	  performs progress synchronization the data is moved from RAM to flash.
	  The host must perform progress synchronization at least
	  every synchronization buffer bytes count.

choice DESKTOP_CONFIG_CHANNEL_DFU_MCUBOOT
	prompt "Adjust the DFU module to be compatible with the specific mode of MCUboot"
	depends on BOOTLOADER_MCUBOOT
	default DESKTOP_CONFIG_CHANNEL_DFU_MCUBOOT_DIRECT_XIP if MCUBOOT_BOOTLOADER_MODE_DIRECT_XIP
	default DESKTOP_CONFIG_CHANNEL_DFU_MCUBOOT_RAM_LOAD if MCUBOOT_BOOTLOADER_MODE_RAM_LOAD
	default DESKTOP_CONFIG_CHANNEL_DFU_MCUBOOT_UNSPECIFIED
	help
	  Adjust the DFU module behavior to the MCUboot bootloader mode. The choice options are
	  only available for the bootloader modes that require adjustments.

config DESKTOP_CONFIG_CHANNEL_DFU_MCUBOOT_DIRECT_XIP
	bool "Adjust the DFU module to be compatible with the direct-xip mode of MCUboot"
	help
	  The option informs the DFU module that the MCUboot bootloader supports
	  direct-xip mode. In this mode, the image is booted directly from the
	  secondary slot instead of moving it to the primary slot. The module by
	  default assumes that MCUboot with direct-xip is used when direct-xip
	  variant image is built.

	  The DFU module assumes that MCUboot direct-xip bootloader simply boots
	  the image with a higher version. The module does not mark the newly
	  uploaded image as pending nor confirm it after a successful boot.

config DESKTOP_CONFIG_CHANNEL_DFU_MCUBOOT_RAM_LOAD
	bool "Adjust the DFU module to be compatible with the RAM load mode of MCUboot"
	depends on USE_DT_CODE_PARTITION
	depends on $(dt_nodelabel_exists,cpuapp_sram_mcuboot_ram_region)
	select EXPERIMENTAL
	help
	  The option informs the DFU module that the MCUboot bootloader supports
	  RAM load mode. In this mode, the image with the higher version is copied to
	  the RAM and booted from there.

	  The DFU module assumes that MCUboot RAM load bootloader simply copies
	  the image with a higher version and boots it from there. The module does not
	  mark the newly uploaded image as pending nor confirm it after a successful boot.

	  This option also requires the definition of the cpuapp_sram_mcuboot_ram_region DTS node
	  to indicate the RAM region reserved for the MCUboot image. This information is used to
	  validate if the executable RAM region of the application image does not overlap with
	  the RAM region of the MCUboot image.

config DESKTOP_CONFIG_CHANNEL_DFU_MCUBOOT_UNSPECIFIED
	bool "Use this option when the bootloader mode does not require any adjustments"
	help
	  Use this option when the bootloader mode does not require any adjustments. For example,
	  the bootloader in the swap mode defaults to this option as it does not require any
	  adjustments.

endchoice

if DESKTOP_CONFIG_CHANNEL_DFU_MCUBOOT_RAM_LOAD

config DESKTOP_CONFIG_CHANNEL_DFU_MCUBOOT_RAM_LOAD_MCUBOOT_RAM_START_ADDR
	hex
	default $(dt_nodelabel_reg_addr_hex,cpuapp_sram_mcuboot_ram_region)
	help
	  The start address of the MCUboot RAM region. The Kconfig option is used to validate
	  if the executable RAM region of the application image (also called the ROM section)
	  does not overlap with the RAM region of the MCUboot image.

endif # DESKTOP_CONFIG_CHANNEL_DFU_MCUBOOT_RAM_LOAD

config DESKTOP_CONFIG_CHANNEL_DFU_VID
	hex "Configuration channel Vendor ID"
	range 0 0XFFFF
	default DESKTOP_DEVICE_VID
	help
	  Configuration channel allows devices to report their Vendor ID. The
	  Vendor ID is reported together with Product ID and device generation.

	  The information is useful if nRF Desktop peripheral is connected
	  through nRF Desktop dongle and host computer has no direct access to
	  the VID and PID.

config DESKTOP_CONFIG_CHANNEL_DFU_PID
	hex "Configuration channel Product ID"
	range 0 0XFFFF
	default DESKTOP_DEVICE_PID
	help
	  Configuration channel allows devices to report their Product ID. The
	  Product ID is reported together with Vendor ID and device generation.

	  The information is useful if nRF Desktop peripheral is connected
	  through nRF Desktop dongle and host computer has no direct access to
	  the VID and PID.

config DESKTOP_CONFIG_CHANNEL_DFU_GENERATION
	string "Device generation"
	default DESKTOP_DEVICE_GENERATION
	help
	  Configuration channel allows devices to report their generation. The
	  generation is reported together with Vendor ID and Product ID.

module = DESKTOP_CONFIG_CHANNEL_DFU
module-str = Config channel DFU
source "subsys/logging/Kconfig.template.log_config"

endif

endmenu
```

## applications/nrf_desktop/src/modules/Kconfig.cpi_state
```kconfig
#
# Copyright (c) 2020 Nordic Semiconductor
#
# SPDX-License-Identifier: LicenseRef-BSD-5-Clause-Nordic
#

menu "CPI State"

config DESKTOP_CPI_STATE_ENABLE
	bool "Enable changing sensor CPI with buttons"
	depends on !DESKTOP_MOTION_NONE
	depends on !DESKTOP_BUTTONS_NONE

if DESKTOP_CPI_STATE_ENABLE

config DESKTOP_CPI_STATE_TOGGLE_UP_BUTTON_ID
	hex "ID of button that toggles CPI upwards"
	default 0x0000

config DESKTOP_CPI_STATE_TOGGLE_DOWN_BUTTON_ID
	hex "ID of button that toggles CPI downwards"
	default 0x0000

config DESKTOP_CPI_STATE_STEP_CHANGE
	int "CPI change per toggle"
	default 1000
	range 1 5000

module = DESKTOP_CPI_STATE
module-str = CPI state
source "subsys/logging/Kconfig.template.log_config"

endif

endmenu
```

## applications/nrf_desktop/src/modules/Kconfig.cpu_meas
```kconfig
#
# Copyright (c) 2020 Nordic Semiconductor
#
# SPDX-License-Identifier: LicenseRef-Nordic-5-Clause
#

menu "CPU load measurement"

config DESKTOP_CPU_MEAS_ENABLE
	bool "Enable measuring CPU load"
	select CPU_LOAD
	help
	  The CPU load is sent periodically using dedicated application event.

if DESKTOP_CPU_MEAS_ENABLE

config DESKTOP_CPU_MEAS_PERIOD
	int "Time between subsequent CPU load events [ms]"
	default 1000
	range 1 4294000
	help
	  The CPU load event is submitted periodically by a delayed work.
	  When the event is submitted, application module resets measurement.
	  According to CPU load subsystem documentation, measurement must be
	  reset at least every 4294 seconds. Otherwise results are invalid.

module = DESKTOP_CPU_MEAS
module-str = CPU meas
source "subsys/logging/Kconfig.template.log_config"

endif

endmenu
```

## applications/nrf_desktop/src/modules/Kconfig.dev_descr
```kconfig
#
# Copyright (c) 2023 Nordic Semiconductor ASA
#
# SPDX-License-Identifier: LicenseRef-Nordic-5-Clause
#

menuconfig DESKTOP_DEV_DESCR_ENABLE
	bool "Device description module"
	depends on DESKTOP_BT_PERIPHERAL
	select DESKTOP_HWID
	help
	  The device description module defines custom GATT Service, which
	  contains information about whether the peripheral supports the Low
	  Latency Packet Mode (LLPM) and Hardware ID (HW ID) of the peripheral.
```

## applications/nrf_desktop/src/modules/Kconfig.dfu_mcumgr
```kconfig
#
# Copyright (c) 2023-2025 Nordic Semiconductor ASA
#
# SPDX-License-Identifier: LicenseRef-Nordic-5-Clause
#

menuconfig DESKTOP_DFU_MCUMGR_ENABLE
	bool "Enable DFU using MCUmgr [EXPERIMENTAL]"
	select EXPERIMENTAL
	select CAF_BLE_SMP_TRANSFER_EVENTS if MCUMGR_TRANSPORT_BT
	select DESKTOP_DFU_MCUMGR_MCUBOOT_DEPS
	select MCUMGR
	select MCUMGR_GRP_OS
	select MCUMGR_GRP_OS_BOOTLOADER_INFO
	select MCUMGR_MGMT_NOTIFICATION_HOOKS
	select MCUMGR_SMP_COMMAND_STATUS_HOOKS
	select CRC
	select NET_BUF
	select FLASH
	select FLASH_MAP
	select ZCBOR
	depends on BOOTLOADER_MCUBOOT
	depends on !MCUBOOT_BOOTLOADER_MODE_RAM_LOAD
	help
	  This option enables an alternative method of performing DFU using the
	  MCUmgr module.

	  The MCUboot RAM load mode is not supported due to the current limitation
	  of this module implementation.

if DESKTOP_DFU_MCUMGR_ENABLE

config DESKTOP_DFU_MCUMGR_MCUBOOT_DEPS
	bool
	select MCUBOOT_BOOTUTIL_LIB
	select IMG_MANAGER
	select MCUMGR_GRP_IMG
	select MCUMGR_GRP_IMG_MUTEX if DESKTOP_DFU_LOCK
	select STREAM_FLASH
	help
	  This option is used to logically group the MCUboot bootloader dependencies in the MCUmgr DFU
	  module. The MCUboot bootloader is the only supported bootloader for this module.

module = DESKTOP_DFU_MCUMGR
module-str = DFU MCUmgr
source "subsys/logging/Kconfig.template.log_config"

endif
```
