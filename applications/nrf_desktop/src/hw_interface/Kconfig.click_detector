## applications/nrf_desktop/src/hw_interface/Kconfig.click_detector
```kconfig
#
# Copyright (c) 2019 Nordic Semiconductor
#
# SPDX-License-Identifier: LicenseRef-Nordic-5-Clause
#

menu "Click detector configuration"

config DESKTOP_CLICK_DETECTOR_ENABLE
	bool "Enable click detector"
	depends on !DESKTOP_BUTTONS_NONE

if DESKTOP_CLICK_DETECTOR_ENABLE

module = DESKTOP_CLICK_DETECTOR
module-str = click detector module
source "subsys/logging/Kconfig.template.log_config"

endif

endmenu
```

## applications/nrf_desktop/src/hw_interface/Kconfig.leds
```kconfig
#
# Copyright (c) 2019 Nordic Semiconductor
#
# SPDX-License-Identifier: LicenseRef-Nordic-5-Clause
#

menu "LEDs configuration"

config DESKTOP_LED_ENABLE
	bool "Enable LED hardware interface"

config DESKTOP_LED_COUNT
	int "Number of LEDs in use"
	depends on DESKTOP_LED_ENABLE
	default 0

config DESKTOP_LED_COLOR_COUNT
	int "Number of color channels per diode"
	depends on DESKTOP_LED_ENABLE
	default 3

config DESKTOP_LED_BRIGHTNESS_MAX
	int "Maximum value for LED brightness"
	depends on DESKTOP_LED_ENABLE
	default 255

if DESKTOP_LED_ENABLE
module = DESKTOP_LED
module-str = LED module
source "subsys/logging/Kconfig.template.log_config"
endif

endmenu
```

## applications/nrf_desktop/src/hw_interface/Kconfig.motion
```kconfig
#
# Copyright (c) 2019 Nordic Semiconductor
#
# SPDX-License-Identifier: LicenseRef-Nordic-5-Clause
#

menu "Motion configuration"

choice
	prompt "Select motion interface"
	default DESKTOP_MOTION_NONE

config DESKTOP_MOTION_NONE
	bool "Disable motion"
	help
	  If selected, no motion source if defined for the interface.

config DESKTOP_MOTION_SENSOR_PMW3360_ENABLE
	bool "Motion from optical sensor PMW3360"
	select DESKTOP_MOTION_SENSOR_ENABLE
	depends on PMW3360
	help
	  If selected, movement data it obtained from PMW3360 optical sensor.

config DESKTOP_MOTION_SENSOR_PAW3212_ENABLE
	bool "Motion from optical sensor PAW3212"
	select DESKTOP_MOTION_SENSOR_ENABLE
	depends on PAW3212
	help
	  If selected, movement data it obtained from PAW3212 optical sensor.

config DESKTOP_MOTION_BUTTONS_ENABLE
	bool "Motion from buttons"
	depends on CAF_BUTTON_EVENTS
	help
	  If selected, movement data it obtained from buttons.

config DESKTOP_MOTION_SIMULATED_ENABLE
	bool "Simulated motion"
	help
	  If selected, movement data is simulated.

endchoice

config DESKTOP_MOTION_SENSOR_ENABLE
	bool

config DESKTOP_MOTION_SENSOR_TYPE
	depends on DESKTOP_MOTION_SENSOR_ENABLE
	string
	default "pmw3360" if DESKTOP_MOTION_SENSOR_PMW3360_ENABLE
	default "paw3212" if DESKTOP_MOTION_SENSOR_PAW3212_ENABLE

config DESKTOP_MOTION_BUTTONS_UP_KEY_ID
	int "Up key ID"
	depends on DESKTOP_MOTION_BUTTONS_ENABLE
	default 0
	help
	  ID of key use for generating up motion.

config DESKTOP_MOTION_BUTTONS_DOWN_KEY_ID
	int "Down key ID"
	depends on DESKTOP_MOTION_BUTTONS_ENABLE
	default 0
	help
	  ID of key use for generating down motion.

config DESKTOP_MOTION_BUTTONS_LEFT_KEY_ID
	int "Left key ID"
	depends on DESKTOP_MOTION_BUTTONS_ENABLE
	default 0
	help
	  ID of key use for generating left motion.

config DESKTOP_MOTION_BUTTONS_RIGHT_KEY_ID
	int "Right key ID"
	depends on DESKTOP_MOTION_BUTTONS_ENABLE
	default 0
	help
	  ID of key use for generating right motion.

config DESKTOP_MOTION_BUTTONS_MOTION_PER_SEC
	int "Motion generated per second during a button press"
	depends on DESKTOP_MOTION_BUTTONS_ENABLE
	range 1 100000
	default 1000

config DESKTOP_MOTION_SIMULATED_EDGE_TIME
	int "Time for transition between two points in a trajectory [us]"
	depends on DESKTOP_MOTION_SIMULATED_ENABLE
	range 8 1000000000
	default 16384
	help
	  The simulated movement data will be tracing predefined path, an eight-sided polygon.
	  Must be power of two (calculations speedup).
	  The resolution may be limited by the precision of the system's hardware clock.

config DESKTOP_MOTION_SIMULATED_SCALE_FACTOR
	int "Scale factor for given shape"
	depends on DESKTOP_MOTION_SIMULATED_ENABLE
	range 1 5
	default 2
	help
	  The simulated movement data will be tracing predefined path, an eight-sided polygon.
	  This option defines scale factor for tracked polygon size.

config DESKTOP_MOTION_SENSOR_THREAD_STACK_SIZE
	int "Motion module thread stack size"
	depends on DESKTOP_MOTION_SENSOR_ENABLE
	range 0 4096
	default 512
	help
	  Stack size for motion sensor thread.

config DESKTOP_MOTION_SENSOR_EMPTY_SAMPLES_COUNT
	int "Empty sample count before fetching is stopped"
	depends on DESKTOP_MOTION_SENSOR_ENABLE
	default 10
	help
	  Number of sensor readouts with no movement reported after which
	  module will switch from actively fetching samples to waiting
	  for an interrupt from the sensor.

config DESKTOP_MOTION_SENSOR_CPI
	int "Motion sensor default CPI"
	depends on DESKTOP_MOTION_SENSOR_ENABLE
	default 0
	help
	  Default CPI value.

config DESKTOP_MOTION_SENSOR_SLEEP1_TIMEOUT_MS
	int "Motion sensor default sleep 1 timeout in ms"
	depends on DESKTOP_MOTION_SENSOR_ENABLE
	default 0
	help
	  Time in milliseconds after last motion detection in which sensor
	  enters a low power mode 1.

config DESKTOP_MOTION_SENSOR_SLEEP2_TIMEOUT_MS
	int "Motion sensor default sleep 2 timeout in ms"
	depends on DESKTOP_MOTION_SENSOR_ENABLE
	default 0
	help
	  Time in milliseconds after last motion detection in which sensor
	  enters a low power mode 2.

config DESKTOP_MOTION_SENSOR_SLEEP3_TIMEOUT_MS
	int "Motion sensor default sleep 3 timeout in ms"
	depends on DESKTOP_MOTION_SENSOR_ENABLE
	default 0
	help
	  Time in milliseconds after last motion detection in which sensor
	  enters a low power mode 3.

config DESKTOP_MOTION_SENSOR_SLEEP1_SAMPLE_TIME_DEFAULT
	int "Motion sensor default sleep1 sample time"
	depends on DESKTOP_MOTION_SENSOR_ENABLE
	default 0

config DESKTOP_MOTION_SENSOR_SLEEP2_SAMPLE_TIME_DEFAULT
	int "Motion sensor default sleep2 sample time"
	depends on DESKTOP_MOTION_SENSOR_ENABLE
	default 0

config DESKTOP_MOTION_SENSOR_SLEEP3_SAMPLE_TIME_DEFAULT
	int "Motion sensor default sleep3 sample time"
	depends on DESKTOP_MOTION_SENSOR_ENABLE
	default 0

config DESKTOP_MOTION_SENSOR_SLEEP3_SAMPLE_TIME_CONNECTED
	int "Motion sensor sleep3 sample time when connected"
	depends on DESKTOP_MOTION_SENSOR_ENABLE
	default DESKTOP_MOTION_SENSOR_SLEEP3_SAMPLE_TIME_DEFAULT

config DESKTOP_MOTION_SENSOR_SLEEP_DISABLE_ON_USB
	bool "Disable low power modes if powered from USB"
	depends on DESKTOP_MOTION_SENSOR_ENABLE
	depends on DESKTOP_USB_ENABLE
	depends on !DESKTOP_BATTERY_CHARGER_NONE
	default y
	help
	  Low power modes reduce device power consumption, but increase
	  response time.

config DESKTOP_MOTION_PM_EVENTS
	bool "Power management events support"
	depends on DESKTOP_MOTION_SIMULATED_ENABLE || DESKTOP_MOTION_SENSOR_ENABLE
	depends on CAF_PM_EVENTS
	default y
	help
	  React on power management events in motion module.

if !DESKTOP_MOTION_NONE
module = DESKTOP_MOTION
module-str = motion module
source "subsys/logging/Kconfig.template.log_config"
endif

endmenu
```

## applications/nrf_desktop/src/hw_interface/Kconfig.passkey
```kconfig
#
# Copyright (c) 2020 Nordic Semiconductor
#
# SPDX-License-Identifier: LicenseRef-Nordic-5-Clause
#

menu "Passkey input configuration"

choice
	prompt "Select passkey input interface"
	default DESKTOP_PASSKEY_NONE

config DESKTOP_PASSKEY_NONE
	bool "Disable passkey"
	help
	  If selected, passkey is disabled.

config DESKTOP_PASSKEY_BUTTONS
	bool "Passkey based on button presses"
	depends on CAF_BUTTON_EVENTS
	help
	  If selected, the passkey module is used to handle numeric passkey input.
	  The input handling is based on button presses.

endchoice

config DESKTOP_PASSKEY_MAX_LEN
	int "Max number of digits in passkey"
	range 0 9
	default 0
	depends on !DESKTOP_PASSKEY_NONE
	help
	  Maximum number of digits in a passkey.

if !DESKTOP_PASSKEY_NONE

module = DESKTOP_PASSKEY
module-str = passkey module
source "subsys/logging/Kconfig.template.log_config"

endif

endmenu
```

## applications/nrf_desktop/src/hw_interface/Kconfig.selector
```kconfig
#
# Copyright (c) 2019 Nordic Semiconductor
#
# SPDX-License-Identifier: LicenseRef-Nordic-5-Clause
#

menu "Selector configuration"

config DESKTOP_SELECTOR_HW_ENABLE
	depends on CAF
	bool "Enable HW based selector"
	help
	  This option enables hardware based selector for nRF Desktop application.
	  If selector state changes, selector_event is sent.

if DESKTOP_SELECTOR_HW_ENABLE

module = DESKTOP_SELECTOR_HW
module-str = selector hw module
source "subsys/logging/Kconfig.template.log_config"

endif

endmenu
```

## applications/nrf_desktop/src/hw_interface/Kconfig.wheel
```kconfig
#
# Copyright (c) 2019 Nordic Semiconductor
#
# SPDX-License-Identifier: LicenseRef-Nordic-5-Clause
#

menu "Wheel configuration"
	depends on QDEC_NRFX

config DESKTOP_WHEEL_ENABLE
	bool "Enable wheel hardware interface"
	depends on QDEC_NRFX
	help
	  This option enables wheel hardware interface for nRF Desktop application.
	  Wheel hardware interface is responsible for generating events related to rotation of the
	  mouse wheel.

config DESKTOP_WHEEL_SENSOR_VALUE_DIVIDER
	int "Wheel sensor value divider"
	depends on DESKTOP_WHEEL_ENABLE
	range 1 2048
	default 1
	help
	  A value obtained from the wheel sensor will be divided
	  by provided argument before being processed further.

config DESKTOP_WHEEL_SENSOR_IDLE_TIMEOUT
	int "Wheel sensor idle timeout"
	depends on DESKTOP_WHEEL_ENABLE
	range 0 3600
	default 0
	help
	  Time in seconds before sensor goes to idle state.
	  If set to zero sensor is always active.

config DESKTOP_WHEEL_INVERT_AXIS
	bool "Invert wheel axis"
	depends on DESKTOP_WHEEL_ENABLE
	help
	  Switch the orientation of the wheel sensor.

if DESKTOP_WHEEL_ENABLE
module = DESKTOP_WHEEL
module-str = wheel module
source "subsys/logging/Kconfig.template.log_config"
endif

endmenu
```

## applications/nrf_desktop/src/modules/Kconfig
```kconfig
#
# Copyright (c) 2018 Nordic Semiconductor
#
# SPDX-License-Identifier: LicenseRef-Nordic-5-Clause
#

menu "Application modules"

rsource "Kconfig.caf_ble_state.default"
rsource "Kconfig.caf_ble_adv.default"
rsource "Kconfig.caf_power_manager.default"
rsource "Kconfig.caf_settings_loader.default"

rsource "Kconfig.hid_state"
rsource "Kconfig.led_state"
rsource "Kconfig.led_stream"
rsource "Kconfig.usb_state"
rsource "Kconfig.ble_bond"
rsource "Kconfig.ble_conn_params"
rsource "Kconfig.ble_latency"
rsource "Kconfig.ble_passkey"
rsource "Kconfig.ble_discovery"
rsource "Kconfig.ble_scan"
rsource "Kconfig.ble_qos"
rsource "Kconfig.dev_descr"
rsource "Kconfig.dfu_mcumgr"
rsource "Kconfig.fast_pair"
rsource "Kconfig.swift_pair"
rsource "Kconfig.hids"
rsource "Kconfig.hid_forward"
rsource "Kconfig.bas"
rsource "Kconfig.qos"
rsource "Kconfig.config_channel"
rsource "Kconfig.fn_keys"
rsource "Kconfig.watchdog"
rsource "Kconfig.hotfixes"
rsource "Kconfig.failsafe"
rsource "Kconfig.cpu_meas"
rsource "Kconfig.nrf_profiler_sync"

endmenu
```
