## applications/nrf_desktop/src/modules/Kconfig.ble_latency
```kconfig
#
# Copyright (c) 2023 Nordic Semiconductor ASA
#
# SPDX-License-Identifier: LicenseRef-Nordic-5-Clause
#

menuconfig DESKTOP_BLE_LATENCY_ENABLE
	bool "BLE latency module"
	depends on DESKTOP_BT_PERIPHERAL
	help
	  Enable BLE latency module that controls Bluetooth LE connection
	  latency. The module lowers the connection latency when configuration
	  channel is in use or when firmware update is received by SMP (low
	  latency ensures quick data exchange).

	  The module also keeps the connection latency low for LLPM connections
	  to improve performance and disconnects Bluetooth peer if connection
	  has not been secured in the predefined amount of time after the
	  connection occurred.

if DESKTOP_BLE_LATENCY_ENABLE

config DESKTOP_BLE_SECURITY_FAIL_TIMEOUT_S
	int "Security fail timeout [s]"
	default 10
	help
	  After this time peripheral device disconnects if security is not
	  established.

config DESKTOP_BLE_LOW_LATENCY_LOCK
	bool "Keep the slave latency low for LLPM connections"
	depends on BT_LL_SOFTDEVICE
	help
	  When this option is selected, the slave latency is kept low
	  for the LLPM connection unless device is in low power mode. This
	  speeds up sending the first HID report after not sending a report for
	  some connection intervals. Enabling this option increases the power
	  consumption of the device.

config DESKTOP_BLE_LATENCY_PM_EVENTS
	bool "Power management events support"
	depends on CAF_PM_EVENTS
	default y
	help
	  React on power management events in BLE latency module.

module = DESKTOP_BLE_LATENCY
module-str = BLE latency
source "subsys/logging/Kconfig.template.log_config"

endif # DESKTOP_BLE_LATENCY_ENABLE
```

## applications/nrf_desktop/src/modules/Kconfig.ble_passkey
```kconfig
#
# Copyright (c) 2022 Nordic Semiconductor ASA
#
# SPDX-License-Identifier: LicenseRef-Nordic-5-Clause
#

menuconfig DESKTOP_BLE_ENABLE_PASSKEY
	bool "Bluetooth LE passkey module"
	depends on !DESKTOP_PASSKEY_NONE
	depends on !BT_FAST_PAIR
	depends on DESKTOP_BT_PERIPHERAL
	help
	  Enable passkey based pairing for increased security.

	  The feature should not be used together with Fast Pair,
	  because Fast Pair currently does not support devices that
	  use screen or keyboard for Bluetooth authentication.

if DESKTOP_BLE_ENABLE_PASSKEY

config BT_SMP_ENFORCE_MITM
	default n
	help
	  Disable to allow bonding with the nRF Desktop dongle that has no
	  MITM capabilities.

module = DESKTOP_BLE_PASSKEY
module-str = BLE passkey
source "subsys/logging/Kconfig.template.log_config"

endif # DESKTOP_BLE_ENABLE_PASSKEY
```

## applications/nrf_desktop/src/modules/Kconfig.ble_qos
```kconfig
#
# Copyright (c) 2022 Nordic Semiconductor ASA
#
# SPDX-License-Identifier: LicenseRef-Nordic-5-Clause
#

menuconfig DESKTOP_BLE_QOS_ENABLE
	bool "Bluetooth LE QoS module"
	depends on BT_LL_SOFTDEVICE
	depends on CPU_CORTEX_M4
	select BT_HCI_VS_EVT_USER
	help
	  Enable device to avoid congested RF channels.

if DESKTOP_BLE_QOS_ENABLE

config DESKTOP_BLE_QOS_INTERVAL
	int "Processing interval for QoS thread [ms]"
	default 1000
	help
	  Configure processing interval for QoS algorithm.
	  Longer intervals means more time to accumulate CRC stats,
	  and vice versa.

config DESKTOP_BLE_QOS_STACK_SIZE
	int "Base stack size for QoS thread"
	default 512
	help
	  Configure base stack size for QoS processing thread.

config DESKTOP_BLE_QOS_STATS_PRINTOUT_ENABLE
	bool "Enable BLE QoS statistics printout"
	depends on USB_DEVICE_STACK
	select USB_COMPOSITE_DEVICE
	select USB_CDC_ACM
	select SERIAL
	select UART_LINE_CTRL
	select UART_INTERRUPT_DRIVEN
	help
	  Enable to get real-time QoS information printouts via CDC ACM.

config DESKTOP_BLE_QOS_STATS_PRINT_STACK_SIZE
	int "Stack size addition for QoS printout"
	default 784
	depends on DESKTOP_BLE_QOS_STATS_PRINTOUT_ENABLE
	help
	  This size increase is added to the QoS base stack size
	  to facilitate statistics printout.

module = DESKTOP_BLE_QOS
module-str = BLE channel map management
source "subsys/logging/Kconfig.template.log_config"

endif # DESKTOP_BLE_QOS_ENABLE
```

## applications/nrf_desktop/src/modules/Kconfig.ble_scan
```kconfig
#
# Copyright (c) 2022 Nordic Semiconductor ASA
#
# SPDX-License-Identifier: LicenseRef-Nordic-5-Clause
#

menuconfig DESKTOP_BLE_SCAN_ENABLE
	bool "Bluetooth LE scan module"
	select BT_SCAN
	select BT_SCAN_FILTER_ENABLE
	depends on DESKTOP_BT_CENTRAL
	help
	  Enable device to scan for peripheral devices.

if DESKTOP_BLE_SCAN_ENABLE

config BT_SCAN_NAME_CNT
	default 2
	help
	  The nRF Desktop by default uses two name filters. The peripheral
	  device may advertise either as mouse or as keyboard.

config BT_SCAN_ADDRESS_CNT
	default BT_MAX_PAIRED
	help
	  The nRF Desktop needs an address filter per every bonded peripheral.

config BT_SCAN_CONN_ATTEMPTS_FILTER
	default y
	help
	  The connection attempts filter is enabled by default to limit number
	  of attempts to connect to the device.

config DESKTOP_BLE_SCAN_START_TIMEOUT_S
	int "Scan start timeout [s]"
	default 5
	help
	  After disabled, scanning is re-enabled after defined time of connected
	  peripherals inactivity (scanning has negative impact on user
	  experience - e.g. may cause mouse pointer lags).

config DESKTOP_BLE_SCAN_DURATION_S
	int "Scan duration [s]"
	default 30
	help
	  After this time scan is disabled if any peripheral is connected.

config DESKTOP_BLE_FORCED_SCAN_DURATION_S
	int "Forced scan duration [s]"
	default 4
	help
	  Duration of the forced scan operation in seconds. The module enters a
	  forced scan state right after boot or wakeup, on successful peripheral
	  discovery, on peripheral disconnection, on connection failure, on bond
	  erase and on scan request.

	  Setting forced scan duration to 0 disables the feature.

config DESKTOP_BLE_SCAN_MOUSE_LIMIT
	int "Maximum number of bonded mice"
	default 1
	range 0 255

config DESKTOP_BLE_SCAN_KEYBOARD_LIMIT
	int "Maximum number of bonded keyboards"
	default 1
	range 0 255

config DESKTOP_BLE_NEW_PEER_SCAN_ON_BOOT
	bool "Look for peers after boot"
	depends on DESKTOP_BLE_NEW_PEER_SCAN_REQUEST
	help
	  When enabled the device will look for new peers also after it was
	  booted.

config DESKTOP_BLE_SCAN_PM_EVENTS
	bool "Stop and block scanning in the power down mode"
	default y
	depends on CAF_PM_EVENTS
	help
	  Stop and block scanning for peers if the central switched to the power down mode
	  to reduce power consumption.

module = DESKTOP_BLE_SCAN
module-str = BLE scan
source "subsys/logging/Kconfig.template.log_config"

endif # DESKTOP_BLE_SCAN_ENABLE
```

## applications/nrf_desktop/src/modules/Kconfig.caf_ble_adv.default
```kconfig
#
# Copyright (c) 2022 Nordic Semiconductor ASA
#
# SPDX-License-Identifier: LicenseRef-Nordic-5-Clause
#

# nRF Desktop specific configuration overlay for CAF BLE advertising module.

config DESKTOP_BLE_ADV
	bool "Bluetooth LE advertising module (CAF)"
	depends on DESKTOP_BT_PERIPHERAL
	select CAF_BLE_ADV
	help
	  nRF Desktop uses Bluetooth LE advertising module from Common
	  Application Framework (CAF).

	  By default, nRF Desktop application does not use direct advertising,
	  but uses fast advertising and enables filter accept list.

if DESKTOP_BLE_ADV

config CAF_BLE_ADV_POWER_DOWN_ON_DISCONNECTION_REASON_0X15
	depends on CAF_BLE_ADV_PM_EVENTS
	default y
	help
	  nRF Desktop peripherals power down and suspend Bluetooth advertising
	  when bonded peer disconnects with reason 0x15 (Remote Device
	  Terminated due to Power Off) to avoid waking up the HID host until
	  user input is detected.

config CAF_BLE_ADV_DIRECT_ADV
	default n
	help
	  By default, nRF Desktop peripherals do not use direct advertising.

config CAF_BLE_ADV_FAST_ADV
	default y
	help
	  By default, nRF Desktop peripherals use fast advertising.

config CAF_BLE_ADV_FILTER_ACCEPT_LIST
	default y
	help
	  By default, nRF Desktop peripherals enable filter accept list.

config BT_ADV_PROV_FLAGS
	default y

config BT_ADV_PROV_GAP_APPEARANCE
	default y

config BT_ADV_PROV_DEVICE_NAME
	default y

config BT_ADV_PROV_DEVICE_NAME_PAIRING_MODE_ONLY
	default n
	help
	  nRF Desktop provides device name also outside of pairing mode. This is
	  done for backwards compatibility.

config BT_ADV_PROV_SWIFT_PAIR
	default y

config BT_ADV_PROV_FAST_PAIR
	default y if BT_FAST_PAIR

config BT_ADV_PROV_FAST_PAIR_SHOW_UI_PAIRING
	depends on BT_ADV_PROV_FAST_PAIR
	default n
	help
	  nRF Desktop peripheral supports one bond per local identity. Disable
	  the UI indication during Fast Pair not discoverable advertising to
	  prevent bonding failures.

config BT_ADV_PROV_TX_POWER
	default y

config DESKTOP_ADV_PROV_UUID16_ALL
	depends on (DESKTOP_HIDS_ENABLE || DESKTOP_BAS_ENABLE)
	default y

endif # DESKTOP_BLE_ADV
```

## applications/nrf_desktop/src/modules/Kconfig.caf_ble_state.default
```kconfig
#
# Copyright (c) 2022 Nordic Semiconductor ASA
#
# SPDX-License-Identifier: LicenseRef-Nordic-5-Clause
#

# nRF Desktop specific configuration overlay for CAF BLE state module.

config DESKTOP_BLE_STATE
	bool "Bluetooth LE state module (CAF)"
	select CAF_BLE_STATE
	help
	  nRF Desktop uses Bluetooth LE state module from Common Application
	  Framework (CAF).
```

## applications/nrf_desktop/src/modules/Kconfig.caf_power_manager.default
```kconfig
#
# Copyright (c) 2022 Nordic Semiconductor ASA
#
# SPDX-License-Identifier: LicenseRef-Nordic-5-Clause
#

# nRF Desktop specific configuration overlay for CAF power manager module.

config DESKTOP_POWER_MANAGER
	bool "Power manager module (CAF)"
	select CAF_POWER_MANAGER
	imply CAF_POWER_MANAGER_STAY_ON if DESKTOP_ROLE_HID_DONGLE
	help
	  nRF Desktop uses power manager module from Common Application
	  Framework (CAF).

	  By default, the nRF Desktop dongle stays on and remains idle instead
	  of switching SoC to OFF mode after the power manager timeout.
```

## applications/nrf_desktop/src/modules/Kconfig.caf_settings_loader.default
```kconfig
#
# Copyright (c) 2022 Nordic Semiconductor ASA
#
# SPDX-License-Identifier: LicenseRef-Nordic-5-Clause
#

# nRF Desktop specific configuration overlay for CAF settings loader module.

config DESKTOP_SETTINGS_LOADER
	bool "Settings loader module (CAF)"
	select CAF_SETTINGS_LOADER
	select SETTINGS
	imply ZMS if SOC_FLASH_NRF_RRAM
	imply NVS if !SOC_FLASH_NRF_RRAM
	imply FLASH
	imply FLASH_MAP
	imply FLASH_PAGE_LAYOUT
	help
	  nRF Desktop uses settings loader module from Common Application
	  Framework (CAF).

	  The settings partition is located in internal non-volatile memory.
	  By default, nRF Desktop application, depending on the non-volatile
	  memory technology used by the device, uses either the Zephyr Memory
	  Storage (ZMS) or Non-Volatile Storage (NVS) settings backend.
	  ZMS is used for the devices with the RRAM non-volatile memory that
	  do not require explicit erase. Otherwise, the NVS is used.

if DESKTOP_SETTINGS_LOADER

if NVS

config NVS_LOG_LEVEL
	default 2
	help
	  The nRF Desktop shows only warning and error logs related to the NVS.
	  This is done to avoid flooding logs.

endif # NVS

if ZMS

config ZMS_LOG_LEVEL
	default 2
	help
	  The nRF Desktop shows only warning and error logs related to the ZMS.
	  This is done to avoid flooding logs.

endif # ZMS

config SETTINGS_DYNAMIC_HANDLERS
	default n
	help
	  The nRF Desktop does not use dynamic settings handlers. Disable the
	  functionality by default to save memory.

endif # DESKTOP_SETTINGS_LOADER
```

## applications/nrf_desktop/src/modules/Kconfig.config
```kconfig
#
# Copyright (c) 2018 Nordic Semiconductor
#
# SPDX-License-Identifier: LicenseRef-BSD-5-Clause-Nordic
#

menu "Settings loading service"

config DESKTOP_SETTINGS_LOAD_BY_THREAD_ENABLE
	bool "Enable loading of setting by separate thead"
	help
	  The option enables loading of settings by separate
	  thread in background instead of use of system
	  work queue for that purpose.

if DESKTOP_SETTINGS_LOAD_BY_THREAD_ENABLE
config DESKTOP_SETTINGS_LOAD_THREAD_STACK_SIZE
	int "Settings module thread stack size"
	range 0 4096
	default 1024
	help
	  Stack size for thread responsible for loading
	  settings from flash memory.
endif

if !DESKTOP_SETTINGS_LOAD_BY_THREAD_ENABLE
config DESKTOP_SETTINGS_LOAD_THREAD_STACK_SIZE
	int
	default 0
endif

endmenu
```
