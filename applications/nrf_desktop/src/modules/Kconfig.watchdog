## applications/nrf_desktop/src/modules/Kconfig.watchdog
```kconfig
#
# Copyright (c) 2019 Nordic Semiconductor
#
# SPDX-License-Identifier: LicenseRef-Nordic-5-Clause
#

menu "Watchdog settings"

config DESKTOP_WATCHDOG_ENABLE
	bool "Enable watchdog support"
	select WATCHDOG
	help
	  Enable watchdog to reset the device in case of problems.

if DESKTOP_WATCHDOG_ENABLE

config DESKTOP_WATCHDOG_TIMEOUT
	int "Watchdog timeout value [ms]"
	default 1500
	range 500 120000
	help
	  Timeout of watchdog timer. After the time elapse a device will be restarted.

module = DESKTOP_WATCHDOG
module-str = watchdog
source "subsys/logging/Kconfig.template.log_config"

endif

endmenu
```

## applications/nrf_desktop/src/services/Kconfig
```kconfig
#
# Copyright (c) 2018 Nordic Semiconductor
#
# SPDX-License-Identifier: LicenseRef-BSD-5-Clause-Nordic
#

menu "BLE Services"

config DESKTOP_HID_MOUSE
	bool "Mouse HID device"
	help
	  This option controls if target is visible as mouse HID device.

config DESKTOP_HID_KEYBOARD
	bool "Keyboard HID device"
	help
	  This option controls if target is visible as keyboard HID device.

config DESKTOP_HID_CONSUMER_CTRL
	bool "Consumer control HID device"
	help
	  This option controls if target is visible as consumer control HID
	  device.

config DESKTOP_BAS_ENABLE
	bool
	help
	  This option enables battery service.

config DESKTOP_HIDS_ENABLE
	bool
	help
	  This option enables HID over GATT service.

config DESKTOP_HID_PERIPHERAL
	bool
	default y
	depends on BT_PERIPHERAL
	depends on (DESKTOP_HID_MOUSE || DESKTOP_HID_KEYBOARD || DESKTOP_HID_CONSUMER_CTRL)
	select BT_GATT_HIDS
	select NRF_BT_DIS
	select DESKTOP_BAS_ENABLE
	select DESKTOP_HIDS_ENABLE
	help
	  This option selects required options if device is HID peripheral.

if DESKTOP_BAS_ENABLE

module = DESKTOP_BAS
module-str = battery service
source "subsys/logging/Kconfig.template.log_config"

endif

if DESKTOP_HIDS_ENABLE

module = DESKTOP_HIDS
module-str = HID over GATT service
source "subsys/logging/Kconfig.template.log_config"

endif

endmenu
```

## applications/nrf_desktop/src/util/Kconfig
```kconfig
#
# Copyright (c) 2022 Nordic Semiconductor ASA
#
# SPDX-License-Identifier: LicenseRef-Nordic-5-Clause
#

menu "Utilities"

rsource "Kconfig.adv_prov"
rsource "Kconfig.dfu_lock"
rsource "Kconfig.hid_eventq"
rsource "Kconfig.hid_keymap"
rsource "Kconfig.hid_reportq"
rsource "Kconfig.hwid"
rsource "Kconfig.keys_state"

endmenu
```

## applications/nrf_desktop/src/util/Kconfig.dfu_lock
```kconfig
#
# Copyright (c) 2025 Nordic Semiconductor ASA
#
# SPDX-License-Identifier: LicenseRef-Nordic-5-Clause
#

menuconfig DESKTOP_DFU_LOCK
	bool "DFU lock module"
	default y if (DESKTOP_CONFIG_CHANNEL_DFU_ENABLE && DESKTOP_DFU_MCUMGR_ENABLE)
	help
	  Enable nRF Desktop DFU lock module for synchronizing multiple DFU
	  methods.

	  The module is automatically enabled when the Config Channel DFU and
	  the MCUmgr DFU are both enabled.

if DESKTOP_DFU_LOCK

module = DESKTOP_DFU_LOCK
module-str = DFU Lock
source "subsys/logging/Kconfig.template.log_config"

endif # DESKTOP_DFU_LOCK
```

## applications/nrf_desktop/src/util/Kconfig.hid_eventq
```kconfig
#
# Copyright (c) 2025 Nordic Semiconductor ASA
#
# SPDX-License-Identifier: LicenseRef-Nordic-5-Clause
#

menuconfig DESKTOP_HID_EVENTQ
	bool "Enable HID event queue utility"
	depends on DESKTOP_ROLE_HID_PERIPHERAL
	help
	  The HID event queue utility can be used to temporarily enqueue HID
	  events related to keypresses.

if DESKTOP_HID_EVENTQ

module = DESKTOP_HID_EVENTQ
module-str = HID event queue
source "subsys/logging/Kconfig.template.log_config"

endif # DESKTOP_HID_EVENTQ
```

## applications/nrf_desktop/src/util/Kconfig.hid_keymap
```kconfig
#
# Copyright (c) 2025 Nordic Semiconductor ASA
#
# SPDX-License-Identifier: LicenseRef-Nordic-5-Clause
#

menuconfig DESKTOP_HID_KEYMAP
	bool "Enable HID keymap utility"
	depends on DESKTOP_ROLE_HID_PERIPHERAL
	help
	  The HID keymap utility can be used to map application-specific key ID
	  to a HID usage ID. The mapping is statically defined in configuration.

if DESKTOP_HID_KEYMAP

config DESKTOP_HID_KEYMAP_DEF_PATH
	string "Path to file defining HID keymap"
	default "hid_keymap_def.h"
	help
	  Location of configuration file that holds information about mapping
	  from application-specific key ID to HID usage ID.

config DESKTOP_HID_KEYMAP_CACHE
	bool "Cache the last returned mapping"
	default y
	help
	  Caching speeds up mapping in case mapping for the same key ID is
	  requested multiple times in a row.

module = DESKTOP_HID_KEYMAP
module-str = HID keymap
source "subsys/logging/Kconfig.template.log_config"

endif # DESKTOP_HID_KEYMAP
```

## applications/nrf_desktop/src/util/Kconfig.hid_reportq
```kconfig
#
# Copyright (c) 2025 Nordic Semiconductor ASA
#
# SPDX-License-Identifier: LicenseRef-Nordic-5-Clause
#

menuconfig DESKTOP_HID_REPORTQ
	bool "Enable HID report queue utility"
	depends on DESKTOP_ROLE_HID_DONGLE
	help
	  The HID report queue utility can be used to enqueue HID reports from
	  connected HID peripherals. The queue simplifies integrating new
	  modules that receive HID reports from peripherals.

	  On the HID peripheral, the HID state module is used as a source of HID
	  input reports. The HID state module does not use the HID report queue
	  utility.

if DESKTOP_HID_REPORTQ

config DESKTOP_HID_REPORTQ_MAX_ENQUEUED_REPORTS
	int "Maximum number of enqueued HID reports"
	range 1 255
	default 2
	help
	  Maximum number of enqueued HID report events is limited to control
	  memory usage. The limit is defined separately for every HID input
	  report ID.

config DESKTOP_HID_REPORTQ_QUEUE_COUNT
	int "Number of supported HID report queues"
	range 1 1024
	default DESKTOP_HID_DONGLE_BOND_COUNT
	default 1
	help
	  Maximum number of HID report queues that can be used simultaneously.

module = DESKTOP_HID_REPORTQ
module-str = HID report queue
source "subsys/logging/Kconfig.template.log_config"

endif # DESKTOP_HID_REPORTQ
```

## applications/nrf_desktop/src/util/Kconfig.hwid
```kconfig
#
# Copyright (c) 2025 Nordic Semiconductor ASA
#
# SPDX-License-Identifier: LicenseRef-Nordic-5-Clause
#

config DESKTOP_HWID
	bool "Hardware ID module"
	select HWINFO
	help
	  Enable nRF Desktop hardware ID utility. The hardware ID is obtained
	  from Zephyr hwinfo driver.
```

## applications/nrf_desktop/src/util/Kconfig.keys_state
```kconfig
#
# Copyright (c) 2025 Nordic Semiconductor ASA
#
# SPDX-License-Identifier: LicenseRef-Nordic-5-Clause
#

menuconfig DESKTOP_KEYS_STATE
	bool "Enable keys state utility"
	help
	  The utility can be used to track the state of active keys.

if DESKTOP_KEYS_STATE

config DESKTOP_KEYS_STATE_KEY_CNT_MAX
	int "Maximum number of keys that can be simultaneously active"
	default 8
	range 1 255
	help
	  The configuration option determines the maximum number of keys that
	  can be simultaneously tracked by the keys state.

module = DESKTOP_KEYS_STATE
module-str = keys state
source "subsys/logging/Kconfig.template.log_config"

endif # DESKTOP_KEYS_STATE
```

## applications/nrf_desktop/sysbuild/b0/boards/nrf52840dongle_nrf52840.conf
```kconfig
# The nrf52840dongle uses USB CDC as default UART.
# The USB CDC ACM is not used by the nRF Desktop application.
CONFIG_BOARD_SERIAL_BACKEND_CDC_ACM=n

CONFIG_BOARD_HAS_NRF5_BOOTLOADER=n
```

## applications/nrf_desktop/sysbuild/b0/boards/nrf5340dk_nrf5340_cpuapp.conf
```kconfig
# The anomaly 160 workaround is not needed for the bootloader.
CONFIG_SOC_NRF53_ANOMALY_160_WORKAROUND_NEEDED=n
```

## applications/nrf_rpc/host/sample.yaml
```yaml
sample:
  name: nRF RPC application
  description: Test nRF RPC application
tests:
  sample.host.rpc_ble:
    build_only: true
    platform_allow: >
      nrf52840dk_nrf52840
    tags: ci_build
    extra_args: >
      SNIPPET="ble"
    integration_platforms:
      - nrf52840dk_nrf52840
  sample.host.rpc_ot:
    build_only: true
    platform_allow: >
      nrf52840dk_nrf52840
    tags: ci_build
    extra_args: >
      SNIPPET="openthread"
    integration_platforms:
      - nrf52840dk_nrf52840
  sample.host.rpc:
    build_only: true
    platform_allow: >
      nrf52840dk_nrf52840
    tags: ci_build
    extra_args: >
      SNIPPET="ble;openthread"
    integration_platforms:
      - nrf52840dk_nrf52840
```

## applications/nrf_rpc/remote/sample.yaml
```yaml
sample:
  name: nRF RPC application
  description: Test nRF RPC application
tests:
  sample.remote.rpc_ble:
    build_only: true
    platform_allow: >
      nrf52840dk_nrf52840
    tags: ci_build
    extra_args: >
      SNIPPET="ble"
    integration_platforms:
      - nrf52840dk_nrf52840
  sample.remote.rpc_ot:
    build_only: true
    platform_allow: >
      nrf52840dk_nrf52840
    tags: ci_build
    extra_args: >
      SNIPPET="openthread"
    integration_platforms:
      - nrf52840dk_nrf52840
  sample.remote.rpc:
    build_only: true
    platform_allow: >
      nrf52840dk_nrf52840
    tags: ci_build
    extra_args: >
      SNIPPET="ble;openthread"
    integration_platforms:
      - nrf52840dk_nrf52840
```

## applications/pelion_client/Kconfig
```kconfig
#
# Copyright (c) 2021 Nordic Semiconductor ASA
#
# SPDX-License-Identifier: LicenseRef-Nordic-5-Clause
#

menu "Pelion Cloud Client"
rsource "src/events/Kconfig"
rsource "src/modules/Kconfig"
endmenu

menu "Zephyr Kernel"
source "Kconfig.zephyr"
endmenu
```

## applications/pelion_client/configuration/nrf9160dk_nrf9160_ns/boards/nrf9160dk_nrf9160_ns_0_14_0.conf
```kconfig
#
# Copyright (c) 2021 Nordic Semiconductor ASA
#
# SPDX-License-Identifier: LicenseRef-Nordic-5-Clause
#
################################################################################

CONFIG_PELION_UPDATE_DEVELOPER=y

################################################################################
# External flash configuration needed for bootloader

CONFIG_SPI=y
CONFIG_SPI_NOR=y
CONFIG_SPI_NOR_FLASH_LAYOUT_PAGE_SIZE=4096
CONFIG_SPI_NOR_SFDP_DEVICETREE=y
```

## applications/pelion_client/configuration/nrf9160dk_nrf9160_ns/child_image/mcuboot/boards/nrf9160dk_nrf9160_0_14_0.conf
```kconfig
#
# Copyright (c) 2021 Nordic Semiconductor ASA
#
# SPDX-License-Identifier: LicenseRef-Nordic-5-Clause
#
################################################################################

# Logger
CONFIG_LOG_MAX_LEVEL=2

# External flash
CONFIG_MULTITHREADING=y
CONFIG_BOOT_MAX_IMG_SECTORS=2048

CONFIG_SPI=y
CONFIG_SPI_NOR=y
CONFIG_SPI_NOR_FLASH_LAYOUT_PAGE_SIZE=4096
CONFIG_SPI_NOR_SFDP_DEVICETREE=y
```

## applications/pelion_client/configuration/nrf9160dk_nrf9160_ns/child_image/mcuboot/boards/nrf9160dk_nrf9160_0_14_0_release.conf
```kconfig
#
# Copyright (c) 2021 Nordic Semiconductor ASA
#
# SPDX-License-Identifier: LicenseRef-Nordic-5-Clause
#
################################################################################

# External flash
CONFIG_MULTITHREADING=y
CONFIG_BOOT_MAX_IMG_SECTORS=2048

CONFIG_SPI=y
CONFIG_SPI_NOR=y
CONFIG_SPI_NOR_FLASH_LAYOUT_PAGE_SIZE=4096
CONFIG_SPI_NOR_SFDP_DEVICETREE=y

CONFIG_PM_EXTERNAL_FLASH_SUPPORT_LEGACY=y
CONFIG_PM_EXTERNAL_FLASH=y
CONFIG_PM_EXTERNAL_FLASH_DEV_NAME="MX25R64"
CONFIG_PM_EXTERNAL_FLASH_BASE=0x0
CONFIG_PM_EXTERNAL_FLASH_SIZE=0x800000
```

## applications/pelion_client/sample.yaml
```yaml
sample:
  name: Pelion Client Application
  description: Pelion conectivity reference application
tests:
  applications.pelion_client.zdebug:
    build_only: true
    extra_args: EXTRA_CFLAGS='-Wno-error=int-to-pointer-cast' EXTRA_CFLAGS='-Wno-error=implicit-function-declaration' EXTRA_CFLAGS='-Wno-error=format' EXTRA_CFLAGS='-Wno-error=pointer-to-int-cast' EXTRA_CFLAGS='-Wno-error=cpp' EXTRA_CFLAGS='-Wno-error=discarded-qualifiers' EXTRA_CFLAGS='-Wno-error=uninitialized' EXTRA_CFLAGS='-Wno-error=unused-function' EXTRA_CFLAGS='-Wno-error=deprecated-declarations'
    platform_allow: nrf52840dk_nrf52840 nrf9160dk_nrf9160_ns nrf5340dk_nrf5340_cpuapp nrf5340dk_nrf5340_cpuapp_ns
    integration_platforms:
      - nrf52840dk_nrf52840
      - nrf9160dk_nrf9160_ns
      - nrf5340dk_nrf5340_cpuapp
      - nrf5340dk_nrf5340_cpuapp_ns
    tags: ci_build
```

## applications/pelion_client/src/events/Kconfig
```kconfig
#
# Copyright (c) 2021 Nordic Semiconductor ASA
#
# SPDX-License-Identifier: LicenseRef-Nordic-5-Clause
#

menu "Event options"

comment "Initially logged events"

config PELION_INIT_LOG_PELION_STATE_EVENTS
	bool "Log Pelion state events"
	depends on LOG
	default y

config PELION_INIT_LOG_PELION_CREATE_OBJECTS_EVENTS
	bool "Log Pelion create objects events"
	depends on LOG
	default y

endmenu
```

## applications/pelion_client/src/events/Kconfig.factory_reset_event
```kconfig
#
# Copyright (c) 2021 Nordic Semiconductor
#
# SPDX-License-Identifier: LicenseRef-Nordic-5-Clause
#

config PELION_CLIENT_FACTORY_RESET_EVENTS
	bool "Enable factory reset events"
	help
	  Enable the event that informs the system that factory reset was requested.

config PELION_CLIENT_INIT_LOG_FACTORY_RESET_EVENTS
	bool "Log factory reset events"
	depends on LOG
	depends on PELION_CLIENT_FACTORY_RESET_EVENTS
	default y
	help
	  Log the factory reset events.
```

## applications/pelion_client/src/events/Kconfig.keep_alive_event
```kconfig
#
# Copyright (c) 2021 Nordic Semiconductor
#
# SPDX-License-Identifier: LicenseRef-Nordic-5-Clause
#

config PELION_CLIENT_KEEP_ALIVE_EVENTS
	bool "Enable keep alive events"
	help
	  Enable keep alive events.

config PELION_CLIENT_INIT_LOG_KEEP_ALIVE_EVENTS
	bool "Log power manager keep alive events"
	depends on LOG
	depends on PELION_CLIENT_KEEP_ALIVE_EVENTS
	default y
	help
	  Log the keep alive events.
```

## applications/pelion_client/src/events/Kconfig.power_manager_event
```kconfig
#
# Copyright (c) 2021 Nordic Semiconductor
#
# SPDX-License-Identifier: LicenseRef-Nordic-5-Clause
#

config PELION_CLIENT_POWER_MANAGER_EVENTS
	bool "Power manager event"
	help
	  Enable power manager event.

config PELION_CLIENT_INIT_LOG_POWER_MANAGER_EVENTS
	bool "Log power manager event"
	depends on LOG
	depends on PELION_CLIENT_POWER_MANAGER_EVENTS
	default y
	help
	  Log the power manager event.
```

## applications/pelion_client/src/modules/Kconfig
```kconfig
#
# Copyright (c) 2021 Nordic Semiconductor ASA
#
# SPDX-License-Identifier: LicenseRef-Nordic-5-Clause
#

rsource "Kconfig.dfu"
rsource "Kconfig.led_state"
rsource "Kconfig.net"
rsource "Kconfig.oma_objects"
rsource "Kconfig.pelion"
```

## applications/pelion_client/src/modules/Kconfig.dfu
```kconfig
#
# Copyright (c) 2021 Nordic Semiconductor ASA
#
# SPDX-License-Identifier: LicenseRef-Nordic-5-Clause
#

menu "FW update"

module = PELION_CLIENT_DFU
module-str = DFU module
source "subsys/logging/Kconfig.template.log_config"

endmenu
```

## applications/pelion_client/src/modules/Kconfig.factory_reset_request
```kconfig
#
# Copyright (c) 2021 Nordic Semiconductor ASA
#
# SPDX-License-Identifier: LicenseRef-Nordic-5-Clause
#

menu "Factory reset request"

config PELION_CLIENT_FACTORY_RESET_REQUEST_ENABLE
	bool "Enable factory reset request module"
	select PELION_CLIENT_FACTORY_RESET_EVENTS
	help
	  Enable module that generates initialization event with
	  factory reset request.

config PELION_CLIENT_FACTORY_RESET_REQUEST_DELAY
	int "Time in miliseconds to wait for button event at initialization"
	default 50
	help
	  The time to wait for button event when the module is initialized.
	  The time should be long enough for the button module to react
	  for the button that is pressed during initialization.

endmenu
```
