## applications/nrf_desktop/src/modules/Kconfig.dvfs
```kconfig
#
# Copyright (c) 2024 Nordic Semiconductor ASA
#
# SPDX-License-Identifier: LicenseRef-Nordic-5-Clause
#

menuconfig DESKTOP_DVFS
	bool "DVFS module [EXPERIMENTAL]"
	depends on SOC_NRF54H20_CPUAPP || SOC_NRF54H20_ENGB_CPUAPP
	select EXPERIMENTAL
	select NRFS_DVFS_SERVICE_ENABLED
	select CLOCK_CONTROL
	select CLOCK_CONTROL_NRF2
	default y
	help
	  This option enable DVFS module which switches frequency and voltage according
	  to application needs.

if DESKTOP_DVFS

config DESKTOP_DVFS_FREQ_HIGH
	int
	default 320000000

config DESKTOP_DVFS_FREQ_MED
	int
	default 128000000

config DESKTOP_DVFS_FREQ_LOW
	int
	default 64000000

config DESKTOP_DVFS_RETRY_BUSY_TIMEOUT_MS
	int "Retry timeout"
	default 1
	range 1 10000
	help
	  Timeout in milliseconds specifying time after which DVFS module will retry
	  DVFS frequency change. This timeout is applied in case another DVFS change
	  request is still in progress which causes the current request to fail.

config DESKTOP_DVFS_RETRY_INIT_TIMEOUT_MS
	int "Retry timeout"
	default 500
	range 1 10000
	help
	  Timeout in milliseconds specifying time after which DVFS module will retry
	  DVFS frequency change. This timeout is applied in case DVFS is not yet initialized
	  which causes the current request to fail.

config DESKTOP_DVFS_RETRY_COUNT
	int "Number of retries"
	default 5
	range 1 255
	help
	  Number of retries of DVFS frequency change after which DVFS module will report
	  MODULE_STATE_ERROR.

module = DESKTOP_DVFS
module-str = DVFS
source "subsys/logging/Kconfig.template.log_config"

dvfs_state = INITIALIZING
dfvs_frequency = FREQ_HIGH
dvfs_timeout = 0
rsource "Kconfig.dvfs_state_template"

if CAF_BLE_COMMON_EVENTS && (BT_MAX_CONN = 1)
dvfs_state = LLPM_CONNECTED
dfvs_frequency = FREQ_MEDLOW
dvfs_timeout = 0
rsource "Kconfig.dvfs_state_template"
endif # CAF_BLE_COMMON_EVENTS && (BT_MAX_CONN = 1)

if DESKTOP_USB_ENABLE
dvfs_state = USB_CONNECTED
dfvs_frequency = FREQ_HIGH
dvfs_timeout = 0
rsource "Kconfig.dvfs_state_template"
endif # DESKTOP_USB_ENABLE

if DESKTOP_CONFIG_CHANNEL_ENABLE
dvfs_state = CONFIG_CHANNEL
dfvs_frequency = FREQ_HIGH
dvfs_timeout = 5000
rsource "Kconfig.dvfs_state_template"
endif # DESKTOP_CONFIG_CHANNEL_ENABLE

if CAF_BLE_SMP_TRANSFER_EVENTS
dvfs_state = SMP_TRANSFER
dfvs_frequency = FREQ_HIGH
dvfs_timeout = 5000
rsource "Kconfig.dvfs_state_template"
endif # CAF_BLE_SMP_TRANSFER_EVENTS

endif # DESKTOP_DVFS
```

## applications/nrf_desktop/src/modules/Kconfig.dvfs_state_template
```kconfig
#
# Copyright (c) 2024 Nordic Semiconductor ASA
#
# SPDX-License-Identifier: LicenseRef-Nordic-5-Clause
#

menuconfig DESKTOP_DVFS_STATE_$(dvfs_state)_ENABLE
	bool "Handle the DVFS $(dvfs_state) state"
	default y

if DESKTOP_DVFS_STATE_$(dvfs_state)_ENABLE

config DESKTOP_DVFS_STATE_$(dvfs_state)_TIMEOUT_MS
	int "Timeout in milliseconds for the DVFS $(dvfs_state) state" if $(dvfs_timeout) != 0
	default $(dvfs_timeout)
	range 0 65535
	help
	  Timeout in milliseconds specifying time after which DVFS request related to
	  the DVFS $(dvfs_state) state times out.
	  A request is automatically cleared on timeout.

choice "DESKTOP_DVFS_STATE_$(dvfs_state)_ACTIVE_FREQ"
	prompt "Active frequency of the DVFS $(dvfs_state) state"
	default DESKTOP_DVFS_STATE_$(dvfs_state)_ACTIVE_$(dfvs_frequency)

config DESKTOP_DVFS_STATE_$(dvfs_state)_ACTIVE_FREQ_HIGH
	bool "High frequency"

config DESKTOP_DVFS_STATE_$(dvfs_state)_ACTIVE_FREQ_MEDLOW
	bool "Medium low frequency"

endchoice

endif # DESKTOP_DVFS_STATE_$(dvfs_state)_ENABLE
```

## applications/nrf_desktop/src/modules/Kconfig.factory_reset
```kconfig
#
# Copyright (c) 2023 Nordic Semiconductor ASA
#
# SPDX-License-Identifier: LicenseRef-Nordic-5-Clause
#

config DESKTOP_FACTORY_RESET
	bool "Factory reset module"
	default y
	depends on DESKTOP_CONFIG_CHANNEL_ENABLE
	depends on BT_FAST_PAIR
	depends on CAF_BLE_BOND_SUPPORTED
	select BT_FAST_PAIR_STORAGE_USER_RESET_ACTION
	select REBOOT
	help
	  The module allows to trigger factory reset using configuration channel
	  set operation. The factory reset clears the stored Fast Pair data,
	  removes Bluetooth bonds and resets all of the Bluetooth local
	  identities (apart from the default one that cannot be reset). The
	  factory reset is performed using nRF Connect SDK Fast Pair API.

if DESKTOP_FACTORY_RESET

module = DESKTOP_FACTORY_RESET
module-str = nRF Desktop factory reset
source "subsys/logging/Kconfig.template.log_config"

endif # DESKTOP_FACTORY_RESET
```

## applications/nrf_desktop/src/modules/Kconfig.failsafe
```kconfig
#
# Copyright (c) 2020 Nordic Semiconductor
#
# SPDX-License-Identifier: LicenseRef-Nordic-5-Clause
#

menu "Failsafe erase"

config DESKTOP_FAILSAFE_ENABLE
	bool "Enable failsafe"
	depends on WATCHDOG
	depends on !RESET_ON_FATAL_ERROR
	help
	  When a device is rebooted by watchdog or due to the CPU lockup,
	  the settings partition will be erased.
	  This is to prevent the broken settings from permanently rendering
	  the device unusable.

if DESKTOP_FAILSAFE_ENABLE

module = DESKTOP_FAILSAFE
module-str = failsafe
source "subsys/logging/Kconfig.template.log_config"

endif

endmenu
```

## applications/nrf_desktop/src/modules/Kconfig.fast_pair
```kconfig
#
# Copyright (c) 2022 Nordic Semiconductor ASA
#
# SPDX-License-Identifier: LicenseRef-Nordic-5-Clause
#

menuconfig DESKTOP_FAST_PAIR
	bool "Fast Pair module"
	depends on BT_ADV_PROV_FAST_PAIR
	depends on CAF_BLE_COMMON_EVENTS
	select DESKTOP_BLE_DONGLE_PEER_ID_INFO if DESKTOP_BLE_DONGLE_PEER_ENABLE
	default y if (CAF_BLE_STATE_MAX_LOCAL_ID_BONDS > 1)
	help
	  Enable a small application module that control Fast Pair show/hide UI
	  indication during Fast Pair not discoverable advertising.

if DESKTOP_FAST_PAIR

config DESKTOP_FAST_PAIR_LIMIT_NORMAL_PAIRING
	bool "Allow normal Bluetooth pairing only in pairing mode"
	default y
	help
	  Register Bluetooth authentication callbacks and reject normal
	  Bluetooth pairing when outside of pairing mode (if the used Bluetooth
	  local identity already has a bonded peer).

config DESKTOP_FAST_PAIR_MAX_LOCAL_ID_BONDS
	int
	default CAF_BLE_STATE_MAX_LOCAL_ID_BONDS

module = DESKTOP_FAST_PAIR
module-str = nRF Desktop Fast Pair
source "subsys/logging/Kconfig.template.log_config"

endif # DESKTOP_FAST_PAIR
```

## applications/nrf_desktop/src/modules/Kconfig.fn_keys
```kconfig
#
# Copyright (c) 2019 Nordic Semiconductor
#
# SPDX-License-Identifier: LicenseRef-Nordic-5-Clause
#

menu "Function keys"

config DESKTOP_FN_KEYS_ENABLE
	bool "Enable function keys support"
	help
	  Button remapper adds fn bit to all key ids while fn key is pressed.

if DESKTOP_FN_KEYS_ENABLE

config DESKTOP_FN_KEYS_SWITCH
	hex "Fn button"
	default 0x0
	help
	  Define button used as a function key.

config DESKTOP_FN_KEYS_LOCK
	hex "Fn lock button"
	default 0x0
	help
	  Define button used as a function key lock.

config DESKTOP_STORE_FN_LOCK
	bool "Store Fn lock state"
	default y
	depends on SETTINGS
	help
	  Define if device should store Fn lock state after reboot.

config DESKTOP_FN_KEYS_MAX_ACTIVE
	int "Max Fn key pressed"
	default 8
	help
	  Maximum number of function keys pressed at the same time.

module = DESKTOP_FN_KEYS
module-str = Fn keys
source "subsys/logging/Kconfig.template.log_config"

endif

endmenu
```

## applications/nrf_desktop/src/modules/Kconfig.hid
```kconfig
#
# Copyright (c) 2020 Nordic Semiconductor
#
# SPDX-License-Identifier: LicenseRef-Nordic-5-Clause
#

menu "HID"

config DESKTOP_HID_REPORT_DESC
	string "HID report descriptor"
	default ""
	help
	  This option specifies a path to the HID report descriptor file.

config DESKTOP_HID_MOUSE
	bool "Device is a HID mouse"
	select DESKTOP_HID_REPORT_MOUSE_SUPPORT
	help
	  Enable reports needed by a mouse.

config DESKTOP_HID_KEYBOARD
	bool "Device is a HID keyboard"
	select DESKTOP_HID_REPORT_KEYBOARD_SUPPORT
	select DESKTOP_HID_REPORT_SYSTEM_CTRL_SUPPORT
	select DESKTOP_HID_REPORT_CONSUMER_CTRL_SUPPORT
	help
	  Enable reports needed by a keyboard.

config DESKTOP_HID_DONGLE
	bool "Device is a HID dongle"
	select DESKTOP_HID_REPORT_MOUSE_SUPPORT
	select DESKTOP_HID_REPORT_KEYBOARD_SUPPORT
	select DESKTOP_HID_REPORT_SYSTEM_CTRL_SUPPORT
	select DESKTOP_HID_REPORT_CONSUMER_CTRL_SUPPORT
	help
	  Enable reports needed by a dongle.

menu "HID Reports"

config DESKTOP_HID_REPORT_MOUSE_SUPPORT
	bool "Mouse report support"
	help
	  This option controls if the device supports HID mouse report.
	  Report is added to the report map. It does not need to be generated
	  by the device.

config DESKTOP_HID_REPORT_KEYBOARD_SUPPORT
	bool "Keyboard report support"
	help
	  This option controls if the device supports HID keyboard reports.
	  Report is added to the report map. It does not need to be generated
	  by the device.

config DESKTOP_HID_REPORT_SYSTEM_CTRL_SUPPORT
	bool "System control report support"
	help
	  This option controls if the device supports HID system control report.
	  Report is added to the report map. It does not need to be generated
	  by the device.

config DESKTOP_HID_REPORT_CONSUMER_CTRL_SUPPORT
	bool "Consumer control report support"
	help
	  This option controls if the device supports HID consumer control
	  report.
	  Report is added to the report map. It does not need to be generated
	  by the device.

endmenu


choice
	prompt "Select boot protocol interface"
	default DESKTOP_HID_BOOT_INTERFACE_DISABLED

config DESKTOP_HID_BOOT_INTERFACE_DISABLED
	bool "Boot interface disabled"
	help
	  Device will not provide any boot interface.

config DESKTOP_HID_BOOT_INTERFACE_MOUSE
	bool "Boot interface mouse"
	depends on DESKTOP_HID_REPORT_MOUSE_SUPPORT
	help
	  Device will use the mouse boot report.

config DESKTOP_HID_BOOT_INTERFACE_KEYBOARD
	bool "Boot interface keyboard"
	depends on DESKTOP_HID_REPORT_KEYBOARD_SUPPORT
	help
	  Device will use the keyboard boot report.

endchoice


endmenu
```

## applications/nrf_desktop/src/modules/Kconfig.hid_forward
```kconfig
#
# Copyright (c) 2020 Nordic Semiconductor
#
# SPDX-License-Identifier: LicenseRef-Nordic-5-Clause
#

menu "BLE HID Client"

config DESKTOP_HID_FORWARD_ENABLE
	bool "Enable HID forward"
	select BT_HOGP
	select DESKTOP_HID_REPORTQ
	depends on DESKTOP_ROLE_HID_DONGLE
	depends on DESKTOP_BT_CENTRAL
	help
	  This option enables HID over GATT Client.
	  The reports received from the BLE are forwarded to the USB.

if DESKTOP_HID_FORWARD_ENABLE

config DESKTOP_HID_FORWARD_SUBSCRIBER_COUNT
	int "Number of HID subscribers"
	range 1 255
	default DESKTOP_HID_DONGLE_BOND_COUNT
	help
	  By default, the module uses a dedicated HID subscriber (USB HID class
	  instance) for every BLE bonded HID peripheral. Set this option to 1 to
	  forward all of the HID reports received from HID peripherals to one
	  subscriber (required if using a single USB HID instance).

	  The configured number of HID subscribers must match number of USB HID
	  class instances.

config BT_HOGP_REPORTS_MAX
	default 12
	help
	  By default, nRF Desktop dongle supports up to 12 HID reports to allow
	  for connecting two peripherals with up to 6 HID reports each on
	  average.

module = DESKTOP_HID_FORWARD
module-str = HID over GATT client
source "subsys/logging/Kconfig.template.log_config"

endif

endmenu
```

## applications/nrf_desktop/src/modules/Kconfig.hid_provider_consumer_ctrl
```kconfig
#
# Copyright (c) 2025 Nordic Semiconductor ASA
#
# SPDX-License-Identifier: LicenseRef-Nordic-5-Clause
#

config DESKTOP_HID_REPORT_PROVIDER_CONSUMER_CTRL
	bool
	default y if !DESKTOP_HID_REPORT_PROVIDER_CONSUMER_CTRL_ALT
	depends on DESKTOP_HID_REPORT_CONSUMER_CTRL_SUPPORT
	select DESKTOP_HID_KEYMAP
	select DESKTOP_HID_EVENTQ
	select DESKTOP_KEYS_STATE
	help
	  This option automatically enables the default HID consumer control
	  report provider for HID peripheral that supports HID consumer control
	  report.

config DESKTOP_HID_REPORT_PROVIDER_CONSUMER_CTRL_ALT
	bool "Use custom HID consumer control report provider"
	depends on DESKTOP_HID_REPORT_CONSUMER_CTRL_SUPPORT
	help
	  Enable this option if you want to support HID consumer control report
	  and use a custom HID consumer control report provider. Make sure to
	  introduce the custom HID consumer control report provider if you
	  enable this option.

if DESKTOP_HID_REPORT_PROVIDER_CONSUMER_CTRL

config DESKTOP_HID_REPORT_PROVIDER_CONSUMER_CTRL_KEYPRESS_EXPIRATION
	int "HID keypress expiration [ms]"
	default DESKTOP_HID_REPORT_EXPIRATION
	default 500
	help
	  If a keypress is recorded before HID subscriber connects, it is stored
	  in HID event queue and processed after the subscriber connects. This
	  Kconfig option specifies time after which a queued keypress will be
	  considered expired. The higher the value, the longer the period from
	  which the module will recall pressed keys when the connection with HID
	  host is established.

	  The first default is deprecated and used for backwards compatibility.

config DESKTOP_HID_REPORT_PROVIDER_CONSUMER_CTRL_EVENT_QUEUE_SIZE
	int "HID keypress queue size"
	default DESKTOP_HID_EVENT_QUEUE_SIZE
	default 12
	range 2 255
	help
	  The option limits the number of keypresses (button press or release)
	  on the HID event queue where the keypresses are stored before the
	  connection with HID host is established. If there is no space in the
	  queue to enqueue a new key state change, the oldest element is
	  released.

	  The first default is deprecated and used for backwards compatibility.

module = DESKTOP_HID_REPORT_PROVIDER_CONSUMER_CTRL
module-str = HID provider consumer control
source "subsys/logging/Kconfig.template.log_config"

endif # DESKTOP_HID_REPORT_PROVIDER_CONSUMER_CTRL
```

## applications/nrf_desktop/src/modules/Kconfig.hid_provider_mouse
```kconfig
#
# Copyright (c) 2025 Nordic Semiconductor ASA
#
# SPDX-License-Identifier: LicenseRef-Nordic-5-Clause
#

config DESKTOP_HID_REPORT_PROVIDER_MOUSE
	bool
	default y if !DESKTOP_HID_REPORT_PROVIDER_MOUSE_ALT
	depends on DESKTOP_HID_REPORT_MOUSE_SUPPORT
	select DESKTOP_HID_KEYMAP
	help
	  This option automatically enables the default HID mouse report
	  provider for HID peripheral that supports HID mouse report.

config DESKTOP_HID_REPORT_PROVIDER_MOUSE_ALT
	bool "Use custom HID mouse report provider"
	depends on DESKTOP_HID_REPORT_MOUSE_SUPPORT
	help
	  Enable this option if you want to support HID mouse report and use a
	  custom HID mouse report provider. Make sure to introduce the custom
	  HID mouse report provider if you enable this option.

if DESKTOP_HID_REPORT_PROVIDER_MOUSE

module = DESKTOP_HID_REPORT_PROVIDER_MOUSE
module-str = HID provider mouse
source "subsys/logging/Kconfig.template.log_config"

endif # DESKTOP_HID_REPORT_PROVIDER_MOUSE
```
