## applications/nrf_desktop/src/modules/Kconfig.hid_state
```kconfig
#
# Copyright (c) 2018 Nordic Semiconductor
#
# SPDX-License-Identifier: LicenseRef-Nordic-5-Clause
#

menu "HID State"

config DESKTOP_HID_STATE_ENABLE
	bool "Enable HID state"
	depends on DESKTOP_ROLE_HID_PERIPHERAL
	help
	  The module generates HID reports based on user input.

if DESKTOP_HID_STATE_ENABLE

config DESKTOP_HID_STATE_HID_KEYMAP_DEF_PATH
	string "File defining HID keymap"
	default "hid_keymap_def.h"
	help
	  Location of configuration file that holds information about mapping
	  between buttons and generated reports.

config DESKTOP_HID_STATE_HID_KEYBOARD_LEDS_DEF_PATH
	string "File defining HID keyboard LEDs"
	default "hid_keyboard_leds_def.h"
	help
	  Location of configuration file that holds information about LEDs
	  associated with HID keyboard LEDs report.

config DESKTOP_HID_STATE_PM_ENABLE
	bool "Enable HID power manager integration"
	depends on CAF_POWER_MANAGER
	select CAF_KEEP_ALIVE_EVENTS
	default y
	help
	  This enables small module that blocks power down if HID is active.

config DESKTOP_HID_REPORT_EXPIRATION
	int "HID report expiration [ms]"
	default 500
	help
	  Define the time after which a HID report expires
	  and is not sent again.

config DESKTOP_HID_EVENT_QUEUE_SIZE
	int "HID event queue size"
	default 12
	range 2 255
	help
	  Size of the HID event queue.

module = DESKTOP_HID_STATE
module-str = HID state
source "subsys/logging/Kconfig.template.log_config"

endif

endmenu
```

## applications/nrf_desktop/src/modules/Kconfig.hids
```kconfig
#
# Copyright (c) 2018 Nordic Semiconductor
#
# SPDX-License-Identifier: LicenseRef-Nordic-5-Clause
#

menu "BLE HID Service"

config DESKTOP_HIDS_ENABLE
	bool "Enable GATT HID Service"
	depends on DESKTOP_BT_PERIPHERAL
	select BT_HIDS
	select BT_CONN_CTX
	help
	  This option enables HID over GATT Service application module.

if DESKTOP_HIDS_ENABLE

config DESKTOP_HIDS_FIRST_REPORT_DELAY
	int "First HID report delay [ms]"
	default 500 if DESKTOP_PERIPHERAL_TYPE_KEYBOARD
	default 0
	range 0 2000
	help
	  If set to non-zero, the peripheral will delay sending first HID
	  report after the connection security was established. This is done to
	  ensure that central will be ready to receive the data. nRF Desktop
	  centrals reenable the subscriptions on every reconnection. HID report
	  is dropped if received before the subscription was reenabled.

	  By default, nRF Desktop keyboard uses a delay of 500 ms to prevent
	  dropping HID reports right after reconnection.

choice BT_HIDS_DEFAULT_PERM
	default BT_HIDS_DEFAULT_PERM_RW_ENCRYPT
	help
	  nRF Desktop Bluetooth peripherals require encryption to access HID
	  attributes. This is consistent with HID over GATT profile
	  specification.
endchoice

config BT_HIDS_ATTR_MAX
	default 19 if (DESKTOP_PERIPHERAL_TYPE_MOUSE && \
		       !DESKTOP_CONFIG_CHANNEL_OUT_REPORT)
	default 22 if (DESKTOP_PERIPHERAL_TYPE_MOUSE && \
		      DESKTOP_CONFIG_CHANNEL_OUT_REPORT)
	default 32 if (DESKTOP_PERIPHERAL_TYPE_KEYBOARD && \
		       !DESKTOP_CONFIG_CHANNEL_OUT_REPORT)
	default 35 if (DESKTOP_PERIPHERAL_TYPE_KEYBOARD && \
		       DESKTOP_CONFIG_CHANNEL_OUT_REPORT)
	help
	  The maximum number of GATT attribute descriptors for HIDS is set
	  assuming that nRF Desktop peripheral supports all of the HID input
	  and output reports defined in default configuration for the selected
	  peripheral type, boot protocol and HID feature report used by the
	  configuration channel.

	  Make sure to update the value if you enable additional HID reports.

config BT_HIDS_INPUT_REP_MAX
	default 1 if DESKTOP_PERIPHERAL_TYPE_MOUSE
	default 3 if DESKTOP_PERIPHERAL_TYPE_KEYBOARD
	help
	  nRF Desktop mouse by default uses only HID mouse input report.
	  nRF Desktop keyboard by default uses HID keyboard, system control and
	  consumer control input reports.

	  Make sure to update the value if you enable an additional HID input
	  report.

config BT_HIDS_OUTPUT_REP_MAX
	default 2 if (DESKTOP_CONFIG_CHANNEL_OUT_REPORT && \
		      DESKTOP_HID_REPORT_KEYBOARD_SUPPORT)
	default 1 if (DESKTOP_CONFIG_CHANNEL_OUT_REPORT || \
		      DESKTOP_HID_REPORT_KEYBOARD_SUPPORT)
	default 0
	help
	  nRF Desktop Bluetooth peripheral by default uses HID output reports
	  for configuration channel and keyboard LEDs.

config BT_HIDS_FEATURE_REP_MAX
	default 1 if DESKTOP_CONFIG_CHANNEL_ENABLE
	default 0
	help
	  nRF Desktop Bluetooth peripheral by default uses HID feature report
	  only for the configuration channel.

module = DESKTOP_HIDS
module-str = HID over GATT service
source "subsys/logging/Kconfig.template.log_config"

endif

endmenu
```

## applications/nrf_desktop/src/modules/Kconfig.hotfixes
```kconfig
#
# Copyright (c) 2019 Nordic Semiconductor
#
# SPDX-License-Identifier: LicenseRef-Nordic-5-Clause
#

menu "Hotfix set"

config DESKTOP_HFCLK_LOCK_ENABLE
	bool "Keep HF clock enabled [DEPRECATED]"
	depends on CAF_BLE_USE_LLPM
	depends on !SOC_SERIES_NRF54H
	select DEPRECATED
	help
	  The HF clock needs to be enabled during data transmission over BLE.
	  Enabling the HF clock right before the data transmission adds an extra
	  latency of around 1.4 ms (0.85 ms in case of nRF54L Series SoCs) for
	  the first packet (in a row) that is transmitted. The extra latency is
	  caused by the HF clock startup latency. Keeping the HF clock enabled
	  all the time removes the extra latency caused by the clock startup at
	  the cost of increased power consumption.

	  The HF clock lock hotfix is not supported for nRF54H Series SoCs. For
	  these SoCs, a part of the Bluetooth stack runs on the radio core.
	  Keeping the HF clock enabled by the application running on application
	  core does not mitigate the extra HID report latency caused by the HF
	  clock startup, because the application cannot notify a part of the
	  Bluetooth stack running on the radio core that HF clock is already
	  enabled. The clock startup latency unconditionally affects the first
	  transmitted packet.

	  The hotfix is deprecated and will be removed in the future. Use the
	  CONFIG_DESKTOP_BLE_LOW_LATENCY_LOCK instead. Setting the peripheral
	  latency LLPM connection parameter to `0` on a peripheral leads to
	  keeping the HF clock enabled. That mitigates the extra HID report
	  latency caused by the HF clock startup delay.

config DESKTOP_CONSTLAT_ENABLE
	bool "Constant latency interrupts"
	depends on !SOC_SERIES_NRF54L
	depends on !SOC_SERIES_NRF54H
	select NRFX_POWER
	help
	  When enabled, the SoC uses configuration for constant latency
	  interrupts. This reduces interrupt propagation time but increases
	  power consumption.

	  Currently, the nRF54L Series SoCs do not support the nrfx POWER driver
	  (CONFIG_NRFX_POWER). Because of that, the hotfix cannot be used by
	  these SoCs.

	  nRF54H Series SoCs do not enable constant latency interrupts through
	  the nrfx POWER driver. This SoC series is currently not supported
	  by the hotfix.

config DESKTOP_CONSTLAT_DISABLE_ON_STANDBY
	bool "Disable constant latency interrupts on standby"
	depends on CAF_PM_EVENTS
	depends on DESKTOP_CONSTLAT_ENABLE
	help
	  When enabled constant latency interrupts will be disabled when
	  the devices switches to standby.

endmenu
```

## applications/nrf_desktop/src/modules/Kconfig.led_state
```kconfig
#
# Copyright (c) 2018 Nordic Semiconductor
#
# SPDX-License-Identifier: LicenseRef-Nordic-5-Clause
#

if CAF_LED_EVENTS

menu "LED state"

config DESKTOP_LED_STATE_DEF_PATH
	string "File defining used LED effects"
	default "led_state_def.h"
	help
	  Location of configuration file that holds information about the used
	  LED effects.

module = DESKTOP_LED_STATE
module-str = LED state
source "subsys/logging/Kconfig.template.log_config"

endmenu

endif
```

## applications/nrf_desktop/src/modules/Kconfig.led_stream
```kconfig
#
# Copyright (c) 2019 Nordic Semiconductor
#
# SPDX-License-Identifier: LicenseRef-Nordic-5-Clause
#

menu "LED stream"

config DESKTOP_LED_STREAM_ENABLE
	bool "Enable LED stream"
	depends on CAF_LED_EVENTS && DESKTOP_CONFIG_CHANNEL_ENABLE
	help
	  Enable RGB LED effect streaming.

config DESKTOP_LED_STREAM_QUEUE_SIZE
	int "Stream led event queue size"
	depends on DESKTOP_LED_STREAM_ENABLE
	default 15
	range 2 254
	help
	  Size of the LED stream event queue.

if DESKTOP_LED_STREAM_ENABLE

module = DESKTOP_LED_STREAM
module-str = LED stream
source "subsys/logging/Kconfig.template.log_config"

endif

endmenu
```

## applications/nrf_desktop/src/modules/Kconfig.nrf_profiler_sync
```kconfig
#
# Copyright (c) 2020 Nordic Semiconductor
#
# SPDX-License-Identifier: LicenseRef-Nordic-5-Clause
#

menu "nRF Profiler sync"

config DESKTOP_NRF_PROFILER_SYNC_GPIO_ENABLE
	bool "Enable nrf_profiler sync based on GPIO"
	depends on GPIO
	depends on APP_EVENT_MANAGER_PROFILER_TRACER
	help
	  This option can be used to synchronize timestamps for nrf_profiler events
	  on two devices.

	  When this option is enabled nRF Desktop devices generate nrf_profiler
	  event (sync_event) that is used for synchronization. Central generates
	  square wave using GPIO, peripheral reacts on the edges. Make sure that
	  selected pins of the central and the peripheral are connected
	  together.

if DESKTOP_NRF_PROFILER_SYNC_GPIO_ENABLE

choice
	prompt "Select device role"
	default DESKTOP_NRF_PROFILER_SYNC_PERIPHERAL

config DESKTOP_NRF_PROFILER_SYNC_CENTRAL
	bool "Central"
	help
	  This is the default option, the device is central.

config DESKTOP_NRF_PROFILER_SYNC_PERIPHERAL
	bool "Peripheral"
	help
	  If selected, the device is peripheral.

endchoice

config DESKTOP_NRF_PROFILER_SYNC_GPIO_PORT
	int "Sync GPIO port"
	range 0 1
	default 0
	help
	  This option defines which GPIO port is to be used to generate/receive
	  synchronization signal. The signal is used to synchronize timestamps
	  between two different devices.

config DESKTOP_NRF_PROFILER_SYNC_GPIO_PIN
	int "Sync GPIO pin"
	range 0 31
	default 0
	help
	  This option defines which GPIO pin is to be used to generate/receive
	  synchronization signal. The signal is used to synchronize timestamps
	  between two different devices.

module = DESKTOP_NRF_PROFILER_SYNC
module-str = nrf_profiler_sync
source "subsys/logging/Kconfig.template.log_config"

endif

endmenu
```

## applications/nrf_desktop/src/modules/Kconfig.power_manager
```kconfig
#
# Copyright (c) 2018 Nordic Semiconductor
#
# SPDX-License-Identifier: LicenseRef-BSD-5-Clause-Nordic
#

menu "Power manager"

config DESKTOP_POWER_MANAGER_ENABLE
	bool "Enable power management"
	depends on HAS_SYS_POWER_STATE_DEEP_SLEEP_1
	select DEVICE_POWER_MANAGEMENT
	select SYS_POWER_DEEP_SLEEP_STATES
	help
	  Enable power management, which will put the device to low-power mode
	  if it is idle.

if DESKTOP_POWER_MANAGER_ENABLE

config DESKTOP_POWER_MANAGER_CONSTLAT
	bool "Constant latency interrupts"
	help
	  When enabled SoC will use configuration for constant latency
	  interrupts. This reduces interrupt propagation time but increases
	  power consumption.

config DESKTOP_POWER_MANAGER_STAY_ON
	bool "Stay on while no connections"
	help
	  If disabled the device will switch SoC to OFF mode after power
	  manager timeout is done. If enabled the device will stay on
	  but remain idle. If the device is connected it will always stay on
	  and maintain the connection, regardless of the setting.

config DESKTOP_POWER_MANAGER_TIMEOUT
	int "Power down timeout [s]"
	default 120
	help
	  Time in seconds after which the device will enter low-power mode.

config DESKTOP_POWER_MANAGER_ERROR_TIMEOUT
	int "Power manager timeout on error [s]"
	default 30
	help
	 Time in seconds after which the device will be turned off after an error.

module = DESKTOP_POWER_MANAGER
module-str = power manager
source "subsys/logging/Kconfig.template.log_config"

endif

endmenu
```

## applications/nrf_desktop/src/modules/Kconfig.profiler_sync
```kconfig
#
# Copyright (c) 2020 Nordic Semiconductor
#
# SPDX-License-Identifier: LicenseRef-Nordic-5-Clause
#

menu "Profiler sync"

config DESKTOP_PROFILER_SYNC_GPIO_ENABLE
	bool "Enable profiler sync based on GPIO"
	depends on GPIO
	depends on EVENT_MANAGER_PROFILER
	help
	  This option can be used to synchronize timestamps for profiler events
	  on two devices.

	  When this option is enabled nRF Desktop devices generate profiler
	  event (sync_event) that is used for synchronization. Central generates
	  square wave using GPIO, peripheral reacts on the edges. Make sure that
	  selected pins of the central and the peripheral are connected
	  together.

if DESKTOP_PROFILER_SYNC_GPIO_ENABLE

choice
	prompt "Select device role"
	default DESKTOP_PROFILER_SYNC_PERIPHERAL

config DESKTOP_PROFILER_SYNC_CENTRAL
	bool "Central"
	help
	  This is the default option, the device is central.

config DESKTOP_PROFILER_SYNC_PERIPHERAL
	bool "Peripheral"
	help
	  If selected, the device is peripheral.

endchoice

config DESKTOP_PROFILER_SYNC_GPIO_PORT
	int "Sync GPIO port"
	range 0 1
	default 0
	help
	  This option defines which gpio port is to be used to generate/receive
	  synchronization signal. The signal is used to synchronize timestamps
	  between two different devices.

config DESKTOP_PROFILER_SYNC_GPIO_PIN
	int "Sync GPIO pin"
	range 0 31
	default 0
	help
	  This option defines which gpio pin is to be used to generate/receive
	  synchronization signal. The signal is used to synchronize timestamps
	  between two different devices.

module = DESKTOP_PROFILER_SYNC
module-str = profiler_sync
source "subsys/logging/Kconfig.template.log_config"

endif

endmenu
```

## applications/nrf_desktop/src/modules/Kconfig.qos
```kconfig
#
# Copyright (c) 2020 Nordic Semiconductor
#
# SPDX-License-Identifier: LicenseRef-Nordic-5-Clause
#

menu "BLE QOS Service"

config DESKTOP_QOS_ENABLE
	bool "QoS service"
	depends on DESKTOP_BLE_QOS_ENABLE
	depends on DESKTOP_BT_PERIPHERAL
	help
	  This option enables QoS service.

if DESKTOP_QOS_ENABLE

module = DESKTOP_QOS
module-str = QoS service
source "subsys/logging/Kconfig.template.log_config"

endif

endmenu
```

## applications/nrf_desktop/src/modules/Kconfig.settings_load
```kconfig
#
# Copyright (c) 2020 Nordic Semiconductor
#
# SPDX-License-Identifier: LicenseRef-BSD-5-Clause-Nordic
#

menu "Settings loading service"

config DESKTOP_SETTINGS_LOAD_BY_THREAD_ENABLE
	bool "Enable loading of setting by separate thead"
	depends on SETTINGS
	help
	  The option enables loading of settings by separate
	  thread in background instead of use of system
	  work queue for that purpose.

config DESKTOP_SETTINGS_LOAD_THREAD_STACK_SIZE
	int "Settings module thread stack size"
	depends on DESKTOP_SETTINGS_LOAD_BY_THREAD_ENABLE
	range 0 4096
	default 1024
	help
	  Stack size for thread responsible for loading
	  settings from flash memory.

if !DESKTOP_SETTINGS_LOAD_BY_THREAD_ENABLE
config DESKTOP_SETTINGS_LOAD_THREAD_STACK_SIZE
	int
	default 0
endif

if SETTINGS

module = DESKTOP_SETTINGS_LOAD
module-str = Settings load
source "subsys/logging/Kconfig.template.log_config"

endif

endmenu
```
