/*
 * Copyright (c) 2026 Nordic Semiconductor ASA
 *
 * SPDX-License-Identifier: LicenseRef-Nordic-5-Clause
 */

#include "memory_map.dtsi"
#include "app_common.dtsi"

/* Enable LED 2 for keyboard lock indicators. */
/ {
	pwmleds2 {
		status = "okay";
	};
};

&pwm_led2 {
	label = "Num Lock LED";
};
