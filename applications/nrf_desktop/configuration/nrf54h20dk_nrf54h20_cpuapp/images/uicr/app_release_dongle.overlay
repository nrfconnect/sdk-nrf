/*
 * Copyright (c) 2025 Nordic Semiconductor ASA
 *
 * SPDX-License-Identifier: LicenseRef-Nordic-5-Clause
 */

/* Aligning the DTS configuration between the UICR image and the application (default) image.
 * The UICR image must use the same DTS configuration as the default image.
 */
#include "../../app_release_dongle.overlay"
