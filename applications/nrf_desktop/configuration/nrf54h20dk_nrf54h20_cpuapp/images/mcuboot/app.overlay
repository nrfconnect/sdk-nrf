/*
 * Copyright (c) 2025 Nordic Semiconductor ASA
 *
 * SPDX-License-Identifier: LicenseRef-Nordic-5-Clause
 */

#include "../../memory_map.dtsi"

/* The nRF54H20 DK defines memory map using DTS.
 * Assign the bootloader partition to the MCUboot image.
 */
/ {
	chosen {
		zephyr,code-partition = &cpuapp_boot_partition;
	};
};

/* Remove the undefined property value from the disabled VPR cores to prevent build errors. */
&cpuflpr_vpr {
	/delete-property/ source-memory;
};

&cpuppr_vpr {
	/delete-property/ source-memory;
};
