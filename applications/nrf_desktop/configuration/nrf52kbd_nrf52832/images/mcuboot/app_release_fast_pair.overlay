/*
 * Copyright (c) 2026 Nordic Semiconductor ASA
 *
 * SPDX-License-Identifier: LicenseRef-Nordic-5-Clause
 */

#include "../../memory_map_release_fast_pair.dtsi"

/* The nRF52 Keyboard defines memory map using DTS.
 * Assign the bootloader partition to MCUboot image.
 */
/ {
	chosen {
		zephyr,code-partition = &boot_partition;
	};
};
