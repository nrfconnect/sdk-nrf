/*
 * Copyright (c) 2026 Nordic Semiconductor ASA
 *
 * SPDX-License-Identifier: LicenseRef-Nordic-5-Clause
 */

#include "app_common.dtsi"
#include "memory_map_release.dtsi"

/* For nRF54L, watchdog status is disabled by default. Needs to be enabled in DTS overlay */
&wdt30 {
	status = "okay";
};

secondary_app_partition: &slot1_partition {};
