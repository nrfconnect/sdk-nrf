/*
 * Copyright (c) 2026 Nordic Semiconductor ASA
 *
 * SPDX-License-Identifier: LicenseRef-Nordic-5-Clause
 */

#include "../../memory_map_mcuboot_qspi.dtsi"

/* The nRF52840 DK defines memory map using DTS.
 * Assign the bootloader partition to MCUboot image.
 */
/ {
	chosen {
		/* Used by the Partition Manager (when enabled through sysbuild).
		 * Unused when the DTS-based memory map is used.
		 */
		nordic,pm-ext-flash = &mx25r64;
		zephyr,code-partition = &boot_partition;
	};
};
