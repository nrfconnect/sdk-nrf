/*
 * Copyright (c) 2024 Nordic Semiconductor ASA
 *
 * SPDX-License-Identifier: LicenseRef-Nordic-5-Clause
 */

#include "app_common.dtsi"

/ {
	/* Configure DTS nodes used for USB next HID support. */
	hid_dev_0: hid_dev_0 {
		compatible = "zephyr,hid-device";
		label = "HID0";
		protocol-code = "keyboard";
		in-polling-period-us = <1000>;
		in-report-size = <64>;
	};

	hid_dev_1: hid_dev_1 {
		compatible = "zephyr,hid-device";
		label = "HID1";
		protocol-code = "keyboard";
		in-polling-period-us = <1000>;
		in-report-size = <64>;
	};
};
