/*
 * Copyright (c) 2026 Nordic Semiconductor ASA
 *
 * SPDX-License-Identifier: LicenseRef-Nordic-5-Clause
 */

#include "memory_map_fast_pair.dtsi"
#include "app_common.dtsi"

secondary_app_partition: &slot1_partition {};

/ {
	/* Configure DTS nodes used for USB next HID support. */
	hid_dev_0: hid_dev_0 {
		compatible = "zephyr,hid-device";
		label = "HID0";
		protocol-code = "mouse";
		in-polling-period-us = <1000>;
		in-report-size = <64>;
	};
};
