/*
 * Copyright (c) 2026 Nordic Semiconductor ASA
 *
 * SPDX-License-Identifier: LicenseRef-Nordic-5-Clause
 */

#include "memory_map_fast_pair.dtsi"
#include "app_common.dtsi"

secondary_app_partition: &slot1_partition {};
