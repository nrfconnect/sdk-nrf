/*
 * Copyright (c) 2025 Nordic Semiconductor ASA
 *
 * SPDX-License-Identifier: LicenseRef-Nordic-5-Clause
 */

#include "../../../nrf54h20dk_nrf54h20_cpuapp/memory_map.dtsi"

slot0_partition: &cpurad_slot0_partition {
	label = "image-0";
};

slot1_partition: &cpurad_slot1_partition {
	label = "image-1";
};

secondary_app_partition: &cpurad_slot1_partition {};
