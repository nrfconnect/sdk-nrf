## CMakeLists.txt
```
# Copyright (c) 2024 Nordic Semiconductor ASA
# SPDX-License-Identifier: LicenseRef-Nordic-5-Clause

cmake_minimum_required(VERSION 3.20.0)
find_package(Zephyr REQUIRED HINTS $ENV{ZEPHYR_BASE})

project(platform_key_loader)
target_sources(app PRIVATE src/main.c)
```

## Kconfig
```
# Copyright (c) 2024 Nordic Semiconductor ASA
# SPDX-License-Identifier: LicenseRef-Nordic-5-Clause

config NRF_KEY_LOADER_BASE_PATH
	default "${ZEPHYR_NRF_MODULE_DIR}/applications/platform_key_loader/keys"

source "Kconfig.zephyr"
```

## sample.yaml
```
sample:
  name: Platform Key Loader
  description: |
    Application used for loading platform keys

common:
  build_only: true

tests:
  applications.platform_key_loader:
    platform_allow: nrf54h20dk/nrf54h20/cpuapp
    integration_platforms:
      - nrf54h20dk/nrf54h20/cpuapp
```

## sysbuild.conf
```
SB_CONFIG_SUIT_ENVELOPE=y
```

## prj.conf
```kconfig
# Enable key loader subsystem
CONFIG_NRF_KEY_LOADER=y

# Enable output
CONFIG_CONSOLE=y
CONFIG_LOG=y

# Build
CONFIG_SIZE_OPTIMIZATIONS=y

# Enable nordic security backend and PSA APIs
CONFIG_NRF_SECURITY=y
CONFIG_MBEDTLS_PSA_CRYPTO_C=y

# Enable PSA crypto from SSF client
CONFIG_PSA_SSF_CRYPTO_CLIENT=y
CONFIG_SSF_PSA_CRYPTO_SERVICE_ENABLED=y

# Disable Oberon PSA crypto drivers
CONFIG_PSA_CRYPTO_DRIVER_OBERON=n

# Bugfixes
CONFIG_DCACHE=n
```

## boards/nrf54h20dk_nrf54h20_cpuapp.overlay
```dts
/*
 * Copyright (c) 2024 Nordic Semiconductor ASA
 * SPDX-License-Identifier: LicenseRef-Nordic-5-Clause
 */

&cpusec_cpuapp_ipc {
	status = "okay";
};

&cpuapp_ram0x_region {
	status = "okay";
};

&cpusec_bellboard {
	status = "okay";
};

&cpuapp_bellboard {
	status = "okay";
};
```

## src/main.c
```c
/*
 * Copyright (c) 2024 Nordic Semiconductor ASA
 * SPDX-License-Identifier: LicenseRef-Nordic-5-Clause
 */

int main(void)
{
	return 0;
}
```
