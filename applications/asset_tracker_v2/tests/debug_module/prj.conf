## CMakeLists.txt
```
#
# Copyright (c) 2021 Nordic Semiconductor
#
# SPDX-License-Identifier: LicenseRef-Nordic-5-Clause
#

cmake_minimum_required(VERSION 3.13.1)

find_package(Zephyr REQUIRED HINTS $ENV{ZEPHYR_BASE})
project(debug_module_test)

# Set CMake path variables for convenience
set(ASSET_TRACKER_V2_DIR ../..)

# Generate runner for the test
test_runner_generate(src/debug_module_test.c)

# Create mock for Memfault SDK source files
cmock_handle(${ZEPHYR_MEMFAULT_FIRMWARE_SDK_MODULE_DIR}/components/include/memfault/metrics/metrics.h memfault/metrics)
cmock_handle(${ZEPHYR_MEMFAULT_FIRMWARE_SDK_MODULE_DIR}/ports/zephyr/include/memfault/ports/zephyr/http.h memfault/ports/zephyr)
cmock_handle(${ZEPHYR_MEMFAULT_FIRMWARE_SDK_MODULE_DIR}/components/include/memfault/core/data_packetizer.h memfault/core)
cmock_handle(${ZEPHYR_MEMFAULT_FIRMWARE_SDK_MODULE_DIR}/components/include/memfault/core/trace_event.h memfault/core)
cmock_handle(${ZEPHYR_MEMFAULT_FIRMWARE_SDK_MODULE_DIR}/components/include/memfault/panics/coredump.h memfault/panics)
cmock_handle(${ZEPHYR_MEMFAULT_FIRMWARE_SDK_MODULE_DIR}/ports/include/memfault/ports/watchdog.h memfault/ports)

# Create mock for nRF SDK
cmock_handle(${ZEPHYR_NRF_MODULE_DIR}/include/app_event_manager.h)
cmock_handle(${ZEPHYR_NRF_MODULE_DIR}/subsys/app_event_manager/app_event_manager_priv.h )

# Create mock for Asset Tracker v2 application source files
cmock_handle(${ASSET_TRACKER_V2_DIR}/src/modules/modules_common.h)
cmock_handle(${ASSET_TRACKER_V2_DIR}/src/watchdog/watchdog_app.h)

# Add debug module (Unit Under Test)
target_sources(app PRIVATE ${ASSET_TRACKER_V2_DIR}/src/modules/debug_module.c)

# Add test source file
target_sources(app PRIVATE src/debug_module_test.c)

# Include Asset Tracker v2 application folders
target_include_directories(app PRIVATE .)
target_include_directories(app PRIVATE ${ASSET_TRACKER_V2_DIR}/src/)
target_include_directories(app PRIVATE ${ASSET_TRACKER_V2_DIR}/src/watchdog)
target_include_directories(app PRIVATE ${ASSET_TRACKER_V2_DIR}/src/modules/)
target_include_directories(app PRIVATE ${ASSET_TRACKER_V2_DIR}/src/events/)
target_include_directories(app PRIVATE ${ASSET_TRACKER_V2_DIR}/configuration/memfault/)

# Include nRF SDK directories
target_include_directories(app PRIVATE ${ZEPHYR_NRF_MODULE_DIR}/subsys/app_event_manager)
target_include_directories(app PRIVATE ${ZEPHYR_NRF_MODULE_DIR}/modules/cjson/include)

# Include Memfault SDK directories
target_include_directories(app PRIVATE ${ZEPHYR_MEMFAULT_FIRMWARE_SDK_MODULE_DIR}/components/include/)
target_include_directories(app PRIVATE ${ZEPHYR_MEMFAULT_FIRMWARE_SDK_MODULE_DIR}/components/include/core)

# Include nRFxlib directories
target_include_directories(app PRIVATE ${ZEPHYR_NRFXLIB_MODULE_DIR}/nrf_modem/include/)

# Include platform specific header file that is used to describe the registers of
# the given platform. Without this file, generation of mocks will
# fail due to a incomplete type warning.
set_property(SOURCE mocks/memfault/panics/cmock_coredump.c PROPERTY COMPILE_FLAGS
	     "-include ${ZEPHYR_MEMFAULT_FIRMWARE_SDK_MODULE_DIR}/components/include/memfault/panics/arch/arm/cortex_m.h")

# Options that cannot be passed through Kconfig fragments.
target_compile_options(app PRIVATE
  	-DCONFIG_ASSET_TRACKER_V2_APP_VERSION_MAX_LEN=20
	-DCONFIG_DEBUG_MODULE_LOG_LEVEL=4
	-DCONFIG_MEMFAULT=y
	-DCONFIG_WATCHDOG_APPLICATION=y
	-DCONFIG_DEBUG_MODULE=y
	-DCONFIG_DEBUG_MODULE_MEMFAULT_USE_EXTERNAL_TRANSPORT=y
	-DCONFIG_DEBUG_MODULE_MEMFAULT_WATCHDOG_DELTA_MS=5000
	-DCONFIG_DEBUG_MODULE_MEMFAULT_CHUNK_SIZE_MAX=80
	-DCONFIG_DEBUG_MODULE_MEMFAULT_THREAD_STACK_SIZE=1024
	-DCONFIG_DEBUG_MODULE_MEMFAULT_UPDATES_MIN_INTERVAL_SEC=900
	-DCONFIG_CLOUD_CODEC_APN_LEN_MAX=1
	-DCONFIG_MODEM_APN_LEN_MAX=1
	-DCONFIG_CLOUD_CODEC_LWM2M_PATH_LIST_ENTRIES_MAX=1
	-DCONFIG_CLOUD_CODEC_LWM2M_PATH_ENTRY_SIZE_MAX=1
	-DCONFIG_LTE_NEIGHBOR_CELLS_MAX=10
)
```

## prj.conf
```kconfig
#
# Copyright (c) 2021 Nordic Semiconductor ASA
#
# SPDX-License-Identifier: LicenseRef-Nordic-5-Clause
#

CONFIG_UNITY=y
CONFIG_HEAP_MEM_POOL_SIZE=1024
CONFIG_PICOLIBC=y
CONFIG_ASSERT=y
CONFIG_LOG=y

# Make CONFIG_APP_EVENT_MANAGER_MAX_EVENT_CNT defined
CONFIG_APP_EVENT_MANAGER=y

# Application Event Manager requires sys_reboot()
CONFIG_REBOOT=y
# The following option is required to silence the linker warning about orphan
# sections. The Application Event Manager header files uses orphan sections.
```

## boards/native_posix.conf
```kconfig
#
# Copyright (c) 2023 Nordic Semiconductor ASA
#
# SPDX-License-Identifier: LicenseRef-Nordic-5-Clause
#
CONFIG_EXTERNAL_LIBC=y
```

## boards/nrf9160dk_nrf9160_ns.conf
```kconfig
# The following option is required to silence the linker warning about orphan
# sections. The event manager header files uses orphan sections.
CONFIG_LINKER_ORPHAN_SECTION_PLACE=y
```

## src/debug_module_test.c
```c
/*
 * Copyright (c) 2021 Nordic Semiconductor ASA
 *
 * SPDX-License-Identifier: LicenseRef-Nordic-5-Clause
 */

#include <unity.h>
#include <stdbool.h>
#include <stdlib.h>
#include <memfault/metrics/cmock_metrics.h>
#include <memfault/core/cmock_data_packetizer.h>
#include <memfault/ports/cmock_watchdog.h>
#include <memfault/panics/cmock_coredump.h>

#include "cmock_modules_common.h"
#include "cmock_app_event_manager.h"
#include "cmock_app_event_manager_priv.h"
#include "cmock_watchdog_app.h"

#include "app_module_event.h"
#include "debug_module_event.h"
#include "data_module_event.h"

extern struct event_listener __event_listener_debug_module;

/* The addresses of the following structures will be returned when the app_event_manager_alloc()
 * function is called.
 */
static struct app_module_event app_module_event_memory;
static struct data_module_event data_module_event_memory;
static struct debug_module_event debug_module_event_memory;

#define DEBUG_MODULE_EVT_HANDLER(aeh) __event_listener_debug_module.notification(aeh)

/* Dummy structs to please linker. The APP_EVENT_SUBSCRIBE macros in debug_module.c
 * depend on these to exist. But since we are unit testing, we dont need
 * these subscriptions and hence these structs can remain uninitialized.
 */
struct event_type __event_type_debug_module_event;
struct event_type __event_type_app_module_event;
struct event_type __event_type_data_module_event;
struct event_type __event_type_cloud_module_event;
struct event_type __event_type_modem_module_event;
struct event_type __event_type_sensor_module_event;
struct event_type __event_type_ui_module_event;
struct event_type __event_type_util_module_event;

/* It is required to be added to each test. That is because unity's
 * main may return nonzero, while zephyr's main currently must
 * return 0 in all cases (other values are reserved).
 */
extern int unity_main(void);

/* Local reference of the internal application watchdog callback in debug module. Used to
 * infuse callback events directly from the test runner.
 */
watchdog_evt_handler_t debug_module_watchdog_callback;

static void latch_watchdog_callback(watchdog_evt_handler_t handler, int no_of_calls)
{
	debug_module_watchdog_callback = handler;
}

static void validate_debug_data_ready_evt(struct app_event_header *aeh, int no_of_calls)
{
	struct debug_module_event *event = cast_debug_module_event(aeh);

	TEST_ASSERT_EQUAL(DEBUG_EVT_MEMFAULT_DATA_READY, event->type);

	/* Free payload received in the DEBUG_EVT_MEMFAULT_DATA_READY event. */
	k_free(event->data.memfault.buf);
}

/* Stub used to verify parameters passed into module_start(). */
static int module_start_stub(struct module_data *module, int num_calls)
{
	TEST_ASSERT_EQUAL_STRING("debug", module->name);
	TEST_ASSERT_NULL(module->msg_q);
	TEST_ASSERT_FALSE(module->supports_shutdown);

	return 0;
}

void setup_debug_module_in_init_state(void)
{
	__cmock_app_event_manager_alloc_ExpectAnyArgsAndReturn(&app_module_event_memory);
	__cmock_app_event_manager_free_ExpectAnyArgs();
	struct app_module_event *app_module_event = new_app_module_event();

	app_module_event->type = APP_EVT_START;

	__cmock_watchdog_register_handler_ExpectAnyArgs();
	__cmock_watchdog_register_handler_AddCallback(&latch_watchdog_callback);
	__cmock_module_start_Stub(&module_start_stub);

#if defined(CONFIG_BOARD_NATIVE_SIM)
	__cmock_app_event_manager_alloc_ExpectAnyArgsAndReturn(&debug_module_event_memory);
	__cmock__event_submit_ExpectAnyArgs();
	__cmock_app_event_manager_alloc_ExpectAnyArgsAndReturn(&debug_module_event_memory);
	__cmock__event_submit_ExpectAnyArgs();
#endif /* defined(CONFIG_BOARD_NATIVE_SIM) */

	TEST_ASSERT_EQUAL(0, DEBUG_MODULE_EVT_HANDLER(
		(struct app_event_header *)app_module_event));
	app_event_manager_free(app_module_event);
}

/* Test that the debug module is able to submit Memfault data externally through events
 * of type DEBUG_EVT_MEMFAULT_DATA_READY carrying chunks of data.
 */
void test_memfault_trigger_data_send(void)
{
	resetTest();
	setup_debug_module_in_init_state();

	__cmock__event_submit_ExpectAnyArgs();

	__cmock_memfault_packetizer_data_available_ExpectAndReturn(1);
	__cmock_memfault_packetizer_get_chunk_ExpectAnyArgsAndReturn(1);
	__cmock_memfault_packetizer_get_chunk_ExpectAnyArgsAndReturn(0);

	/* Expect the debug module to generate an event with accompanied Memfault metric data. */
	__cmock__event_submit_Stub(&validate_debug_data_ready_evt);

	__cmock_app_event_manager_alloc_ExpectAnyArgsAndReturn(&data_module_event_memory);
	__cmock_app_event_manager_free_ExpectAnyArgs();
	struct data_module_event *data_module_event = new_data_module_event();

	data_module_event->type = DATA_EVT_DATA_SEND;

	__cmock_app_event_manager_alloc_IgnoreAndReturn(&debug_module_event_memory);
	TEST_ASSERT_EQUAL(0, DEBUG_MODULE_EVT_HANDLER(
		(struct app_event_header *)data_module_event));
	app_event_manager_free(data_module_event);

	/* Add a minor sleep to allow execution of the internal memfault transport thread in the
	 * debug module to finish before the rest runner.
	 */
	k_sleep(K_SECONDS(1));
}

/* Test whether the correct Memfault software watchdog APIs are called on callbacks from the
 * application watchdog library.
 */
void test_memfault_software_watchdog_trigger_on_callback(void)
{
	resetTest();
	setup_debug_module_in_init_state();

	__cmock_memfault_software_watchdog_enable_ExpectAndReturn(0);

	/* Expect a software watchdog timer 5 seconds lower than the passed in value to be used. */
	__cmock_memfault_software_watchdog_update_timeout_ExpectAndReturn(55000, 0);
	__cmock_memfault_software_watchdog_feed_ExpectAndReturn(0);

	struct watchdog_evt evt = {
		.type = WATCHDOG_EVT_START
	};

	debug_module_watchdog_callback(&evt);

	memset(&evt, 0, sizeof(struct watchdog_evt));

	evt.type = WATCHDOG_EVT_TIMEOUT_INSTALLED;
	evt.timeout = 60000;

	debug_module_watchdog_callback(&evt);

	memset(&evt, 0, sizeof(struct watchdog_evt));

	evt.type = WATCHDOG_EVT_FEED;
}

int main(void)
{
	(void)unity_main();
	return 0;
}
```
