## applications/asset_tracker_v2/tests/nrf_cloud_codec_mocked_cjson/testcase.yaml
```yaml
tests:
  asset_tracker_v2.nrf_cloud_codec_mocked_cjson_test:
    sysbuild: true
    platform_allow:
      - native_sim
    integration_platforms:
      - native_sim
    tags:
      - nrf_cloud_codec_mocked_cJSON
      - sysbuild
      - ci_applications_asset_tracker_v2
```

## applications/asset_tracker_v2/tests/ui_module/testcase.yaml
```yaml
tests:
  asset_tracker_v2.ui_module_test.tester:
    sysbuild: true
    platform_allow:
      - native_sim
    integration_platforms:
      - native_sim
    tags:
      - ui_module
      - sysbuild
      - ci_applications_asset_tracker_v2
```

## applications/connectivity_bridge/Kconfig
```kconfig
#
# Copyright (c) 2020 Nordic Semiconductor ASA
#
# SPDX-License-Identifier: LicenseRef-Nordic-5-Clause
#

menu "Connectivity Bridge"
rsource "src/modules/Kconfig"
rsource "src/events/Kconfig"
endmenu

menu "Zephyr Kernel"
source "Kconfig.zephyr"
endmenu
```

## applications/connectivity_bridge/Kconfig.sysbuild
```kconfig
#
# Copyright (c) 2023 Nordic Semiconductor
#
# SPDX-License-Identifier: LicenseRef-Nordic-5-Clause
#

source "share/sysbuild/Kconfig"

config NRF_DEFAULT_IPC_RADIO
	default y

config NETCORE_IPC_RADIO_BT_HCI_IPC
	default y

config SECURE_BOOT_NETCORE
	default y if BOARD_THINGY91X_NRF5340_CPUAPP

config SECURE_BOOT_APPCORE
	default y if BOARD_THINGY91X_NRF5340_CPUAPP
```

## applications/connectivity_bridge/boards/nrf5340dk_nrf5340_cpuapp.conf
```kconfig
CONFIG_RETENTION_BOOT_MODE=y

CONFIG_USB_MAX_POWER=250
CONFIG_USB_DEVICE_PRODUCT="Connectivity Bridge"

CONFIG_USB_DEVICE_VID=0x1915
CONFIG_USB_DEVICE_PID=0x910A

CONFIG_USB_MAX_NUM_TRANSFERS=8
CONFIG_BRIDGE_CMSIS_DAP_BULK_ENABLE=y
CONFIG_RETENTION_BOOT_MODE=y
CONFIG_REBOOT=y
CONFIG_GPIO=y

CONFIG_DK_LIBRARY=y
CONFIG_DAP=y
CONFIG_DP_DRIVER=y

CONFIG_CMSIS_DAP_DEVICE_VENDOR="Nordic Semiconductor ASA"

CONFIG_NET_BUF=y

CONFIG_CLOCK_CONTROL_NRF_K32SRC_SYNTH=y

CONFIG_BOARD_ENABLE_DCDC_APP=n
CONFIG_BOARD_ENABLE_DCDC_NET=n
CONFIG_BOARD_ENABLE_DCDC_HV=n

CONFIG_NFCT_PINS_AS_GPIOS=y
CONFIG_SOC_ENABLE_LFXO=n
```

## applications/connectivity_bridge/boards/thingy91x_nrf5340_cpuapp.conf
```kconfig
CONFIG_BT=y
CONFIG_BT_DEVICE_NAME="Thingy:91 X UART"
CONFIG_BT_DEVICE_NAME_DYNAMIC=y
CONFIG_BT_PERIPHERAL=y
CONFIG_BT_PERIPHERAL_PREF_MIN_INT=6
CONFIG_BT_PERIPHERAL_PREF_MAX_INT=16
CONFIG_BT_PERIPHERAL_PREF_LATENCY=0
CONFIG_BT_PERIPHERAL_PREF_TIMEOUT=400
CONFIG_BT_BONDABLE=n

CONFIG_BT_MAX_CONN=1
CONFIG_BT_AUTO_PHY_UPDATE=y
CONFIG_BT_DATA_LEN_UPDATE=y
CONFIG_BT_HCI_ACL_FLOW_CONTROL=y
CONFIG_BT_L2CAP_TX_MTU=247
CONFIG_BT_BUF_ACL_RX_SIZE=251
CONFIG_BT_NUS=y
CONFIG_BT_GATT_CLIENT=y
CONFIG_BT_SMP=y
CONFIG_BT_BUF_ACL_TX_COUNT=10
CONFIG_BT_BUF_ACL_TX_SIZE=251
CONFIG_BT_CTLR_DATA_LENGTH_MAX=251

CONFIG_USB_MAX_POWER=250
CONFIG_USB_DEVICE_PRODUCT="Thingy:91 X UART"

CONFIG_USB_DEVICE_VID=0x1915
CONFIG_USB_DEVICE_PID=0x910A

CONFIG_USB_MAX_NUM_TRANSFERS=8
CONFIG_BRIDGE_CMSIS_DAP_BULK_ENABLE=y
CONFIG_RETENTION_BOOT_MODE=y
CONFIG_REBOOT=y
CONFIG_GPIO=y

CONFIG_DK_LIBRARY=y
```

## applications/connectivity_bridge/sample.yaml
```yaml
sample:
  description: Connectivity Bridge application
  name: Connectivity Bridge
tests:
  applications.connectivity_bridge:
    sysbuild: true
    build_only: true
    platform_allow:
      - thingy91/nrf52840
      - thingy91x/nrf5340/cpuapp
    integration_platforms:
      - thingy91/nrf52840
      - thingy91x/nrf5340/cpuapp
    tags: ci_build sysbuild
```

## applications/connectivity_bridge/src/events/Kconfig
```kconfig
#
# Copyright (c) 2020 Nordic Semiconductor
#
# SPDX-License-Identifier: LicenseRef-Nordic-5-Clause
#

if LOG

menu "Event options"

comment "Initially logged events"

config BRIDGE_LOG_MODULE_STATE_EVENT
	bool "Module state event"
	default y

config BRIDGE_LOG_UART_DATA_EVENT
	bool "UART data event"
	default y

config BRIDGE_LOG_CDC_DATA_EVENT
	bool "CDC data event"
	default y

config BRIDGE_LOG_BLE_DATA_EVENT
	bool "BLE data event"
	default y

config BRIDGE_LOG_BLE_CTRL_EVENT
	bool "BLE data event"
	default y

config BRIDGE_LOG_PEER_CONN_EVENT
	bool "Peer connection event"
	default y

config BRIDGE_LOG_FS_EVENT
	bool "File system event"
	default y

config BRIDGE_LOG_POWER_DOWN_EVENT
	bool "Power down event"
	default y

endmenu

endif
```

## applications/connectivity_bridge/src/modules/Kconfig
```kconfig
#
# Copyright (c) 2020 Nordic Semiconductor
#
# SPDX-License-Identifier: LicenseRef-Nordic-5-Clause
#

module = BRIDGE_UART
module-str = UART device
source "subsys/logging/Kconfig.template.log_config"

config BRIDGE_CDC_ENABLE
	bool "Enable USB CDC ACM"
	depends on USB_DEVICE_STACK
	select USB_CDC_ACM
	help
		This option enables USB CDC ACM
		and exposes two COM ports, bridging the two UART interfaces.

if BRIDGE_CDC_ENABLE

module = BRIDGE_CDC
module-str = USB CDC ACM device
source "subsys/logging/Kconfig.template.log_config"

endif

config BRIDGE_CMSIS_DAP_BULK_ENABLE
	bool "Enable USB Bulk"
	depends on USB_DEVICE_STACK
	select USB_DEVICE_BOS

if BRIDGE_CMSIS_DAP_BULK_ENABLE

module = BRIDGE_BULK
module-str = USB Bulk device
source "subsys/logging/Kconfig.template.log_config"

config BULK_USB_THREAD_STACK_SIZE
	int "USB Bulk thread stack size"
	default 1024
	help
	  Size of stack for USB Bulk handler thread.

endif

config BRIDGE_MSC_ENABLE
	bool "Enable USB Mass Storage"
	depends on BRIDGE_CDC_ENABLE
	select USB_MASS_STORAGE
	select FILE_SYSTEM
	help
		This option enables USB Mass Storage Device Class,
		and exposes utility files via USB.

if BRIDGE_MSC_ENABLE

module = BRIDGE_MSC
module-str = USB mass storage device
source "subsys/logging/Kconfig.template.log_config"

endif

config BRIDGE_BLE_ENABLE
	bool "Enable BLE UART Service"
	depends on BT_NUS
	help
	  This option enables BLE NUS Service.
	  BLE advertisement will run continuously when not connected.
	  NOTE: There is no encryption or authentication enabled for the BLE link.

if BRIDGE_BLE_ENABLE

module = BRIDGE_BLE
module-str = BLE UART Service
source "subsys/logging/Kconfig.template.log_config"

config BRIDGE_BLE_ALWAYS_ON
	bool "Enable BLE always active"
	help
	  This option sets BLE as always active.
	  When not always active, it has to be enabled via config file change.

endif

if PM_DEVICE

module = BRIDGE_POWER_MGMT
module-str = Bridge power management
source "subsys/logging/Kconfig.template.log_config"

endif

config BRIDGE_BUF_SIZE
	int "Transport interface buffer size"
	default 4096
	help
	  Size of transmit/receive buffer for transfer between interfaces.

config BRIDGE_UART_BUF_COUNT
	int "UART buffer block count"
	default 3
	range 3 255
	help
	  Number of buffer blocks assigned for UART instances.
	  This value is scaled with the number of interfaces.
	  With the default instance count of 2, and for example 3 buffers,
	  the total will be 6 buffers.
	  Note that all buffers are shared between UART instances.
```

## applications/connectivity_bridge/src/uart/Kconfig
```kconfig
#
# Copyright (c) 2021 Georgi Valkov
#
# SPDX-License-Identifier: LicenseRef-Nordic-5-Clause
#

menu "UART miniport options"

comment "UART miniport"


endmenu
```

## applications/connectivity_bridge/sysbuild/b0/boards/thingy91x_nrf5340_cpuapp.conf
```kconfig
#
# Copyright (c) 2024 Nordic Semiconductor ASA
#
# SPDX-License-Identifier: LicenseRef-Nordic-5-Clause
#

# CC3xx is currently not used for nrf53
CONFIG_HW_CC3XX=n
CONFIG_NRF_CC3XX_PLATFORM=n
```

## applications/connectivity_bridge/sysbuild/mcuboot/boards/nrf5340dk_nrf5340_cpuapp.conf
```kconfig
#
# Copyright (c) 2021 Nordic Semiconductor ASA
#
# SPDX-License-Identifier: LicenseRef-Nordic-5-Clause
#

# CC3xx is currently not used for nrf53
CONFIG_HW_CC3XX=n
CONFIG_NRF_CC3XX_PLATFORM=n

# Required for kernel operation
CONFIG_CLOCK_CONTROL=y
CONFIG_SYS_CLOCK_EXISTS=y

CONFIG_CLOCK_CONTROL_NRF_K32SRC_SYNTH=y

CONFIG_BOARD_ENABLE_DCDC_APP=n
CONFIG_BOARD_ENABLE_DCDC_NET=n
CONFIG_BOARD_ENABLE_DCDC_HV=n

CONFIG_NFCT_PINS_AS_GPIOS=y
CONFIG_SOC_ENABLE_LFXO=n
```

## applications/esl/central_esl/Kconfig
```kconfig
#
# Copyright (c) 2022 Nordic Semiconductor
#
# SPDX-License-Identifier: LicenseRef-Nordic-5-Clause
#

source "Kconfig.zephyr"

menu "Nordic ESL BLE GATT service client"

config BT_ESL_CLIENT_THREAD_STACK_SIZE
	int "Thread stack size"
	default 1024
	help
	  Stack size used in each of the two threads

config BT_ESL_SECURITY_ENABLED
	bool "Enable security"
	select BT_SMP
	select BT_BONDABLE
	select BT_BONDING_REQUIRED
	help
	  "Enable BLE security for the ESL service"

config BT_ESL_AP_AUTO_MODE
	bool "AP auto onboarding Tag mode"
	help
	  "Enable,AP will auto scan and configure tag. Disable,AP will only accept shell command"

if BT_ESL_AP_AUTO_MODE
config BT_ESL_AP_AUTO_TAG_PER_GROUP
	int "Tag per group"
	default ESL_CLIENT_MAX_RESPONSE_SLOT_BUFFER
	help
	  "How many tags should keep in same group for auto onboarding.
	   Tag number exceeds this number should be in next group.
	   Otherwise, response key is not enough for all tags in same group.
	   How to choose this number depends on what scenario we want to show.
	   Less or equal to ESL_CLIENT_MAX_RESPONSE_SLOT_BUFFER demostrates decrypts response EAD on-the-fly.
	   Greater than ESL_CLIENT_MAX_RESPONSE_SLOT_BUFFER demostrates ESL AP able to control large amount of tags at the same time."

config BT_ESL_AP_GROUP_PER_BUTTON
	int "Group per button"
	default 3
	help
	  "How many groups should be controlled by one button.
	   If this number is greater than 1, AP will control multiple groups by one button.
	   Otherwise, AP will control one group by one button."
endif

config BT_ESL_AP_AUTO_PAST_TAG
	bool "AP auto past mode"
	help
	  "Enable,AP will auto send update complete command and PAST to unsynchronized tag. Disable,AP will only accept shell command"

config BT_ESL_AP_PTS
	bool "ESL access point for PTS test"
	help
	  Enable PTS test for ESL access point

module = CENTRAL_ESL
module-str = central esl
source "${ZEPHYR_BASE}/subsys/logging/Kconfig.template.log_config"
endmenu

rsource "../service/Kconfig.esl_client"
```

## applications/esl/central_esl/boards/nrf52840dk_nrf52840.conf
```kconfig
#
# Copyright (c) 2023 Nordic Semiconductor ASA
#
# SPDX-License-Identifier: LicenseRef-Nordic-5-Clause
#

# External Flash for TAG OTS image storage
# Need this when storage is on flash
CONFIG_MPU_ALLOW_FLASH_WRITE=y

# Need this when storage is on MX25R64 QSPI
CONFIG_NORDIC_QSPI_NOR=y
CONFIG_NORDIC_QSPI_NOR_FLASH_LAYOUT_PAGE_SIZE=4096
CONFIG_FLASH=y
CONFIG_FLASH_MAP=y
CONFIG_FLASH_PAGE_LAYOUT=y
CONFIG_FILE_SYSTEM=y
CONFIG_FILE_SYSTEM_LITTLEFS=y
CONFIG_PM_PARTITION_REGION_LITTLEFS_EXTERNAL=y
CONFIG_PM_PARTITION_SIZE_LITTLEFS=0x300000
CONFIG_FILE_SYSTEM_SHELL=y
CONFIG_RESET_ON_FATAL_ERROR=n
CONFIG_ESL_CLIENT_MAX_GROUP=64

# ESL AP two CDC uart, one for command, one for SMP
CONFIG_USB_DEVICE_STACK=y
CONFIG_USB_DEVICE_PRODUCT="Nordic ESL Access Point"
CONFIG_UART_LINE_CTRL=y

# Ensure an MCUboot-compatible binary is generated
CONFIG_BOOTLOADER_MCUBOOT=y

# LOG
# CONFIG_MCUBOOT_UTIL_LOG_LEVEL_WRN=y
# CONFIG_MCUMGR_LOG_LEVEL_DBG=y
# CONFIG_BT_DEBUG_OTS_CLIENT=y
# CONFIG_BT_OTS_CLIENT_LOG_LEVEL_DBG=y

# PAWR timing
CONFIG_BT_CTLR_SDC_PAWR_ADV_COUNT=1
CONFIG_BT_CTLR_SDC_PERIODIC_ADV_RSP_TX_BUFFER_COUNT=3
CONFIG_BT_CTLR_SDC_PERIODIC_ADV_RSP_RX_BUFFER_COUNT=12
CONFIG_BT_PER_ADV_SYNC_MAX=1
CONFIG_BT_CTLR_SDC_MAX_CONN_EVENT_LEN_DEFAULT=2500
CONFIG_BT_BUF_ACL_RX_SIZE=502
CONFIG_BT_BUF_CMD_TX_SIZE=255
CONFIG_BT_BUF_EVT_DISCARDABLE_SIZE=255
CONFIG_BT_CTLR_SDC_PERIPHERAL_COUNT=0
CONFIG_BT_CTLR_ADV_DATA_LEN_MAX=73
CONFIG_BT_CTLR_TX_PWR_PLUS_8=y
```

## applications/esl/central_esl/boards/thingy53_nrf5340_cpuapp.conf
```kconfig
#
# Copyright (c) 2023 Nordic Semiconductor ASA
#
# SPDX-License-Identifier: LicenseRef-Nordic-5-Clause
#

# External Flash for TAG OTS image storage
# Need this when storage is on flash
CONFIG_MPU_ALLOW_FLASH_WRITE=y

# Need this when storage is on MX25R64 QSPI
CONFIG_NORDIC_QSPI_NOR=y
CONFIG_NORDIC_QSPI_NOR_FLASH_LAYOUT_PAGE_SIZE=4096
CONFIG_FLASH=y
CONFIG_FLASH_MAP=y
CONFIG_FLASH_PAGE_LAYOUT=y
CONFIG_FILE_SYSTEM=y
CONFIG_FILE_SYSTEM_LITTLEFS=y
CONFIG_FILE_SYSTEM_SHELL=y
CONFIG_RESET_ON_FATAL_ERROR=n

# ESL AP two CDC uart, one for command, one for SMP
CONFIG_USB_DEVICE_STACK=y
CONFIG_USB_DEVICE_PRODUCT="Nordic ESL Access Point"
CONFIG_UART_LINE_CTRL=y
CONFIG_USB_DEVICE_INITIALIZE_AT_BOOT=y

# # Ensure an MCUboot-compatible binary is generated
CONFIG_BOOTLOADER_MCUBOOT=y

# Enable logging
# CONFIG_MCUBOOT_UTIL_LOG_LEVEL_WRN=y
# CONFIG_MCUMGR_LOG_LEVEL_DBG=y
# CONFIG_BT_DEBUG_OTS_CLIENT=y
# CONFIG_BT_OTS_CLIENT_LOG_LEVEL_DBG=y
```

## applications/esl/central_esl/sample.yaml
```yaml
sample:
  name: BLE ESL AP
  description: Bluetooth Low Energy ESL Access Point application
tests:
  applications.bluetooth.central_esl:
    build_only: true
    platform_allow: nrf52840dk_nrf52840 nrf5340dk_nrf5340_cpuapp thingy53_nrf5340_cpuapp
    integration_platforms:
      - nrf52840dk_nrf52840
      - nrf5340dk_nrf5340_cpuapp
      - thingy53_nrf5340_cpuapp
    tags: bluetooth ci_build
```

## applications/esl/peripheral_esl/sample.yaml
```yaml
sample:
  name: BLE ESL Tag
  description: Bluetooth Low Energy ESL Tag application
tests:
  application.bluetooth.peripheral_esl:
    build_only: true
    platform_allow: nrf52dk_nrf52832 nrf52833dk_nrf52833 nrf52840dk_nrf52840 nrf21540dk_nrf52840
      nrf52840dongle_nrf52840 thingy52_nrf52832
    integration_platforms:
      - nrf52dk_nrf52832
      - nrf52833dk_nrf52833
      - nrf52840dk_nrf52840
      - nrf21540dk_nrf52840
      - nrf52840dongle_nrf52840
      - thingy52_nrf52832
    tags: bluetooth ci_build
  application.bluetooth.peripheral_esl_52832epd:
    build_only: true
    platform_allow: nrf52dk_nrf52832
    tags: bluetooth ci_build
    extra_args: OVERLAY_CONFIG=nrf52dk_nrf52832_epd.conf
      DTC_OVERLAY_FILE="conf/nrf52dk_nrf52832/nrf52dk_nrf52832_epd.overlay"
  application.bluetooth.peripheral_esl_52833epd:
    build_only: true
    platform_allow: nrf52833dk_nrf52833
    tags: bluetooth ci_build
    extra_args: OVERLAY_CONFIG=nrf52833dk_nrf52833_power_profiler_release_epd.conf
      DTC_OVERLAY_FILE="conf/nrf52833dk_nrf52833/nrf52833dk_nrf52833_release_epd.overlay"
```
