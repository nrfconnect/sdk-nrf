## applications/esl/service/Kconfig.esl.defaults
```kconfig
#
# Copyright (c) 2022 Nordic Semiconductor ASA
#
# SPDX-License-Identifier: LicenseRef-Nordic-5-Clause
#

config BT_NRF_SERVICES
	bool
	default y

config SMF
	bool
	default y

# Periodic Sync
config BT_OBSERVER
	bool
	default y

config BT_EXT_ADV
	bool
	default y

config BT_PER_ADV_SYNC
	bool
	default y

config BT_CTLR_SYNC_TRANSFER_RECEIVER_SUPPORT
	bool
	default y

config BT_CTLR_SYNC_TRANSFER_RECEIVER
	bool
	default y

config BT_PER_ADV_SYNC_TRANSFER_RECEIVER
	bool
	default y

config BT_CTLR_SDC_PAWR_SYNC
	bool
	default y

config BT_PER_ADV_SYNC_RSP
	bool
	default y

config BT_CTLR_SDC_PERIODIC_SYNC_RSP_TX_BUFFER_COUNT
	int
	default 1

# Display and Image
if BT_ESL_DISPLAY_MAX > 0
	config BT_ESL_IMAGE_AVAILABLE
	bool
	default y

# BT Object Transfer service
	config BT_OTS
	bool
	default y

	config BT_L2CAP_DYNAMIC_CHANNEL
	bool
	default y

	config BT_OTS_DIR_LIST_OBJ
	bool
	default y

	config BT_OTS_OBJ_NAME_WRITE_SUPPORT
	bool
	default n

	config BT_OTS_OACP_WRITE_SUPPORT
	bool
	default y

	config BT_OTS_OACP_PATCH_SUPPORT
	bool
	default y

	config BT_OTS_OLCP_GO_TO_SUPPORT
	bool
	default y

	config BT_OTS_OACP_CHECKSUM_SUPPORT
	bool
	default y

	choice BT_OTS_LOG_LEVEL_CHOICE
		default BT_OTS_LOG_LEVEL_INF
	endchoice

	config FILE_SYSTEM
	default n

	config FILE_SYSTEM_LITTLEFS
	default n

	config FILE_SYSTEM_SHELL
	default n

endif

# LED
if BT_ESL_LED_MAX > 0
	config LED
	bool
	default y

	config PWM
	bool
	default n

	config LED_PWM
	bool
	default n
endif

config BT_SHELL
	default n

config ESL_SYNC_COUNT
	default 1

choice BT_ESL_PERM
	default BT_ESL_DEFAULT_PERM_RW
endchoice # BT_ESL_PERM

config NRFX_TEMP
	bool
	default y

# Device Information Service
config BT_DIS
	default y

config BT_DIS_PNP
	default y

config BT_DIS_FW_REV
	default y

config BT_DIS_FW_REV_STR
	default MCUBOOT_IMAGE_VERSION if BOOTLOADER_MCUBOOT
	default "0.0.0"
```

## applications/esl/service/Kconfig.esl_client.defaults
```kconfig
#
# Copyright (c) 2022 Nordic Semiconductor ASA
#
# SPDX-License-Identifier: LicenseRef-Nordic-5-Clause
#

if BT_ESL_CLIENT

config BT_NRF_SERVICES
	bool
	default y

config BT_EXT_ADV
	bool
	default y

config BT_EXT_ADV_MAX_ADV_SET
	int
	default 3

config BT_PER_ADV
	bool
	default y

config BT_PER_ADV_SYNC
	bool
	default y

config BT_PER_ADV_RSP
	bool
	default y

config BT_CTLR_SYNC_TRANSFER_SENDER_SUPPORT
	bool
	default y

config BT_CTLR_SYNC_TRANSFER_SENDER
	bool
	default y

config BT_PER_ADV_SYNC_TRANSFER_SENDER
	bool
	default y

config BT_CTLR_SDC_PAWR_ADV
	bool
	default y

config BT_CTLR_ADV_EXT
	bool
	default y

config BT_BROADCASTER
	bool
	default y

config BT_OTS_CLIENT
	bool
	default y

config BT_OTS_OACP_CHECKSUM_SUPPORT
	bool
	default y

config BT_L2CAP_TX_BUF_COUNT
	int
	default 8

config BT_SHELL
	default n

endif # BT_ESL_CLIENT

config BT_ESL_PERIPHERAL_MAX
	int
	default BT_MAX_CONN

config BT_ESL_SCAN_REPORT_INTERVAL
	default 120

config BT_ESL_LED_INDICATION
	default y

# PAWR timing
config ESL_PAWR_INTERVAL_MIN
	int
	default 1408

config ESL_PAWR_INTERVAL_MAX
	int
	default 1408

config ESL_CLIENT_MAX_GROUP
	int
	default 128

config ESL_SUBEVENT_INTERVAL
	int
	default 11

config ESL_RESPONSE_SLOT_DELAY
	int
	default 8

config ESL_RESPONSE_SLOT_SPACING
	int
	default 3

config ESL_NUM_RESPONSE_SLOTS
	int
	default 8

config ESL_CLIENT_MAX_RESPONSE_SLOT_BUFFER
	int
	default 8
```

## applications/hpf/Kconfig
```kconfig
config HPF_DEVELOPER_MODE
	bool "HPF developer mode"
	help
	  High Performance Framework developer mode.
	  If enabled, changes in HRT files will be included in build.
	  Otherwise, if there is a change in HRT that produces a different ASM file than
	  the provided one, build error is reported.
```

## applications/hpf/gpio/Kconfig
```kconfig
choice HPF_GPIO_BACKEND
	prompt "Backend"
	default HPF_GPIO_BACKEND_ICMSG

config HPF_GPIO_BACKEND_MBOX
	bool "mbox"

config HPF_GPIO_BACKEND_ICMSG
	bool "icmsg"
	select IPC_SERVICE

config HPF_GPIO_BACKEND_ICBMSG
	bool "icbmsg"
	select IPC_SERVICE

endchoice

config HPF_DEVELOPER_MODE
	bool "HPF developer mode"
	help
	  High Performance Framework developer mode.
	  If enabled, changes in HRT files will be included in build.
	  Otherwise, if there is a change in HRT that produces a different ASM file than
	  the provided one, build error is reported.

source "Kconfig.zephyr"
```

## applications/hpf/gpio/sample.yaml
```yaml
sample:
  name: HPF GPIO application
  description: HPF GPIO application
common:
  integration_platforms:
    - nrf54l15dk/nrf54l15/cpuflpr
tests:
  applications.hpf.gpio.mbox:
    build_only: true
    sysbuild: true
    platform_allow: nrf54l15dk/nrf54l15/cpuflpr
    tags:
      - ci_build
      - sysbuild
      - gpio
      - ci_applications_hpf
    required_snippets:
      - hpf-gpio-mbox

  applications.hpf.gpio.icmsg:
    build_only: true
    sysbuild: true
    platform_allow: nrf54l15dk/nrf54l15/cpuflpr
    tags:
      - ci_build
      - sysbuild
      - gpio
      - ci_applications_hpf
    required_snippets:
      - hpf-gpio-icmsg

  applications.hpf.gpio.icbmsg:
    sysbuild: true
    build_only: true
    platform_allow: nrf54l15dk/nrf54l15/cpuflpr
    tags:
      - ci_build
      - sysbuild
      - gpio
      - ci_applications_hpf
    required_snippets:
      - hpf-gpio-icbmsg
```

## applications/hpf/mspi/Kconfig
```kconfig
config HPF_MSPI_MAX_RESPONSE_SIZE
	int "Max size of response that can be sent to APP core. In bytes."
	default 524

config HPF_MSPI_IPC_NO_COPY
	bool "IPC no copy mode"
	default y
	depends on SOC_NRF54L15 || SOC_NRF54LM20A || SOC_NRF54LM20B || SOC_NRF54LV10A
	help
	  If y Data is passed through IPC by reference,
	  this requires both cores to be able to access each others memory spaces.
	  If n Data is passed through IPC by copy.

config HPF_MSPI_FAULT_TIMER
	bool "HPF application fault timer"
	help
	  Enable HPF application fault timer.
	  Timer is used to detect application faults. If the timer expires,
	  the application is considered to be in a fault state.

config HPF_MSPI_CORRECT_FOR_EXTRA_VTIM_CYCLE
	bool "HPF MSPI application should take into account an extra clock cycle output by VTIM."
	default y if SOC_NRF54L15
	default n
	help
	  If enabled, HPF MSPI application corrects for an extra clock cycle generated by VTIM
	  real-time peripheral.

config HPF_DEVELOPER_MODE
	bool "HPF developer mode"
	help
	  High Performance Framework developer mode.
	  If enabled, changes in HRT files will be included in build.
	  Otherwise, if there is a change in HRT that produces a different ASM file than
	  the provided one, build error is reported.

source "Kconfig.zephyr"
```

## applications/hpf/mspi/boards/nrf54l15dk_nrf54l15_cpuflpr.conf
```kconfig
# Single-threaded
CONFIG_MULTITHREADING=n
CONFIG_KERNEL_MEM_POOL=n
CONFIG_LOG=n

# Drivers and peripherals
CONFIG_I2C=n
CONFIG_WATCHDOG=n
CONFIG_GPIO=n
CONFIG_PINCTRL=n
CONFIG_SPI=n
CONFIG_SERIAL=n
CONFIG_FLASH=n

# Power management
CONFIG_PM=n

# Interrupts
CONFIG_DYNAMIC_INTERRUPTS=n
CONFIG_IRQ_OFFLOAD=n
CONFIG_GEN_SW_ISR_TABLE=n

# Memory protection
CONFIG_THREAD_STACK_INFO=n
CONFIG_THREAD_CUSTOM_DATA=n
CONFIG_FPU=n

# Boot
CONFIG_BOOT_BANNER=n
CONFIG_NCS_BOOT_BANNER=n

# Console
CONFIG_CONSOLE=n
CONFIG_UART_CONSOLE=n
CONFIG_STDOUT_CONSOLE=n
CONFIG_PRINTK=n
CONFIG_EARLY_CONSOLE=n

# Build
CONFIG_SIZE_OPTIMIZATIONS=y

# No timer support in the kernel
CONFIG_SYS_CLOCK_EXISTS=n

CONFIG_OUTPUT_DISASSEMBLY=y
CONFIG_COMMON_LIBC_MALLOC=n

CONFIG_COMPILER_OPT="-fshort-enums"
CONFIG_PBUF_RX_READ_BUF_SIZE=768
```
