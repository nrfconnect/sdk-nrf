## CMakeLists.txt
```
#
# Copyright (c) 2021 Nordic Semiconductor ASA
#
# SPDX-License-Identifier: LicenseRef-Nordic-5-Clause
#

cmake_minimum_required(VERSION 3.20.0)

find_package(Zephyr REQUIRED HINTS $ENV{ZEPHYR_BASE})
project(json_common_test)

set(ASSET_TRACKER_V2_DIR ../..)

test_runner_generate(src/main.c)

FILE(GLOB app_sources src/*.c)
target_sources(app PRIVATE ${app_sources})

target_include_directories(app PRIVATE
	${CMAKE_CURRENT_SOURCE_DIR}/src
	${ASSET_TRACKER_V2_DIR}/src/cloud/cloud_codec/
	${ZEPHYR_NRFXLIB_MODULE_DIR}/nrf_modem/include/)

target_sources(app PRIVATE
	${CMAKE_CURRENT_SOURCE_DIR}/mock/date_time_mock.c
	${ASSET_TRACKER_V2_DIR}/src/cloud/cloud_codec/json_common.c
	${ASSET_TRACKER_V2_DIR}/src/cloud/cloud_codec/json_helpers.c)

target_compile_options(app PRIVATE
	-DCONFIG_ASSET_TRACKER_V2_APP_VERSION_MAX_LEN=20
	-DCONFIG_MODEM_APN_LEN_MAX=1
	-DCONFIG_CLOUD_CODEC_LWM2M_PATH_LIST_ENTRIES_MAX=1
	-DCONFIG_CLOUD_CODEC_LWM2M_PATH_ENTRY_SIZE_MAX=1
	-DCONFIG_LTE_NEIGHBOR_CELLS_MAX=10
	-DCONFIG_LOCATION_METHOD_WIFI=y
	-DCONFIG_LOCATION_METHOD_WIFI_SCANNING_RESULTS_MAX_CNT=10
)

# The test uses double precision floating point numbers. This is not enabled by default in unity
# unless we set the following define.
zephyr_compile_definitions(UNITY_INCLUDE_DOUBLE)
```

## Kconfig
```
#
# Copyright (c) 2021 Nordic Semiconductor ASA
#
# SPDX-License-Identifier: LicenseRef-Nordic-5-Clause
#

menu "JSON common test"

rsource "../../src/cloud/cloud_codec/Kconfig"
source "Kconfig.zephyr"

endmenu
```

## prj.conf
```kconfig
#
# Copyright (c) 2021 Nordic Semiconductor ASA
#
# SPDX-License-Identifier: LicenseRef-Nordic-5-Clause
#

CONFIG_UNITY=y
CONFIG_MAIN_STACK_SIZE=4096

# cJSON
CONFIG_CJSON_LIB=y

# General
CONFIG_HEAP_MEM_POOL_SIZE=10700
CONFIG_PICOLIBC=y
CONFIG_PICOLIBC_IO_FLOAT=y
```

## prj_native_posix.conf
```kconfig
#
# Copyright (c) 2021 Nordic Semiconductor ASA
#
# SPDX-License-Identifier: LicenseRef-Nordic-5-Clause
#

# ZTEST
CONFIG_ZTEST=y

# cJSON
CONFIG_CJSON_LIB=y

# General
CONFIG_HEAP_MEM_POOL_SIZE=10700
```

## boards/native_posix.conf
```kconfig
#
# Copyright (c) 2021 Nordic Semiconductor ASA
#
# SPDX-License-Identifier: LicenseRef-Nordic-5-Clause
#

CONFIG_NEWLIB_LIBC=n
CONFIG_NEWLIB_LIBC_FLOAT_PRINTF=n
```

## src/json_validate.h
```c
/*
 * Copyright (c) 2021 Nordic Semiconductor ASA
 *
 * SPDX-License-Identifier: LicenseRef-Nordic-5-Clause
 */

#define TEST_VALIDATE_BATTERY_JSON_SCHEMA							\
				"{"								\
					"\"bat\":{"						\
						"\"v\":3600,"					\
						"\"ts\":1563968747123"				\
					"}"							\
				"}"

#define TEST_VALIDATE_GNSS_JSON_SCHEMA								\
				"{"								\
					"\"gnss\":{"						\
						"\"v\":{"					\
							"\"lat\":62,"				\
							"\"lng\":10,"				\
							"\"acc\":24,"				\
							"\"alt\":170,"				\
							"\"spd\":1,"				\
							"\"hdg\":176"				\
						"},"						\
						"\"ts\":1563968747123"				\
					"}"							\
				"}"

#define TEST_VALIDATE_ENVIRONMENTAL_JSON_SCHEMA							\
				"{"								\
					"\"env\":{"						\
						"\"v\":{"					\
							"\"temp\":23,"				\
							"\"hum\":50,"				\
							"\"atmp\":101,"				\
							"\"bsec_iaq\":50"			\
						"},"						\
						"\"ts\":1563968747123"				\
					"}"							\
				"}"

#define TEST_VALIDATE_ENVIRONMENTAL_JSON_SCHEMA_AIR_QUALITY_DISABLED				\
				"{"								\
					"\"env\":{"						\
						"\"v\":{"					\
							"\"temp\":23,"				\
							"\"hum\":50,"				\
							"\"atmp\":101"				\
						"},"						\
						"\"ts\":1563968747123"				\
					"}"							\
				"}"

#define TEST_VALIDATE_MODEM_DYNAMIC_JSON_SCHEMA							\
				"{"								\
					"\"roam\":{"						\
						"\"v\":{"					\
							"\"band\":3,"				\
							"\"nw\":\"NB-IoT\","			\
							"\"rsrp\":-8,"				\
							"\"area\":12,"				\
							"\"mccmnc\":24202,"			\
							"\"cell\":33703719,"			\
							"\"ip\":\"10.81.183.99\""		\
						"},"						\
						"\"ts\":1563968747123"				\
					"}"							\
				"}"

#define TEST_VALIDATE_MODEM_STATIC_JSON_SCHEMA							\
				"{"								\
					"\"dev\":{"						\
						"\"v\":{"					\
							"\"imei\":\"352656106111232\","		\
							"\"iccid\":\"89450421180216211234\","	\
							"\"modV\":\"mfw_nrf9160_1.2.3\","	\
							"\"brdV\":\"nrf9160dk_nrf9160\","	\
							"\"appV\":\"v1.0.0-development\""	\
						"},"						\
						"\"ts\":1563968747123"				\
					"}"							\
				"}"

#define TEST_VALIDATE_UI_JSON_SCHEMA								\
				"{"								\
					"\"btn\":{"						\
						"\"v\":1,"					\
						"\"ts\":1563968747123"				\
					"}"							\
				"}"

#define TEST_VALIDATE_IMPACT_JSON_SCHEMA							\
				"{"								\
					"\"impact\":{"						\
						"\"v\":300,"					\
						"\"ts\":1563968747123"				\
					"}"							\
				"}"

#define TEST_VALIDATE_NEIGHBOR_CELLS_JSON_SCHEMA						\
				"{"								\
					"\"lte\":{"						\
						"\"mcc\":242,"					\
						"\"mnc\":1,"					\
						"\"cell\":21679716,"				\
						"\"area\":40401,"				\
						"\"earfcn\":6446,"				\
						"\"adv\":80,"					\
						"\"rsrp\":-7,"					\
						"\"rsrq\":28,"					\
						"\"ts\":1563968747123,"				\
						"\"nmr\":["					\
							"{"					\
								"\"earfcn\":262143,"		\
								"\"cell\":501,"			\
								"\"rsrp\":-8,"			\
								"\"rsrq\":25"			\
							"},"					\
							"{"					\
								"\"earfcn\":262265,"		\
								"\"cell\":503,"			\
								"\"rsrp\":-5,"			\
								"\"rsrq\":20"			\
							"}"					\
						"]"						\
					"}"							\
				"}"

#define TEST_VALIDATE_WIFI_AP_JSON_DATA								\
				"{"								\
					"\"wifi\":{"						\
						"\"ts\":1563968747123,"				\
						"\"aps\":["					\
							"\"1300a5a0d29c\","			\
							"\"5c35b5c27b3e\","			\
							"\"7344f6c900cd\","			\
							"\"545e8d443d81\""			\
						"]"						\
					"}"							\
				"}"

#define TEST_VALIDATE_AGNSS_REQUEST_JSON_SCHEMA							\
				"{"								\
					"\"mcc\":242,"						\
					"\"mnc\":1,"						\
					"\"area\":40401,"					\
					"\"cell\":21679716,"					\
					"\"types\":["						\
						"1,"						\
						"2,"						\
						"3,"						\
						"4,"						\
						"5,"						\
						"6,"						\
						"7,"						\
						"8,"						\
						"9"						\
					"]"							\
				"}"

#define TEST_VALIDATE_PGPS_REQUEST_JSON_SCHEMA							\
				"{"								\
					"\"n\":42,"						\
					"\"int\":240,"						\
					"\"day\":15160,"					\
					"\"time\":40655"					\
				"}"

#define TEST_VALIDATE_ARRAY_BATTERY_JSON_SCHEMA							\
				"["								\
					"{"							\
						"\"v\":3600,"					\
						"\"ts\":1563968747123"				\
					"}"							\
				"]"

#define TEST_VALIDATE_ARRAY_GNSS_JSON_SCHEMA							\
				"["								\
					"{"							\
						"\"v\":{"					\
							"\"lat\":62,"				\
							"\"lng\":10,"				\
							"\"acc\":24,"				\
							"\"alt\":170,"				\
							"\"spd\":1,"				\
							"\"hdg\":176"				\
						"},"						\
						"\"ts\":1563968747123"				\
					"}"							\
				"]"

#define TEST_VALIDATE_ARRAY_GNSS_NO_HEADING_JSON_SCHEMA						\
				"["								\
					"{"							\
						"\"v\":{"					\
							"\"lat\":62,"				\
							"\"lng\":10,"				\
							"\"acc\":24,"				\
							"\"alt\":170,"				\
							"\"spd\":1"				\
						"},"						\
						"\"ts\":1563968747123"				\
					"}"							\
				"]"

#define TEST_VALIDATE_ARRAY_ENVIRONMENTAL_JSON_SCHEMA						\
				"["								\
					"{"							\
						"\"v\":{"					\
							"\"temp\":23,"				\
							"\"hum\":50,"				\
							"\"atmp\":101,"				\
							"\"bsec_iaq\":55"			\
						"},"						\
						"\"ts\":1563968747123"				\
					"}"							\
				"]"

#define TEST_VALIDATE_ARRAY_MODEM_DYNAMIC_JSON_SCHEMA						\
				"["								\
					"{"							\
						"\"v\":{"					\
							"\"band\":20,"				\
							"\"nw\":\"LTE-M\","			\
							"\"rsrp\":-8,"				\
							"\"area\":12,"				\
							"\"mccmnc\":24202,"			\
							"\"cell\":33703719,"			\
							"\"ip\":\"10.81.183.99\""		\
						"},"						\
						"\"ts\":1563968747123"				\
					"}"							\
				"]"

#define TEST_VALIDATE_ARRAY_MODEM_STATIC_JSON_SCHEMA						\
				"["								\
					"{"							\
						"\"v\":{"					\
							"\"imei\":\"352656106111232\","		\
							"\"iccid\":\"89450421180216211234\","	\
							"\"modV\":\"mfw_nrf9160_1.2.3\","	\
							"\"brdV\":\"nrf9160dk_nrf9160\","	\
							"\"appV\":\"v1.0.0-development\""	\
						"},"						\
						"\"ts\":1563968747123"				\
					"}"							\
				"]"

#define TEST_VALIDATE_ARRAY_UI_JSON_SCHEMA							\
				"["								\
					"{"							\
						"\"v\":1,"					\
						"\"ts\":1563968747123"				\
					"}"							\
				"]"

#define TEST_VALIDATE_ARRAY_IMPACT_JSON_SCHEMA							\
				"["								\
					"{"							\
						"\"v\":300,"					\
						"\"ts\":1563968747123"				\
					"}"							\
				"]"

#define TEST_VALIDATE_CONFIGURATION_JSON_SCHEMA							\
				"{"								\
					"\"cfg\":{"						\
						"\"act\":false,"				\
						"\"loct\":60,"					\
						"\"actwt\":120,"				\
						"\"mvres\":120,"				\
						"\"mvt\":3600,"					\
						"\"accath\":10,"				\
						"\"accith\":5,"					\
						"\"accito\":80,"				\
						"\"nod\":["					\
							"\"gnss\","				\
							"\"ncell\""				\
						"]"						\
					"}"							\
				"}"

#define TEST_VALIDATE_BATCH_JSON_SCHEMA								\
			"{"									\
				"\"bat\":["							\
					"{"							\
						"\"v\":3600,"					\
						"\"ts\":1563968747123"				\
					"},"							\
					"{"							\
						"\"v\":3600,"					\
						"\"ts\":1563968747123"				\
					"}"							\
				"],"								\
				"\"btn\":["							\
					"{"							\
						"\"v\":1,"					\
						"\"ts\":1563968747123"				\
					"},"							\
					"{"							\
						"\"v\":1,"					\
						"\"ts\":1563968747123"				\
					"}"							\
				"],"								\
				"\"impact\":["							\
					"{"							\
						"\"v\":300,"					\
						"\"ts\":1563968747123"				\
					"},"							\
					"{"							\
						"\"v\":300,"					\
						"\"ts\":1563968747123"				\
					"}"							\
				"],"								\
				"\"gnss\":["							\
					"{"							\
						"\"v\":{"					\
							"\"lat\":62,"				\
							"\"lng\":10,"				\
							"\"acc\":24,"				\
							"\"alt\":170,"				\
							"\"spd\":1,"				\
							"\"hdg\":176"				\
						"},"						\
						"\"ts\":1563968747123"				\
					"},"							\
					"{"							\
						"\"v\":{"					\
							"\"lat\":62,"				\
							"\"lng\":10,"				\
							"\"acc\":24,"				\
							"\"alt\":170,"				\
							"\"spd\":1,"				\
							"\"hdg\":176"				\
						"},"						\
						"\"ts\":1563968747123"				\
					"}"							\
				"],"								\
				"\"env\":["							\
					"{"							\
						"\"v\":{"					\
							"\"temp\":23,"				\
							"\"hum\":50,"				\
							"\"atmp\":80,"				\
							"\"bsec_iaq\":50"			\
						"},"						\
						"\"ts\":1563968747123"				\
					"},"							\
					"{"							\
						"\"v\":{"					\
							"\"temp\":23,"				\
							"\"hum\":50,"				\
							"\"atmp\":101,"				\
							"\"bsec_iaq\":55"			\
						"},"						\
						"\"ts\":1563968747123"				\
					"}"							\
				"],"								\
				"\"roam\":["							\
					"{"							\
						"\"v\":{"					\
							"\"band\":3,"				\
							"\"nw\":\"NB-IoT\","			\
							"\"rsrp\":-8,"				\
							"\"area\":12,"				\
							"\"mccmnc\":24202,"			\
							"\"cell\":33703719,"			\
							"\"ip\":\"10.81.183.99\""		\
						"},"						\
						"\"ts\":1563968747123"				\
					"},"							\
					"{"							\
						"\"v\":{"					\
							"\"band\":20,"				\
							"\"nw\":\"LTE-M\","			\
							"\"rsrp\":-5,"				\
							"\"area\":12,"				\
							"\"mccmnc\":24202,"			\
							"\"cell\":33703719,"			\
							"\"ip\":\"10.81.183.99\""		\
						"},"						\
						"\"ts\":1563968747123"				\
					"}"							\
				"],"								\
				"\"dev\":["							\
					"{"							\
						"\"v\":{"					\
							"\"imei\":\"352656106111232\","		\
							"\"iccid\":\"89450421180216211234\","	\
							"\"modV\":\"mfw_nrf9160_1.2.3\","	\
							"\"brdV\":\"nrf9160dk_nrf9160\","	\
							"\"appV\":\"v1.0.0-development\""	\
						"},"						\
						"\"ts\":1563968747123"				\
					"},"							\
					"{"							\
						"\"v\":{"					\
							"\"imei\":\"352656106111232\","		\
							"\"iccid\":\"89450421180216211234\","	\
							"\"modV\":\"mfw_nrf9160_1.2.3\","	\
							"\"brdV\":\"nrf9160dk_nrf9160\","	\
							"\"appV\":\"v1.0.0-development\""	\
						"},"						\
						"\"ts\":1563968747123"				\
					"}"							\
				"]"								\
			"}"
```

## src/json_validate_nrfcloud.h
```c
/*
 * Copyright (c) 2021 Nordic Semiconductor ASA
 *
 * SPDX-License-Identifier: LicenseRef-Nordic-5-Clause
 */

#define TEST_VALIDATE_BATTERY_JSON_SCHEMA\
				"{"\
					"\"batteryVoltage\":{"\
						"\"data\":3600,"\
						"\"ts\":1563968747123"\
					"}"\
				"}"

#define TEST_VALIDATE_GNSS_JSON_SCHEMA\
				"{"\
					"\"gnss\":{"\
						"\"data\":{"\
							"\"lng\":10,"\
							"\"lat\":62,"\
							"\"acc\":24,"\
							"\"alt\":170,"\
							"\"spd\":1,"\
							"\"hdg\":176"\
						"},"\
						"\"ts\":1563968747123"\
					"}"\
				"}"

#define TEST_VALIDATE_ENVIRONMENTAL_JSON_SCHEMA\
				"{"\
					"\"env\":{"\
						"\"data\":{"\
							"\"temp\":23,"\
							"\"hum\":50,"\
							"\"atmp\":101,"\
							"\"bsec_iaq\":50"\
						"},"\
						"\"ts\":1563968747123"\
					"}"\
				"}"

#define TEST_VALIDATE_ENVIRONMENTAL_JSON_SCHEMA_AIR_QUALITY_DISABLED\
				"{"\
					"\"env\":{"\
						"\"data\":{"\
							"\"temp\":23,"\
							"\"hum\":50,"\
							"\"atmp\":101"\
						"},"\
						"\"ts\":1563968747123"\
					"}"\
				"}"

#define TEST_VALIDATE_MODEM_DYNAMIC_JSON_SCHEMA\
				"{"\
					"\"networkInfo\":{"\
						"\"data\":{"\
							"\"currentBand\":3,"\
							"\"networkMode\":\"NB-IoT\","\
							"\"rsrp\":-8,"\
							"\"areaCode\":12,"\
							"\"mccmnc\":24202,"\
							"\"cellID\":33703719,"\
							"\"ipAddress\":\"10.81.183.99\""\
						"},"\
						"\"ts\":1563968747123"\
					"}"\
				"}"

#define TEST_VALIDATE_MODEM_STATIC_JSON_SCHEMA\
				"{"\
					"\"deviceInfo\":{"\
						"\"data\":{"\
							"\"imei\":\"352656106111232\","\
							"\"iccid\":\"89450421180216211234\","\
							"\"modemFirmware\":\"mfw_nrf9160_1.2.3\","\
							"\"board\":\"nrf9160dk_nrf9160\","\
							"\"appVersion\":\"v1.0.0-development\""\
						"},"\
						"\"ts\":1563968747123"\
					"}"\
				"}"

#define TEST_VALIDATE_UI_JSON_SCHEMA\
				"{"\
					"\"btn\":{"\
						"\"data\":1,"\
						"\"ts\":1563968747123"\
					"}"\
				"}"

#define TEST_VALIDATE_NEIGHBOR_CELLS_JSON_SCHEMA\
				"{"\
					"\"mcc\":242,"\
					"\"mnc\":1,"\
					"\"eci\":21679716,"\
					"\"tac\":40401,"\
					"\"earfcn\":6446,"\
					"\"adv\":80,"\
					"\"rsrp\":-7,"\
					"\"rsrq\":28,"\
					"\"ts\":1563968747123,"\
					"\"nmr\":["\
						"{"\
							"\"earfcn\":262143,"\
							"\"pci\":501,"\
							"\"rsrp\":-8,"\
							"\"rsrq\":25"\
						"},"\
						"{"\
							"\"earfcn\":262265,"\
							"\"pci\":503,"\
							"\"rsrp\":-5,"\
							"\"rsrq\":20"\
						"}"\
					"]"\
				"}"

#define TEST_VALIDATE_AGPS_REQUEST_JSON_SCHEMA\
				"{"\
					"\"mcc\":242,"\
					"\"mnc\":1,"\
					"\"area\":40401,"\
					"\"cell\":21679716,"\
					"\"types\":["\
						"1,"\
						"2,"\
						"3,"\
						"4,"\
						"6,"\
						"7,"\
						"8,"\
						"9"\
					"]"\
				"}"

#define TEST_VALIDATE_PGPS_REQUEST_JSON_SCHEMA\
				"{"\
					"\"n\":42,"\
					"\"int\":240,"\
					"\"day\":15160,"\
					"\"time\":40655"\
				"}"

#define TEST_VALIDATE_ACCELEROMETER_JSON_SCHEMA\
				"{"\
					"\"acc\":{"\
						"\"data\":{"\
							"\"x\":1,"\
							"\"y\":2,"\
							"\"z\":3"\
						"},"\
						"\"ts\":1563968747123"\
					"}"\
				"}"

#define TEST_VALIDATE_ARRAY_BATTERY_JSON_SCHEMA\
				"["\
					"{"\
						"\"data\":3600,"\
						"\"ts\":1563968747123"\
					"}"\
				"]"

#define TEST_VALIDATE_ARRAY_GNSS_JSON_SCHEMA\
				"["\
					"{"\
						"\"data\":{"\
							"\"lng\":10,"\
							"\"lat\":62,"\
							"\"acc\":24,"\
							"\"alt\":170,"\
							"\"spd\":1,"\
							"\"hdg\":176"\
						"},"\
						"\"ts\":1563968747123"\
					"}"\
				"]"

#define TEST_VALIDATE_ARRAY_ENVIRONMENTAL_JSON_SCHEMA\
				"["\
					"{"\
						"\"data\":{"\
							"\"temp\":23,"\
							"\"hum\":50,"\
							"\"atmp\":101,"\
							"\"bsec_iaq\":55"\
						"},"\
						"\"ts\":1563968747123"\
					"}"\
				"]"

#define TEST_VALIDATE_ARRAY_MODEM_DYNAMIC_JSON_SCHEMA\
				"["\
					"{"\
						"\"data\":{"\
							"\"currentBand\":20,"\
							"\"networkMode\":\"LTE-M\","\
							"\"rsrp\":-8,"\
							"\"areaCode\":12,"\
							"\"mccmnc\":24202,"\
							"\"cellID\":33703719,"\
							"\"ipAddress\":\"10.81.183.99\""\
						"},"\
						"\"ts\":1563968747123"\
					"}"\
				"]"

#define TEST_VALIDATE_ARRAY_MODEM_STATIC_JSON_SCHEMA\
				"["\
					"{"\
						"\"data\":{"\
							"\"imei\":\"352656106111232\","\
							"\"iccid\":\"89450421180216211234\","\
							"\"modemFirmware\":\"mfw_nrf9160_1.2.3\","\
							"\"board\":\"nrf9160dk_nrf9160\","\
							"\"appVersion\":\"v1.0.0-development\""\
						"},"\
						"\"ts\":1563968747123"\
					"}"\
				"]"

#define TEST_VALIDATE_ARRAY_UI_JSON_SCHEMA\
				"["\
					"{"\
						"\"data\":1,"\
						"\"ts\":1563968747123"\
					"}"\
				"]"

#define TEST_VALIDATE_ARRAY_ACCELEROMETER_JSON_SCHEMA\
				"["\
					"{"\
						"\"data\":{"\
							"\"x\":1,"\
							"\"y\":2,"\
							"\"z\":3"\
						"},"\
						"\"ts\":1563968747123"\
					"}"\
				"]"

#define TEST_VALIDATE_CONFIGURATION_JSON_SCHEMA\
				"{"\
					"\"config\":{"\
						"\"activeMode\":false,"\
						"\"gnssTimeout\":60,"\
						"\"activeWaitTime\":120,"\
						"\"movementResolution\":120,"\
						"\"movementTimeout\":3600,"\
						"\"movementThreshold\":2,"\
						"\"nod\":["\
							"\"gnss\","\
							"\"ncell\""\
						"]"\
					"}"\
				"}"

#define TEST_VALIDATE_BATCH_JSON_SCHEMA\
			"{"\
				"\"batteryVoltage\":["\
					"{"\
						"\"data\":3600,"\
						"\"ts\":1563968747123"\
					"},"\
					"{"\
						"\"data\":3600,"\
						"\"ts\":1563968747123"\
					"}"\
				"],"\
				"\"btn\":["\
					"{"\
						"\"data\":1,"\
						"\"ts\":1563968747123"\
					"},"\
					"{"\
						"\"data\":1,"\
						"\"ts\":1563968747123"\
					"}"\
				"],"\
				"\"gnss\":["\
					"{"\
						"\"data\":{"\
							"\"lng\":10,"\
							"\"lat\":62,"\
							"\"acc\":24,"\
							"\"alt\":170,"\
							"\"spd\":1,"\
							"\"hdg\":176"\
						"},"\
						"\"ts\":1563968747123"\
					"},"\
					"{"\
						"\"data\":{"\
							"\"lng\":10,"\
							"\"lat\":62,"\
							"\"acc\":24,"\
							"\"alt\":170,"\
							"\"spd\":1,"\
							"\"hdg\":176"\
						"},"\
						"\"ts\":1563968747123"\
					"}"\
				"],"\
				"\"env\":["\
					"{"\
						"\"data\":{"\
							"\"temp\":23,"\
							"\"hum\":50,"\
							"\"atmp\":80,"\
							"\"bsec_iaq\":50"\
						"},"\
						"\"ts\":1563968747123"\
					"},"\
					"{"\
						"\"data\":{"\
							"\"temp\":23,"\
							"\"hum\":50,"\
							"\"atmp\":101,"\
							"\"bsec_iaq\":55"\
						"},"\
						"\"ts\":1563968747123"\
					"}"\
				"],"\
				"\"acc\":["\
					"{"\
						"\"data\":{"\
							"\"x\":1,"\
							"\"y\":2,"\
							"\"z\":3"\
						"},"\
						"\"ts\":1563968747123"\
					"},"\
					"{"\
						"\"data\":{"\
							"\"x\":1,"\
							"\"y\":2,"\
							"\"z\":3"\
						"},"\
						"\"ts\":1563968747123"\
					"}"\
				"],"\
				"\"networkInfo\":["\
					"{"\
						"\"data\":{"\
							"\"currentBand\":3,"\
							"\"networkMode\":\"NB-IoT\","\
							"\"rsrp\":-8,"\
							"\"areaCode\":12,"\
							"\"mccmnc\":24202,"\
							"\"cellID\":33703719,"\
							"\"ipAddress\":\"10.81.183.99\""\
						"},"\
						"\"ts\":1563968747123"\
					"},"\
					"{"\
						"\"data\":{"\
							"\"currentBand\":20,"\
							"\"networkMode\":\"LTE-M\","\
							"\"rsrp\":-5,"\
							"\"areaCode\":12,"\
							"\"mccmnc\":24202,"\
							"\"cellID\":33703719,"\
							"\"ipAddress\":\"10.81.183.99\""\
						"},"\
						"\"ts\":1563968747123"\
					"}"\
				"],"\
				"\"deviceInfo\":["\
					"{"\
						"\"data\":{"\
							"\"imei\":\"352656106111232\","\
							"\"iccid\":\"89450421180216211234\","\
							"\"modemFirmware\":\"mfw_nrf9160_1.2.3\","\
							"\"board\":\"nrf9160dk_nrf9160\","\
							"\"appVersion\":\"v1.0.0-development\""\
						"},"\
						"\"ts\":1563968747123"\
					"},"\
					"{"\
						"\"data\":{"\
							"\"imei\":\"352656106111232\","\
							"\"iccid\":\"89450421180216211234\","\
							"\"modemFirmware\":\"mfw_nrf9160_1.2.3\","\
							"\"board\":\"nrf9160dk_nrf9160\","\
							"\"appVersion\":\"v1.0.0-development\""\
						"},"\
						"\"ts\":1563968747123"\
					"}"\
				"]"\
			"}"
```
