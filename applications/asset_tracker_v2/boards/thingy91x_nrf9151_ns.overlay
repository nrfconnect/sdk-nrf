/*
 * Copyright (c) 2024 Nordic Semiconductor ASA
 *
 * SPDX-License-Identifier: LicenseRef-Nordic-5-Clause
 */

#include <thingy91x_wifi.dtsi>

/ {
	aliases {
		temp-sensor = &bme680;
		humidity-sensor = &bme680;
		pressure-sensor = &bme680;
		iaq-sensor = &bme680;
		accelerometer = &accelerometer_lp;
		ext-flash = &flash_ext;
	};
};

&accelerometer_lp {
	status = "okay";
	odr = < 5 >;
};

&bme680 {
	status = "okay";
};
