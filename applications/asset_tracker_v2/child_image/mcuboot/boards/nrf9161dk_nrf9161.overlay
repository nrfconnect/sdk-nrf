/*
 * Copyright (c) 2023 Nordic Semiconductor ASA
 *
 * SPDX-License-Identifier: LicenseRef-Nordic-5-Clause
 */

&gd25wb256 {
	status = "okay";
};

/ {
	/* Configure partition manager to use gd25wb256 as the external flash */
	chosen {
		nordic,pm-ext-flash = &gd25wb256;
	};
};
