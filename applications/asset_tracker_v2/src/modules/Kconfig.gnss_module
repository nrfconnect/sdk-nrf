## applications/asset_tracker_v2/src/modules/Kconfig.gnss_module
```kconfig
#
# Copyright (c) 2021 Nordic Semiconductor
#
# SPDX-License-Identifier: LicenseRef-Nordic-5-Clause
#

menuconfig GNSS_MODULE
	bool "GNSS module"
	select DATE_TIME
	default y

if GNSS_MODULE

choice GNSS_MODULE_DATA_FORMAT
	prompt "Select GNSS data format"
	default GNSS_MODULE_PVT

config GNSS_MODULE_PVT
	bool "Include PVT data in GNSS fix event"
	help
	  PVT stands for position, velocity, and time.
	  The GNSS data will be included as a struct in the GNSS_EVT_DATA_READY event propagated by this module upon a fix.

config GNSS_MODULE_NMEA
	bool "Include NMEA data in GNSS fix event"
	help
	  NMEA is a defined ASCII representation of GNSS data.
	  The GNSS data will be included as a string in the GNSS_EVT_DATA_READY event.

endchoice

config GNSS_MODULE_PGPS_STORE_LOCATION
	bool "Store location to modem upon fix"
	help
	  If this option is enabled. The location of the device is stored to flash upon every GNSS
	  fix. This can shorten the first time to fix for semi-stationary applications by injecting
	  the last known location, current time and relevant predicted ephemerides to the
	  modem upon boot.
	  Note that this may also increase flash wear.

config GNSS_MODULE_AGPS_FILTERED
	bool "Request only visible satellite ephemerides"
	default NRF_CLOUD_AGPS_FILTERED
	depends on NRF_CLOUD_AGPS_FILTERED

config GNSS_MODULE_ELEVATION_MASK
	int "Minimum elevation angle for visible satellites"
	default NRF_CLOUD_AGPS_ELEVATION_MASK
	depends on NRF_CLOUD_AGPS_FILTERED

choice GNSS_MODULE_DYNAMICS_MODE
	prompt "Tune GNSS performance for a specific use case"
	default GNSS_MODULE_DYNAMICS_MODE_GENERAL_PURPOSE
	help
	  Dynamics mode can be used to tune GNSS performance for a specific use case.
	  Use of a matching dynamics mode improves the positioning performance.

config GNSS_MODULE_DYNAMICS_MODE_GENERAL_PURPOSE
	bool "General purpose mode."

config GNSS_MODULE_DYNAMICS_MODE_STATIONARY
	bool "Optimize for stationary use case."

config GNSS_MODULE_DYNAMICS_MODE_PEDESTRIAN
	bool "Optimize for pedestrian use case."

config GNSS_MODULE_DYNAMICS_MODE_AUTOMOTIVE
	bool "Optimize for automotive use case."
endchoice

config GNSS_MODULE_ALLOW_LOW_ACCURACY
	bool "Allow for low accuracy fixes using as few as three satellites."
	default n

config GNSS_MODULE_DISABLE_SCHED_DOWNLOAD
	bool "Disable scheduled downloads of ephemerides and almanacs."
	default n
	help
	  Should only be used with A-GPS. Otherwise, GNSS will never get some data
	  (for example ionospheric corrections), which may affect the accuracy.

endif # GNSS_MODULE

module = GNSS_MODULE
module-str = GNSS module
source "subsys/logging/Kconfig.template.log_config"
```

## applications/asset_tracker_v2/src/modules/Kconfig.gps_module
```kconfig
#
# Copyright (c) 2021 Nordic Semiconductor
#
# SPDX-License-Identifier: LicenseRef-Nordic-5-Clause
#

menuconfig GPS_MODULE
	bool "GPS module"
	select DATE_TIME
	default y

if GPS_MODULE

choice
	prompt "Select GNSS data format"
	default GPS_MODULE_PVT

config GPS_MODULE_PVT
	bool "Include PVT data in GNSS fix event"

config GPS_MODULE_NMEA
	bool "Include NMEA data in GNSS fix event"

endchoice

config GPS_MODULE_PGPS_STORE_LOCATION
	bool "Store location to modem upon fix"
	help
	  If this option is enabled. The location of the device is stored to flash upon every GNSS
	  fix. This can shorten the first time to fix for semi-stationary applications by injecting
	  the last known location, current time and relevant predicted ephemerides to the
	  modem upon boot.

choice GPS_MODULE_ANTENNA
	default GPS_MODULE_ANTENNA_ONBOARD
	prompt "Select which antenna to use for GNSS"

config GPS_MODULE_ANTENNA_ONBOARD
	bool "Use onboard antenna"

config GPS_MODULE_ANTENNA_EXTERNAL
	bool "Use external antenna"

endchoice

config GPS_MODULE_AT_MAGPIO
	string "AT%XMAGPIO command"
	default "AT\%XMAGPIO=1,0,0,1,1,1574,1577" if BOARD_NRF9160DK_NRF9160_NS
	default "AT\%XMAGPIO=1,1,1,7,1,746,803,2,698,748,2,1710,2200,3,824,894,4,880,960,5,791,849,7,1565,1586" if BOARD_THINGY91_NRF9160_NS
	help
	  Defines what is the AT%XMAGPIO command to be sent to GNSS module. Leave
	  empty if this command should not be sent.

config GPS_MODULE_AT_COEX0
	string "AT%XCOEX0 command"
	default "AT\%XCOEX0=1,1,1565,1586" if (BOARD_NRF9160DK_NRF9160_NS || BOARD_THINGY91_NRF9160_NS) && GPS_MODULE_ANTENNA_ONBOARD
	default "AT\%XCOEX0" if (BOARD_NRF9160DK_NRF9160_NS || BOARD_THINGY91_NRF9160_NS) && GPS_MODULE_ANTENNA_EXTERNAL
	help
	  Defines what is the AT%XCOEX0 command to be sent to GNSS module. Leave
	  empty if this command should not be sent.

endif # GPS_MODULE

module = GPS_MODULE
module-str = GPS module
source "subsys/logging/Kconfig.template.log_config"
```

## applications/asset_tracker_v2/src/modules/Kconfig.led_module
```kconfig
#
# Copyright (c) 2021 Nordic Semiconductor
#
# SPDX-License-Identifier: LicenseRef-Nordic-5-Clause
#

menuconfig LED_CONTROL
	bool "LED control library"
	depends on CAF_LEDS
	default y

config LED_STATE_DEF_PATH
	string "Configuration file"
	default "led_state_def.h"
	help
	  Location of configuration file for led_state_def file.

if CAF_LEDS

choice CAF_LEDS_OUTPUT
	prompt "Select LED driver"
	default CAF_LEDS_PWM if BOARD_THINGY91_NRF9160_NS
	default CAF_LEDS_GPIO

endchoice

endif

module = LED_CONTROL
module-str = LED control library
source "subsys/logging/Kconfig.template.log_config"
```

## applications/asset_tracker_v2/src/modules/Kconfig.location_module
```kconfig
#
# Copyright (c) 2022 Nordic Semiconductor
#
# SPDX-License-Identifier: LicenseRef-Nordic-5-Clause
#

menuconfig LOCATION_MODULE
	bool "Location module"
	select LOCATION
	select LOCATION_SERVICE_EXTERNAL
	default y

if LOCATION_MODULE

config LOCATION_MODULE_NEIGHBOR_CELLS_DATA_CONVERT_RSRP_TO_DBM
	bool "Convert RSRP values to dBm for neighbor cell measurements"
	default y if AWS_IOT || AZURE_IOT_HUB
	help
	  If this option is enabled, RSRP values are converted to dBm before being
	  sent out by the module with the LOCATION_MODULE_EVT_NEIGHBOR_CELLS_DATA_READY event.
	  Don't convert RSRP to dBm when building for nRF Cloud, this is handled during encoding
	  using the nRF Cloud cellular positioning library.

config LOCATION_MODULE_NEIGHBOR_CELLS_DATA_CONVERT_RSRQ_TO_DB
	bool "Convert RSRQ values to dB for neighbor cell measurements"
	default y if AWS_IOT || AZURE_IOT_HUB
	help
	  If this option is enabled, RSRQ values are converted to dB before being
	  sent out by the module with the LOCATION_MODULE_EVT_NEIGHBOR_CELLS_DATA_READY event.
	  Don't convert RSRQ to dB when building for nRF Cloud, this is handled during encoding
	  using the nRF Cloud cellular positioning library.

# When a dedicated partition is used for P-GPS, the partition size and the number of predictions
# needs to be decreased from the default values to fit in flash
config NRF_CLOUD_PGPS_PARTITION_SIZE
	default 0x10000 if NRF_CLOUD_PGPS_STORAGE_PARTITION

config NRF_CLOUD_PGPS_NUM_PREDICTIONS
	default 32 if NRF_CLOUD_PGPS_STORAGE_PARTITION

module = LOCATION_MODULE
module-str = Location module
source "subsys/logging/Kconfig.template.log_config"

endif # LOCATION_MODULE
```

## applications/asset_tracker_v2/src/modules/Kconfig.modem_module
```kconfig
#
# Copyright (c) 2021 Nordic Semiconductor
#
# SPDX-License-Identifier: LicenseRef-Nordic-5-Clause
#

menuconfig MODEM_MODULE
	bool "Modem module"
	select LTE_LINK_CONTROL
	select PDN
	select PDN_ESM_STRERROR
	select MODEM_INFO
	default y

if MODEM_MODULE

config MODEM_THREAD_STACK_SIZE
	int "Modem module thread stack size"
	default 2048

config MODEM_DYNAMIC_DATA_CONVERT_RSRP_TO_DBM
	bool "Convert RSRP values to dBm for dynamic modem data"
	default y
	help
	  If this option is enabled, RSRP values are converted to dBm before being
	  sent out by the module with the MODEM_EVT_MODEM_DYNAMIC_DATA_READY event.

endif # MODEM_MODULE

# Since this configuration is used in the module's event header file, it cannot be guarded
# by the CONFIG_MODEM_MODULE option. This file can be included in modules even if the source file
# of the module it self is not included.

config MODEM_APN_LEN_MAX
	int "APN maximum length"
	default 30
	help
	  Maximum size of APN (Access Point Name) included in MODEM_EVT_MODEM_DYNAMIC_DATA_READY
	  events.

module = MODEM_MODULE
module-str = Modem module
source "subsys/logging/Kconfig.template.log_config"
```

## applications/asset_tracker_v2/src/modules/Kconfig.modules_common
```kconfig
#
# Copyright (c) 2021 Nordic Semiconductor
#
# SPDX-License-Identifier: LicenseRef-Nordic-5-Clause
#

module = MODULES_COMMON
module-str = Common modules
source "subsys/logging/Kconfig.template.log_config"
```

## applications/asset_tracker_v2/src/modules/Kconfig.sensor_module
```kconfig
#
# Copyright (c) 2021 Nordic Semiconductor
#
# SPDX-License-Identifier: LicenseRef-Nordic-5-Clause
#

menuconfig SENSOR_MODULE
	bool "Sensor module"
	select EXTERNAL_SENSORS if BOARD_THINGY91_NRF9160_NS
	default y

if SENSOR_MODULE

config SENSOR_THREAD_STACK_SIZE
	int "Sensor module thread stack size"
	default 4096 if EXTERNAL_SENSORS_BME680_BSEC
	default 1280

rsource "../ext_sensors/Kconfig"

endif # SENSOR_MODULE

module = SENSOR_MODULE
module-str = Sensor module
source "subsys/logging/Kconfig.template.log_config"
```

## applications/asset_tracker_v2/src/modules/Kconfig.ui_module
```kconfig
#
# Copyright (c) 2021 Nordic Semiconductor
#
# SPDX-License-Identifier: LicenseRef-Nordic-5-Clause
#

menuconfig UI_MODULE
	bool "User Interface module"
	select DK_LIBRARY
	default y

if UI_MODULE

config UI_THREAD_STACK_SIZE
	int "UI module thread stack size"
	default 512

rsource "../led/Kconfig"

endif # UI_MODULE

module = UI_MODULE
module-str = User Interface module
source "subsys/logging/Kconfig.template.log_config"
```

## applications/asset_tracker_v2/src/modules/Kconfig.util_module
```kconfig
#
# Copyright (c) 2021 Nordic Semiconductor
#
# SPDX-License-Identifier: LicenseRef-Nordic-5-Clause
#

menuconfig UTIL_MODULE
	bool "Utility module"
	default y

if UTIL_MODULE

config REBOOT_TIMEOUT
	int "Irrecoverable error reboot timeout"
	default 30
	help
	 This option specifies the timeout after an irrecoverable error has been reported to the
	 utility module, that the module will initiate a reboot. However, If all modules acknowledge
	 the utility module's shutdown request before this timeout expires,
	 the reboot will occur earlier.

endif # UTIL_MODULE

module = UTIL_MODULE
module-str = Utility module
source "subsys/logging/Kconfig.template.log_config"
```

## applications/asset_tracker_v2/src/watchdog/Kconfig
```kconfig
#
# Copyright (c) 2021 Nordic Semiconductor
#
# SPDX-License-Identifier: LicenseRef-Nordic-5-Clause
#

menuconfig WATCHDOG_APPLICATION
	bool "Application watchdog"
	select WATCHDOG
	default y

if WATCHDOG_APPLICATION

config WATCHDOG_APPLICATION_TIMEOUT_SEC
	int "Application watchdog timeout in seconds"
	default 60

endif # WATCHDOG_APPLICATION

module = WATCHDOG
module-str = Watchdog
source "subsys/logging/Kconfig.template.log_config"
```

## applications/asset_tracker_v2/sysbuild/mcuboot/boards/nrf9151dk_nrf9151.conf
```kconfig
#
# Copyright (c) 2024 Nordic Semiconductor ASA
#
# SPDX-License-Identifier: LicenseRef-Nordic-5-Clause
#

# MCUboot config to enable secondary slot on the external flash

CONFIG_FLASH=y
CONFIG_SPI=y
CONFIG_SPI_NOR=y
CONFIG_SPI_NOR_FLASH_LAYOUT_PAGE_SIZE=4096
CONFIG_SPI_NOR_SFDP_DEVICETREE=y

CONFIG_PM_PARTITION_SIZE_MCUBOOT=0x13E00
CONFIG_PM_OVERRIDE_EXTERNAL_DRIVER_CHECK=y

CONFIG_MULTITHREADING=y
CONFIG_MAIN_STACK_SIZE=2048
CONFIG_BOOT_MAX_IMG_SECTORS=256
```

## applications/asset_tracker_v2/tests/debug_module/boards/native_posix.conf
```kconfig
#
# Copyright (c) 2023 Nordic Semiconductor ASA
#
# SPDX-License-Identifier: LicenseRef-Nordic-5-Clause
#
CONFIG_EXTERNAL_LIBC=y
```

## applications/asset_tracker_v2/tests/debug_module/boards/nrf9160dk_nrf9160_ns.conf
```kconfig
# The following option is required to silence the linker warning about orphan
# sections. The event manager header files uses orphan sections.
CONFIG_LINKER_ORPHAN_SECTION_PLACE=y
```

## applications/asset_tracker_v2/tests/debug_module/testcase.yaml
```yaml
tests:
  asset_tracker_v2.debug_module_test.tester:
    sysbuild: true
    platform_allow:
      - native_sim
    integration_platforms:
      - native_sim
    tags:
      - debug_module
      - sysbuild
      - ci_applications_asset_tracker_v2
```

## applications/asset_tracker_v2/tests/gps_module/Kconfig
```kconfig
# Config options for logger sample app
#
# Copyright (c) 2021 Nordic Semiconductor ASA
#
# SPDX-License-Identifier: LicenseRef-Nordic-5-Clause
#

mainmenu "GPS Module unity test"

menu "GPS Module configuration"

config UUT_PARAM_CHECK
	bool "Enabled function parameter check"

endmenu

source "Kconfig.zephyr"
```

## applications/asset_tracker_v2/tests/gps_module/testcase.yaml
```yaml
tests:
  asset_tracker_v2.gps_module_test.tester:
    platform_allow: native_posix qemu_cortex_m3 nrf9160dk_nrf9160_ns
    tags: gps_module
```

## applications/asset_tracker_v2/tests/json_common/Kconfig
```kconfig
#
# Copyright (c) 2021 Nordic Semiconductor ASA
#
# SPDX-License-Identifier: LicenseRef-Nordic-5-Clause
#

menu "JSON common test"

rsource "../../src/cloud/cloud_codec/Kconfig"
source "Kconfig.zephyr"

endmenu
```

## applications/asset_tracker_v2/tests/json_common/testcase.yaml
```yaml
tests:
  applications.asset_tracker_v2.cloud.cloud_codec.json_common.aws:
    sysbuild: true
    platform_allow: nrf9160dk/nrf9160 native_sim qemu_cortex_m3
    integration_platforms:
      - nrf9160dk/nrf9160
      - native_sim
      - qemu_cortex_m3
    tags: json_common_test-aws sysbuild
    extra_configs:
      - CONFIG_CLOUD_CODEC_AWS_IOT=y
  applications.asset_tracker_v2.cloud.cloud_codec.json_common.azure:
    sysbuild: true
    platform_allow: nrf9160dk/nrf9160 native_sim qemu_cortex_m3
    integration_platforms:
      - nrf9160dk/nrf9160
      - native_sim
      - qemu_cortex_m3
    tags: json_common_test-azure sysbuild
    extra_configs:
      - CONFIG_CLOUD_CODEC_AZURE_IOT_HUB=y
```

## applications/asset_tracker_v2/tests/location_module/Kconfig
```kconfig
# Config options for Location module test
#
# Copyright (c) 2022 Nordic Semiconductor ASA
#
# SPDX-License-Identifier: LicenseRef-Nordic-5-Clause
#
source "Kconfig.zephyr"
```

## applications/asset_tracker_v2/tests/location_module/boards/native_posix.conf
```kconfig
#
# Copyright (c) 2022 Nordic Semiconductor ASA
#
# SPDX-License-Identifier: LicenseRef-Nordic-5-Clause
#
CONFIG_EXTERNAL_LIBC=y
```

## applications/asset_tracker_v2/tests/location_module/testcase.yaml
```yaml
tests:
  asset_tracker_v2.location_module_test.tester:
    sysbuild: true
    platform_allow:
      - native_sim
    integration_platforms:
      - native_sim
    tags:
      - location_module
      - sysbuild
      - ci_applications_asset_tracker_v2
```

## applications/asset_tracker_v2/tests/lwm2m_integration/testcase.yaml
```yaml
tests:
  asset_tracker_v2.lwm2m_integration:
    sysbuild: true
    platform_allow:
      - native_sim
    integration_platforms:
      - native_sim
    tags:
      - lwm2m_integration
      - sysbuild
      - ci_applications_asset_tracker_v2
```

## applications/asset_tracker_v2/tests/modules_common/testcase.yaml
```yaml
tests:
  applications.asset_tracker_v2.modules_common:
    platform_allow: nrf9160dk_nrf9160 native_posix qemu_cortex_m3
    integration_platforms:
      - nrf9160dk_nrf9160
      - native_posix
      - qemu_cortex_m3
    tags: modules_common_test
```

## applications/asset_tracker_v2/tests/nrf_cloud_codec/testcase.yaml
```yaml
tests:
  asset_tracker_v2.nrf_cloud_codec_test:
    sysbuild: true
    platform_allow:
      - native_sim
    integration_platforms:
      - native_sim
    tags:
      - nrf_cloud_codec
      - sysbuild
      - ci_applications_asset_tracker_v2
```
