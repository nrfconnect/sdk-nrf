## CMakeLists.txt
```
cmake_minimum_required(VERSION 3.20.0)

# Set your project name here
set(APP_NAME my_uart_logging_app)

find_package(Zephyr REQUIRED HINTS $ENV{ZEPHYR_BASE})
project(reproduce_conn_bridge_uart)

# Add your source files here
target_sources(app PRIVATE src/main.c)


#cmake_minimum_required(VERSION 3.20.0)

#find_package(Zephyr REQUIRED HINTS $ENV{ZEPHYR_BASE})
#project(reproduce)
#zephyr_compile_definitions(PROJECT_NAME=${PROJECT_NAME})

# NORDIC SDK APP START
#target_sources(app PRIVATE src/main.c)
# NORDIC SDK APP END

# Application sources
#add_subdirectory(src)
```

## Kconfig.sysbuild
```
#
# Copyright (c) 2023 Nordic Semiconductor
#
# SPDX-License-Identifier: LicenseRef-Nordic-5-Clause
#

choice BOOTLOADER
	default BOOTLOADER_MCUBOOT if !BOARD_NATIVE_SIM
endchoice

config SECURE_BOOT_APPCORE
	default y if BOARD_NRF9160DK_NRF9160_NS \
		|| BOARD_NRF9151DK_NRF9151_NS \
		|| BOARD_NRF9161DK_NRF9161_NS

config WIFI_NRF700X
	default y if BOARD_THINGY91X_NRF9151_NS

config PM_EXTERNAL_FLASH_MCUBOOT_SECONDARY
	default y if BOARD_NRF9151DK_NRF9151_NS || BOARD_NRF9161DK_NRF9161_NS
	default y if BOARD_NRF9160DK_NRF9160_NS \
		&& "${BOARD_REVISION}" != "0.1.0" \
		&& "${BOARD_REVISION}" != "0.7.0" \
		&& "${BOARD_REVISION}" != "0.7.1" \
		&& "${BOARD_REVISION}" != "0.8.0" \
		&& "${BOARD_REVISION}" != "0.8.2" \
		&& "${BOARD_REVISION}" != "0.8.3" \
		&& "${BOARD_REVISION}" != "0.8.5" \
		&& "${BOARD_REVISION}" != "0.9.0"

source "${ZEPHYR_BASE}/share/sysbuild/Kconfig"
```

## prj.conf
```kconfig
# Enable UART
CONFIG_SERIAL=y
# CONFIG_UART_CONSOLE=y

# Enable logging
#CONFIG_LOG=y
#CONFIG_LOG_MODE_IMMEDIATE=y

# CONFIG_NEWLIB_LIBC=y

# Optional: Reduce the size of the log buffer
# CONFIG_LOG_BUFFER_SIZE=512

# Enable required device drivers
#CONFIG_SERIAL_SUPPORT_ASYNC=y
#CONFIG_UART=y
CONFIG_UART_ASYNC_API=y
CONFIG_UART_0_ASYNC=y
CONFIG_UART_0_INTERRUPT_DRIVEN=n
CONFIG_UART_1_ASYNC=y
CONFIG_UART_1_INTERRUPT_DRIVEN=n

CONFIG_HEAP_MEM_POOL_SIZE=2048
CONFIG_MAIN_STACK_SIZE=4096
CONFIG_SYSTEM_WORKQUEUE_STACK_SIZE=4096

CONFIG_SECURE_BOOT=n
CONFIG_BUILD_S1_VARIANT=n

CONFIG_REBOOT=y

#CONFIG_TFM_LOG_LEVEL_SILENCE=y
```

## boards/thingy91_nrf9160_ns.overlay
```dts
/ {
	aliases {
		log-uart = &uart0;
		extra-uart = &uart1;
	};
};

&uart1 {
	status = "okay";
};
```

## src/main.c
```c
#include <zephyr/kernel.h>
#include <zephyr/device.h>
#include <zephyr/drivers/uart.h>
#include <zephyr/sys/printk.h>
#include <zephyr/sys/reboot.h>
#include <zephyr/logging/log.h>

LOG_MODULE_REGISTER(main);

#define LOG_INTERVAL_MS 10

static const struct device *log_uart_dev = DEVICE_DT_GET(DT_ALIAS(log_uart));
static const struct device *extra_uart_dev = DEVICE_DT_GET(DT_ALIAS(extra_uart));

static K_SEM_DEFINE(log_uart_tx_sem, 0, 1);
static K_SEM_DEFINE(extra_uart_tx_sem, 0, 1);

void callback(const struct device *dev, struct uart_event *evt, void *user_data)
{
	ARG_UNUSED(user_data);

	if (evt->type == UART_TX_DONE || evt->type == UART_TX_ABORTED) {
		if (dev == log_uart_dev) {
			k_sem_give(&log_uart_tx_sem);
		} else if (dev == extra_uart_dev) {
			k_sem_give(&extra_uart_tx_sem);
		}
	}
}

int main(void)
{
	int err;

	LOG_INF("UART log test");

	BUILD_ASSERT(IS_ENABLED(CONFIG_UART_ASYNC_API));

	if (!device_is_ready(log_uart_dev)) {
		LOG_ERR("UART0 is not ready");
		return 1;
	}

	if (!device_is_ready(extra_uart_dev)) {
		LOG_ERR("UART1 is not ready");
		return 1;
	}

	err = uart_callback_set(log_uart_dev, callback, NULL);
	if (err) {
		LOG_ERR("uart_callback_set err, %d", err);
		return 1;
	}

	err = uart_callback_set(extra_uart_dev, callback, NULL);
	if (err) {
		LOG_ERR("uart_callback_set err, %d", err);
		return 1;
	}

	int app_counter = 0;
	int trace_counter = 0;

	k_sem_give(&log_uart_tx_sem);
	k_sem_give(&extra_uart_tx_sem);

	while (trace_counter < 500) {
		char app_log_msg[32];
		char trace_log_msg[32];

		int app_len = snprintf(app_log_msg, sizeof(app_log_msg), "app log %d\r\n",
			app_counter++);
		k_sem_take(&log_uart_tx_sem, K_FOREVER);
		uart_tx(log_uart_dev, app_log_msg, app_len, SYS_FOREVER_MS);

		int trace_len = snprintf(trace_log_msg, sizeof(trace_log_msg), "trace log %d\r\n",
			trace_counter++);
		k_sem_take(&extra_uart_tx_sem, K_FOREVER);
		uart_tx(extra_uart_dev, trace_log_msg, trace_len, SYS_FOREVER_MS);

		k_msleep(LOG_INTERVAL_MS);
	}

	sys_reboot(SYS_REBOOT_WARM);

	return 0;
}
```
