## CMakeLists.txt
```
#
# Copyright (c) 2024 Nordic Semiconductor ASA
#
# SPDX-License-Identifier: LicenseRef-Nordic-5-Clause
#
cmake_minimum_required(VERSION 3.20.0)

find_package(Zephyr REQUIRED HINTS $ENV{ZEPHYR_BASE})

project(nrf_rpc_host)

# NORDIC SDK APP START
target_sources(app PRIVATE
    src/main.c
    src/shell.c
)
# NORDIC SDK APP START
```

## sample.yaml
```
sample:
  name: nRF RPC application
  description: Test nRF RPC application
tests:
  sample.host.rpc_ble:
    build_only: true
    platform_allow: >
      nrf52840dk_nrf52840
    tags: ci_build
    extra_args: >
      SNIPPET="ble"
    integration_platforms:
      - nrf52840dk_nrf52840
  sample.host.rpc_ot:
    build_only: true
    platform_allow: >
      nrf52840dk_nrf52840
    tags: ci_build
    extra_args: >
      SNIPPET="openthread"
    integration_platforms:
      - nrf52840dk_nrf52840
  sample.host.rpc:
    build_only: true
    platform_allow: >
      nrf52840dk_nrf52840
    tags: ci_build
    extra_args: >
      SNIPPET="ble;openthread"
    integration_platforms:
      - nrf52840dk_nrf52840
```

## prj.conf
```kconfig
#
# Copyright (c) 2024 Nordic Semiconductor
#
# SPDX-License-Identifier: LicenseRef-Nordic-5-Clause
#
CONFIG_HEAP_MEM_POOL_SIZE=4096

CONFIG_THREAD_CUSTOM_DATA=y

CONFIG_NRF_RPC=y
CONFIG_NRF_RPC_CBOR=y
CONFIG_NRF_RPC_ZCBOR_BACKUPS=1
CONFIG_NRF_RPC_THREAD_STACK_SIZE=4096
CONFIG_NRF_RPC_UART_TRANSPORT=y

CONFIG_UART_LINE_CTRL=y
CONFIG_UART_INTERRUPT_DRIVEN=y

CONFIG_SHELL=y

CONFIG_SYSTEM_WORKQUEUE_STACK_SIZE=2144
```

## src/main.c
```c
/*
 * Copyright (c) 2024 Nordic Semiconductor ASA
 *
 * SPDX-License-Identifier: LicenseRef-Nordic-5-Clause
 */

#include <zephyr/device.h>
#include <zephyr/logging/log.h>
#include <zephyr/drivers/uart.h>

#include <zephyr/kernel.h>
#include <zephyr/device.h>

#include <nrf_rpc_tr.h>
#include <nrf_rpc/nrf_rpc_uart.h>
#include <nrf_rpc_errno.h>
#include <nrf_rpc_cbor.h>
#include <sys/errno.h>


LOG_MODULE_REGISTER(nrf_rpc_host, CONFIG_NRF_RPC_HOST_LOG_LEVEL);

//NRF_RPC_UART_TRANSPORT(uart_tr, DEVICE_DT_GET(DT_NODELABEL(uart0)));
//NRF_RPC_GROUP_DEFINE(nrf_rpc_group, "nrf_uart_rpc", &uart_tr, NULL, NULL, NULL);
/*
struct remote_inc_result {
        int err;
        int output;
};

static void remote_inc_rsp(const struct nrf_rpc_group *group, struct nrf_rpc_cbor_ctx *ctx,
                           void *handler_data)
{
        struct remote_inc_result *result =
                (struct remote_inc_result *)handler_data;

        if (zcbor_int32_decode(ctx->zs, &result->output)) {
                result->err = 0;
        } else {
                result->err = -NRF_EINVAL;
        }
}

int remote_inc(int input, int *output)
{
        struct remote_inc_result result;
        struct nrf_rpc_cbor_ctx ctx;

        NRF_RPC_CBOR_ALLOC(&nrf_rpc_group, ctx, MAX_ENCODED_LEN);

        if (zcbor_int32_put(ctx.zs, input)) {
                if (!nrf_rpc_cbor_cmd(&nrf_rpc_group, RPC_COMMAND_INC, &ctx,
                                remote_inc_rsp, &result)) {
                        *output = result.output;
                        return result.err;
                } else {
                        return -NRF_EINVAL;
                }
        }
        return -NRF_EINVAL;
}
*/
static void err_handler(const struct nrf_rpc_err_report *report)
{
	printk("nRF RPC error %d ocurred. See nRF RPC logs for more details.",
	       report->code);
	//k_oops();
}

static int serialization_init(void)
{

	int err;

	printk("Init begin\n");

	err = nrf_rpc_init(err_handler);
	if (err) {
		LOG_ERR("Init failed %d\n", err);
		return -NRF_EINVAL;
	}

	printk("Init done\n");

	return 0;
}

int main(void)
{
	int ret;

	k_sleep(K_MSEC(3000));
	ret = serialization_init();

	if (ret != 0) {
		LOG_ERR("Init RPC Failed.");
	}

	printk("Welcome to RPC host\r\n");
	/*while (true) {
		k_sleep(K_MSEC(5000));
		int input = 0;
		int output = 0;
		//remote_inc(input, &output);

		printk("input: %d output: %d\r\n", input, output);
	}*/
	return 0;
}
```
