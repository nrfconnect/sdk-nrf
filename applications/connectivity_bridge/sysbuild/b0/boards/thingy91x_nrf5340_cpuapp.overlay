/*
 * Copyright (c) 2026 Nordic Semiconductor ASA
 *
 * SPDX-License-Identifier: LicenseRef-Nordic-5-Clause
 */

#include "../../../partitions/thingy91x_nrf5340_cpuapp_memory_map.dtsi"

/ {
	chosen {
		zephyr,code-partition = &b0_partition;
	};
};
