## applications/nrf5340_audio/src/modules/Kconfig
```kconfig
#
# Copyright (c) 2022 Nordic Semiconductor ASA
#
# SPDX-License-Identifier: LicenseRef-Nordic-5-Clause
#

rsource "Kconfig.defaults"

menu "Modules"

config BUTTON_DEBOUNCE_MS
	int "Button debounce time in ms"
	default 50

config AUDIO_SYNC_TIMER_USES_RTC
	bool
	default y
	select NRFX_RTC

config USBD_PID
	hex
	default 0x530A

config USBD_VID
	hex
	default 0x1915

config USBD_PRODUCT
	string
	default "nRF5340 USB Audio"

config USBD_MANUFACTURER
	string
	default "Nordic Semiconductor AS"

config USBD_SELF_POWERED
	bool "USB device Self-powered attribute"
	default y
	help
	  Set the Self-powered attribute in the configuration.

config USBD_MAX_POWER
	int
	default 50 if USBD_SELF_POWERED
	default 250 # if !USBD_SELF_POWERED
	help
	  The maximum power consumption of the USB device in units of 2 mA
	  (i.e., the value 50 represents 100 mA, the value 250 represents 500 mA).

config USBD_REMOTE_WAKEUP
	bool "USB device Remote Wakeup attribute"
	help
	  Set the Remote Wakeup attribute in the configuration.

#----------------------------------------------------------------------------#
menuconfig NRF5340_AUDIO_POWER_MEASUREMENT
	bool "Power measurement"
	help
	  Include the power measurement driver for the nRF5340 Audio DK

if NRF5340_AUDIO_POWER_MEASUREMENT

config POWER_MEAS_INTERVAL_MS
	int "Power measurement interval in milliseconds"
	default 8500
	help
	  Power measurement runs continuously, this option just establishes the
	  results polling period. Note that this value needs to be >= the configured
	  sampling interval on the current sensor. When below, repeated measurements
	  will be observed.

config POWER_MEAS_START_ON_BOOT
	bool "Start power measurements for all rails on boot"
	help
	  This option will automatically start and periodically print
	  the voltage, current consumption, and power usage for the
	  following rails: VBAT, VDD1_CODEC, VDD2_CODEC, and VDD2_NRF

endif # NRF5340_AUDIO_POWER_MEASUREMENT

#----------------------------------------------------------------------------#
menu "I2S"

config I2S_LRCK_FREQ_HZ
	int
	default AUDIO_SAMPLE_RATE_HZ
	help
	 The sample rate of I2S. For now this is tied directly to
	 AUDIO_SAMPLE_RATE_HZ
	 Note that this setting is only valid in I2S master mode.

config I2S_CH_NUM
	int
	default 2
	help
	 The I2S driver itself supports both mono and stereo.
	 Parts of the implementation are configured for only stereo.

endmenu # I2S

#----------------------------------------------------------------------------#
menu "Log levels"

module = MODULE_AUDIO_USB
module-str = module-audio-usb
source "subsys/logging/Kconfig.template.log_config"

module = MODULE_BUTTON_HANDLER
module-str = module-button-handler
source "subsys/logging/Kconfig.template.log_config"

module = MODULE_HW_CODEC
module-str = module-hw-codec
source "subsys/logging/Kconfig.template.log_config"

module = MODULE_LED
module-str = module-led
source "subsys/logging/Kconfig.template.log_config"

module = MODULE_POWER
module-str = module-power
source "subsys/logging/Kconfig.template.log_config"

module = MODULE_NRF5340_AUDIO_DK
module-str = module-nrf5340-audio_dk
source "subsys/logging/Kconfig.template.log_config"

endmenu # Log levels

#----------------------------------------------------------------------------#
menu "Thread priorities"

config POWER_MEAS_THREAD_PRIO
	int "Priority for power measurement thread"
	default 6
	help
	  This is a preemptible thread.

config BUTTON_PUBLISH_THREAD_PRIO
	int "Priority for button publish thread"
	default 5
	help
	  This is a preemptible thread.
	  This thread will publish button events to zbus.

config VOLUME_MSG_SUB_THREAD_PRIO
	int "Priority for volume message subscribe thread"
	default 5
	help
	  This is a preemptible thread.
	  This thread will subscribe to volume events from zbus.

endmenu # Thread priorities

#----------------------------------------------------------------------------#
menu "Stack sizes"

config POWER_MEAS_STACK_SIZE
	int "Stack size for power measurement thread"
	default 1152

config BUTTON_PUBLISH_STACK_SIZE
	int "Stack size for button publish thread"
	default 450

config VOLUME_MSG_SUB_STACK_SIZE
	int "Stack size for volume message subscribe thread"
	default 768

endmenu # Stack sizes

#----------------------------------------------------------------------------#
menu "Zbus"

config VOLUME_MSG_SUB_QUEUE_SIZE
	int "Queue size for volume message subscriber"
	default 4

endmenu # Zbus

#----------------------------------------------------------------------------#
config NRF5340_AUDIO_SD_CARD_MODULE
	bool "Audio SD Card Module"
	help
	  Include the audio SD card module to support streaming audio files from an SD card.

if NRF5340_AUDIO_SD_CARD_MODULE

module = MODULE_SD_CARD
module-str = module-sd-card
source "subsys/logging/Kconfig.template.log_config"

endif # NRF5340_AUDIO_SD_CARD_MODULE

config NRF5340_AUDIO_SD_CARD_LC3_FILE
	bool "SD card LC3 file support"
	depends on NRF5340_AUDIO_SD_CARD_MODULE
	default n
	help
	  Include support for reading and parsing LC3 files from an SD card.

if NRF5340_AUDIO_SD_CARD_LC3_FILE

module = MODULE_SD_CARD_LC3_FILE
module-str = module-sd-card-lc3-file
source "subsys/logging/Kconfig.template.log_config"

endif # NRF5340_AUDIO_SD_CARD_LC3_FILE

menuconfig SD_CARD_PLAYBACK
	bool "Enable playback from SD card"
	depends on NRF5340_AUDIO_SD_CARD_MODULE
	select EXPERIMENTAL
	default n
	select RING_BUFFER

if SD_CARD_PLAYBACK

config SD_CARD_PLAYBACK_STACK_SIZE
	int "Stack size for the SD card playback thread"
	default 4096

config SD_CARD_PLAYBACK_RING_BUF_SIZE
	int "Size of the ring buffer for the SD card playback module"
	default 960

config SD_CARD_PLAYBACK_THREAD_PRIO
	int "Priority for the SD card playback thread"
	default 7


module = MODULE_SD_CARD_PLAYBACK
module-str = module-sd-card-playback
source "subsys/logging/Kconfig.template.log_config"

endif # SD_CARD_PLAYBACK

menuconfig NRF5340_AUDIO_SD_CARD_LC3_STREAMER
	bool "Audio SD Card LC3 Streamer"
	depends on NRF5340_AUDIO_SD_CARD_LC3_FILE
	select EXPERIMENTAL

if NRF5340_AUDIO_SD_CARD_LC3_STREAMER

config SD_CARD_LC3_STREAMER_STACK_SIZE
	int "Stack size for the SD card LC3 streamer thread"
	default 1500

config SD_CARD_LC3_STREAMER_THREAD_PRIO
	int "Priority for the SD card LC3 streamer thread"
	default 4

config SD_CARD_LC3_STREAMER_MAX_NUM_STREAMS
	int "Maximum number of concurrent LC3 streams"
	default 5
	range 0 255

config SD_CARD_LC3_STREAMER_MAX_FRAME_SIZE
	int "Maximum frame size for LC3 streams"
	default 251

module = MODULE_SD_CARD_LC3_STREAMER
module-str = module-sd-card-lc3-streamer
source "subsys/logging/Kconfig.template.log_config"

endif # NRF5340_AUDIO_SD_CARD_LC3_STREAMER

endmenu # Modules
```

## applications/nrf5340_audio/src/modules/Kconfig.defaults
```kconfig
#
# Copyright (c) 2022 Nordic Semiconductor ASA
#
# SPDX-License-Identifier: LicenseRef-Nordic-5-Clause
#

# GATEWAY
if AUDIO_DEV = 2

if AUDIO_SOURCE_USB

config UDC_NRF_THREAD_STACK_SIZE
	default 1024

config USBD_THREAD_STACK_SIZE
	default 4096

config UDC_BUF_POOL_SIZE
	default 2048

config NRF_USBD_COMMON_LOG_LEVEL
	default 2

config USBC_LOG_LEVEL
	default 2

config USBD_LOG_LEVEL
	default 2

config USBD_UAC2_LOG_LEVEL
	default 2

config UDC_DRIVER_LOG_LEVEL
	default 2

config USBD_MAX_SPEED
	default 0 # FULL

endif # AUDIO_SOURCE_USB

endif # AUDIO_DEV = 2 (GATEWAY)
```

## applications/nrf5340_audio/src/modules/display/Kconfig
```kconfig
#
# Copyright (c) 2023 Nordic Semiconductor ASA
#
# SPDX-License-Identifier: LicenseRef-Nordic-5-Clause
#

menuconfig NRF5340_AUDIO_DK_DISPLAY
	bool "Display for nRF5340 Audio DK [EXPERIMENTAL]"
	select EXPERIMENTAL
	default n

if NRF5340_AUDIO_DK_DISPLAY

rsource "Kconfig.defaults"

module = NRF5340_AUDIO_DK_DISPLAY
module-str = nrf5340_audio_dk_display
source "subsys/logging/Kconfig.template.log_config"

config NRF5340_AUDIO_DK_DISPLAY_TAB_LOG
	bool "Enable the log tab on the display"
	depends on LOG
	default y

if NRF5340_AUDIO_DK_DISPLAY_TAB_LOG

config NRF5340_AUDIO_DK_DISPLAY_TAB_LOG_LEVEL
	int "Log level for message displayed on screen"
	default 2

config NRF5340_AUDIO_DK_DISPLAY_TAB_LOG_TIMESTAMP
	bool "Display timestamp in us in front of log message"
	default n

config NRF5340_AUDIO_DK_DISPLAY_TAB_LOG_MAX_LEN
	int "Number of messages to be stored"
	default 10

endif # NRF5340_AUDIO_DK_DISPLAY_TAB_LOG

config NRF5340_AUDIO_DK_DISPLAY_TAB_MENU_UPDATE_INTERVAL_MS
	int "Update interval for the menu tab, in milliseconds"
	default 500

endif # NRF5340_AUDIO_DK_DISPLAY
```

## applications/nrf5340_audio/src/modules/display/Kconfig.defaults
```kconfig
#
# Copyright (c) 2023 Nordic Semiconductor ASA
#
# SPDX-License-Identifier: LicenseRef-Nordic-5-Clause
#

config DISPLAY
	default y

config LVGL
	default y

config LV_Z_MEM_POOL_NUMBER_BLOCKS
	int "Number of max size blocks in memory pool"
	default 8

config LV_FONT_MONTSERRAT_14
	default y

config LV_FONT_MONTSERRAT_48
	default y

config LV_FONT_MONTSERRAT_20
	default y

config LV_Z_VDB_SIZE
	int "Virtual display buffer size"
	default 32
```

## applications/nrf5340_audio/src/utils/Kconfig
```kconfig
#
# Copyright (c) 2022 Nordic Semiconductor ASA
#
# SPDX-License-Identifier: LicenseRef-Nordic-5-Clause
#

menu "Utils"

menu "FIFO"

config FIFO_FRAME_SPLIT_NUM
	int "Number of blocks to make up one frame of audio data"
	default 10
	help
		Easy DMA in I2S requires two buffers to be filled before I2S
		transmission will begin. In order to reduce latency, an audio
		frame can be split into multiple blocks with this parameter. USB
		sends data in 1 ms blocks, so we need the split to match that.
		Since we set frame size to 10 ms for USB, 10 is selected as
		FRAME_SPLIT_NUM

config FIFO_TX_FRAME_COUNT
	int "Max number of audio frames in TX slab"
	default 3
	help
		FIFO_TX is the buffer that holds decoded audio data before it
		is sent to either I2S or USB

config FIFO_RX_FRAME_COUNT
	int "Max number of audio frames in RX slab"
	default 1
	help
		FIFO_RX is the buffer that holds uncompressed audio data coming
		from either I2S or USB

endmenu # FIFO

#----------------------------------------------------------------------------#
menu "Log levels"

config LOG_BOARD_VERSION_LEVEL
	int "Log level for the board/HW version"
	default 3

config LOG_CS47L63_LEVEL
	int "Log level for CS47L63"
	default 2

endmenu # Log levels
endmenu # Utils
```

## applications/nrf5340_audio/src/utils/Kconfig.defaults
```kconfig
#
# Copyright (c) 2022 Nordic Semiconductor ASA
#
# SPDX-License-Identifier: LicenseRef-Nordic-5-Clause
#

# Channel assignment writes to UICR
config NRFX_NVMC
	default y
```

## applications/nrf5340_audio/unicast_client/Kconfig.defaults
```kconfig
#
# Copyright (c) 2023 Nordic Semiconductor ASA
#
# SPDX-License-Identifier: LicenseRef-Nordic-5-Clause
#

config UTF8
	default y

## ACL related configs ##
config BT_MAX_CONN
	default 2

# Generic Audio Source - 0x0880
config BT_DEVICE_APPEARANCE
	default 2176

config BT_MAX_PAIRED
	default 2

config BT_GATT_DYNAMIC_DB
	default y


## ISO related configs ##
config BT_ISO_MAX_CHAN
	default 4

config BT_BAP_UNICAST_CLIENT
	default y

config BT_ISO_TX_BUF_COUNT
	default 2

config BT_BAP_UNICAST_CLIENT_GROUP_STREAM_COUNT
	default 4

config BT_BAP_UNICAST_CLIENT_ASE_SNK_COUNT
	default 2

config BT_BAP_UNICAST_CLIENT_ASE_SRC_COUNT
	default 2

config BT_VCP_VOL_CTLR
	default y

config BT_MCS
	default y

config BT_MPL
	default y

config MCTL
	default y

config MCTL_LOCAL_PLAYER_CONTROL
	default y

config MCTL_LOCAL_PLAYER_REMOTE_CONTROL
	default y


## LC3 related configs ##
config LC3_BITRATE
	default BT_AUDIO_BITRATE_UNICAST_SINK

config LC3_ENC_CHAN_MAX
	default 2

config LC3_DEC_CHAN_MAX
	default 1
```

## applications/nrf5340_audio/unicast_server/Kconfig.defaults
```kconfig
#
# Copyright (c) 2023 Nordic Semiconductor ASA
#
# SPDX-License-Identifier: LicenseRef-Nordic-5-Clause
#

## ACL related configs ##
config BT_MAX_CONN
	default 4

config BT_MAX_PAIRED
	default 4

config BT_PERIPHERAL
	default y

config BT_GATT_AUTO_RESUBSCRIBE
	default n

config BT_GATT_AUTO_SEC_REQ
	default n


## ISO related configs ##
config BT_ISO_PERIPHERAL
	default y

config BT_BAP_UNICAST
	default y

config BT_BAP_UNICAST_SERVER
	default y

config BT_ISO_MAX_CHAN
	default 2

# Earbud - 0x0941
config BT_DEVICE_APPEARANCE
	default 2369

config BT_GAP_PERIPHERAL_PREF_PARAMS
	default n

config BT_ASCS
	default y

config BT_ASCS_MAX_ASE_SNK_COUNT
	default 1

config BT_ASCS_MAX_ASE_SRC_COUNT
	default 1 if STREAM_BIDIRECTIONAL
	default 0 if !STREAM_BIDIRECTIONAL

config BT_VCP_VOL_REND
	default y

config BT_MCC
	default y

config BT_MCC_READ_MEDIA_STATE
	default y

config BT_MCC_SET_MEDIA_CONTROL_POINT
	default y

# For fixing compatibility issue with Android 14
config BT_PAC_SNK
	default y

config BT_PAC_SNK_NOTIFIABLE
	default y

config BT_PAC_SRC
	default y

config BT_PAC_SRC_NOTIFIABLE
	default y

config BT_CSIP_SET_MEMBER
	default y

config BT_CAP_ACCEPTOR
	default y

config BT_CAP_ACCEPTOR_SET_MEMBER
	default y

config BT_AUDIO_CODEC_CFG_MAX_METADATA_SIZE
	default 25


## LC3 related configs ##
config LC3_BITRATE
	default BT_AUDIO_BITRATE_UNICAST_SRC

config LC3_ENC_CHAN_MAX
	default 1

config LC3_DEC_CHAN_MAX
	default 1
```
