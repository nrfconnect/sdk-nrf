## applications/nrf5340_audio/src/bluetooth/bt_stream/unicast/Kconfig
```kconfig
#
# Copyright (c) 2023 Nordic Semiconductor ASA
#
# SPDX-License-Identifier: LicenseRef-Nordic-5-Clause
#

rsource "Kconfig.defaults"

menu "Unicast"

config BT_AUDIO_PREF_SINK_SAMPLE_RATE_VALUE
	hex
	default 0x03 if BT_AUDIO_PREF_SINK_SAMPLE_RATE_16KHZ
	default 0x05 if BT_AUDIO_PREF_SINK_SAMPLE_RATE_24KHZ
	default 0x08 if BT_AUDIO_PREF_SINK_SAMPLE_RATE_48KHZ

choice BT_AUDIO_PREF_SINK_SAMPLE_RATE
	prompt "Preferred BT audio sink sample rate"
	default BT_AUDIO_PREF_SINK_SAMPLE_RATE_16KHZ if BT_BAP_UNICAST_16_2_1
	default BT_AUDIO_PREF_SINK_SAMPLE_RATE_24KHZ if STREAM_BIDIRECTIONAL
	default BT_AUDIO_PREF_SINK_SAMPLE_RATE_24KHZ if BT_BAP_UNICAST_24_2_1
	default BT_AUDIO_PREF_SINK_SAMPLE_RATE_48KHZ
	help
	  Select the preferred sample rate to stream if there are more than one to choose from.
	  Only valid when used by unicast_client if CONFIG_SAMPLE_RATE_CONVERTER=y and
	  CONFIG_AUDIO_SAMPLE_RATE_48000_HZ=y, meaning 16, 24, and 48kHz are supported.

config  BT_AUDIO_PREF_SINK_SAMPLE_RATE_48KHZ
	bool "48 kHz"
	help
	  Select 48000 Hz as the preferred sink sample rate.

config  BT_AUDIO_PREF_SINK_SAMPLE_RATE_24KHZ
	bool "24 kHz"
	help
	  Select 24000 Hz as the preferred sink sample rate.

config  BT_AUDIO_PREF_SINK_SAMPLE_RATE_16KHZ
	bool "16 kHz"
	help
	  Select 16000 Hz as the preferred sink sample rate.
endchoice

config BT_AUDIO_PREF_SOURCE_SAMPLE_RATE_VALUE
	hex
	default 0x03 if BT_AUDIO_PREF_SOURCE_SAMPLE_RATE_16KHZ
	default 0x05 if BT_AUDIO_PREF_SOURCE_SAMPLE_RATE_24KHZ
	default 0x08 if BT_AUDIO_PREF_SOURCE_SAMPLE_RATE_48KHZ

choice BT_AUDIO_PREF_SOURCE_SAMPLE_RATE
	prompt "Preferred BT audio source sample rate"
	default BT_AUDIO_PREF_SOURCE_SAMPLE_RATE_16KHZ if BT_BAP_UNICAST_16_2_1
	default BT_AUDIO_PREF_SOURCE_SAMPLE_RATE_24KHZ if STREAM_BIDIRECTIONAL
	default BT_AUDIO_PREF_SOURCE_SAMPLE_RATE_24KHZ if BT_BAP_UNICAST_24_2_1
	default BT_AUDIO_PREF_SOURCE_SAMPLE_RATE_48KHZ
	help
	  Select the preferred sample rate to stream if there are more than one to choose from.
	  Only valid when used by unicast_client if CONFIG_SAMPLE_RATE_CONVERTER=y and
	  CONFIG_AUDIO_SAMPLE_RATE_48000_HZ=y, meaning 16, 24, and 48kHz are supported.

config  BT_AUDIO_PREF_SOURCE_SAMPLE_RATE_48KHZ
	bool "48 kHz"
	help
	  Select 48000 Hz as the preferred source sample rate.

config  BT_AUDIO_PREF_SOURCE_SAMPLE_RATE_24KHZ
	bool "24 kHz"
	help
	  Select 24000 Hz as the preferred source sample rate.

config  BT_AUDIO_PREF_SOURCE_SAMPLE_RATE_16KHZ
	bool "16 kHz"
	help
	  Select 16000 Hz as the preferred source sample rate.
endchoice

choice BT_BAP_UNICAST_BAP_CONFIGURATION
	prompt "Unicast codec configuration"
	depends on TRANSPORT_CIS
	default BT_BAP_UNICAST_CONFIGURABLE
	help
	  Select the unicast codec configuration as given in
	  Table 5.2 of the Bluetooth Audio Profile Specification.
	  USB only supports 48 kHz samplig rate.

config BT_BAP_UNICAST_CONFIGURABLE
	bool "Configurable unicast settings"
	depends on TRANSPORT_CIS
	help
	  Configurable option that doesn't follow any preset. Allows for more flexibility.

config BT_BAP_UNICAST_16_2_1
	bool "16_2_1"
	depends on TRANSPORT_CIS
	help
	  Unicast mandatory codec capability 16_2_1.
	  16kHz, 32kbps, 2 retransmits, 10ms transport latency, and 40ms presentation delay.

config BT_BAP_UNICAST_24_2_1
	bool "24_2_1"
	depends on TRANSPORT_CIS
	help
	  Unicast codec capability 24_2_1.
	  24kHz, 48kbps, 2 retransmits, 10ms transport latency, and 40ms presentation delay.

config BT_BAP_UNICAST_48_4_1
	bool "48_4_1"
	depends on TRANSPORT_CIS
	help
	  Unicast codec capability 48_4_1.
	  48kHz, 96kbps, 5 retransmits, 20ms transport latency, and 40ms presentation delay.
endchoice

choice	BT_AUDIO_PRES_DLY_SRCH
	prompt "Default search mode for the presentation delay"
	default BT_AUDIO_PRES_DELAY_SRCH_PREF_MIN
	help
	  Set the default search mode for the presentation delay.

config BT_AUDIO_PRES_DELAY_SRCH_MIN
	bool "Largest minimum delay over all audio receivers"
	help
	  Search for the largest minimum delay over all audio receivers.

config BT_AUDIO_PRES_DELAY_SRCH_MAX
	bool "Smallest maximum delay over all audio receivers"
	help
	  Search for the smallest maximum delay over all audio receivers.

config BT_AUDIO_PRES_DELAY_SRCH_PREF_MIN
	bool "Largest minimum preferred delay over all audio receivers"
	help
	  Search for the largest minimum preferred delay over all audio receivers.

config BT_AUDIO_PRES_DELAY_SRCH_PREF_MAX
	bool "Smallest maximum preferred delay over all audio receivers"
	help
	  Search for the smallest maximum preferred delay over all audio receivers.

config BT_AUDIO_PRES_DELAY_SRCH_SOURCE
	bool "Use the presentation delay of audio source or client"
	help
	  Use the presentation delay defined by the broadcast_source or unicast_client if it
	  is within the range set by AUDIO_MIN_PRES_DLY_US and AUDIO_MAX_PRES_DLY_US. This will
	  override the audio receiver presentation delay as long as it is in range of
	  the max and min supported by the audio receivers. If it is outside this range,
	  then it will revert to the closest supported value.
endchoice

config BT_AUDIO_PAC_REC_PRINT
	bool "Print discovered Published Audio Capabilities"
	help
	  Print the supported capabilities of a unicast server when it is discovered.


config CODEC_CAP_COUNT_MAX
	int "Max storage of codec capabilities"
	default 5
	help
	  Max number of codec capabilities to store per stream.

config BT_AUDIO_PREFERRED_MIN_PRES_DLY_US
	int "The preferred minimum presentation delay"
	range AUDIO_MIN_PRES_DLY_US AUDIO_MAX_PRES_DLY_US
	default AUDIO_MIN_PRES_DLY_US
	help
	  The preferred minimum presentation delay in microseconds. This can not
	  be less than the absolute minimum presentation delay.

config BT_AUDIO_PREFERRED_MAX_PRES_DLY_US
	int "The preferred maximum presentation delay"
	range BT_AUDIO_PREFERRED_MIN_PRES_DLY_US AUDIO_MAX_PRES_DLY_US
	default 40000
	help
	  The preferred maximum presentation delay in microseconds. This can not
	  be less than the absolute maximum presentation delay.

config BT_AUDIO_BITRATE_UNICAST_SINK
	int "ISO stream bitrate"
	depends on TRANSPORT_CIS
	default 64000 if BT_BAP_UNICAST_CONFIGURABLE && STREAM_BIDIRECTIONAL
	default 96000 if BT_BAP_UNICAST_CONFIGURABLE
	default 32000 if BT_BAP_UNICAST_16_2_1
	default 48000 if BT_BAP_UNICAST_24_2_1
	help
	  Bitrate for the unicast sink ISO stream.

config BT_AUDIO_BITRATE_UNICAST_SRC
	int "ISO stream bitrate"
	depends on TRANSPORT_CIS
	default 32000 if BT_BAP_UNICAST_16_2_1
	default 48000 if BT_BAP_UNICAST_24_2_1
	default 64000
	help
	  Bitrate for the unicast source ISO stream.

config BT_SET_IDENTITY_RESOLVING_KEY_DEFAULT
	string
	default "NRF5340_TWS_DEMO"
	help
	  Default string to configure the Set Identify Resolving Key (SIRK), must
	  be changed before production uniquely for each coordinated set.

config BT_SET_IDENTITY_RESOLVING_KEY
	string "String used to configure the SIRK"
	depends on TRANSPORT_CIS && BT_BAP_UNICAST_SERVER
	default BT_SET_IDENTITY_RESOLVING_KEY_DEFAULT
	help
	  Defines a string to configure the Set Identify Resolving Key (SIRK), must
	  be changed before production uniquely for each coordinated set. The SIRK
	  must be 16 characters (16 bytes).


#----------------------------------------------------------------------------#
menu "Log levels"

module = UNICAST_SERVER
module-str = unicast_server
source "subsys/logging/Kconfig.template.log_config"

module = UNICAST_CLIENT
module-str = unicast_client
source "subsys/logging/Kconfig.template.log_config"

module = SERVER_STORE
module-str = server_store
source "subsys/logging/Kconfig.template.log_config"

endmenu # Log levels
endmenu # Unicast
```

## applications/nrf5340_audio/src/bluetooth/bt_stream/unicast/Kconfig.defaults
```kconfig
#
# Copyright (c) 2023 Nordic Semiconductor ASA
#
# SPDX-License-Identifier: LicenseRef-Nordic-5-Clause
#

config BT_GATT_CLIENT
	default y

config BT_BONDABLE
	default y

config BT_PRIVACY
	default y

config BT_FILTER_ACCEPT_LIST
	default y

config BT_SMP
	default y

config BT_GAP_AUTO_UPDATE_CONN_PARAMS
	default n

config BT_AUTO_PHY_UPDATE
	default n

config BT_AUTO_DATA_LEN_UPDATE
	default n

config BT_L2CAP_TX_BUF_COUNT
	default 12

config BT_BUF_ACL_RX_SIZE
	default 502 if (AUDIO_DFU > 0)
	default 259

config BT_BUF_ACL_TX_COUNT
	default 12

config SETTINGS
	default y

config BT_SETTINGS
	default y

config FLASH
	default y

config FLASH_MAP
	default y

config NVS
	default y

config NVS_LOG_LEVEL
	default 2

config BT_ASCS_MAX_ASE_SRC_COUNT
	default 1
```

## applications/nrf5340_audio/src/drivers/Kconfig
```kconfig
#
# Copyright (c) 2022 Nordic Semiconductor ASA
#
# SPDX-License-Identifier: LicenseRef-Nordic-5-Clause
#

menu "Drivers"

menuconfig NRF5340_AUDIO_CS47L63_DRIVER
	bool "CS47L63 HW codec driver"
	select HW_CODEC_CIRRUS_LOGIC
	help
	  Include the driver for the Cirrus Logic CS47L63 hardware codec chip

if NRF5340_AUDIO_CS47L63_DRIVER

config CS47L63_THREAD_PRIO
	int "Priority for CS47L63 thread"
	default 5
	help
	  This is a preemptible thread

config CS47L63_STACK_SIZE
	int "Stack size for CS47L63"
	default 700

module = CS47L63
module-str = cs47l63
source "subsys/logging/Kconfig.template.log_config"

endif # NRF5340_AUDIO_CS47L63_DRIVER
endmenu # Drivers
```

## applications/nrf5340_audio/src/events/Kconfig
```kconfig
#
# Copyright (c) 2022 Nordic Semiconductor ASA
#
# SPDX-License-Identifier: LicenseRef-Nordic-5-Clause
#

menu "Events"

menu "Log levels"

module = CTRL_EVENTS
module-str = ctrl-events
source "subsys/logging/Kconfig.template.log_config"

endmenu # Log levels
endmenu # Events
```
