## applications/nrf9160dk_demo/Kconfig
```kconfig
#
# Copyright (c) 2018 Nordic Semiconductor ASA
#
# SPDX-License-Identifier: LicenseRef-BSD-5-Clause-Nordic
#

menu "nRF9160DK Demo"

rsource "src/ui/Kconfig"

config APPLICATION_WORKQUEUE_STACK_SIZE
	int "Application workqueue stack size"
	default 2048

config APPLICATION_WORKQUEUE_PRIORITY
	int "Application workqueue priority"
	default SYSTEM_WORKQUEUE_PRIORITY

menu "Device and modem"

config POWER_OPTIMIZATION_ENABLE
	bool "Enable power optimization"
	default y
	select LTE_EDRX_REQ

if MODEM_INFO

config HOLD_TIME_RSRP
	int "Minimum time [s] between RSRP subscription messages"
	default 60
	help
	  The minimum time in seconds where the modem
	  informer is allowed to submit RSRP data to the cloud.

endif

endmenu # Device

menu "Cloud"

config MQTT_KEEPALIVE
	int "Time after last transmission to send a ping to keep connection on"
	default 1200
	help
	  This should be set to the expected time between messages sent from
	  this device. Making it larger than the expected data period does not
	  conserve bandwidth, as the ping is only sent if nothing else
	  has been within the specified period. Shorter values can prevent hidden
	  NAT timeouts at the carrier, but also will interrupt GPS fix attempts
	  and slow down TTFF.

config CLOUD_BUTTON
	bool "Enable button sensor"
	default y

config CLOUD_BUTTON_INPUT
	int "Set button sensor button number"
	range 1 4 if BOARD_NRF9160_PCA10090NS
	default 1

config CLOUD_CONNECT_RETRY_DELAY
	int "Cloud connection retry delay in seconds"
	default 480
	help
	  Time to wait before trying to reconnect to the cloud if the
	  previous attempt failed (in seconds).

config CLOUD_CONNECT_COUNT_MAX
	int "Maximum number of cloud connection attempts"
	default 8
	help
	  Maximum number of unsuccessful cloud connection attempts.
	  Device will wait for the value defined by CLOUD_CONNECT_RETRY_DELAY
	  between attempts.

config CLOUD_WAIT_DURATION
	int "Cloud connection acknowledge wait duration"
	default 30
	help
	  How long the device should wait for a CONNACK
	  event from the cloud when connecting.  Device will reboot
	  if an ack is not received within the duration.

config CLOUD_FOTA_APP
	bool "Enable firmware over-the-air upgrades for application"
	depends on AWS_FOTA
	depends on DFU_TARGET_MCUBOOT
	default y

config CLOUD_FOTA_MODEM
	bool "Enable firmware over-the-air upgrades for modem"
	depends on AWS_FOTA
	depends on DFU_TARGET_MODEM
	default y

config CLOUD_CONNECT_ERR_REBOOT_S
	int "Seconds to wait before rebooting when a cloud connect error occurs"
	default 300

endmenu # Cloud

config NRF9160DK_DEMO_WATCHDOG_TIMEOUT_MSEC
	int "Watchdog timeout in milliseconds"
	default 10000

config USE_AT_HOST
	bool "Enable AT commands"
	default y
	select AT_HOST_LIBRARY
	help
		Enable the AT host library so that AT commands can be sent to and
		received from a serial terminal.

endmenu

menu "Zephyr Kernel"
source "Kconfig.zephyr"
endmenu

module = NRF9160DK_DEMO
module-str = nRF9160DK Demo
source "${ZEPHYR_BASE}/subsys/logging/Kconfig.template.log_config"
```

## applications/nrf9160dk_demo/sample.yaml
```yaml
sample:
  name: nRF9160DK Demo Application
tests:
  test_build:
    build_only: true
    build_on_all: true
    platform_whitelist: nrf9160_pca10090ns qemu_x86
    tags: ci_build
```

## applications/nrf9160dk_demo/src/ui/Kconfig
```kconfig
#
# Copyright (c) 2019 Nordic Semiconductor ASA
#
# SPDX-License-Identifier: LicenseRef-BSD-5-Clause-Nordic
#

config USE_UI_MODULE
	bool "Enable UI module"
	default y
	help
		Enable the User Interface module for user interaction on
		development kit hardware.

module = UI
module-str = User Interface
source "${ZEPHYR_BASE}/subsys/logging/Kconfig.template.log_config"
```

## applications/nrf_audio/Kconfig.defaults
```kconfig
#
# Copyright (c) 2022 Nordic Semiconductor ASA
#
# SPDX-License-Identifier: LicenseRef-Nordic-5-Clause
#

config REBOOT
	default y

config MAIN_THREAD_PRIORITY
	default 10

config MAIN_STACK_SIZE
	default 2500 if SD_CARD_PLAYBACK
	default 2000

config SYSTEM_WORKQUEUE_STACK_SIZE
	default 2000

# As long as thread names are used, config must be set to "y"
config THREAD_NAME
	default y

# Workaround to not use fatal_error.c in NCS. Note that the system may still
# reset on error depending on the build configuraion
config RESET_ON_FATAL_ERROR
	default n

# Default Configurations for nRF Audio applications
config ZBUS
	default y

config ZBUS_RUNTIME_OBSERVERS
	default y

config ZBUS_MSG_SUBSCRIBER
	default y

config SENSOR
	default y

config REGULATOR
	default y

config CONTIN_ARRAY
	default y

config NRFX_I2S
	default y

config PCM_MIX
	default y

config PSCM
	default y

config I2C
	default y

# Audio codec LC3 related defines
# FPU_SHARING enables preservation of the hardware floating point registers
# across context switches to allow multiple threads to perform concurrent
# floating point operations.
config FPU
	default y

config FPU_SHARING
	default y

# Enable SPI interface
config SPI
	default y

# Enable ADC for board version readback
config ADC
	default y

# Allocate buffer on RAM for transferring chunck of data
# from Flash to SPI
config SPI_NRFX_RAM_BUFFER_SIZE
	default 8
```

## applications/nrf_audio/Kconfig.sysbuild
```kconfig
#
# Copyright (c) 2024 Nordic Semiconductor
#
# SPDX-License-Identifier: LicenseRef-Nordic-5-Clause
#

config NRF_DEFAULT_IPC_RADIO
	default y

config PARTITION_MANAGER
	default n

source "share/sysbuild/Kconfig"
```

## applications/nrf_audio/boards/nrf5340dk_nrf5340_cpuapp.conf
```kconfig
#
# Copyright (c) 2026 Nordic Semiconductor ASA
#
# SPDX-License-Identifier: LicenseRef-Nordic-5-Clause
#

CONFIG_NRFX_NVMC=y
CONFIG_NRFX_CLOCK=y
CONFIG_AUDIO_SYNC_TIMER_USES_RTC=y
```

## applications/nrf_audio/sample.yaml
```yaml
sample:
  name: nRF Audio application
  description: LE Audio and Auracast implementation example
tests:
  applications.nrf_audio.headset_unicast_unidir_usb:
    integration_platforms:
      - nrf5340_audio_dk/nrf5340/cpuapp
      - nrf5340dk/nrf5340/cpuapp
    platform_allow:
      - nrf5340_audio_dk/nrf5340/cpuapp
      - nrf5340dk/nrf5340/cpuapp
    sysbuild: true
    build_only: true
    tags:
      - ci_build
      - sysbuild
      - ci_applications_nrf_audio
    extra_args:
      - EXTRA_CONF_FILE=unicast_server/overlay-unicast_server.conf
  applications.nrf_audio.gateway_unicast_bidir_usb:
    integration_platforms:
      - nrf5340_audio_dk/nrf5340/cpuapp
      - nrf5340dk/nrf5340/cpuapp
    platform_allow:
      - nrf5340_audio_dk/nrf5340/cpuapp
      - nrf5340dk/nrf5340/cpuapp
    sysbuild: true
    build_only: true
    tags:
      - ci_build
      - sysbuild
      - ci_applications_nrf_audio
    extra_args:
      - CONFIG_STREAM_BIDIRECTIONAL=y
      - EXTRA_CONF_FILE=unicast_client/overlay-unicast_client.conf
  applications.nrf_audio.headset_broadcast_sink_usb:
    integration_platforms:
      - nrf5340_audio_dk/nrf5340/cpuapp
      - nrf5340dk/nrf5340/cpuapp
    platform_allow:
      - nrf5340_audio_dk/nrf5340/cpuapp
      - nrf5340dk/nrf5340/cpuapp
    sysbuild: true
    build_only: true
    tags:
      - ci_build
      - sysbuild
      - ci_applications_nrf_audio
    extra_args:
      - EXTRA_CONF_FILE=broadcast_sink/overlay-broadcast_sink.conf
  applications.nrf_audio.gateway_broadcast_source_i2s:
    integration_platforms:
      - nrf5340_audio_dk/nrf5340/cpuapp
      - nrf5340dk/nrf5340/cpuapp
    platform_allow:
      - nrf5340_audio_dk/nrf5340/cpuapp
      - nrf5340dk/nrf5340/cpuapp
    sysbuild: true
    build_only: true
    tags:
      - ci_build
      - sysbuild
      - ci_applications_nrf_audio
    extra_args:
      - CONFIG_AUDIO_SOURCE_I2S=y
      - EXTRA_CONF_FILE=broadcast_source/overlay-broadcast_source.conf
  applications.nrf_audio.headset_unicast_sd_card:
    integration_platforms:
      - nrf5340_audio_dk/nrf5340/cpuapp
    platform_allow:
      - nrf5340_audio_dk/nrf5340/cpuapp
    sysbuild: true
    build_only: true
    tags:
      - ci_build
      - sysbuild
      - ci_applications_nrf_audio
    extra_args:
      - CONFIG_SD_CARD_PLAYBACK=y
      - EXTRA_CONF_FILE=unicast_server/overlay-unicast_server.conf
  applications.nrf_audio.headset_unicast_debug_bidir_usb:
    integration_platforms:
      - nrf5340_audio_dk/nrf5340/cpuapp
      - nrf5340dk/nrf5340/cpuapp
    platform_allow:
      - nrf5340_audio_dk/nrf5340/cpuapp
      - nrf5340dk/nrf5340/cpuapp
    sysbuild: true
    build_only: true
    tags:
      - ci_build
      - sysbuild
      - ci_applications_nrf_audio
    extra_args:
      - CONFIG_STREAM_BIDIRECTIONAL=y
      - EXTRA_CONF_FILE=unicast_server/overlay-unicast_server.conf
  applications.nrf_audio.headset_broadcast_alternative_i2s:
    integration_platforms:
      - nrf5340_audio_dk/nrf5340/cpuapp
      - nrf5340dk/nrf5340/cpuapp
    platform_allow:
      - nrf5340_audio_dk/nrf5340/cpuapp
      - nrf5340dk/nrf5340/cpuapp
    sysbuild: true
    build_only: true
    tags:
      - ci_build
      - sysbuild
      - ci_applications_nrf_audio
    extra_args:
      - CONFIG_DEBUG=n
      - CONFIG_ASSERT=n
      - CONFIG_STACK_USAGE=n
      - CONFIG_THREAD_MONITOR=n
      - CONFIG_SERIAL=n
      - CONFIG_CONSOLE=n
      - CONFIG_PRINTK=n
      - CONFIG_BT_SETTINGS_USE_PRINTK=n
      - CONFIG_NCS_BOOT_BANNER=n
      - CONFIG_UART_CONSOLE=n
      - CONFIG_BOOT_BANNER=n
      - CONFIG_AUDIO_SOURCE_I2S=y
      - EXTRA_CONF_FILE=broadcast_sink/overlay-broadcast_sink.conf
  applications.nrf_audio.headset_unicast_alternative_bidir_i2s:
    integration_platforms:
      - nrf5340_audio_dk/nrf5340/cpuapp
      - nrf5340dk/nrf5340/cpuapp
    platform_allow:
      - nrf5340_audio_dk/nrf5340/cpuapp
      - nrf5340dk/nrf5340/cpuapp
    sysbuild: true
    build_only: true
    tags:
      - ci_build
      - sysbuild
      - ci_applications_nrf_audio
    extra_args:
      - CONFIG_DEBUG=n
      - CONFIG_ASSERT=n
      - CONFIG_STACK_USAGE=n
      - CONFIG_THREAD_MONITOR=n
      - CONFIG_SERIAL=n
      - CONFIG_CONSOLE=n
      - CONFIG_PRINTK=n
      - CONFIG_BT_SETTINGS_USE_PRINTK=n
      - CONFIG_NCS_BOOT_BANNER=n
      - CONFIG_UART_CONSOLE=n
      - CONFIG_BOOT_BANNER=n
      - CONFIG_STREAM_BIDIRECTIONAL=y
      - CONFIG_AUDIO_SOURCE_I2S=y
      - EXTRA_CONF_FILE=unicast_server/overlay-unicast_server.conf
  applications.nrf_audio.gateway_broadcast_source_alternative_usb:
    integration_platforms:
      - nrf5340_audio_dk/nrf5340/cpuapp
      - nrf5340dk/nrf5340/cpuapp
    platform_allow:
      - nrf5340_audio_dk/nrf5340/cpuapp
      - nrf5340dk/nrf5340/cpuapp
    sysbuild: true
    build_only: true
    tags:
      - ci_build
      - sysbuild
      - ci_applications_nrf_audio
    extra_args:
      - CONFIG_DEBUG=n
      - CONFIG_ASSERT=n
      - CONFIG_STACK_USAGE=n
      - CONFIG_THREAD_MONITOR=n
      - CONFIG_SERIAL=n
      - CONFIG_CONSOLE=n
      - CONFIG_PRINTK=n
      - CONFIG_BT_SETTINGS_USE_PRINTK=n
      - CONFIG_NCS_BOOT_BANNER=n
      - CONFIG_UART_CONSOLE=n
      - CONFIG_BOOT_BANNER=n
      - EXTRA_CONF_FILE=broadcast_source/overlay-broadcast_source.conf
  applications.nrf_audio.gateway_unicast_client_bidir_alternative_i2s:
    integration_platforms:
      - nrf5340_audio_dk/nrf5340/cpuapp
      - nrf5340dk/nrf5340/cpuapp
    platform_allow:
      - nrf5340_audio_dk/nrf5340/cpuapp
      - nrf5340dk/nrf5340/cpuapp
    sysbuild: true
    build_only: true
    tags:
      - ci_build
      - sysbuild
      - ci_applications_nrf_audio
    extra_args:
      - CONFIG_DEBUG=n
      - CONFIG_ASSERT=n
      - CONFIG_STACK_USAGE=n
      - CONFIG_THREAD_MONITOR=n
      - CONFIG_SERIAL=n
      - CONFIG_CONSOLE=n
      - CONFIG_PRINTK=n
      - CONFIG_BT_SETTINGS_USE_PRINTK=n
      - CONFIG_NCS_BOOT_BANNER=n
      - CONFIG_UART_CONSOLE=n
      - CONFIG_BOOT_BANNER=n
      - CONFIG_STREAM_BIDIRECTIONAL=y
      - CONFIG_AUDIO_SOURCE_I2S=y
      - EXTRA_CONF_FILE=unicast_client/overlay-unicast_client.conf
```
