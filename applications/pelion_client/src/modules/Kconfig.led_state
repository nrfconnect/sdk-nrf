## applications/sdp/gpio/Kconfig
```kconfig
choice SDP_GPIO_BACKEND
	prompt "Backend"
	default SDP_GPIO_BACKEND_ICMSG

config SDP_GPIO_BACKEND_MBOX
	bool "mbox"

config SDP_GPIO_BACKEND_ICMSG
	bool "icmsg"
	select IPC_SERVICE

config SDP_GPIO_BACKEND_ICBMSG
	bool "icbmsg"
	select IPC_SERVICE

endchoice

rsource "../Kconfig"
source "Kconfig.zephyr"
```

## applications/sdp/gpio/sample.yaml
```yaml
sample:
  name: SDP GPIO application
  description: SDP GPIO application
common:
  integration_platforms:
    - nrf54l15dk/nrf54l15/cpuflpr
tests:
  applications.sdp.gpio.mbox:
    build_only: true
    sysbuild: true
    platform_allow: nrf54l15dk/nrf54l15/cpuflpr
    tags:
      - ci_build
      - sysbuild
      - gpio
    required_snippets:
      - sdp-gpio-mbox

  applications.sdp.gpio.icmsg:
    build_only: true
    sysbuild: true
    platform_allow: nrf54l15dk/nrf54l15/cpuflpr
    tags:
      - ci_build
      - sysbuild
      - gpio
    required_snippets:
      - sdp-gpio-icmsg

  applications.sdp.gpio.icbmsg:
    sysbuild: true
    build_only: true
    platform_allow: nrf54l15dk/nrf54l15/cpuflpr
    tags:
      - ci_build
      - sysbuild
      - gpio
    required_snippets:
      - sdp-gpio-icbmsg
```

## applications/sdp/mspi/Kconfig
```kconfig
config SDP_MSPI_MAX_RESPONSE_SIZE
	int "Max size of response that can be sent to APP core. In bytes."
	default 128

config SDP_MSPI_IPC_NO_COPY
	bool "IPC no copy mode"
	default y
	depends on SOC_NRF54L15
	help
	  If y Data is passed through IPC by reference,
	  this requires both cores to be able to access each others memory spaces.
	  If n Data is passed through IPC by copy.

source "Kconfig.zephyr"
```

## applications/sdp/mspi/sample.yaml
```yaml
sample:
  name: SDP mSPI application
  description: SDP mSPI application
common:
  integration_platforms:
    - nrf54l15dk/nrf54l15/cpuflpr
tests:
  applications.sdp.mspi:
    build_only: true
    sysbuild: true
    platform_allow: nrf54l15dk/nrf54l15/cpuflpr
    tags:
      - ci_build
      - sysbuild
      - mspi
```
