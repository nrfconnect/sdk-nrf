## applications/pelion_client/src/modules/Kconfig.led_state
```kconfig
#
# Copyright (c) 2021 Nordic Semiconductor ASA
#
# SPDX-License-Identifier: LicenseRef-Nordic-5-Clause
#

menu "LED state"

module = PELION_CLIENT_LED_STATE
module-str = LED state module
source "subsys/logging/Kconfig.template.log_config"

endmenu
```

## applications/pelion_client/src/modules/Kconfig.net
```kconfig
#
# Copyright (c) 2021 Nordic Semiconductor ASA
#
# SPDX-License-Identifier: LicenseRef-Nordic-5-Clause
#

menu "Networking"

config PELION_CLIENT_LOG_WAITING_ON_CONNECTION
	bool "Log waiting on connection"
	depends on LOG
	default y
	help
	  If enabled periodic message informing about connection in progress
	  will be emitted.

if PELION_CLIENT_LOG_WAITING_ON_CONNECTION

config PELION_CLIENT_WAITING_ON_CONNECTION_LOG_PERIOD
	int "Waiting on connection log period [s]"
	range 1 3600
	default 5
	help
	  Time in seconds at which waiting on connection log is emitted.

endif

if !PELION_CLIENT_LOG_WAITING_ON_CONNECTION

config PELION_CLIENT_WAITING_ON_CONNECTION_LOG_PERIOD
	int
	default 0

endif

module = PELION_CLIENT_NET
module-str = Networking module
source "subsys/logging/Kconfig.template.log_config"

endmenu
```

## applications/pelion_client/src/modules/Kconfig.oma_objects
```kconfig
#
# Copyright (c) 2021 Nordic Semiconductor ASA
#
# SPDX-License-Identifier: LicenseRef-Nordic-5-Clause
#

menu "OMA objects"

config PELION_CLIENT_OMA_STOPWATCH
	bool "OMA stopwatch object"
	default y
	help
	  OMA stopwatch object resources will be added.

if PELION_CLIENT_OMA_STOPWATCH

config PELION_CLIENT_OMA_STOPWATCH_TIMEOUT
	int "OMA stopwatch timeout [s]"
	range 1 2147483647
	default 10
	help
	  Define how often stopwatch will update its timestamp.

module = PELION_CLIENT_OMA_STOPWATCH
module-str = OMA stopwatch module
source "subsys/logging/Kconfig.template.log_config"

endif

config PELION_CLIENT_OMA_DIGITAL_INPUT
	bool "OMA digital input object"
	default y
	help
	  OMA digital input object resources will be added.

if PELION_CLIENT_OMA_DIGITAL_INPUT

module = PELION_CLIENT_OMA_DIGITAL_INPUT
module-str = OMA digital input module
source "subsys/logging/Kconfig.template.log_config"

endif

endmenu
```

## applications/pelion_client/src/modules/Kconfig.pelion
```kconfig
#
# Copyright (c) 2021 Nordic Semiconductor ASA
#
# SPDX-License-Identifier: LicenseRef-Nordic-5-Clause
#

menu "Pelion"

config PELION_CLIENT_PAUSE_ON_DISCONNECT
	bool "Pause Pelion on network disconnection"
	default y
	help
	  When network disconnects cloud client will be paused. On reconnection
	  it will be resumed. Note that to avoid TLS handshake on resume
	  mbedtls must support SSL context serialization.

config PELION_CLIENT_USE_APPLICATION_NETWORK_CALLBACK
	bool "Register network callback by the application"
	default y
	select PELION_PAL_USE_APPLICATION_NETWORK_CALLBACK
	help
	  When this option is enabled, the application must provide definition
	  of the setter function for registering network status callback.
	  Application shall use the callback function to notify Pelion client
	  about changes in network connectivity, allowing the client to stay
	  dormant during network loss.

	  Signature for setter C function:
	  #include "pal.h"
	  palStatus_t pal_plat_setConnectionStatusCallback(uint32_t interfaceIndex,
							   connectionStatusCallback callback,
							   void *client_arg)

module = PELION_CLIENT_PELION
module-str = Pelion module
source "subsys/logging/Kconfig.template.log_config"

endmenu
```

## applications/pelion_client/src/modules/Kconfig.power_manager
```kconfig
#
# Copyright (c) 2021 Nordic Semiconductor
#
# SPDX-License-Identifier: LicenseRef-Nordic-5-Clause
#

menu "Power manager"

config PELION_CLIENT_POWER_MANAGER_ENABLE
	bool "Enable power management"
	select PM_DEVICE
	select CAF_PM_EVENTS
	select PELION_CLIENT_KEEP_ALIVE_EVENTS
	help
	  Enable power management, which will put the device to low-power mode
	  if it is idle.

if PELION_CLIENT_POWER_MANAGER_ENABLE

config PELION_CLIENT_POWER_MANAGER_STAY_ON
	bool "Stay on while no connections"
	help
	  If disabled the device will switch SoC to OFF mode after power
	  manager timeout is done. If enabled the device will stay on
	  but remain idle. If the device is connected it will always stay on
	  and maintain the connection, regardless of the setting.

config PELION_CLIENT_POWER_MANAGER_TIMEOUT
	int "Power down timeout [s]"
	default 120
	help
	  Time in seconds after which the device will enter low-power mode.

config PELION_CLIENT_POWER_MANAGER_ERROR_TIMEOUT
	int "Power manager timeout on error [s]"
	default 30
	help
	 Time in seconds after which the device will be turned off after an error.

module = PELION_CLIENT_POWER_MANAGER
module-str = power manager
source "subsys/logging/Kconfig.template.log_config"

endif

endmenu
```

## applications/peripheral_sensor_node/Kconfig
```kconfig
#
# Copyright (c) 2023 Nordic Semiconductor
#
# SPDX-License-Identifier: LicenseRef-Nordic-5-Clause
#

menu "Peripheral sensor node application"
rsource "src/events/Kconfig"
rsource "src/modules/Kconfig"
endmenu

menu "Zephyr Kernel"
source "Kconfig.zephyr"
endmenu
```

## applications/peripheral_sensor_node/sample.yaml
```yaml
sample:
  name: Peripheral Sensor Node
  description: Peripheral Sensor Node application reference design
tests:
  applications.peripheral_sensor_node:
    sysbuild: true
    platform_allow: nrf54l15pdk/nrf54l15/cpuapp
    integration_platforms:
      - nrf54l15pdk/nrf54l15/cpuapp
    tags: ci_build sysbuild
    extra_args: SHIELD=pca63565
    timeout: 150
    harness: console
    harness_config:
      fixture: pca63565
      type: multi_line
      ordered: true
      regex:
        - "ble_state: Bluetooth initialized"
        - "ble_adv: Advertising started"
        - "app_event_manager: e:module_state_event module:ble_adv state:READY"
        - "app_event_manager: e:sensor_state_event sensor:imu state:ACTIVE"
        - "app_event_manager: e:sensor_state_event sensor:env state:ACTIVE"
        - "nsms: env .*"
        - "nsms: imu .*"
        - "app_event_manager: e: power_down_event"
        - "ble_adv: Advertising stopped"
        - "app_event_manager: e:module_state_event module:ble_adv state:OFF"
        - "app_event_manager: e:sensor_state_event sensor:env state:SLEEP"
        - "app_event_manager: e:sensor_state_event sensor:imu state:SLEEP"
        - "app_event_manager: e: wake_up_event"
        - "app_event_manager: e:module_state_event module:ble_adv state:READY"
        - "app_event_manager: e:sensor_state_event sensor:imu state:ACTIVE"
        - "app_event_manager: e:sensor_state_event sensor:env state:ACTIVE"
        - "nsms: env .*"
        - "nsms: imu .*"
        - "app_event_manager: e: power_down_event"
        - "ble_adv: Advertising stopped"
        - "app_event_manager: e:module_state_event module:ble_adv state:OFF"
        - "app_event_manager: e:sensor_state_event sensor:env state:SLEEP"
        - "app_event_manager: e:sensor_state_event sensor:imu state:SLEEP"
```

## applications/peripheral_sensor_node/src/events/Kconfig
```kconfig
#
# Copyright (c) 2023 Nordic Semiconductor
#
# SPDX-License-Identifier: LicenseRef-Nordic-5-Clause
#

menu "Event options"

rsource "Kconfig.app_sensor_event"

endmenu
```

## applications/peripheral_sensor_node/src/events/Kconfig.app_sensor_event
```kconfig
#
# Copyright (c) 2023 Nordic Semiconductor
#
# SPDX-License-Identifier: LicenseRef-Nordic-5-Clause
#

config APP_SENSOR_EVENTS
	bool "Enable application sensor events"
	help
	  Enable support for application sensor events.

config APP_INIT_LOG_SENSOR_EVENTS
	bool "Log app sensor events"
	depends on APP_SENSOR_EVENTS
	depends on LOG
	default y
	help
	  Log app sensor events, used to notify about sensor start/stop.
```

## applications/peripheral_sensor_node/src/modules/Kconfig
```kconfig
#
# Copyright (c) 2023 Nordic Semiconductor
#
# SPDX-License-Identifier: LicenseRef-Nordic-5-Clause
#

menu "Application modules"

rsource "Kconfig.app_control"
rsource "Kconfig.sensors"

endmenu
```

## applications/peripheral_sensor_node/src/modules/Kconfig.app_control
```kconfig
#
# Copyright (c) 2023 Nordic Semiconductor ASA
#
# SPDX-License-Identifier: LicenseRef-Nordic-5-Clause
#

menuconfig APP_CONTROL
	bool "Application control"
	depends on CAF
	select APP_SENSOR_EVENTS
	select CAF_SENSOR_EVENTS
	select CAF_PM_EVENTS
	default y

if APP_CONTROL

config APP_CONTROL_BURST_INTERVAL_S
	int "Burst interval [s]"
	range 60 5400
	default 120
	help
	  Time in seconds between burst data acquisition from sensors.
	  If sensor data burst is not triggered by wake_up event from IMU,
	  burst is performed every interval value.

config APP_CONTROL_BURST_MEAS_CNT
	int "Number of measurements for a single burst"
	range 1 30
	default 10
	help
	  Number of measurements single burst acquires before going to sleep.

config APP_CONTROL_BURST_MEAS_INTERVAL_MS
	int "Burst measurements interval [ms]"
	range 1000 15000
	default 1000
	help
	  Interval between measurements for a single burst.

module = APP_CONTROL
module-str = app control
source "subsys/logging/Kconfig.template.log_config"

endif # APP_CONTROL
```

## applications/peripheral_sensor_node/src/modules/Kconfig.sensors
```kconfig
#
# Copyright (c) 2023 Nordic Semiconductor ASA
#
# SPDX-License-Identifier: LicenseRef-Nordic-5-Clause
#

menuconfig APP_SENSORS
	bool "Sensors module"
	depends on SENSOR
	select APP_SENSOR_EVENTS
	select CAF_SENSOR_EVENTS
	help
	  The module is handling sensor sampling and management.

if APP_SENSORS

config APP_SENSORS_DEF_PATH
	string "Configuration file"
	default "sensor_def.h"
	help
	  Location of configuration file for sensor sampler module.

config APP_SENSORS_THREAD_STACK_SIZE
	int "Size of sensor sampler thread stack"
	default 2048
	help
	  The module samples sensors in a dedicated thread. The thread stack size must be big
	  enough for used sensors.

config APP_SENSORS_THREAD_PRIORITY
	int "Priority of sensor sampler thread"
	default 2
	help
	  It is recommended to use preemptive thread priority to make sure that the thread will
	  not block other operations in the system.

module = APP_SENSORS
module-str = app sensors module
source "subsys/logging/Kconfig.template.log_config"

endif # APP_SENSORS
```

## applications/platform_key_loader/Kconfig
```kconfig
# Copyright (c) 2024 Nordic Semiconductor ASA
# SPDX-License-Identifier: LicenseRef-Nordic-5-Clause

config NRF_KEY_LOADER_BASE_PATH
	default "${ZEPHYR_NRF_MODULE_DIR}/applications/platform_key_loader/keys"

source "Kconfig.zephyr"
```

## applications/platform_key_loader/sample.yaml
```yaml
sample:
  name: Platform Key Loader
  description: |
    Application used for loading platform keys

common:
  build_only: true

tests:
  applications.platform_key_loader:
    platform_allow: nrf54h20dk/nrf54h20/cpuapp
    integration_platforms:
      - nrf54h20dk/nrf54h20/cpuapp
```

## applications/protocols_serialization/Kconfig
```kconfig
#
# Copyright (c) 2024 Nordic Semiconductor ASA
#
# SPDX-License-Identifier: LicenseRef-Nordic-5-Clause
#

menu "Protocols serialization server"

choice LOG_MODE
	default LOG_MODE_DEFERRED
endchoice

config LOG_BUFFER_SIZE
	default 8192

config LOG_FUNC_NAME_PREFIX_DBG
	default n

config LOG_BACKEND_RTT
	default n

config LOG_BACKEND_UART
	default n

module = NRF_PS_SERVER
module-str = nrf_ps_server
source "${ZEPHYR_BASE}/subsys/logging/Kconfig.template.log_config"

endmenu # "Protocols serialization server"

menu "Zephyr Kernel"
source "Kconfig.zephyr"
endmenu
```

## applications/protocols_serialization/client/Kconfig
```kconfig
#
# Copyright (c) 2024 Nordic Semiconductor ASA
#
# SPDX-License-Identifier: LicenseRef-Nordic-5-Clause
#

mainmenu "Protocols serialization client"

config RPC_CRASH_LOG_READ_BUFFER_SIZE
	int "Crash log read buffer size"
	depends on LOG_FORWARDER_RPC
	default 256
	help
	  Size of the stack buffer used for reading a single chunk of the crash
	  log from the server device.

menu "Zephyr Kernel"
source "Kconfig.zephyr"
endmenu

module = NRF_RPC_HOST
module-str = nrf_rpc_host
source "${ZEPHYR_BASE}/subsys/logging/Kconfig.template.log_config"
```

## applications/protocols_serialization/client/sample.yaml
```yaml
sample:
  name: Protocols serialization client application
  description: Demonstrates serialization of BLE and OpenThread API using nRF RPC
tests:
  applications.protocols_serialization.client.rpc_ble:
    build_only: true
    platform_allow: >
      nrf52840dk/nrf52840
    tags: ci_build
    extra_args: >
      SNIPPET="ble"
    integration_platforms:
      - nrf52840dk/nrf52840
  applications.protocols_serialization.client.rpc_ot:
    build_only: true
    platform_allow: >
      nrf52840dk/nrf52840
    tags: ci_build
    extra_args: >
      SNIPPET="openthread"
    integration_platforms:
      - nrf52840dk/nrf52840
  applications.protocols_serialization.client.rpc:
    build_only: true
    platform_allow: >
      nrf52840dk/nrf52840
    tags: ci_build
    extra_args: >
      SNIPPET="ble;openthread"
    integration_platforms:
      - nrf52840dk/nrf52840
        
```

## applications/protocols_serialization/sample.yaml
```yaml
sample:
  name: Protocols serialization server application
  description: Demonstrates serialization of BLE and OpenThread API using nRF RPC
tests:
  applications.protocols_serialization.rpc_ble:
    build_only: true
    platform_allow: >
      nrf52840dk/nrf52840
      nrf54l15pdk/nrf54l15/cpuapp
    tags: ci_build
    extra_args: >
      SNIPPET="ble"
    integration_platforms:
      - nrf52840dk/nrf52840
      - nrf54l15pdk/nrf54l15/cpuapp
  applications.protocols_serialization.rpc_ot:
    build_only: true
    platform_allow: >
      nrf52840dk/nrf52840
      nrf54l15pdk/nrf54l15/cpuapp
    tags: ci_build
    extra_args: >
      SNIPPET="openthread"
    integration_platforms:
      - nrf52840dk/nrf52840
      - nrf54l15pdk/nrf54l15/cpuapp
  applications.protocols_serialization.rpc:
    build_only: true
    platform_allow: >
      nrf52840dk/nrf52840
      nrf54l15pdk/nrf54l15/cpuapp
    tags: ci_build
    extra_args: >
      SNIPPET="ble;openthread;debug;coex;log_rpc"
    integration_platforms:
      - nrf52840dk/nrf52840
      - nrf54l15pdk/nrf54l15/cpuapp
```

## applications/protocols_serialization/server/boards/nrf54l15pdk_nrf54l15_cpuapp.conf
```kconfig
#
# Copyright (c) 2024 Nordic Semiconductor
#
# SPDX-License-Identifier: LicenseRef-Nordic-5-Clause
#
CONFIG_MAIN_STACK_SIZE=4196
```

## applications/protocols_serialization/server/sample.yaml
```yaml
sample:
  name: Protocols serialization server application
  description: Demonstrates serialization of BLE and OpenThread API using nRF RPC
tests:
  applications.protocols_serialization.server.rpc_ble:
    build_only: true
    platform_allow: >
      nrf52840dk_nrf52840
    tags: ci_build
    extra_args: >
      SNIPPET="ble"
    integration_platforms:
      - nrf52840dk_nrf52840
  applications.protocols_serialization.server.rpc_ot:
    build_only: true
    platform_allow: >
      nrf52840dk_nrf52840
    tags: ci_build
    extra_args: >
      SNIPPET="openthread"
    integration_platforms:
      - nrf52840dk_nrf52840
  applications.protocols_serialization.server.rpc:
    build_only: true
    platform_allow: >
      nrf52840dk_nrf52840
    tags: ci_build
    extra_args: >
      SNIPPET="ble;openthread"
    integration_platforms:
      - nrf52840dk_nrf52840
```

## applications/sdp/Kconfig
```kconfig
config SDP_DEVELOPER_MODE
	bool "SDP developer mode"
	help
	  SDP developer mode.
	  If enabled, changes in HRT files will be included in build.
	  Otherwise, if there is a change in HRT that produces a different ASM file than
	  the provided one, build error is reported.
```
