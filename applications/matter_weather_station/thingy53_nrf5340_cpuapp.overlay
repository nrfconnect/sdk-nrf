/*
 * Copyright (c) 2021 Nordic Semiconductor ASA
 *
 * SPDX-License-Identifier: LicenseRef-Nordic-5-Clause
 */

 &i2c1 {
	bme688@76 {
        compatible = "bosch,bme680";
        label = "BME688";
        reg = <0x76>;
    };
};
