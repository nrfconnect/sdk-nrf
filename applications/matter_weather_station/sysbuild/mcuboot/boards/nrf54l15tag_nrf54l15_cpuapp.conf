## applications/matter_weather_station/sysbuild/mcuboot/boards/nrf54l15tag_nrf54l15_cpuapp.conf
```kconfig
#
# Copyright (c) 2026 Nordic Semiconductor ASA
#
# SPDX-License-Identifier: LicenseRef-Nordic-5-Clause
#

# TODO: Workaround, disable memory guard to avoid false faults in application after boot
CONFIG_HW_STACK_PROTECTION=n

CONFIG_BOOT_WATCHDOG_FEED=n

CONFIG_BOOT_SWAP_SAVE_ENCTLV=n
CONFIG_BOOT_BOOTSTRAP=n

# Disable all debug features
CONFIG_ASSERT_VERBOSE=n
CONFIG_ASSERT_NO_FILE_INFO=y
CONFIG_PRINTK=n

# Bootloader size optimization to fit into 28 KB partition.
# These options can be safely disabled because in this configuration,
# the secondary slot resides in the internal RRAM, so features
# needed to handle the external flash are not needed.
CONFIG_SPI_NOR=n
CONFIG_SERIAL=n
CONFIG_GPIO=n
CONFIG_MULTITHREADING=n
CONFIG_TICKLESS_KERNEL=n
CONFIG_TIMEOUT_64BIT=n
CONFIG_NRF_ENABLE_ICACHE=n

# Currently, without tickless kernel, the SYSCOUNTER value after the software
# reset is not set properly and due to that the first system interrupt is not called
# in the proper time - the SYSCOUNTER value is set to the value from before
# reset + 1. Hence, the reboot time increases more and more.
# To avoid it enable tickles kernel for mcuboot.
CONFIG_TICKLESS_KERNEL=y
```

## applications/matter_weather_station/sysbuild/mcuboot/boards/thingy53_nrf5340_cpuapp.conf
```kconfig
#
# Copyright (c) 2026 Nordic Semiconductor ASA
#
# SPDX-License-Identifier: LicenseRef-Nordic-5-Clause
#

CONFIG_PICOLIBC=y
CONFIG_COMMON_LIBC_MALLOC_ARENA_SIZE=0

CONFIG_BOOT_SWAP_SAVE_ENCTLV=n
CONFIG_BOOT_ENCRYPT_IMAGE=n
CONFIG_BOOT_BOOTSTRAP=n
CONFIG_LOG_MODE_MINIMAL=y
CONFIG_LOG_DEFAULT_LEVEL=0
CONFIG_MCUBOOT_LOG_LEVEL_INF=y
CONFIG_NCS_APPLICATION_BOOT_BANNER_STRING="MCUboot"

CONFIG_SYSTEM_CLOCK_NO_WAIT=y

CONFIG_MBEDTLS_CFG_FILE="mcuboot-mbedtls-cfg.h"

CONFIG_BOOT_MAX_IMG_SECTORS=2048
CONFIG_BOOT_SIGNATURE_TYPE_RSA=y

# Flash
CONFIG_BOOT_ERASE_PROGRESSIVELY=y
CONFIG_SOC_FLASH_NRF_EMULATE_ONE_BYTE_WRITE_ACCESS=y

# Serial
CONFIG_SERIAL=y
CONFIG_UART_LINE_CTRL=y

# MCUBoot serial
CONFIG_GPIO=y
CONFIG_GPIO_NRFX_INTERRUPT=n
CONFIG_MCUBOOT_SERIAL=y
CONFIG_MCUBOOT_SERIAL_DIRECT_IMAGE_UPLOAD=y
CONFIG_BOOT_SERIAL_CDC_ACM=y

# Required by QSPI
CONFIG_NORDIC_QSPI_NOR=y
CONFIG_NORDIC_QSPI_NOR_FLASH_LAYOUT_PAGE_SIZE=4096
CONFIG_NORDIC_QSPI_NOR_STACK_WRITE_BUFFER_SIZE=16

# Required by USB
CONFIG_MULTITHREADING=y

# USB
CONFIG_BOARD_SERIAL_BACKEND_CDC_ACM=n
CONFIG_USB_DEVICE_REMOTE_WAKEUP=n
CONFIG_USB_DEVICE_MANUFACTURER="Nordic Semiconductor ASA"
CONFIG_USB_DEVICE_PRODUCT="Bootloader Thingy:53"
CONFIG_USB_DEVICE_VID=0x1915
CONFIG_USB_DEVICE_PID=0x5300
CONFIG_USB_CDC_ACM=y

# Decrease memory footprint
CONFIG_ERRNO=n
CONFIG_I2C=n
CONFIG_UART_NRFX=n

# The following configurations are required to support simultaneous multi image update
CONFIG_PCD_APP=y
CONFIG_UPDATEABLE_IMAGE_NUMBER=2
CONFIG_BOOT_UPGRADE_ONLY=y
# The network core cannot access external flash directly. The flash simulator must be used to
# provide a memory region that is used to forward the new firmware to the network core.
CONFIG_FLASH_SIMULATOR=y
CONFIG_FLASH_SIMULATOR_DOUBLE_WRITES=y
CONFIG_FLASH_SIMULATOR_STATS=n

# Enable custom command to erase settings partition.
CONFIG_ENABLE_MGMT_PERUSER=y
CONFIG_BOOT_MGMT_CUSTOM_STORAGE_ERASE=y
```

## applications/nrf5340_audio/Kconfig
```kconfig
#
# Copyright (c) 2018 Nordic Semiconductor ASA
#
# SPDX-License-Identifier: LicenseRef-Nordic-5-Clause
#

menuconfig NRF5340_AUDIO
	 bool "nRF5340 Audio [EXPERIMENTAL]"
	 select EXPERIMENTAL

if NRF5340_AUDIO

config CUSTOM_BROADCASTER
	bool "Allow custom broadcasters"
	default n
	help
	  Incomplete feature for now, but will introduce support for multiple BIGs and subgroups.

config AUDIO_DEV
	int "Select which device type to compile for. 1=HEADSET or 2=GATEWAY"
	range 1 2
	default 1
	help
	  Setting this variable to 1 selects that the project is compiled
	  as a HEADSET device.
	  Setting to 2 will compile as a GATEWAY.

choice NRF5340_AUDIO_TRANSPORT_MODE
	prompt "Choose BIS or CIS for ISO transport"
	default TRANSPORT_CIS if WALKIE_TALKIE_DEMO
	default TRANSPORT_CIS

config TRANSPORT_BIS
	bool "Use BIS (Broadcast Isochronous Stream)"

config TRANSPORT_CIS
	bool "Use CIS (Connected Isochronous Stream)"

endchoice

#----------------------------------------------------------------------------#
if (TRANSPORT_BIS && AUDIO_DEV = 1)
rsource "broadcast_sink/Kconfig.defaults"
endif # TRANSPORT_BIS && AUDIO_DEV = 1

if (TRANSPORT_BIS && AUDIO_DEV = 2)
rsource "broadcast_source/Kconfig.defaults"
endif # TRANSPORT_BIS && AUDIO_DEV = 2

if (TRANSPORT_CIS && AUDIO_DEV = 1)
rsource "unicast_server/Kconfig.defaults"
endif # TRANSPORT_CIS && AUDIO_DEV = 1

if (TRANSPORT_CIS && AUDIO_DEV = 2)
rsource "unicast_client/Kconfig.defaults"
endif # TRANSPORT_CIS && AUDIO_DEV = 2



rsource "Kconfig.defaults"
rsource "src/audio/Kconfig"
rsource "src/bluetooth/Kconfig"
rsource "src/drivers/Kconfig"
rsource "src/modules/Kconfig"
rsource "src/utils/Kconfig"

#----------------------------------------------------------------------------#
menu "Logging"

module = MAIN
module-str = main
source "subsys/logging/Kconfig.template.log_config"

config PRINT_STACK_USAGE_MS
	depends on THREAD_ANALYZER && INIT_STACKS
	int "Print stack usage every x milliseconds"
	default 5000

endmenu # Log levels

#----------------------------------------------------------------------------#
endif # NRF5340_AUDIO

source "Kconfig.zephyr"
```

## applications/nrf5340_audio/Kconfig.defaults
```kconfig
#
# Copyright (c) 2022 Nordic Semiconductor ASA
#
# SPDX-License-Identifier: LicenseRef-Nordic-5-Clause
#

config REBOOT
	bool
	default y

config MAIN_THREAD_PRIORITY
	int
	default 10

config MAIN_STACK_SIZE
	int
	default 3616

config SYSTEM_WORKQUEUE_STACK_SIZE
	int
	default 4096

# As long as thread names are used, config must be set to "y"
config THREAD_NAME
	bool
	default y

config NCS_INCLUDE_RPMSG_CHILD_IMAGE
	default n

# Workaround to not use fatal_error.c in NCS. Note that the system may still
# reset on error depending on the build configuraion
config RESET_ON_FATAL_ERROR
	bool
	default n

# Default Config for Debug and Release build
config HW_CODEC_CIRRUS_LOGIC
	bool
	default y

config BT
	bool
	default y

config BOARD_ENABLE_DCDC_APP
	bool
	default y

config BOARD_ENABLE_DCDC_NET
	bool
	default y

config BOARD_ENABLE_CPUNET
	bool
	default y

config NFCT_PINS_AS_GPIOS
	bool
	default y

config SENSOR
	bool
	default y

config CONTIN_ARRAY
	bool
	default y

config NRFX_I2S
	bool
	default y

config PCM_MIX
	bool
	default y

config TONE
	bool
	default y

config PSCM
	bool
	default y

config DATA_FIFO
	bool
	default y

# Enable NRFX_CLOCK for ACLK control
config NRFX_CLOCK
	bool
	default y

config I2C
	bool
	default y

choice LIBC_IMPLEMENTATION
	# NOTE: Since we are not using minimal libc, error codes from
	#       minimal libc are not used
	default NEWLIB_LIBC
endchoice

# Audio codec LC3 related defines
# FPU_SHARING enables preservation of the hardware floating point registers
# across context switches to allow multiple threads to perform concurrent
# floating point operations.
config FPU
	bool
	default y

config FPU_SHARING
	bool
	default y

# Enable SDHC interface
config DISK_DRIVERS
	bool
	default y

config DISK_DRIVER_SDMMC
	bool
	default y

# Enable SPI interface
config SPI
	bool
	default y

# Enable ADC for board version readback
config ADC
	bool
	default y

# Allocate buffer on RAM for transferring chunck of data
# from Flash to SPI
config SPI_NRFX_RAM_BUFFER_SIZE
	int
	default 8

# Config the file system
config FILE_SYSTEM
	bool
	default y

config FAT_FILESYSTEM_ELM
	bool
	default y

config FS_FATFS_LFN
	bool
	default y
choice FS_FATFS_LFN_MODE
	# Using stack for LFN work queue
	default FS_FATFS_LFN_MODE_STACK
endchoice

# exFAT enabled to support longer file names and higher transfer speed
config FS_FATFS_EXFAT
	bool
	default y

# Set the maximum file name length to 255
config FS_FATFS_MAX_LFN
	int
	default 255
```

## applications/nrf5340_audio/Kconfig.sysbuild
```kconfig
#
# Copyright (c) 2024 Nordic Semiconductor
#
# SPDX-License-Identifier: LicenseRef-Nordic-5-Clause
#

config NRF_DEFAULT_IPC_RADIO
	default y

config AUDIO_DFU_EXTERNAL_FLASH
	bool "Audio Application DFU using external flash"
	default n
	help
	  Use external flash to store the images downloaded during DFU. This requires the external
	  flash shield with the MX25R6435F on the SPI bus.

choice BOOTLOADER
	default BOOTLOADER_MCUBOOT if AUDIO_DFU_EXTERNAL_FLASH
endchoice

config SECURE_BOOT_NETCORE
	default y if AUDIO_DFU_EXTERNAL_FLASH

config NETCORE_APP_UPDATE
	default y if AUDIO_DFU_EXTERNAL_FLASH

config PM_EXTERNAL_FLASH_MCUBOOT_SECONDARY
	default y if AUDIO_DFU_EXTERNAL_FLASH

config PM_OVERRIDE_EXTERNAL_DRIVER_CHECK
	default y if AUDIO_DFU_EXTERNAL_FLASH

source "${ZEPHYR_BASE}/share/sysbuild/Kconfig"
```

## applications/nrf5340_audio/boards/nrf5340_audio_dk_nrf5340_cpuapp.conf
```kconfig
#
# Copyright (c) 2024 Nordic Semiconductor ASA
#
# SPDX-License-Identifier: LicenseRef-Nordic-5-Clause
#

CONFIG_NRF5340_AUDIO_CS47L63_DRIVER=y
CONFIG_NRF5340_AUDIO_SD_CARD_MODULE=y
CONFIG_UDC_DRIVER_HIGH_SPEED_SUPPORT_ENABLED=n
```

## applications/nrf5340_audio/boards/nrf5340_audio_dk_nrf5340_cpuapp_release.conf
```kconfig
#
# Copyright (c) 2024 Nordic Semiconductor ASA
#
# SPDX-License-Identifier: LicenseRef-Nordic-5-Clause
#

CONFIG_NRF5340_AUDIO_CS47L63_DRIVER=y
CONFIG_NRF5340_AUDIO_SD_CARD_MODULE=y
```

## applications/nrf5340_audio/boards/nrf5340dk_nrf5340_cpuapp.conf
```kconfig
#
# Copyright (c) 2024 Nordic Semiconductor ASA
#
# SPDX-License-Identifier: LicenseRef-Nordic-5-Clause
#

CONFIG_NRF5340_AUDIO_CS47L63_DRIVER=n
CONFIG_NRF5340_AUDIO_POWER_MEASUREMENT=n
CONFIG_NRF5340_AUDIO_SD_CARD_MODULE=n
```

## applications/nrf5340_audio/broadcast_sink/Kconfig.defaults
```kconfig
#
# Copyright (c) 2023 Nordic Semiconductor ASA
#
# SPDX-License-Identifier: LicenseRef-Nordic-5-Clause
#

## ACL related configs ##
config BT_OBSERVER
	default y

config BT_PERIPHERAL
	default y

config BT_BUF_ACL_TX_COUNT
	default 18

config BT_CAP_ACCEPTOR
	default y if BT_AUDIO_SCAN_DELEGATOR
	select BT_CSIP_SET_MEMBER
	select BT_CAP_ACCEPTOR_SET_MEMBER
	select BT_GAP_PERIPHERAL_PREF_PARAMS
	select BT_VCP_VOL_REND

config BT_PERIPHERAL_PREF_MIN_INT
	default 64

config BT_PERIPHERAL_PREF_MAX_INT
	default 69

config BT_PERIPHERAL_PREF_LATENCY
	default 0

config BT_PERIPHERAL_PREF_TIMEOUT
	default 200

# Generic Audio Sink - 0x0840
config BT_DEVICE_APPEARANCE
	default 2112

config BT_PER_ADV_SYNC_MAX
	default 2

config BT_SMP
	default y


## ISO related configs ##
config BT_ISO_SYNC_RECEIVER
	default y

config BT_BAP_BROADCAST_SINK
	default y

config BT_BAP_SCAN_DELEGATOR
	default y

config BT_BAP_BROADCAST_SNK_STREAM_COUNT
	default 2

config BT_BAP_BROADCAST_SNK_COUNT
	default 2

config BT_ISO_MAX_CHAN
	default 2

config BT_ISO_MAX_BIG
	default 2

config BT_AUDIO_RX
	default y

config BT_PER_ADV_SYNC_TRANSFER_RECEIVER
	default y if BT_AUDIO_SCAN_DELEGATOR
	select SETTINGS
	select BT_SETTINGS
	select FLASH
	select FLASH_MAP
	select NVS

config NVS_LOG_LEVEL
	default 2

config BT_DEVICE_NAME
	default "NRF5340_BIS_HEADSET"

## PACS related configs ##
config BT_PAC_SNK_NOTIFIABLE
	default y

config BT_PAC_SNK
	default y

config BT_PAC_SRC_NOTIFIABLE
	default y

config BT_PAC_SRC
	default y

## Audio related configs ##
config AUDIO_MUTE
	default n

config AUDIO_TEST_TONE
	default n


## LC3 related configs ##
config LC3_DEC_CHAN_MAX
	default 1
```

## applications/nrf5340_audio/broadcast_source/Kconfig.defaults
```kconfig
#
# Copyright (c) 2023 Nordic Semiconductor ASA
#
# SPDX-License-Identifier: LicenseRef-Nordic-5-Clause
#

## ISO related configs ##
config BT_CAP_INITIATOR
	default y

config BT_MAX_CONN
	default 1

# Broadcasting Device - 0x0885
config BT_DEVICE_APPEARANCE
	default 2181

config BT_ISO_BROADCASTER
	default y

config BT_BAP_BROADCAST_SOURCE
	default y

config BT_ISO_TX_BUF_COUNT
	default 2

config BT_BAP_BROADCAST_SRC_STREAM_COUNT
	default 2

config BT_ISO_MAX_CHAN
	default 2

config BT_ISO_MAX_BIG
	default 2

config BT_AUDIO_TX
	default y


## LC3 related configs ##
config LC3_BITRATE
	default BT_AUDIO_BITRATE_BROADCAST_SRC

config LC3_ENC_CHAN_MAX
	default 2
```

## applications/nrf5340_audio/dfu/conf/Kconfig.dfu
```kconfig
#
# Copyright (c) 2022 Nordic Semiconductor ASA
#
# SPDX-License-Identifier: LicenseRef-Nordic-5-Clause
#

config AUDIO_DFU
	int "Select which DFU type. 0=NONE, 1=Internal flash, 2=External flash"
	range 0 2
	default 0
	help
	  Setting this variable to 0 disables DFU.
	  Setting this variable to 1 selects internal flash single image DFU.
	  Setting this variable to 2 selects external flash multi images DFU.

config B0N_MINIMAL
	bool "B0N use minimal or not"
	default n
	help
	  Let CMakelist choose corresponding overlay file

if AUDIO_DFU = 1 || AUDIO_DFU = 2

# Empty net core image is needed when DFU is enabled
config NCS_SAMPLE_EMPTY_NET_CORE_CHILD_IMAGE
	bool "Dummy Net core application"
	default y

config AUDIO_DFU_ENABLE
	bool
	default y
	select EXPERIMENTAL
	help
		To show warning message of EXPERIMENTAL feature DFU

config BOOTLOADER_MCUBOOT
	bool
	default y

config SYSTEM_WORKQUEUE_STACK_SIZE
	int
	default 4096

config THREAD_NAME
	bool
	default y

# DFU
config MCUMGR
	bool
	default y

config MCUMGR_CMD_OS_MGMT
	bool
	default y

config OS_MGMT_TASKSTAT
	bool
	default y

config MCUMGR_CMD_STAT_MGMT
	bool
	default y

config MCUMGR_CMD_IMG_MGMT
	bool
	default y

config MCUMGR_BUF_SIZE
	int
	default 1024

# DFU over BLE
config BT_PERIPHERAL
	default y

config MCUMGR_SMP_BT
	bool
	default y

config MCUMGR_SMP_BT_AUTHEN
	bool
	default n

config BT_L2CAP_TX_MTU
	int
	default 498

config BT_BUF_ACL_TX_SIZE
	int
	default 502

config MCUMGR_BUF_COUNT
	int
	default 6

config THREAD_MONITOR
	bool
	default y

config STATS
	bool
	default y

config STATS_NAMES
	bool
	default y

config MCUBOOT_IMAGE_VERSION
	string
	default "0.0.0+0"

config BT_DEVICE_NAME_DYNAMIC
	bool
	default y

config BT_DEVICE_NAME_GATT_WRITABLE
	bool
	default n

config BT_DEVICE_NAME_MAX
	int
	default 30

endif # AUDIO_DFU = 1 and AUDIO_DFU = 2 (INTERNAL/EXTERNAL)

if AUDIO_DFU = 1

# Reduce footprint for internal flash debug build
choice COMPILER_OPTIMIZATIONS
	default SIZE_OPTIMIZATIONS
endchoice

endif # AUDIO_DFU = 1 (INTERNAL)

if AUDIO_DFU = 2

config UPDATEABLE_IMAGE_NUMBER
	int
	default 2

config IMG_ERASE_PROGRESSIVELY
	bool
	default y

config PM_EXTERNAL_FLASH_MCUBOOT_SECONDARY
	bool
	default y

#External Flash
config SPI_NOR
	bool
	default y

config SPI_NOR_CS_WAIT_DELAY
	int
	default 5

choice SPI_NOR_SFDP
	default SPI_NOR_SFDP_DEVICETREE
endchoice

# Change default flash erase size for flexible flash layout
config SPI_NOR_FLASH_LAYOUT_PAGE_SIZE
	int
	default 4096

# Enable custom SMP request to erase settings partition.
config MCUMGR_GRP_ZEPHYR_BASIC
	bool
	default y

config MCUMGR_GRP_BASIC_CMD_STORAGE_ERASE
	bool
	default y

config BOOT_IMAGE_ACCESS_HOOKS
	bool
	default y

config PM_OVERRIDE_EXTERNAL_DRIVER_CHECK
	bool
	default y

endif # AUDIO_DFU = 2 (EXTERNAL)
```
