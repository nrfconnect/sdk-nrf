## applications/nrf5340_audio/src/bluetooth/bt_content_control/Kconfig
```kconfig
#
# Copyright (c) 2023 Nordic Semiconductor ASA
#
# SPDX-License-Identifier: LicenseRef-Nordic-5-Clause
#

menu "Content control"

rsource "media/Kconfig"

#----------------------------------------------------------------------------#
menu "Log level"

module = BT_CONTENT_CTRL
module-str = bt_content_ctrl
source "subsys/logging/Kconfig.template.log_config"

endmenu # Log level
endmenu # Content control
```

## applications/nrf5340_audio/src/bluetooth/bt_content_control/media/Kconfig
```kconfig
#
# Copyright (c) 2023 Nordic Semiconductor ASA
#
# SPDX-License-Identifier: LicenseRef-Nordic-5-Clause
#

menu "Media"

#----------------------------------------------------------------------------#
menu "Log level"

module = BT_CONTENT_CTRL_MEDIA
module-str = bt_content_ctrl_media
source "subsys/logging/Kconfig.template.log_config"

endmenu # Log level
endmenu # Media
```

## applications/nrf5340_audio/src/bluetooth/bt_management/Kconfig
```kconfig
#
# Copyright (c) 2023 Nordic Semiconductor ASA
#
# SPDX-License-Identifier: LicenseRef-Nordic-5-Clause
#

menu "BT management"

#----------------------------------------------------------------------------#
rsource "dfu/Kconfig"
rsource "advertising/Kconfig"
rsource "scanning/Kconfig"

#----------------------------------------------------------------------------#
menu "Log level"

module = BT_MGMT
module-str = bt-mgmt
source "subsys/logging/Kconfig.template.log_config"

endmenu # Log level
endmenu # BT management
```

## applications/nrf5340_audio/src/bluetooth/bt_management/advertising/Kconfig
```kconfig
#
# Copyright (c) 2023 Nordic Semiconductor ASA
#
# SPDX-License-Identifier: LicenseRef-Nordic-5-Clause
#

menu "Advertising"

config BLE_ACL_PER_ADV_INT_MIN
	hex "Minimum periodic advertising interval"
	range 0x0018 0x03C0
	default 0x0078
	help
	  Minimum hexadecimal value for the interval of periodic advertisements.
	  For ms, multiply the provided value by 1.25.

config BLE_ACL_PER_ADV_INT_MAX
	hex "Maximum periodic advertising interval"
	range 0x0018 0x03C0
	default 0x00A0
	help
	  Maximum hexadecimal value for the interval of periodic advertisements.
	  For ms, multiply the provided value by 1.25.

config BLE_ACL_EXT_ADV_INT_MIN
	hex "Minimum extended advertising interval"
	range 0x0030 0x0780
	default 0x30 if TRANSPORT_BIS
	default 0x00A0
	help
	  Minimum hexadecimal value for the interval of extended advertisements.
	  When the LE Audio Controller Subsystem for nRF53 is used, this interval
	  should be a multiple of the ISO interval and maximum 4x larger than the
	  lowest interval if using BIS.
	  For ms, multiply the provided value by 0.625.

config BLE_ACL_EXT_ADV_INT_MAX
	hex "Maximum extended advertising interval"
	range 0x0030 0x0780
	default 0x40 if TRANSPORT_BIS
	default 0x00F0
	help
	  Maximum hexadecimal value for the interval of extended advertisements.
	  When the LE Audio Controller Subsystem for nRF53 is used, this interval
	  should be a multiple of the ISO interval and maximum 4x larger than the
	  lowest interval if using BIS.
	  For ms, multiply the provided value by 0.625.

config EXT_ADV_BUF_MAX
	int "Maximum number of extended advertising data parameters"
	default 20

config EXT_ADV_UUID_BUF_MAX
	int "Maximum number of UUIDs to add to extended advertisements"
	default 40

config BT_DEVICE_MANUFACTURER_ID
	hex "Manufacturer ID"
	default 0xFE58
	help
	  Bluetooth manufacturer ID. For the list of possible values please
	  consult the following link:
	  https://www.bluetooth.com/specifications/assigned-numbers

config BLE_ACL_ADV_SID
	hex "Advertising set ID"
	range 0x00 0x0F
	default 0x00

#----------------------------------------------------------------------------#
menu "Log level"

module = BT_MGMT_ADV
module-str = bt-mgmt-adv
source "subsys/logging/Kconfig.template.log_config"

endmenu # Log level
endmenu # Advertising
```

## applications/nrf5340_audio/src/bluetooth/bt_management/controller_config/Kconfig
```kconfig
#
# Copyright (c) 2023 Nordic Semiconductor ASA
#
# SPDX-License-Identifier: LicenseRef-Nordic-5-Clause
#

rsource "Kconfig.defaults"

menu "Controller config"

#----------------------------------------------------------------------------#
menu "nRF21540"

config NRF_21540_ACTIVE
	def_bool $(shields_list_contains,nrf21540_ek_fwd)
	select EXPERIMENTAL
	help
	  The front end module can help boost the TX power as high as 20 dBm.

choice NRF_21540_MAIN_TX_POWER
	prompt "TX power for the secondary channels"
	default NRF_21540_MAIN_TX_POWER_10DBM
	help
	  Set the TX power for the secondary Bluetooth LE channels (0-36).
	  Check your local regulations for max output power. If the
	  nRF21540 is used with the nRF5340 Audio DK the actual output power
	  will be about 25% lower due to the VDD being 1.8V instead of the
	  nominal 3.3V.

config NRF_21540_MAIN_TX_POWER_0DBM
	bool "0dBm"

config NRF_21540_MAIN_TX_POWER_10DBM
	bool "+10dBm"

config NRF_21540_MAIN_TX_POWER_20DBM
	bool "+20dBm"

endchoice

config NRF_21540_MAIN_DBM
	int
	default 0 if NRF_21540_MAIN_TX_POWER_0DBM
	default 10 if NRF_21540_MAIN_TX_POWER_10DBM
	default 20 if NRF_21540_MAIN_TX_POWER_20DBM

choice NRF_21540_PRI_ADV_TX_POWER
	prompt "TX power for the primary advertising channels"
	default NRF_21540_PRI_ADV_TX_POWER_10DBM
	help
	  Set the TX power for the primary Bluetooth LE advertising channels
	  (37, 38, 39).
	  Check your local regulations for max output power. If the
	  nRF21540 is used with the nRF5340 Audio DK the actual output power
	  will be about 25% lower due to the VDD being 1.8V instead of the
	  nominal 3.3V.

config NRF_21540_PRI_ADV_TX_POWER_0DBM
	bool "0dBm"

config NRF_21540_PRI_ADV_TX_POWER_10DBM
	bool "+10dBm"

config NRF_21540_PRI_ADV_TX_POWER_20DBM
	bool "+20dBm"

endchoice

config NRF_21540_PRI_ADV_DBM
	int
	default 0 if NRF_21540_PRI_ADV_TX_POWER_0DBM
	default 10 if NRF_21540_PRI_ADV_TX_POWER_10DBM
	default 20 if NRF_21540_PRI_ADV_TX_POWER_20DBM

endmenu # nRF21540

#----------------------------------------------------------------------------#
menu "Log level"

module = BT_MGMT_CTLR_CFG
module-str = bt-mgmt-ctlr-cfg
source "subsys/logging/Kconfig.template.log_config"

endmenu # Log level
endmenu # Controller config
```

## applications/nrf5340_audio/src/bluetooth/bt_management/controller_config/Kconfig.defaults
```kconfig
#
# Copyright (c) 2023 Nordic Semiconductor ASA
#
# SPDX-License-Identifier: LicenseRef-Nordic-5-Clause
#

# Bluetooth controller type
if BT_LL_ACS_NRF53

# Not supported on LE Audio Controller Subsystem for nRF53
config BT_ATT_ENFORCE_FLOW
	default n

# Disable Zephyr HCI Vendor-Specific extensions
config BT_HCI_VS_EXT
	default n

# HCI ACL flow control is not supported on BT_LL_ACS_NRF53
config BT_HCI_ACL_FLOW_CONTROL
	default n

endif # BT_LL_ACS_NRF53
```

## applications/nrf5340_audio/src/bluetooth/bt_management/dfu/Kconfig
```kconfig
#
# Copyright (c) 2023 Nordic Semiconductor ASA
#
# SPDX-License-Identifier: LicenseRef-Nordic-5-Clause
#

menuconfig AUDIO_BT_MGMT_DFU
	bool "Enable BT MGMT DFU module"
	default n
	select EXPERIMENTAL
	select BT_DEVICE_NAME_DYNAMIC
	select MCUMGR
	select NET_BUF
	select ZCBOR
	select CRC
	select MCUMGR_TRANSPORT_BT
	select IMG_ERASE_PROGRESSIVELY
	imply MCUMGR_TRANSPORT_BT_CONN_PARAM_CONTROL
	imply IMG_MANAGER
	imply STREAM_FLASH
	imply FLASH_MAP
	imply FLASH
	imply MCUMGR_GRP_IMG
	imply MCUMGR_GRP_OS
	imply MCUMGR_GRP_OS_MCUMGR_PARAMS
	imply MCUMGR_GRP_OS_BOOTLOADER_INFO
	imply MCUMGR_TRANSPORT_BT_REASSEMBLY
	depends on BT_PERIPHERAL
	depends on BOOTLOADER_MCUBOOT
	help
	  Enable the BT MGMT module. This module adds the DFU mode
	  that can be entered from the main application.

if AUDIO_BT_MGMT_DFU

module = BT_MGMT_DFU
module-str = bt-mgmt-dfu
source "subsys/logging/Kconfig.template.log_config"

endif # AUDIO_BT_MGMT_DFU
```

## applications/nrf5340_audio/src/bluetooth/bt_management/scanning/Kconfig
```kconfig
#
# Copyright (c) 2023 Nordic Semiconductor ASA
#
# SPDX-License-Identifier: LicenseRef-Nordic-5-Clause
#

rsource "Kconfig.defaults"

menu "Scanning"

choice NRF5340_AUDIO_GATEWAY_SCAN_MODE
	prompt "Select Scan Mode to find Unicast Headset"
	default SCAN_MODE_PASSIVE

config SCAN_MODE_PASSIVE
	bool "Passive Scan"

config SCAN_MODE_ACTIVE
	bool "Active Scan"

endchoice

choice BT_MGMT_CONNECT_BY
	prompt "Scan Filter"
	default BT_MGMT_CONNECT_BY_NAME

config BT_MGMT_CONNECT_BY_NAME
	bool "Name"
	help
	  If enabled, the scanner will look for a specific name instead of just connecting
	  to the first device it finds. The name to look for is CONFIG_BT_DEVICE_NAME.
	  This is useful for testing with a known device.
	  Note: This is only used if no CSIP Set Identity Resolving Key (SIRK) is available
	  in the bond information.

config BT_MGMT_CONNECT_BY_ADDR
	bool "Address"
	help
	  If enabled, the scanner will look for a specific address instead of a name.
	  The address to look for is set in bt_mgmt_scan_for_conn.c in the addr_check()
	  function. This is useful for testing with a known device.
	  Note: This is only used if no CSIP Set Identity Resolving Key (SIRK) is available
	  in the bond information.

endchoice

config CONNECT_TO_BT_ADDR_LE_STR
	string "Bluetooth LE Address to connect to"
	default "00:00:00:00:00:00"
	help
	  The Bluetooth LE address to connect to. This is useful for testing with a
	  specific device.

#----------------------------------------------------------------------------#
menu "Connection"

config BLE_ACL_CONN_INTERVAL
	int "Bluetooth LE ACL Connection Interval (x*1.25ms)"
	default 8
	help
	  This interval should be a multiple of the ISO interval used. The recommendation is to
	  increase the interval to something like BLE_ACL_CONN_INTERVAL_SLOW after the discovery
	  process is done, to free up time on air.

config BLE_ACL_CONN_INTERVAL_SLOW
	int "Bluetooth LE ACL Connection Interval (x*1.25ms)"
	default 72
	help
	  This interval should be a multiple of the ISO interval used. 72*1.25=90 which will
	  suit both 7.5ms and 10ms.

config BLE_ACL_SLAVE_LATENCY
	int "Bluetooth LE Slave Latency"
	default 0

config BLE_ACL_SUP_TIMEOUT
	int "Bluetooth LE Supervision Timeout (x*10ms)"
	default 100

endmenu # Connection

#----------------------------------------------------------------------------#
menu "Log level"

module = BT_MGMT_SCAN
module-str = bt-mgmt-scan
source "subsys/logging/Kconfig.template.log_config"

endmenu # Log level
endmenu # Scanning
```
