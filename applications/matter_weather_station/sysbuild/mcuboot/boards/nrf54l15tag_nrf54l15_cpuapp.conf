## applications/nrf5340_audio/sample.yaml
```yaml
sample:
  name: nRF5340 Audio application
  description: LE Audio and Auracast implementation example
tests:
  applications.nrf5340_audio.headset_unicast_release_unidir_usb:
    integration_platforms:
      - nrf5340_audio_dk/nrf5340/cpuapp
      - nrf5340dk/nrf5340/cpuapp
    platform_allow:
      - nrf5340_audio_dk/nrf5340/cpuapp
      - nrf5340dk/nrf5340/cpuapp
    sysbuild: true
    build_only: true
    tags:
      - ci_build
      - sysbuild
      - ci_applications_nrf5340_audio
    extra_args:
      - FILE_SUFFIX=release
      - EXTRA_CONF_FILE=unicast_server/overlay-unicast_server.conf
  applications.nrf5340_audio.gateway_unicast_release_bidir_usb:
    integration_platforms:
      - nrf5340_audio_dk/nrf5340/cpuapp
      - nrf5340dk/nrf5340/cpuapp
    platform_allow:
      - nrf5340_audio_dk/nrf5340/cpuapp
      - nrf5340dk/nrf5340/cpuapp
    sysbuild: true
    build_only: true
    tags:
      - ci_build
      - sysbuild
      - ci_applications_nrf5340_audio
    extra_args:
      - FILE_SUFFIX=release
      - CONFIG_STREAM_BIDIRECTIONAL=y
      - EXTRA_CONF_FILE=unicast_client/overlay-unicast_client.conf
  applications.nrf5340_audio.headset_broadcast_sink_release_usb:
    integration_platforms:
      - nrf5340_audio_dk/nrf5340/cpuapp
      - nrf5340dk/nrf5340/cpuapp
    platform_allow:
      - nrf5340_audio_dk/nrf5340/cpuapp
      - nrf5340dk/nrf5340/cpuapp
    sysbuild: true
    build_only: true
    tags:
      - ci_build
      - sysbuild
      - ci_applications_nrf5340_audio
    extra_args:
      - FILE_SUFFIX=release
      - EXTRA_CONF_FILE=broadcast_sink/overlay-broadcast_sink.conf
  applications.nrf5340_audio.gateway_broadcast_source_release_i2s:
    integration_platforms:
      - nrf5340_audio_dk/nrf5340/cpuapp
      - nrf5340dk/nrf5340/cpuapp
    platform_allow:
      - nrf5340_audio_dk/nrf5340/cpuapp
      - nrf5340dk/nrf5340/cpuapp
    sysbuild: true
    build_only: true
    tags:
      - ci_build
      - sysbuild
      - ci_applications_nrf5340_audio
    extra_args:
      - FILE_SUFFIX=release
      - CONFIG_AUDIO_SOURCE_I2S=y
      - EXTRA_CONF_FILE=broadcast_source/overlay-broadcast_source.conf
  applications.nrf5340_audio.headset_unicast_sd_card_release:
    integration_platforms:
      - nrf5340_audio_dk/nrf5340/cpuapp
    platform_allow:
      - nrf5340_audio_dk/nrf5340/cpuapp
    sysbuild: true
    build_only: true
    tags:
      - ci_build
      - sysbuild
      - ci_applications_nrf5340_audio
    extra_args:
      - FILE_SUFFIX=release
      - CONFIG_SD_CARD_PLAYBACK=y
      - EXTRA_CONF_FILE=unicast_server/overlay-unicast_server.conf
  applications.nrf5340_audio.headset_dfu_release_unidir_usb:
    integration_platforms:
      - nrf5340_audio_dk/nrf5340/cpuapp
    platform_allow:
      - nrf5340_audio_dk/nrf5340/cpuapp
    sysbuild: true
    build_only: true
    tags:
      - ci_build
      - sysbuild
      - ci_applications_nrf5340_audio
    extra_args:
      - FILE_SUFFIX=fota
      - ipc_radio_FILE_SUFFIX=release
      - EXTRA_CONF_FILE=unicast_server/overlay-unicast_server.conf
  applications.nrf5340_audio.headset_unicast_debug_bidir_usb:
    integration_platforms:
      - nrf5340_audio_dk/nrf5340/cpuapp
      - nrf5340dk/nrf5340/cpuapp
    platform_allow:
      - nrf5340_audio_dk/nrf5340/cpuapp
      - nrf5340dk/nrf5340/cpuapp
    sysbuild: true
    build_only: true
    tags:
      - ci_build
      - sysbuild
      - ci_applications_nrf5340_audio
    extra_args:
      - CONFIG_STREAM_BIDIRECTIONAL=y
      - EXTRA_CONF_FILE=unicast_server/overlay-unicast_server.conf
```

## applications/nrf5340_audio/src/audio/Kconfig
```kconfig
#
# Copyright (c) 2022 Nordic Semiconductor ASA
#
# SPDX-License-Identifier: LicenseRef-Nordic-5-Clause
#

rsource "Kconfig.defaults"

menu "Audio"

choice AUDIO_FRAME_DURATION
	prompt "Select frame duration - 7.5 ms frame duration is not tested"
	default AUDIO_FRAME_DURATION_10_MS
	help
	  LC3 supports frame duration of 7.5 and 10 ms.
	  If USB is selected as audio source, we should
	  have a frame duration of 10 ms since USB sends 1ms at a time.

config AUDIO_FRAME_DURATION_7_5_MS
	bool "7.5 ms"

config AUDIO_FRAME_DURATION_10_MS
	bool "10 ms"
endchoice

config AUDIO_FRAME_DURATION_US
	int
	default 7500 if AUDIO_FRAME_DURATION_7_5_MS
	default 10000 if AUDIO_FRAME_DURATION_10_MS
	help
	  Audio frame duration in µs.

choice AUDIO_SAMPLE_RATE
	prompt "Audio sample rate"
	default AUDIO_SAMPLE_RATE_16000_HZ if BT_AUDIO_BROADCAST_16_2_1 || BT_AUDIO_BROADCAST_16_2_2 || BT_AUDIO_UNICAST_16_2_1
	default AUDIO_SAMPLE_RATE_24000_HZ if BT_AUDIO_BROADCAST_24_2_1 || BT_AUDIO_BROADCAST_24_2_2 || BT_AUDIO_UNICAST_24_2_1
	default AUDIO_SAMPLE_RATE_48000_HZ
	help
	  This will be selected based on the BAP settings.

config AUDIO_SAMPLE_RATE_16000_HZ
	bool "16 kHz"
	help
	  Sample rate of 16kHz is currently only valid for I2S/line-in.

config AUDIO_SAMPLE_RATE_24000_HZ
	bool "24 kHz"
	help
	  Sample rate of 24kHz is currently only valid for I2S/line-in.

config AUDIO_SAMPLE_RATE_48000_HZ
	bool "48 kHz"
	help
	  Sample rate of 48kHz is valid for both I2S/line-in and USB.
endchoice

config AUDIO_SAMPLE_RATE_HZ
	int
	default 16000 if AUDIO_SAMPLE_RATE_16000_HZ
	default 24000 if AUDIO_SAMPLE_RATE_24000_HZ
	default 48000 if AUDIO_SAMPLE_RATE_48000_HZ
	help
	  I2S supports 16, 24, and 48 kHz sample rates for both input and output.
	  USB supports only 48 kHz for input.

choice AUDIO_BIT_DEPTH
	prompt "Audio bit depth"
	default AUDIO_BIT_DEPTH_16
	help
	  Select the bit depth for audio.

config AUDIO_BIT_DEPTH_16
	bool "16 bit audio"

config AUDIO_BIT_DEPTH_32
	bool "32 bit audio"
endchoice

config AUDIO_BIT_DEPTH_BITS
	int
	default 16 if AUDIO_BIT_DEPTH_16
	default 32 if AUDIO_BIT_DEPTH_32
	help
	  Bit depth of one sample in storage.

config AUDIO_BIT_DEPTH_OCTETS
	int
	default 2 if AUDIO_BIT_DEPTH_16
	default 4 if AUDIO_BIT_DEPTH_32
	help
	  Bit depth of one sample in storage given in octets.

choice AUDIO_SOURCE_GATEWAY
	prompt "Audio source for gateway"
	default AUDIO_SOURCE_I2S if WALKIE_TALKIE_DEMO
	default AUDIO_SOURCE_USB
	help
	  Select audio source for the gateway.

config AUDIO_SOURCE_USB
	bool "Use USB as audio source"
	help
	  Set USB as audio source. Note that this forces the
	  stream to be unidirectional because of CPU load.

config AUDIO_SOURCE_I2S
	bool "Use I2S as audio source"
endchoice

choice AUDIO_HEADSET_CHANNEL
	prompt "Headset audio channel assignment"
	default AUDIO_HEADSET_CHANNEL_RUNTIME
	help
	  Set whether audio channel assignment for the headset
	  should happen at runtime or compile-time.

config AUDIO_HEADSET_CHANNEL_RUNTIME
	bool "Select at runtime"
	help
	  Make channel selection at runtime. Selected value is stored in persistent memory.
	  Left channel: Hold volume-down button on headset while resetting headset.
	  Right channel: Hold volume-up button on headset while resetting headset.

config AUDIO_HEADSET_CHANNEL_COMPILE_TIME
	bool "Set at compile-time"
	help
	  Set channel selection at compile-time.
endchoice

config AUDIO_TEST_TONE
	bool "Test tone instead of doing user defined action"
	default y
	help
	  Use button 4 to set a test tone
	  instead of doing a user defined action.
	  The test tone is generated on the device itself.

config AUDIO_MUTE
	bool "Mute instead of doing user defined action"
	default y
	help
	  Use button 5 to mute audio instead of
	  doing a user defined action.

if AUDIO_HEADSET_CHANNEL_COMPILE_TIME

config AUDIO_HEADSET_CHANNEL
	int "Audio channel used by headset"
	range 0 1
	default 0
	help
	  Audio channel compile-time selection.
	  Left = 0.
	  Right = 1.

endif # AUDIO_HEADSET_CHANNEL_COMPILE_TIME

#----------------------------------------------------------------------------#
menu "SW Codec"

choice SW_CODEC_DEFAULT
	prompt "Starting SW codec"
	default SW_CODEC_LC3
	help
	  Select the default codec to use on start up.

config SW_CODEC_LC3
	bool "LC3"
	select SW_CODEC_LC3_T2_SOFTWARE
	help
	  LC3 is the mandatory codec for LE Audio.

# Leave room for other codecs
endchoice

config SW_CODEC_PLC_DISABLED
	bool "Skip PLC on a bad frame and fill the output buffer(s) with zeros instead"
	default n
	select LC3_PLC_DISABLED

menu "LC3"
visible if SW_CODEC_LC3

config LC3_BITRATE_MAX
	int "Max bitrate for LC3"
	default 124000

config LC3_BITRATE_MIN
	int "Min bitrate for LC3"
	default 32000

config LC3_BITRATE
	int
	range LC3_BITRATE_MIN LC3_BITRATE_MAX
	default 96000

osource "../nrfxlib/lc3/Kconfig"

endmenu # LC3
endmenu # SW Codec

#----------------------------------------------------------------------------#
menu "Stream"

config BUF_BLE_RX_PACKET_NUM
	int
	default 5
	range 2 5
	help
	  Value can be adjusted to affect the overall latency.
	  This adjusts the number packets in the BLE FIFO RX buffer,
	  which is where the main latency resides. A low value will decrease
	  latency and reduce stability, and vice-versa.
	  Two is recommended minimum to reduce the likelyhood of audio
	  gaps due to BLE retransmits.

config STREAM_BIDIRECTIONAL
	depends on TRANSPORT_CIS
	bool "Bidirectional stream"
	default n
	help
	  Bidirectional stream enables encoder and decoder on both sides,
	  and one device can both send and receive audio.

config WALKIE_TALKIE_DEMO
	select STREAM_BIDIRECTIONAL
	bool "Walkie talkie demo"
	default n
	help
	  The walkie talkie demo will set up a bidirectional stream using PDM
	  microphones on each side.

config MONO_TO_ALL_RECEIVERS
	bool "Send mono (first/left channel) to all receivers"
	default y if BT_AUDIO_UNICAST_CLIENT_ASE_SNK_COUNT = 1
	default y if BT_AUDIO_BROADCAST_SRC_STREAM_COUNT = 1
	default n
	help
	  With this flag set, the gateway will encode and send the same (first/left)
	  channel on all ISO channels.

endmenu # Stream

#----------------------------------------------------------------------------#
menu "Log levels"

module = AUDIO_SYSTEM
module-str = audio-system
source "subsys/logging/Kconfig.template.log_config"

module = SW_CODEC_SELECT
module-str = sw-codec-select
source "subsys/logging/Kconfig.template.log_config"

module = STREAMCTRL
module-str = streamctrl
source "subsys/logging/Kconfig.template.log_config"

module = AUDIO_DATAPATH
module-str = audio-datapath
source "subsys/logging/Kconfig.template.log_config"

module = AUDIO_SYNC_TIMER
module-str = audio-sync-timer
source "subsys/logging/Kconfig.template.log_config"

endmenu # Log levels

#----------------------------------------------------------------------------#
menu "Thread priorities"

config ENCODER_THREAD_PRIO
	int "Priority for encoder thread"
	default 3
	help
	  This is a preemptible thread.

config AUDIO_DATAPATH_THREAD_PRIO
	int "Priority for audio datapath thread"
	default 4
	help
	  This is a preemptible thread.

endmenu # Thread priorities

#----------------------------------------------------------------------------#
menu "Stack sizes"

config ENCODER_STACK_SIZE
	int "Stack size for encoder thread"
	default 7500 if AUDIO_BIT_DEPTH_16
	default 11264 if AUDIO_BIT_DEPTH_32

config AUDIO_DATAPATH_STACK_SIZE
	int "Stack size for audio datapath thread"
	default 4096 if AUDIO_BIT_DEPTH_16
	default 8192 if AUDIO_BIT_DEPTH_32

endmenu # Stack sizes
endmenu # Audio
```

## applications/nrf5340_audio/src/audio/Kconfig.defaults
```kconfig
#
# Copyright (c) 2022 Nordic Semiconductor ASA
#
# SPDX-License-Identifier: LicenseRef-Nordic-5-Clause
#

# Audio sync timer
config NRFX_TIMER1
	default y

# Audio sync timer
config NRFX_DPPI
	default y

# Required for calculating test tones
config CMSIS_DSP
	default y

# HEADSET
if AUDIO_DEV = 1

if TRANSPORT_CIS # Depends on TRANSPORT_CIS

config LC3_BITRATE
	default BT_AUDIO_BITRATE_UNICAST_SRC

endif # TRANSPORT_CIS

config LC3_ENC_CHAN_MAX
	default 1

config LC3_DEC_CHAN_MAX
	default 1

if TRANSPORT_BIS # Depends on TRANSPORT_BIS

config AUDIO_TEST_TONE
	default n

config AUDIO_MUTE
	default n

endif # TRANSPORT_BIS

endif # AUDIO_DEV = 1 (HEADSET)

# GATEWAY
if AUDIO_DEV = 2

if TRANSPORT_CIS # Depends on TRANSPORT_CIS

config LC3_BITRATE
	default BT_AUDIO_BITRATE_UNICAST_SINK

endif # TRANSPORT_CIS

if TRANSPORT_BIS # Depends on TRANSPORT_BIS

config LC3_BITRATE
	default BT_AUDIO_BITRATE_BROADCAST_SRC

endif # TRANSPORT_BIS

config LC3_ENC_CHAN_MAX
	default 2

config LC3_DEC_CHAN_MAX
	default 1

endif # AUDIO_DEV = 2 (GATEWAY)
```

## applications/nrf5340_audio/src/bluetooth/Kconfig
```kconfig
#
# Copyright (c) 2022 Nordic Semiconductor ASA
#
# SPDX-License-Identifier: LicenseRef-Nordic-5-Clause
#

rsource "Kconfig.defaults"

menu "Bluetooth"

rsource "bt_management/Kconfig"

#----------------------------------------------------------------------------#
menu "Bluetooth audio"

if TRANSPORT_BIS
rsource "bt_stream/broadcast/Kconfig"
endif # TRANSPORT_BIS

if TRANSPORT_CIS
rsource "bt_stream/unicast/Kconfig"
endif # TRANSPORT_CIS

config BT_AUDIO_PACKING_INTERLEAVED
	bool "Interleaved packing"
	default n
	help
	  ISO channels can either be interleaved or sequentially packed; sequential is the default one.

config BT_AUDIO_CONCURRENT_RX_STREAMS_MAX
	int "Max number of concurrent RX streams"
	range 1 32
	default 1
	help
	  The maximum number of concurrent streams supported in the RX direction.
	  This is the maximum number of streams that can be active at the same time.

config BT_AUDIO_CONCURRENT_TX_STREAMS_MAX
	int "Max number of concurrent TX streams"
	range 1 32
	default 1
	help
	  The maximum number of concurrent streams supported in the TX direction.
	  This is the maximum number of streams that can be active at the same time.

#----------------------------------------------------------------------------#
menu "QoS"

config BT_AUDIO_PRESENTATION_DELAY_US
	int "Presentation delay [us]"
	range AUDIO_MIN_PRES_DLY_US AUDIO_MAX_PRES_DLY_US
	default AUDIO_MIN_PRES_DLY_US
	help
	  The audio source/client defined presentation delay if within
	  AUDIO_MIN_PRES_DLY_US and AUDIO_MAX_PRES_DLY_US range. This will
	  override the audio receivers presentation delay as long as it
	  is in range of the max and min supported by the audio receivers.
	  If it is outside this range, then it will revert to the closest
	  supported value.

config BT_AUDIO_MAX_TRANSPORT_LATENCY_MS
	int "Max transport latency [ms]"
	range 5 4000
	default 10
	help
	  Max transport latency for the ISO link.

config BT_AUDIO_RETRANSMITS
	int "Number of re-transmits"
	range 0 30
	default 2
	help
	  Number of re-transmits for the ISO link. 2 re-transmits means a total
	  of 3 packets sent per stream.

endmenu # QoS
endmenu # Bluetooth audio

rsource "bt_rendering_and_capture/Kconfig"
rsource "bt_content_control/Kconfig"

#----------------------------------------------------------------------------#
menu "Log levels"

module = BLE
module-str = ble
source "subsys/logging/Kconfig.template.log_config"

module = BT_LE_AUDIO_TX
module-str = bt_le_audio_tx
source "subsys/logging/Kconfig.template.log_config"

endmenu # Log levels

#----------------------------------------------------------------------------#
menu "Testing"

config TESTING_BLE_ADDRESS_RANDOM
	bool "Random address and bonding clear on every restart [EXPERIMENTAL]"
	default n
	select EXPERIMENTAL
	help
	  If enabled the system will generate a new address on every
	  restart (i.e. reset, re-flash). Any bonding information will
	  be cleared. This is only for testing purposes.

endmenu # Testing
endmenu # Bluetooth
```

## applications/nrf5340_audio/src/bluetooth/Kconfig.defaults
```kconfig
#
# Copyright (c) 2022 Nordic Semiconductor ASA
#
# SPDX-License-Identifier: LicenseRef-Nordic-5-Clause
#

config BT_AUDIO
	default y

config BT_DEVICE_NAME
	default "NRF5340_AUDIO"

config BT_ECC
	default y if BT

config BT_EXT_ADV
	default y

# Mandatory to support at least 1 for ASCS
config BT_ATT_PREPARE_COUNT
	default 1

config ZBUS_RUNTIME_OBSERVERS
	default y
```
