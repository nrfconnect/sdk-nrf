/*
 * Copyright (c) 2024 Nordic Semiconductor ASA
 *
 * SPDX-License-Identifier: LicenseRef-Nordic-5-Clause
 */

/* Shrink by 160 KB */
&cpurad_slot0_partition {
	reg = <0x54000 DT_SIZE_K(96)>;
};

/* To disable SDFW_SERVICES to save RAM */
&cpusec_cpurad_ipc {
	status = "disabled";
};
