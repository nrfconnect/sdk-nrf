/*
 * Copyright (c) 2024 Nordic Semiconductor ASA
 *
 * SPDX-License-Identifier: LicenseRef-Nordic-5-Clause
 */

&gpio_fwd {
	nrf2220-gpio-if {
		gpios = <&arduino_header 14 0>,	/* cs-gpios */
			<&arduino_header 13 0>;	/* md-gpios */
	};

	nrf2220-twi-if {
		gpios = <&gpio1 2 0>,	/* TWIM_SDA */
			<&gpio1 3 0>;	/* TWIM_SCL */
	};
};
