/*
 * Copyright (c) 2024 Nordic Semiconductor ASA
 *
 * SPDX-License-Identifier: LicenseRef-Nordic-5-Clause
 */

/* This file matches the contents of nrf2220ek.overlay and is intended to be applied to nRF5340
 * application core when nrf2220ek shield is provided to the network core's image build.
 */

&gpio_fwd {
	nrf2220-gpio-if {
		gpios = <&arduino_header 14 0>,	/* cs-gpios */
			<&arduino_header 13 0>;	/* md-gpios */
	};
	nrf2220-twi-if {
		gpios = <&gpio1 2 0>,	/* TWIM_SDA */
			<&gpio1 3 0>;	/* TWIM_SCL */
	};
};
