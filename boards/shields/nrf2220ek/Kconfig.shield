## boards/shields/nrf2220ek/Kconfig.shield
```kconfig
#
# Copyright (c) 2024 Nordic Semiconductor ASA
#
# SPDX-License-Identifier: LicenseRef-Nordic-5-Clause
#

config SHIELD_NRF2220EK
	def_bool $(shields_list_contains,nrf2220ek)
```

## boards/shields/nrf2240eb/Kconfig.shield
```kconfig
#
# Copyright (c) 2024 Nordic Semiconductor ASA
#
# SPDX-License-Identifier: LicenseRef-Nordic-5-Clause
#

config SHIELD_NRF2240EB
	def_bool $(shields_list_contains,nrf2240eb)
```

## boards/shields/nrf2240ek/boards/nrf52833dk_nrf52833.conf
```kconfig
# Options related to the nPM13XX regulator and the workaround
# against voltage drops on the nRF2240 power supply pin VDDPALDO.
CONFIG_SENSOR=y
CONFIG_NPM13XX_CHARGER=y
# Ensure that FEM is initialized after the nPM13XX current limit on the nRF2240EK is set.
CONFIG_SENSOR_INIT_PRIORITY=90
CONFIG_MPSL_FEM_INIT_PRIORITY=91
```

## boards/shields/nrf2240ek/boards/nrf5340dk_nrf5340_cpunet.conf
```kconfig
CONFIG_BOOT_BANNER=n
CONFIG_EARLY_CONSOLE=n
CONFIG_NCS_BOOT_BANNER=n

# Options related to the nPM1300 regulator and the workaround
# against voltage drops on the nRF2240 power supply pin VDDPALDO.
CONFIG_SENSOR=y
CONFIG_NPM1300_CHARGER=y
# Ensure that FEM is initialized after the nPM1300 current limit on the nRF2240EK is set.
CONFIG_SENSOR_INIT_PRIORITY=90
CONFIG_MPSL_FEM_INIT_PRIORITY=91
```

## boards/shields/nrf5340_audio_display/Kconfig.defconfig
```kconfig
#
# Copyright (c) 2023 Nordic Semiconductor ASA
#
# SPDX-License-Identifier: LicenseRef-Nordic-5-Clause
#

if SHIELD_NRF5340_AUDIO_DISPLAY

if DISPLAY

if INPUT

# NOTE: Enable if IRQ line is available (requires to solder jumper)
config INPUT_FT5336_INTERRUPT
	default n

endif # INPUT

if LVGL

config LV_Z_VDB_SIZE
	default 64

config LV_Z_BITS_PER_PIXEL
	default 24

choice LV_COLOR_DEPTH
	default LV_COLOR_DEPTH_32
endchoice

config KSCAN
	default y

config INPUT
	default y

config LV_Z_POINTER_KSCAN
	default y

config LV_Z_POINTER_KSCAN_SWAP_XY
	default y

config LV_Z_POINTER_KSCAN_INVERT_X
	default y

config LV_Z_POINTER_KSCAN_INVERT_Y
	default y

endif # LVGL

endif # DISPLAY

if DISK_DRIVERS

config DISK_DRIVER_SDMMC
	default y

endif # DISK_DRIVERS

endif # SHIELD_NRF5340_AUDIO_DISPLAY
```

## boards/shields/nrf5340_audio_display/Kconfig.shield
```kconfig
#
# Copyright (c) 2023 Nordic Semiconductor ASA
#
# SPDX-License-Identifier: LicenseRef-Nordic-5-Clause
#

config SHIELD_NRF5340_AUDIO_DISPLAY
	def_bool $(shields_list_contains,nrf5340_audio_display)
```

## boards/shields/nrf7002_ek/Kconfig.shield
```kconfig
#
# Copyright (c) 2022 Nordic Semiconductor ASA
#
# SPDX-License-Identifier: LicenseRef-Nordic-5-Clause
#

config SHIELD_NRF7002_EK
	def_bool $(shields_list_contains,nrf7002_ek)
```

## boards/shields/nrf7002eb/Kconfig.shield
```kconfig
#
# Copyright (c) 2023 Nordic Semiconductor ASA
#
# SPDX-License-Identifier: LicenseRef-Nordic-5-Clause
#
config SHIELD_NRF7002EB
	select NRF_WIFI_COMBINED_BUCKEN_IOVDD_GPIO
	def_bool $(shields_list_contains,nrf7002eb)
```

## boards/shields/nrf7002eb2/Kconfig.shield
```kconfig
# Copyright (c) 2025 Nordic Semiconductor ASA
# SPDX-License-Identifier: LicenseRef-Nordic-5-Clause

config SHIELD_NRF7002EB2
	def_bool $(shields_list_contains,nrf7002eb2)

config SHIELD_NRF7002EB2_NRF7001
	def_bool $(shields_list_contains,nrf7002eb2_nrf7001)

config SHIELD_NRF7002EB2_NRF7000
	def_bool $(shields_list_contains,nrf7002eb2_nrf7000)

config SHIELD_NRF7002EB2_COEX
	def_bool $(shields_list_contains,nrf7002eb2_coex)
```

## boards/shields/nrf7002eb_interposer_p1/Kconfig.shield
```kconfig
#
# Copyright (c) 2024 Nordic Semiconductor ASA
#
# SPDX-License-Identifier: LicenseRef-Nordic-5-Clause
#

config SHIELD_NRF7002EB_INTERPOSER_P1
	select DEPRECATED
	def_bool $(shields_list_contains,nrf7002eb_interposer_p1)
```

## boards/shields/nrf7002ek/Kconfig.shield
```kconfig
#
# Copyright (c) 2023 Nordic Semiconductor ASA
#
# SPDX-License-Identifier: LicenseRef-Nordic-5-Clause
#

config SHIELD_NRF7002EK
	def_bool $(shields_list_contains,nrf7002ek)
```

## boards/shields/nrf7002ek_nrf7000/Kconfig.shield
```kconfig
#
# Copyright (c) 2023 Nordic Semiconductor ASA
#
# SPDX-License-Identifier: LicenseRef-Nordic-5-Clause
#

config SHIELD_NRF7002EK_NRF7000
	def_bool $(shields_list_contains,nrf7002ek_nrf7000)
	depends on !WPA_SUPP

config BOARD_NRF7000
	bool
	default y if SHIELD_NRF7002EK_NRF7000
```

## boards/shields/nrf7002ek_nrf7001/Kconfig.shield
```kconfig
#
# Copyright (c) 2023 Nordic Semiconductor ASA
#
# SPDX-License-Identifier: LicenseRef-Nordic-5-Clause
#
config SHIELD_NRF7002EK_NRF7001
	def_bool $(shields_list_contains,nrf7002ek_nrf7001)

config NRF70_2_4G_ONLY
	bool
	default y if SHIELD_NRF7002EK_NRF7001
```

## boards/shields/nrf700x_nrf54h20dk/Kconfig.shield
```kconfig
#
# Copyright (c) 2023 Nordic Semiconductor ASA
#
# SPDX-License-Identifier: LicenseRef-Nordic-5-Clause
#

DT_COMPAT_NORDIC_NRF700X_SPI := nordic,nrf700x-spi

config SHIELD_NRF700X_NRF54H20DK
	select NRF_WIFI_COMBINED_BUCKEN_IOVDD_GPIO
	def_bool $(shields_list_contains,nrf700x_nrf54h20dk)

config NRF7002_ON_SPI
	def_bool $(dt_compat_enabled,$(DT_COMPAT_NORDIC_NRF700X_SPI))
	depends on SHIELD_NRF700X_NRF54H20DK
```

## boards/shields/nrf700x_nrf54h20dk/boards/nrf54h20dk_nrf54h20_cpuapp.conf
```kconfig
#
# Copyright (c) 2024 Nordic Semiconductor ASA
#
# SPDX-License-Identifier: LicenseRef-Nordic-5-Clause
#

CONFIG_SHELL_BACKEND_SERIAL=y
CONFIG_TEST_RANDOM_GENERATOR=y
```

## boards/shields/nrf700x_nrf54l15dk/Kconfig.defconfig
```kconfig
#
# Copyright (c) 2024 Nordic Semiconductor ASA
#
# SPDX-License-Identifier: LicenseRef-Nordic-5-Clause
#

if SHIELD_NRF700X_NRF54L15DK

config NETWORKING
	default y

config WIFI
	default y

config WIFI_NRF70
	default y

config NRFX_GPIOTE
	default y

endif #SHIELD_NRF700X_NRF54L15DK
```

## boards/shields/nrf700x_nrf54l15pdk/Kconfig.shield
```kconfig
#
# Copyright (c) 2024 Nordic Semiconductor ASA
#
# SPDX-License-Identifier: LicenseRef-Nordic-5-Clause
#
DT_COMPAT_NORDIC_NRF700X_QSPI := nordic,nrf700x-qspi
DT_COMPAT_NORDIC_NRF700X_SPI := nordic,nrf700x-spi

config SHIELD_NRF700X_NRF54L15PDK
	select NRF_WIFI_COMBINED_BUCKEN_IOVDD_GPIO
	def_bool $(shields_list_contains,nrf700x_nrf54l15pdk)

config NRF7002_ON_QSPI
	def_bool $(dt_compat_enabled,$(DT_COMPAT_NORDIC_NRF700X_QSPI))
	depends on SHIELD_NRF700X_NRF54L15PDK

config NRF7002_ON_SPI
	def_bool $(dt_compat_enabled,$(DT_COMPAT_NORDIC_NRF700X_SPI))
	depends on SHIELD_NRF700X_NRF54L15PDK
```

## boards/shields/nrf700x_nrf54l15pdk/boards/nrf54l15pdk_nrf54l15_cpuapp.conf
```kconfig
# This is to get both Legacy and PSA to work, for Wi-Fi
CONFIG_TRUSTED_STORAGE=y
CONFIG_PSA_CRYPTO_DRIVER_OBERON=y
CONFIG_PSA_CRYPTO_DRIVER_CRACEN=n
CONFIG_TRUSTED_STORAGE_BACKEND_AEAD_KEY_HASH_UID=y
```

## boards/shields/pca63566/Kconfig.shield
```kconfig
# Copyright (c) 2024 Nordic Semiconductor ASA
# SPDX-License-Identifier: LicenseRef-Nordic-5-Clause

config SHIELD_PCA63566
	def_bool $(shields_list_contains,pca63566)
```

## boards/shields/peripheral_sensor_node/Kconfig.shield
```kconfig
#
# Copyright (c) 2023 Nordic Semiconductor ASA
#
# SPDX-License-Identifier: LicenseRef-Nordic-5-Clause
#

config SHIELD_PERIPHERAL_SENSOR_NODE
	def_bool $(shields_list_contains,peripheral_sensor_node)
```

## cmake/toolchain/llvm/Kconfig.defconfig
```kconfig
#
# Copyright (c) 2025 Nordic Semiconductor
#
# SPDX-License-Identifier: LicenseRef-Nordic-5-Clause
#

# When using LLVM with NCS we want to default to Compiler RT lib and LLD.
choice LLVM_LINKER
	default LLVM_USE_LLD
endchoice

choice RTLIB_IMPLEMENTATION
	default COMPILER_RT_RTLIB
endchoice

config OVERRIDE_FRAME_POINTER_DEFAULT
	default y

config OMIT_FRAME_POINTER
	default y if OVERRIDE_FRAME_POINTER_DEFAULT
```

## core_fw/Kconfig
```kconfig
#
# Copyright (c) 2023 Nordic Semiconductor
#
# SPDX-License-Identifier: LicenseRef-Nordic-5-Clause
#

config NCS_REMOTE_RADIO_CHILD_IMAGE
	bool "Add remote_radio child image [Experimental]"
	depends on !NCS_INCLUDE_RPMSG_CHILD_IMAGE
	select PARTITION_MANAGER_ENABLED
	select EXPERIMENTAL
	help
	  Add remote_radio as a child image (network core).
	  The image can be configured as Bluetooth radio,
	  IEEE 802.15.4 radio or left empty.
```

## core_fw/remote_radio/Kconfig
```kconfig
#
# Copyright (c) 2023 Nordic Semiconductor
#
# SPDX-License-Identifier: LicenseRef-Nordic-5-Clause
#

mainmenu "Nordic remote_radio sample"

config REMOTE_RADIO_802154
	bool "Remote IEEE 802.15.4 radio"
	select NRF_802154_SER_RADIO
	default n
	help
	  Enable the remote IEEE 802.15.4 radio serialization.

config REMOTE_RADIO_BT
	bool "Remote Bluetooth"
	default n
	help
	  Enable the remote Bluetooth radio serialization.

if REMOTE_RADIO_BT

choice REMOTE_RADIO_BT_SER
	default REMOTE_RADIO_BT_RPMSG
	prompt "Bluetooth serialization type"
	help
	  Type of the remote Bluetooth radio serialization used.

config REMOTE_RADIO_BT_RPMSG
	bool "Bluetooth serialization over rpmsg"
	depends on IPC_SERVICE_BACKEND_RPMSG
	depends on BT_HCI_RAW
	help
	  Use rpmsg serialization for Bluetooth.

config REMOTE_RADIO_BT_RPC
	bool "Bluetooth serialization over RPC"
	depends on BT_RPC_HOST
	help
	  Use nRF RPC serialization for Bluetooth.

endchoice # REMOTE_RADIO_BT_SER

config BT_MAX_CONN
	default 4 if REMOTE_RADIO_802154
	default 16 if !REMOTE_RADIO_802154

endif # REMOTE_RADIO_BT

module = REMOTE_RADIO
module-str = "remote_radio"
source "${ZEPHYR_BASE}/subsys/logging/Kconfig.template.log_config"

source "Kconfig.zephyr"
```

## demos/bluetooth/mesh/thingy52/common/model/Kconfig
```kconfig
#
# Copyright (c) 2020 Nordic Semiconductor ASA
#
# SPDX-License-Identifier: LicenseRef-BSD-5-Clause-Nordic
#

config BT_MESH_THINGY52_MOD
	bool "Bluetooth mesh Thingy:52 model"
	select BT_MESH_NRF_MODELS
	help
	  Enable Bluetooth mesh Thingy:52 model.

config BT_MESH_THINGY52_CLI
	bool "Bluetooth mesh Thingy:52 Client model"
	select BT_MESH_NRF_MODELS
	help
	  Enable Bluetooth mesh Thingy:52 Client model.
```

## demos/bluetooth/mesh/thingy52/thingy52_cli/Kconfig
```kconfig
#
# Copyright (c) 2020 Nordic Semiconductor ASA
#
# SPDX-License-Identifier: LicenseRef-BSD-5-Clause-Nordic
#

menu "Thingy:52 Bluetooth Mesh models"
rsource "../common/model/Kconfig"
endmenu

menu "Zephyr kernel"
source "Kconfig.zephyr"
endmenu
```
