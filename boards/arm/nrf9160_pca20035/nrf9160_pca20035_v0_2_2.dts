/*
 * Copyright (c) 2019 Nordic Semiconductor ASA
 *
 * SPDX-License-Identifier: LicenseRef-BSD-5-Clause-Nordic
 */

/dts-v1/;
#include <nordic/nrf9160_sica.dtsi>
#include "nrf9160_pca20035_v0_2_2_common.dts"

/ {
	chosen {
		zephyr,sram = &sram0;
		zephyr,flash = &flash0;
	};
};
