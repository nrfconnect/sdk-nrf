## boards/arm/thingy91_nrf9160/Kconfig.board
```kconfig
# Thingy:91 nRF9160 board configuration
#
# Copyright (c) 2019 Nordic Semiconductor ASA
#
# SPDX-License-Identifier: LicenseRef-Nordic-5-Clause

if SOC_NRF9160_SICA

config BOARD_THINGY91_NRF9160
	bool "nRF9160 THINGY91"

config BOARD_THINGY91_NRF9160_NS
	bool "nRF9160 THINGY91 non-secure"

if BOARD_THINGY91_NRF9160_NS

choice
	prompt "Pre-defined Thingy:91 partition layout"
	default THINGY91_STATIC_PARTITIONS_SECURE_BOOT if SECURE_BOOT
	default THINGY91_STATIC_PARTITIONS_LWM2M_CARRIER if LWM2M_CARRIER
	default THINGY91_STATIC_PARTITIONS_FACTORY

config THINGY91_STATIC_PARTITIONS_FACTORY
	bool "Factory Thingy:91 partition layout"
	help
	   The default Thingy:91 partition layout used in the factory firmware. This ensures
	   firmware updates are compatible with Thingy:91 when flashing firmware over USB or over
	   the air.

config THINGY91_STATIC_PARTITIONS_SECURE_BOOT
	bool "Secure boot Thingy:91 partition layout [EXPERIMENTAL]"
	depends on SECURE_BOOT
	select EXPERIMENTAL
	help
	   Similar to the factory partition layout, but also has space for the Immutable Bootloader
	   and two MCUboot slots. A debugger is needed to flash Thingy:91 the first time.
	   This layout is still under development and should not be used in production.

config THINGY91_STATIC_PARTITIONS_LWM2M_CARRIER
	bool "LWM2M Carrier  partition layout"
	depends on LWM2M_CARRIER
	help
	  Use a partition layout including a storage partition needed for the lwm2m carrier library.

config THINGY91_NO_PREDEFINED_LAYOUT
	bool "None [EXPERIMENTAL]"
	select EXPERIMENTAL
	help
	   Disable pre-defined static partition layout. This allows the application to use a dynamic
	   layout or define a custom static partition layout for the application. A debugger is
	   needed to flash Thingy:91 with a different partition layout.

endchoice

endif # BOARD_THINGY91_NRF9160_NS

endif # SOC_NRF9160_SICA
```

## boards/arm/thingy91_nrf9160/Kconfig.defconfig
```kconfig
# Thingy:91 nRF9160 board configuration
#
# Copyright (c) 2018 Nordic Semiconductor ASA
#
# SPDX-License-Identifier: LicenseRef-BSD-5-Clause-Nordic

if BOARD_THINGY91_NRF9160 || BOARD_THINGY91_NRF9160NS

config BOARD
	default "thingy91_nrf9160"

if ADC

config ADC_0
	bool
	default y

endif # ADC

if I2C

config I2C_2
	bool
	default y

endif # I2C

if PWM

config PWM_0
	bool
	default y

endif # PWM

if SPI

config SPI_3
	bool
	default y

endif # SPI

# For the secure version of the board the firmware is linked at the beginning
# of the flash, or into the code-partition defined in DT if it is intended to
# be loaded by MCUboot. If the secure firmware is to be combined with a non-
# secure image (TRUSTED_EXECUTION_SECURE=y), the secure FW image shall always
# be restricted to the size of its code partition.
# For the non-secure version of the board, the firmware
# must be linked into the code-partition (non-secure) defined in DT, regardless.
# Apply this configuration below by setting the Kconfig symbols used by
# the linker according to the information extracted from DT partitions.

if BOARD_THINGY91_NRF9160 && TRUSTED_EXECUTION_SECURE

config FLASH_LOAD_SIZE
	default $(dt_chosen_reg_size_hex,$(DT_CHOSEN_Z_CODE_PARTITION))

endif # BOARD_THINGY91_NRF9160 && TRUSTED_EXECUTION_SECURE

if BOARD_THINGY91_NRF9160NS

config FLASH_LOAD_OFFSET
	default $(dt_chosen_reg_addr_hex,$(DT_CHOSEN_Z_CODE_PARTITION))

config FLASH_LOAD_SIZE
	default $(dt_chosen_reg_size_hex,$(DT_CHOSEN_Z_CODE_PARTITION))

endif # BOARD_THINGY91_NRF9160NS

endif # BOARD_THINGY91_NRF9160 || BOARD_THINGY91_NRF9160NS
```

## boards/arm/thingy91_nrf9160/dts/bindings/nordic,thingy91-nrf52840-reset.yaml
```yaml
# Copyright (c) 2021 Nordic Semiconductor ASA
# SPDX-License-Identifier: Apache-2.0

description: GPIO used to reset nRF52840 on Thingy:91

compatible: "nordic,thingy91-nrf52840-reset"

include: base.yaml

properties:
  status:
    required: true

  gpios:
    type: phandle-array
    required: true
    description: |
      GPIO to use as nRF52840 reset line: output in nRF9160, input in nRF52840.
```

## boards/arm/thingy91_nrf9160/thingy91_nrf9160_defconfig
```kconfig
CONFIG_SOC_SERIES_NRF91X=y
CONFIG_SOC_NRF9160_SICA=y
CONFIG_BOARD_THINGY91_NRF9160=y

# Enable MPU
CONFIG_ARM_MPU=y

# Enable hardware stack protection
CONFIG_HW_STACK_PROTECTION=y

# Enable TrustZone-M
CONFIG_ARM_TRUSTZONE_M=y

# Enable GPIO
CONFIG_GPIO=y

# Enable UARTE
CONFIG_SERIAL=y

# Enable console
CONFIG_CONSOLE=y
CONFIG_UART_CONSOLE=y

# Enable I2C
CONFIG_I2C=y

# Enable power management IC ADP536x
CONFIG_ADP536X=y

# Disable entropy driver, as it's not yet implemented for nRF9160
CONFIG_ENTROPY_NRF5_RNG=n
```
