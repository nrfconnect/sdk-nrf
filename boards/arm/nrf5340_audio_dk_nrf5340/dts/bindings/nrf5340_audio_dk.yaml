## boards/arm/nrf5340_audio_dk_nrf5340/dts/bindings/nrf5340_audio_dk.yaml
```yaml
# Copyright (c) 2022 Nordic Semiconductor ASA
# SPDX-License-Identifier: Apache-2.0

description: |
  This file contains specific pin mappings for the nRF5340 Audio DK.

compatible: "nrf5340_audio_dk"

include: base.yaml

properties:
    hw-codec-in-gpios:
      type: phandle-array
      required: true
      description: GPIO from HW codec

    hw-codec-irq-in-gpios:
      type: phandle-array
      required: true
      description: Interrupt from HW codec

    hw-codec-reset-out-gpios:
        type: phandle-array
        required: true
        description: Reset HW codec

    hw-codec-sel-out-gpios:
      type: phandle-array
      required: true
      description: HW codec selector

    spi-sel-in-gpios:
      type: phandle-array
      required: true
      description: SPI select detect

    pmic-iset-out-gpios:
      type: phandle-array
      required: true
      description: PMIC ISET

    board-id-en-out-gpios:
      type: phandle-array
      required: true
      description: Board rev enable

    board-id-in-gpios:
      type: phandle-array
      required: true
      description: Board rev readback

    curr-mon-alert-in-gpios:
      type: phandle-array
      required: true
      description: Board rev readback
```

## boards/arm/nrf5340_audio_dk_nrf5340/nrf5340_audio_dk_nrf5340_cpuapp_defconfig
```kconfig
# SPDX-License-Identifier: LicenseRef-Nordic-5-Clause

CONFIG_SOC_SERIES_NRF53X=y
CONFIG_SOC_NRF5340_CPUAPP_QKAA=y
CONFIG_BOARD_NRF5340_AUDIO_DK_NRF5340_CPUAPP=y

CONFIG_ARM_MPU=y

CONFIG_HW_STACK_PROTECTION=y

CONFIG_ARM_TRUSTZONE_M=y

CONFIG_GPIO=y

CONFIG_SERIAL=y

# Enable console
CONFIG_CONSOLE=y
CONFIG_UART_CONSOLE=y

CONFIG_PINCTRL=y
```

## boards/arm/nrf54l15pdk_nrf54l15/Kconfig.board
```kconfig
# Copyright (c) 2022 Nordic Semiconductor ASA
# SPDX-License-Identifier: LicenseRef-Nordic-5-Clause

if SOC_NRF54L15_ENGA_CPUAPP

config BOARD_NRF54L15PDK_NRF54L15_CPUAPP_NS
	bool "nRF54L15 DK nRF54L15 Application MCU non-secure"

endif # SOC_NRF54L15_CPUAPP
```

## boards/arm/nrf54l15pdk_nrf54l15/Kconfig.defconfig
```kconfig
# Copyright (c) 2024 Nordic Semiconductor ASA
# SPDX-License-Identifier: LicenseRef-Nordic-5-Clause

if BOARD_NRF54L15PDK_NRF54L15_CPUAPP_NS

config BOARD
	default "nrf54l15pdk_nrf54l15_cpuapp"

# By default, if we build for a Non-Secure version of the board,
# enable building with TF-M as the Secure Execution Environment.
config BUILD_WITH_TFM
	default y if BOARD_NRF54L15PDK_NRF54L15_CPUAPP_NS

# By default, if we build with TF-M, instruct build system to
# flash the combined TF-M (Secure) & Zephyr (Non Secure) image
config TFM_FLASH_MERGED_BINARY
	bool
	default y
	depends on BUILD_WITH_TFM

# TODO: Remove the options bellow when (NCSDK-25023) is done
config NRF_SPU_FLASH_REGION_SIZE
	hex
	default 0x4000
	# This option does not apply to 54, but we pretend the HW has this limitation
	# for now for easier porting. NCSDK-25023
	help
	  FLASH region size for the NRF_SPU peripheral. For nrf54 the
	  region size is configurable per-region so this option does
	  not apply.

config NRF_SPU_FLASH_REGION_ALIGNMENT
	hex
	default 0x4000
	# This option does not apply to 54, but we pretend the HW has this limitation
	# for now for easier porting. NCSDK-25023
	help
	  FLASH region size for the NRF_SPU peripheral. For nrf54 the
	  region size is configurable per-region so this option does
	  not apply.

config NRF_SPU_RAM_REGION_SIZE
	hex
	default 0x2000
	# This HW limitation does not apply to 54, but we pretend
	# it does for now for easier porting. NCSDK-25023
	help
	  RAM region size for the NRF_SPU peripheral. For nrf54 the
	  region size is configurable per-region so this option does
	  not apply.


config NRF_SPU_RAM_REGION_ALIGNMENT
	hex
	default 0x1000
	help
	  RAM regions must be aligned to this value due to SPU HW
	  limitations.

endif #BOARD_NRF54L15PDK_NRF54L15_CPUAPP_NS
```

## boards/arm/nrf7001dk_nrf5340/Kconfig
```kconfig
# nRF7001 DK board configuration

# Copyright (c) 2023 Nordic Semiconductor ASA
# SPDX-License-Identifier: LicenseRef-Nordic-5-Clause

config IPM_NRFX
	default IPM

config MBOX_NRFX_IPC
	default MBOX

if BOARD_NRF7001DK_NRF5340_CPUAPP || BOARD_NRF7001DK_NRF5340_CPUAPP_NS

config BOARD_ENABLE_DCDC_APP
	bool "Enable Application MCU DCDC converter"
	select SOC_DCDC_NRF53X_APP
	default y

config BOARD_ENABLE_DCDC_NET
	bool "Enable Network MCU DCDC converter"
	select SOC_DCDC_NRF53X_NET
	default y

config BOARD_ENABLE_DCDC_HV
	bool "Enable High Voltage DCDC converter"
	select SOC_DCDC_NRF53X_HV
	default y

choice BT_HCI_BUS_TYPE
	default BT_RPMSG if BT
endchoice

config HEAP_MEM_POOL_SIZE
	default 4096 if BT_RPMSG

config BT_HCI_VS
	default y if BT

config BOARD_ENABLE_CPUNET
	bool "Enable nRF53 Network MCU"
	select SOC_NRF_GPIO_FORWARDER_FOR_NRF5340 if \
		$(dt_compat_enabled,$(DT_COMPAT_NORDIC_NRF_GPIO_FORWARDER))
	help
	  This option enables releasing the Network 'force off' signal, which
	  as a consequence will power up the Network MCU during system boot.
	  Additionally, the option allocates GPIO pins that will be used by UARTE
	  of the Network MCU.
	  Note: GPIO pin allocation can only be configured by the secure Application
	  MCU firmware, so when this option is used with the non-secure version of
	  the board, the application needs to take into consideration, that the
	  secure firmware image must already have configured GPIO allocation for the
	  Network MCU.
	default y if (BT || NRF_802154_SER_HOST)

config DOMAIN_CPUNET_BOARD
	string
	default "nrf7001dk_nrf5340_cpunet" if BOARD_NRF7001DK_NRF5340_CPUAPP || BOARD_NRF7001DK_NRF5340_CPUAPP_NS
	depends on BOARD_ENABLE_CPUNET
	help
	  The board which will be used for CPUNET domain when creating a multi
	  image application where one or more images should be located on
	  another board. For example hci_rpmsg on the nRF5340_cpunet for
	  Bluetooth applications.

endif #  BOARD_NRF7001DK_NRF5340_CPUAPP || BOARD_NRF7001DK_NRF5340_CPUAPP_NS

if BOARD_NRF7001DK_NRF5340_CPUNET

# BT_CTLR depends on BT. When BT is enabled we should default to also
# enabling the controller.
config BT_CTLR
	default y if BT

config BT_ECC
	default y if BT

config DOMAIN_CPUAPP_BOARD
	string
	default "nrf7001dk_nrf5340_cpuapp" if BOARD_NRF7001DK_NRF5340_CPUNET
	help
	  The board which will be used for CPUAPP domain when creating a multi
	  image application where one or more images should be located on
	  another board.

endif # BOARD_NRF7001DK_NRF5340_CPUNET
```

## boards/arm/nrf7001dk_nrf5340/Kconfig.board
```kconfig
# nRF7001 DK NRF5340 board configuration

# Copyright (c) 2023 Nordic Semiconductor ASA
# SPDX-License-Identifier: LicenseRef-Nordic-5-Clause

if SOC_NRF5340_CPUAPP_QKAA

config BOARD_NRF7001DK_NRF5340_CPUAPP
	bool "nRF7001 DK nRF5340 Application MCU"

config BOARD_NRF7001DK_NRF5340_CPUAPP_NS
	bool "nRF7001 DK nRF5340 Application MCU non-secure"

endif # SOC_NRF5340_CPUAPP_QKAA

config BOARD_NRF7001DK_NRF5340_CPUNET
	bool "nRF7001 DK NRF5340 Network MCU"
	depends on SOC_NRF5340_CPUNET_QKAA
```

## boards/arm/nrf7001dk_nrf5340/nrf7001dk_nrf5340_cpuapp_ns_defconfig
```kconfig
# Copyright (c) 2023 Nordic Semiconductor ASA
# SPDX-License-Identifier: LicenseRef-Nordic-5-Clause

CONFIG_SOC_SERIES_NRF53X=y
CONFIG_SOC_NRF5340_CPUAPP_QKAA=y
CONFIG_BOARD_NRF7001DK_NRF5340_CPUAPP_NS=y

# Enable MPU
CONFIG_ARM_MPU=y

# Enable hardware stack protection
CONFIG_HW_STACK_PROTECTION=y

# Enable TrustZone-M
CONFIG_ARM_TRUSTZONE_M=y

# This Board implies building Non-Secure firmware
CONFIG_TRUSTED_EXECUTION_NONSECURE=y

# enable GPIO
CONFIG_GPIO=y

# enable PINCTRL
CONFIG_PINCTRL=y

# Enable uart driver
CONFIG_SERIAL=y

# enable console
CONFIG_CONSOLE=y
CONFIG_UART_CONSOLE=y
```

## boards/arm/nrf7002dk_nrf5340/Kconfig.board
```kconfig
# nRF5340 DK NRF5340 board configuration

# Copyright (c) 2022 Nordic Semiconductor ASA
# SPDX-License-Identifier: LicenseRef-Nordic-5-Clause

if SOC_NRF5340_CPUAPP_QKAA

config BOARD_NRF7002DK_NRF5340_CPUAPP
	bool "nRF7002 DK nRF5340 Application MCU"

config BOARD_NRF7002DK_NRF5340_CPUAPP_NS
	bool "nRF7002 DK nRF5340 Application MCU non-secure"

endif # SOC_NRF5340_CPUAPP_QKAA

config BOARD_NRF7002DK_NRF5340_CPUNET
	bool "nRF7002 DK NRF5340 Network MCU"
	depends on SOC_NRF5340_CPUNET_QKAA
```

## boards/arm/nrf7002dk_nrf7001_nrf5340/Kconfig.board
```kconfig
# Copyright (c) 2023 Nordic Semiconductor ASA
# SPDX-License-Identifier: LicenseRef-Nordic-5-Clause

if SOC_NRF5340_CPUAPP_QKAA

config BOARD_NRF7002DK_NRF7001_NRF5340_CPUAPP
	bool "nRF7002 DK (emulating nRF7001) nRF5340 Application MCU"

config BOARD_NRF7002DK_NRF7001_NRF5340_CPUAPP_NS
	bool "nRF7002 DK (emulating nRF7001) nRF5340 Application MCU non-secure"

endif # SOC_NRF5340_CPUAPP_QKAA

config BOARD_NRF7002DK_NRF7001_NRF5340_CPUNET
	bool "nRF7002 DK (emulating nRF7001) NRF5340 Network MCU"
	depends on SOC_NRF5340_CPUNET_QKAA
```

## boards/arm/nrf9131ek_nrf9131/Kconfig
```kconfig
# Thingy:91 nRF9161 board configuration
#
# Copyright (c) 2019 Nordic Semiconductor ASA
#
# SPDX-License-Identifier: LicenseRef-Nordic-5-Clause

if BOARD_NRF9131EK_NRF9131 || BOARD_NRF9131EK_NRF9131_NS

config BOARD_INIT_PRIORITY
	int "Initialization priority for board configuration"
	default 80

endif # BOARD_NRF9131EK_NRF9131 || BOARD_NRF9131EK_NRF9131_NS

module=BOARD
module-dep=LOG
module-str=Log level for board
source "${ZEPHYR_BASE}/subsys/logging/Kconfig.template.log_config"
```

## boards/arm/nrf9131ek_nrf9131/Kconfig.board
```kconfig
# nRF9161 DK NRF9161 board configuration

# Copyright (c) 2023 Nordic Semiconductor ASA
# SPDX-License-Identifier: Apache-2.0

if SOC_NRF9161_SICA

config BOARD_NRF9131EK_NRF9131
	bool "nRF9161 DK NRF9161"

config BOARD_NRF9131EK_NRF9131_NS
	bool "nRF9161 DK NRF9161 non-secure"

endif # SOC_NRF9161_SICA
```

## boards/arm/nrf9160_pca20035/Kconfig
```kconfig
# Kconfig - nRF91 PCA20035 board configuration
#
# Copyright (c) 2019 Nordic Semiconductor ASA
#
# SPDX-License-Identifier: LicenseRef-BSD-5-Clause-Nordic

module=BOARD
module-dep=LOG
module-str=Log level for board
source "${ZEPHYR_BASE}/subsys/logging/Kconfig.template.log_config"
```

## boards/arm/nrf9160_pca20035/Kconfig.board
```kconfig
# Kconfig - nRF91 PCA20035 board configuration
#
# Copyright (c) 2019 Nordic Semiconductor ASA
#
# SPDX-License-Identifier: LicenseRef-BSD-5-Clause-Nordic

if SOC_NRF9160_SICA

config BOARD_NRF9160_PCA20035
	bool "nRF9160 PCA20035"
	depends on !TRUSTED_EXECUTION_NONSECURE

config BOARD_NRF9160_PCA20035NS
	bool "nRF9160 PCA20035 non-secure"
	depends on TRUSTED_EXECUTION_NONSECURE

endif # SOC_NRF9160_SICA
```

## boards/arm/nrf9160_pca20035/nrf9160_pca20035_defconfig
```kconfig
CONFIG_ARM=y
CONFIG_SOC_SERIES_NRF91X=y
CONFIG_SOC_NRF9160_SICA=y
CONFIG_BOARD_NRF9160_PCA20035=y

# Enable MPU
CONFIG_ARM_MPU=y

# Enable TrustZone-M
CONFIG_ARM_TRUSTZONE_M=y

# Enable GPIO
CONFIG_GPIO=y

# Enable UARTE
CONFIG_SERIAL=y
CONFIG_UART_0_NRF_UARTE=y

# Enable console
CONFIG_CONSOLE=y
CONFIG_UART_CONSOLE=y

# Enable I2C
CONFIG_I2C=y
# Note: I2C_2 is enabled in Kconfig.defconfig where it can depend on I2C
#	to avoid warnings when building for MCUboot, which disables I2C.

# Enable power management IC ADP536x
CONFIG_ADP536X=y

# Disable entropy driver, as it's not yet implemented for nRF9160
CONFIG_ENTROPY_NRF5_RNG=n
```

## boards/arm/nrf9160_pca20035/nrf9160_pca20035_v0_3_0_defconfig
```kconfig
CONFIG_ARM=y
CONFIG_SOC_FAMILY_NRF=y
CONFIG_SOC_SERIES_NRF91X=y
CONFIG_SOC_NRF9160_SICA=y
CONFIG_BOARD_NRF9160_PCA20035_V0_3_0=y

# Enable MPU
CONFIG_ARM_MPU=y

# Enable TrustZone-M
CONFIG_ARM_TRUSTZONE_M=y

# This Board implies building Non-Secure firmware
CONFIG_TRUSTED_EXECUTION_SECURE=y

# Enable GPIO
CONFIG_GPIO=y

# Enable UARTE
CONFIG_SERIAL=y
CONFIG_UART_NRFX=y
CONFIG_UART_0_NRF_UARTE=y

# Enable console
CONFIG_CONSOLE=y
CONFIG_UART_CONSOLE=y

# Disable entropy driver, as it's not yet implemented for nRF9160
CONFIG_ENTROPY_NRF5_RNG=n
```

## boards/arm/nrf9160_pca20035/nrf9160_pca20035ns_defconfig
```kconfig
CONFIG_ARM=y
CONFIG_SOC_SERIES_NRF91X=y
CONFIG_SOC_NRF9160_SICA=y
CONFIG_BOARD_NRF9160_PCA20035NS=y

# Enable MPU
CONFIG_ARM_MPU=y

# Enable TrustZone-M
CONFIG_ARM_TRUSTZONE_M=y

# This Board implies building Non-Secure firmware
CONFIG_TRUSTED_EXECUTION_NONSECURE=y

# Enable GPIO
CONFIG_GPIO=y

# Enable UARTE
CONFIG_SERIAL=y
CONFIG_UART_0_NRF_UARTE=y

# Enable console
CONFIG_CONSOLE=y
CONFIG_UART_CONSOLE=y

# Enable I2C
CONFIG_I2C=y
CONFIG_I2C_2=y

# Enable SPI
CONFIG_SPI=y
CONFIG_SPI_3=y

# Enable power management IC ADP536x
CONFIG_ADP536X=y

# Disable entropy driver, as it's not yet implemented for nRF9160
CONFIG_ENTROPY_NRF5_RNG=n
```

## boards/arm/thingy91_nrf52840/Kconfig
```kconfig
# Thingy:91 nRF52840 board configuration
#
# Copyright (c) 2019 Nordic Semiconductor ASA
#
# SPDX-License-Identifier: LicenseRef-Nordic-5-Clause

if BOARD_THINGY91_NRF52840

config BOARD_ENABLE_DCDC
	bool "Enable DCDC mode"
	select SOC_DCDC_NRF52X
	default y

endif # BOARD_THINGY91_NRF52840
```

## boards/arm/thingy91_nrf52840/Kconfig.board
```kconfig
# nRF52840 THINGY91 board configuration
#
# Copyright (c) 2019 Nordic Semiconductor ASA
#
# SPDX-License-Identifier: LicenseRef-Nordic-5-Clause

config BOARD_THINGY91_NRF52840
	bool "nRF52840 THINGY91"
	depends on SOC_NRF52840_QIAA
```

## boards/arm/thingy91_nrf52840/Kconfig.defconfig
```kconfig
# nRF52840 THINGY91 board configuration
#
# Copyright (c) 2019 Nordic Semiconductor ASA
#
# SPDX-License-Identifier: LicenseRef-Nordic-5-Clause

if BOARD_THINGY91_NRF52840

config BOARD
	default "thingy91_nrf52840"

if USB

config USB_NRFX
	def_bool y

config USB_DEVICE_STACK
	def_bool y

endif # USB

endif # BOARD_THINGY91_NRF52840
```

## boards/arm/thingy91_nrf52840/thingy91_nrf52840_defconfig
```kconfig
CONFIG_SOC_SERIES_NRF52X=y
CONFIG_SOC_NRF52840_QIAA=y
CONFIG_BOARD_THINGY91_NRF52840=y

# Enable MPU
CONFIG_ARM_MPU=y

# Enable PINCTRL
CONFIG_PINCTRL=y

# enable uart driver
CONFIG_SERIAL=y

# Enable console
CONFIG_CONSOLE=y

CONFIG_BOOTLOADER_MCUBOOT=y
```

## boards/arm/thingy91_nrf9160/Kconfig
```kconfig
# Thingy:91 nRF9160 board configuration
#
# Copyright (c) 2019 Nordic Semiconductor ASA
#
# SPDX-License-Identifier: LicenseRef-Nordic-5-Clause

if BOARD_THINGY91_NRF9160 || BOARD_THINGY91_NRF9160_NS

config BOARD_INIT_PRIORITY
	int "Initialization priority for board configuration"
	default 80
	help
	  The Thingy:91 board contains an ADP5360 PMIC that needs to be configured to
	  set up the power domains on the board correctly. This happens during sys_init,
	  and the PMIC setup must happen before the sensors are initialized in order
	  to power them up in time.

endif # BOARD_THINGY91_NRF9160 || BOARD_THINGY91_NRF9160_NS

module=BOARD
module-dep=LOG
module-str=Log level for board
source "${ZEPHYR_BASE}/subsys/logging/Kconfig.template.log_config"
```
