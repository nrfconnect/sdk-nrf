## boards/arm/gl_nrf52840_dev_board/Kconfig.board
```kconfig
config BOARD_GL_NRF52840_DEV_BOARD
	bool "GL NRF52840 Dev Board"
	depends on SOC_NRF52840_QIAA
```

## boards/arm/gl_nrf52840_dev_board/Kconfig.defconfig
```kconfig
if BOARD_GL_NRF52840_DEV_BOARD

config BOARD
	default "gl-nrf52840-dev-board"

config BT_CTLR
	default BT

endif # BOARD_GL_NRF52840_DEV_BOARD
```

## boards/arm/nrf52810_pca20045/Kconfig.board
```kconfig
#
# Copyright (c) 2019 Nordic Semiconductor
#
# SPDX-License-Identifier: LicenseRef-BSD-5-Clause-Nordic
#

config  BOARD_NRF52810_PCA20045
	bool "NRF52810_PCA20045"
	depends on SOC_NRF52810_QFAA
```

## boards/arm/nrf52810_pca20045/Kconfig.defconfig
```kconfig
#
# Copyright (c) 2019 Nordic Semiconductor
#
# SPDX-License-Identifier: LicenseRef-BSD-5-Clause-Nordic
#

if BOARD_NRF52810_PCA20045

config BOARD
	default "nrf52810_pca20045"

config BT_CTLR
	default BT

endif # BOARD_NRF52810_PCA20045
```

## boards/arm/nrf52810dmouse_nrf52810/Kconfig.board
```kconfig
#
# Copyright (c) 2019 Nordic Semiconductor
#
# SPDX-License-Identifier: LicenseRef-Nordic-5-Clause
#

config BOARD_NRF52810DMOUSE_NRF52810
	bool "NRF52810 DMOUSE NRF52810"
	depends on SOC_NRF52810_QFAA
```

## boards/arm/nrf52810dmouse_nrf52810/Kconfig.defconfig
```kconfig
#
# Copyright (c) 2019 Nordic Semiconductor
#
# SPDX-License-Identifier: LicenseRef-Nordic-5-Clause
#

if BOARD_NRF52810DMOUSE_NRF52810

config BOARD
	default "nrf52810dmouse_nrf52810"

config BT_CTLR
	default BT

config HW_STACK_PROTECTION
	default ARCH_HAS_STACK_PROTECTION

endif # BOARD_NRF52810DMOUSE_NRF52810
```

## boards/arm/nrf52810dmouse_nrf52810/nrf52810dmouse_nrf52810_defconfig
```kconfig
CONFIG_SOC_SERIES_NRF52X=y
CONFIG_SOC_NRF52810_QFAA=y
CONFIG_BOARD_NRF52810DMOUSE_NRF52810=y

# Enable MPU
CONFIG_ARM_MPU=y

CONFIG_PINCTRL=y
```

## boards/arm/nrf52820dongle_nrf52820/Kconfig.defconfig
```kconfig
#
# Copyright (c) 2020 Nordic Semiconductor ASA
#
# SPDX-License-Identifier: LicenseRef-Nordic-5-Clause
#

if BOARD_NRF52820DONGLE_NRF52820

config BOARD
	default "nrf52820dongle_nrf52820"

config BT_CTLR
	default BT

endif # BOARD_NRF52820DONGLE_NRF52820
```

## boards/arm/nrf52820dongle_nrf52820/nrf52820dongle_nrf52820_defconfig
```kconfig
CONFIG_SOC_SERIES_NRF52X=y
CONFIG_SOC_NRF52820_QDAA=y
CONFIG_BOARD_NRF52820DONGLE_NRF52820=y

# Enable MPU
CONFIG_ARM_MPU=y

# Enable PINCTRL
CONFIG_PINCTRL=y

# enable GPIO
CONFIG_GPIO=y
```

## boards/arm/nrf52833_pca10111/Kconfig
```kconfig
#
# Copyright (c) 2020 Nordic Semiconductor ASA
#
# SPDX-License-Identifier: LicenseRef-BSD-5-Clause-Nordic
#

if BOARD_NRF52833_PCA10111

config BOARD_ENABLE_DCDC
	bool "Enable DCDC mode"
	select SOC_DCDC_NRF52X
	default y

endif # BOARD_NRF52833_PCA10111
```

## boards/arm/nrf52833_pca10111/Kconfig.board
```kconfig
#
# Copyright (c) 2020 Nordic Semiconductor ASA
#
# SPDX-License-Identifier: LicenseRef-BSD-5-Clause-Nordic
#

config BOARD_NRF52833_PCA10111
	bool "NRF52833 PCA10111"
	depends on SOC_NRF52833_QIAA
```

## boards/arm/nrf52833_pca10111/nrf52833_pca10111_defconfig
```kconfig
CONFIG_ARM=y
CONFIG_SOC_SERIES_NRF52X=y
CONFIG_SOC_NRF52833_QIAA=y
CONFIG_BOARD_NRF52833_PCA10111=y

# Enable MPU
CONFIG_ARM_MPU=y

# enable GPIO
CONFIG_GPIO=y

# additional board options
CONFIG_GPIO_AS_PINRESET=y
CONFIG_NFCT_PINS_AS_GPIOS=y
```

## boards/arm/nrf52833_pca10114/Kconfig.board
```kconfig
#
# Copyright (c) 2020 Nordic Semiconductor ASA
#
# SPDX-License-Identifier: LicenseRef-BSD-5-Clause-Nordic
#

config BOARD_NRF52833_PCA10114
	bool "NRF52833 PCA10114"
	depends on SOC_NRF52833_QIAA
```

## boards/arm/nrf52833_pca10114/Kconfig.defconfig
```kconfig
#
# Copyright (c) 2020 Nordic Semiconductor ASA
#
# SPDX-License-Identifier: LicenseRef-BSD-5-Clause-Nordic
#

if BOARD_NRF52833_PCA10114

config BOARD
	default "nrf52833_pca10114"

endif # BOARD_NRF52833_PCA10114
```

## boards/arm/nrf52833dongle_nrf52833/Kconfig.board
```kconfig
#
# Copyright (c) 2020 Nordic Semiconductor ASA
#
# SPDX-License-Identifier: LicenseRef-Nordic-5-Clause
#

config BOARD_NRF52833DONGLE_NRF52833
	bool "NRF52833 DONGLE NRF52833"
	depends on SOC_NRF52833_QIAA
```

## boards/arm/nrf52833dongle_nrf52833/Kconfig.defconfig
```kconfig
#
# Copyright (c) 2020 Nordic Semiconductor ASA
#
# SPDX-License-Identifier: LicenseRef-Nordic-5-Clause
#

if BOARD_NRF52833DONGLE_NRF52833

config BOARD
	default "nrf52833dongle_nrf52833"

config BT_CTLR
	default BT

endif # BOARD_NRF52833DONGLE_NRF52833
```

## boards/arm/nrf52833dongle_nrf52833/nrf52833dongle_nrf52833_defconfig
```kconfig
CONFIG_SOC_SERIES_NRF52X=y
CONFIG_SOC_NRF52833_QIAA=y
CONFIG_BOARD_NRF52833DONGLE_NRF52833=y

# Enable MPU
CONFIG_ARM_MPU=y

# Enable PINCTRL:
CONFIG_PINCTRL=y

# enable GPIO
CONFIG_GPIO=y

# additional board options
CONFIG_GPIO_AS_PINRESET=y
```

## boards/arm/nrf52833donglev2_nrf52833/Kconfig.defconfig
```kconfig
#
# Copyright (c) 2020 Nordic Semiconductor ASA
#
# SPDX-License-Identifier: LicenseRef-BSD-5-Clause-Nordic
#

if BOARD_NRF52833DONGLEV2_NRF52833

config BOARD
	default "nrf52833donglev2_nrf52833"

config BT_CTLR
	default BT

endif # BOARD_NRF52833DONGLEV2_NRF52833
```

## boards/arm/nrf52840_pca20035/Kconfig.board
```kconfig
# Kconfig - nRF52840 PCA20035 board configuration
#
# Copyright (c) 2019 Nordic Semiconductor ASA
#
# SPDX-License-Identifier: LicenseRef-BSD-5-Clause-Nordic

config BOARD_NRF52840_PCA20035
	bool "nRF52840 PCA20035"
	depends on SOC_NRF52840_QIAA
```

## boards/arm/nrf52840_pca20035/Kconfig.defconfig
```kconfig
# Kconfig - nRF52840 PCA20035 board configuration
#
# Copyright (c) 2019 Nordic Semiconductor ASA
#
# SPDX-License-Identifier: LicenseRef-BSD-5-Clause-Nordic

if BOARD_NRF52840_PCA20035

config BOARD
	default "nrf52840_pca20035"

if USB

config USB_NRFX
	def_bool y

config USB_DEVICE_STACK
	def_bool y

endif # USB

endif # BOARD_NRF52840_PCA20035
```

## boards/arm/nrf52840_pca20035/nrf52840_pca20035_defconfig
```kconfig
CONFIG_ARM=y
CONFIG_SOC_SERIES_NRF52X=y
CONFIG_SOC_NRF52840_QIAA=y
CONFIG_BOARD_NRF52840_PCA20035=y

# Enable MPU
CONFIG_ARM_MPU=y

# enable uart driver
CONFIG_SERIAL=y
CONFIG_UART_0_NRF_UARTE=y
CONFIG_UART_1_NRF_UARTE=y

# Enable console
CONFIG_CONSOLE=y

# Additional board options
CONFIG_GPIO_AS_PINRESET=n
```

## boards/arm/nrf52840_pca20035/nrf52840_pca20035_v0_3_0_defconfig
```kconfig
CONFIG_ARM=y
CONFIG_SOC_FAMILY_NRF=y
CONFIG_SOC_SERIES_NRF52X=y
CONFIG_SOC_NRF52840_QIAA=y
CONFIG_BOARD_NRF52840_PCA20035_V0_3_0=y

# Enable MPU
CONFIG_ARM_MPU=y

# enable uart driver
CONFIG_SERIAL=y
CONFIG_UART_NRFX=y
CONFIG_UART_0_NRF_UART=y
CONFIG_UART_1_NRF_UARTE=y

# Enable console
CONFIG_CONSOLE=y
CONFIG_UART_CONSOLE=n
CONFIG_RTT_CONSOLE=y
CONFIG_USE_SEGGER_RTT=y
CONFIG_LOG_BACKEND_RTT_MODE_DROP=y

# Additional board options
CONFIG_GPIO_AS_PINRESET=n
```

## boards/arm/nrf52840_pca20041/Kconfig
```kconfig
#
# Copyright (c) 2018 Nordic Semiconductor
#
# SPDX-License-Identifier: LicenseRef-BSD-5-Clause-Nordic
#

if BOARD_NRF52840_PCA20041

config BOARD_HAS_DCDC
	bool "Board has DCDC circuitry"
	select SOC_DCDC_NRF52X
	default y

endif # BOARD_NRF52840_PCA20041
```
