## boards/arm/nrf52840_pca20041/Kconfig.board
```kconfig
#
# Copyright (c) 2018 Nordic Semiconductor
#
# SPDX-License-Identifier: LicenseRef-BSD-5-Clause-Nordic
#

config  BOARD_NRF52840_PCA20041
	bool "NRF52840 PCA20041"
	depends on SOC_NRF52840_QIAA
```

## boards/arm/nrf52840_pca20041/Kconfig.defconfig
```kconfig
#
# Copyright (c) 2018 Nordic Semiconductor
#
# SPDX-License-Identifier: LicenseRef-BSD-5-Clause-Nordic
#

if BOARD_NRF52840_PCA20041

config BOARD
	default "nrf52840_pca20041"

if USB

config USB_NRFX
	def_bool y

config USB_DEVICE_STACK
	def_bool y

endif # USB

if IEEE802154

config IEEE802154_NRF5
	def_bool n

endif # IEEE802154

endif # BOARD_NRF52840_PCA20041
```

## boards/arm/nrf52840_pca20041/nrf52840_pca20041_defconfig
```kconfig
CONFIG_ARM=y
CONFIG_SOC_SERIES_NRF52X=y
CONFIG_SOC_NRF52840_QIAA=y
CONFIG_BOARD_NRF52840_PCA20041=y

# Enable MPU
CONFIG_ARM_MPU=y

CONFIG_GPIO_AS_PINRESET=n
```

## boards/arm/nrf52840gmouse_nrf52840/Kconfig
```kconfig
#
# Copyright (c) 2018 Nordic Semiconductor
#
# SPDX-License-Identifier: LicenseRef-Nordic-5-Clause
#

if BOARD_NRF52840GMOUSE_NRF52840

config BOARD_ENABLE_DCDC
	bool "Enable DCDC mode"
	select SOC_DCDC_NRF52X
	default y

endif # BOARD_NRF52840GMOUSE_NRF52840
```

## boards/arm/nrf52840gmouse_nrf52840/Kconfig.board
```kconfig
#
# Copyright (c) 2018 Nordic Semiconductor
#
# SPDX-License-Identifier: LicenseRef-Nordic-5-Clause
#

config BOARD_NRF52840GMOUSE_NRF52840
	bool "NRF52840 GMOUSE NRF52840"
	depends on SOC_NRF52840_QIAA
```

## boards/arm/nrf52840gmouse_nrf52840/Kconfig.defconfig
```kconfig
#
# Copyright (c) 2018 Nordic Semiconductor
#
# SPDX-License-Identifier: LicenseRef-Nordic-5-Clause
#

if BOARD_NRF52840GMOUSE_NRF52840

config BOARD
	default "nrf52840gmouse_nrf52840"

if USB

config USB_NRFX
	def_bool y

config USB_DEVICE_STACK
	def_bool y

endif # USB

if IEEE802154

config IEEE802154_NRF5
	def_bool n

endif # IEEE802154

config BT_CTLR
	default BT

endif # BOARD_NRF52840GMOUSE_NRF52840
```

## boards/arm/nrf52840gmouse_nrf52840/nrf52840gmouse_nrf52840_defconfig
```kconfig
CONFIG_SOC_SERIES_NRF52X=y
CONFIG_SOC_NRF52840_QIAA=y
CONFIG_BOARD_NRF52840GMOUSE_NRF52840=y

# Enable MPU
CONFIG_ARM_MPU=y

CONFIG_PINCTRL=y
```

## boards/arm/nrf52_pca20037/Kconfig
```kconfig
#
# Copyright (c) 2019 Nordic Semiconductor
#
# SPDX-License-Identifier: LicenseRef-BSD-5-Clause-Nordic
#

if BOARD_NRF52_PCA20037

config BOARD_HAS_DCDC
	bool "Board has DCDC circuitry"
	select SOC_DCDC_NRF52X
	default y

endif # BOARD_NRF52_PCA20037
```

## boards/arm/nrf52_pca20037/Kconfig.board
```kconfig
#
# Copyright (c) 2019 Nordic Semiconductor
#
# SPDX-License-Identifier: LicenseRef-BSD-5-Clause-Nordic
#

config  BOARD_NRF52_PCA20037
	bool "NRF52 PCA20037"
	depends on SOC_NRF52832_QFAA
```

## boards/arm/nrf52_pca20037/Kconfig.defconfig
```kconfig
#
# Copyright (c) 2019 Nordic Semiconductor
#
# SPDX-License-Identifier: LicenseRef-BSD-5-Clause-Nordic
#

if BOARD_NRF52_PCA20037

config BOARD
	default "nrf52_pca20037"

endif # BOARD_NRF52_PCA20037
```

## boards/arm/nrf52_pca20037/nrf52_pca20037_defconfig
```kconfig
CONFIG_ARM=y
CONFIG_SOC_SERIES_NRF52X=y
CONFIG_SOC_NRF52832_QFAA=y
CONFIG_BOARD_NRF52_PCA20037=y

# Enable MPU
CONFIG_ARM_MPU=y

CONFIG_GPIO_AS_PINRESET=n
```

## boards/arm/nrf52_pca20041/Kconfig.board
```kconfig
#
# Copyright (c) 2018 Nordic Semiconductor
#
# SPDX-License-Identifier: BSD-5-Clause-Nordic
#

config  BOARD_NRF52_PCA20041
	bool "nRF52 PCA20041"
	select HAS_DTS_GPIO
	select HAS_DTS_I2C
	depends on SOC_NRF52832_QFAA
```

## boards/arm/nrf52_pca20044/Kconfig.board
```kconfig
#
# Copyright (c) 2019 Nordic Semiconductor
#
# SPDX-License-Identifier: LicenseRef-BSD-5-Clause-Nordic
#

config  BOARD_NRF52_PCA20044
	bool "NRF52 PCA20044"
	depends on SOC_NRF52832_QFAA
```

## boards/arm/nrf52_pca20044/Kconfig.defconfig
```kconfig
#
# Copyright (c) 2019 Nordic Semiconductor
#
# SPDX-License-Identifier: LicenseRef-BSD-5-Clause-Nordic
#

if BOARD_NRF52_PCA20044

config BOARD
	default "nrf52_pca20044"

config BT_CTLR
	default BT

endif # BOARD_NRF52_PCA20044
```

## boards/arm/nrf52_pca63519/Kconfig.board
```kconfig
#
# Copyright (c) 2018 Nordic Semiconductor
#
# SPDX-License-Identifier: LicenseRef-BSD-5-Clause-Nordic
#

config  BOARD_NRF52_PCA63519
	bool "nRF52 PCA63519"
	select HAS_DTS_LIS3DH

	depends on SOC_NRF52832_QFAA
```

## boards/arm/nrf52_pca63519/Kconfig.defconfig
```kconfig
#
# Copyright (c) 2018 Nordic Semiconductor
#
# SPDX-License-Identifier: BSD-5-Clause-Nordic
#

if BOARD_NRF52_PCA63519

config BOARD
	default "nrf52_pca63519"

endif # BOARD_NRF52_PCA63519
```

## boards/arm/nrf52_pca63519/nrf52_pca63519_defconfig
```kconfig
CONFIG_ARM=y
CONFIG_SOC_FAMILY_NRF=y
CONFIG_SOC_SERIES_NRF52X=y
CONFIG_SOC_NRF52832_QFAA=y
CONFIG_BOARD_NRF52_PCA63519=y

# Enable MPU
CONFIG_ARM_MPU_NRF52X=y

CONFIG_GPIO_AS_PINRESET=y

CONFIG_I2C=y
CONFIG_I2C_INIT_PRIORITY=60
CONFIG_SYS_LOG_I2C_LEVEL=0
CONFIG_I2C_0=y
CONFIG_I2C_1=y
CONFIG_I2C_NRFX=y
CONFIG_I2C_0_NRF_TWI=y
CONFIG_I2C_1_NRF_TWI=y
```

## boards/arm/nrf52dmouse_nrf52832/Kconfig.board
```kconfig
#
# Copyright (c) 2019 Nordic Semiconductor
#
# SPDX-License-Identifier: LicenseRef-Nordic-5-Clause
#

config BOARD_NRF52DMOUSE_NRF52832
	bool "NRF52 DMOUSE NRF52832"
	depends on SOC_NRF52832_QFAA
```

## boards/arm/nrf52dmouse_nrf52832/Kconfig.defconfig
```kconfig
#
# Copyright (c) 2019 Nordic Semiconductor
#
# SPDX-License-Identifier: LicenseRef-Nordic-5-Clause
#

if BOARD_NRF52DMOUSE_NRF52832

config BOARD
	default "nrf52dmouse_nrf52832"

config BT_CTLR
	default BT

config HW_STACK_PROTECTION
	default ARCH_HAS_STACK_PROTECTION

endif # BOARD_NRF52DMOUSE_NRF52832
```

## boards/arm/nrf52kbd_nrf52832/Kconfig
```kconfig
#
# Copyright (c) 2019 Nordic Semiconductor
#
# SPDX-License-Identifier: LicenseRef-Nordic-5-Clause
#

if BOARD_NRF52KBD_NRF52832

config BOARD_ENABLE_DCDC
	bool "Enable DCDC mode"
	select SOC_DCDC_NRF52X
	default y

endif # BOARD_NRF52KBD_NRF52832
```

## boards/arm/nrf52kbd_nrf52832/Kconfig.board
```kconfig
#
# Copyright (c) 2019 Nordic Semiconductor
#
# SPDX-License-Identifier: LicenseRef-Nordic-5-Clause
#

config BOARD_NRF52KBD_NRF52832
	bool "NRF52 KBD NRF52832"
	depends on SOC_NRF52832_QFAA
```

## boards/arm/nrf52kbd_nrf52832/Kconfig.defconfig
```kconfig
#
# Copyright (c) 2019 Nordic Semiconductor
#
# SPDX-License-Identifier: LicenseRef-Nordic-5-Clause
#

if BOARD_NRF52KBD_NRF52832

config BOARD
	default "nrf52kbd_nrf52832"

config BT_CTLR
	default BT

config HW_STACK_PROTECTION
	default ARCH_HAS_STACK_PROTECTION

endif # BOARD_NRF52KBD_NRF52832
```

## boards/arm/nrf52kbd_nrf52832/nrf52kbd_nrf52832_defconfig
```kconfig
CONFIG_SOC_SERIES_NRF52X=y
CONFIG_SOC_NRF52832_QFAA=y
CONFIG_BOARD_NRF52KBD_NRF52832=y

# Enable MPU
CONFIG_ARM_MPU=y

CONFIG_PINCTRL=y
```
