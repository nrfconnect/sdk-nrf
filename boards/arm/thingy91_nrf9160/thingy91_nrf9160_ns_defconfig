## boards/arm/thingy91_nrf9160/thingy91_nrf9160_ns_defconfig
```kconfig
CONFIG_SOC_SERIES_NRF91X=y
CONFIG_SOC_NRF9160_SICA=y
CONFIG_BOARD_THINGY91_NRF9160_NS=y

# Enable MPU
CONFIG_ARM_MPU=y

# Enable TrustZone-M
CONFIG_ARM_TRUSTZONE_M=y

# This Board implies building Non-Secure firmware
CONFIG_TRUSTED_EXECUTION_NONSECURE=y

# Enable PINCTRL
CONFIG_PINCTRL=y

# Enable GPIO
CONFIG_GPIO=y

# Enable UARTE
CONFIG_SERIAL=y

# Enable console
CONFIG_CONSOLE=y
CONFIG_UART_CONSOLE=y

# Enable SPI
CONFIG_SPI=y

# Disable entropy driver, as it's not yet implemented for nRF9160
CONFIG_ENTROPY_NRF5_RNG=n

CONFIG_BOOTLOADER_MCUBOOT=y
```

## boards/arm/thingy91_nrf9160/thingy91_nrf9160ns_defconfig
```kconfig
CONFIG_SOC_SERIES_NRF91X=y
CONFIG_SOC_NRF9160_SICA=y
CONFIG_BOARD_THINGY91_NRF9160NS=y

# Enable MPU
CONFIG_ARM_MPU=y

# Enable hardware stack protection
CONFIG_HW_STACK_PROTECTION=y

# Enable TrustZone-M
CONFIG_ARM_TRUSTZONE_M=y

# This Board implies building Non-Secure firmware
CONFIG_TRUSTED_EXECUTION_NONSECURE=y

# Enable GPIO
CONFIG_GPIO=y

# Enable UARTE
CONFIG_SERIAL=y

# Enable console
CONFIG_CONSOLE=y
CONFIG_UART_CONSOLE=y

# Enable I2C
CONFIG_I2C=y

# Enable SPI
CONFIG_SPI=y

# Enable power management IC ADP536x
CONFIG_ADP536X=y

# Disable entropy driver, as it's not yet implemented for nRF9160
CONFIG_ENTROPY_NRF5_RNG=n
```

## boards/arm/thingy91x_nrf5340/Kconfig.board
```kconfig
# Copyright (c) 2024 Nordic Semiconductor
# SPDX-License-Identifier: LicenseRef-Nordic-5-Clause

config BOARD_THINGY91X_NRF5340_CPUAPP
	bool "nRF5340_APP THINGY91X"
	depends on SOC_NRF5340_CPUAPP_QKAA

config BOARD_THINGY91X_NRF5340_CPUAPP_NS
	bool "nRF5340_APP THINGY91X"
	depends on SOC_NRF5340_CPUAPP_QKAA

config BOARD_THINGY91X_NRF5340_CPUNET
	bool "nRF5340_NET THINGY91X"
	depends on SOC_NRF5340_CPUNET_QKAA
```

## boards/arm/thingy91x_nrf5340/thingy91x_nrf5340_cpunet_defconfig
```kconfig
# Copyright (c) 2024 Nordic Semiconductor
# SPDX-License-Identifier: LicenseRef-Nordic-5-Clause

CONFIG_SOC_SERIES_NRF53X=y
CONFIG_SOC_NRF5340_CPUNET_QKAA=y
CONFIG_BOARD_THINGY91X_NRF5340_CPUNET=y

# Enable MPU
CONFIG_ARM_MPU=y

# Enable hardware stack protection
CONFIG_HW_STACK_PROTECTION=y

# enable GPIO
CONFIG_GPIO=y

# Enable uart driver
CONFIG_SERIAL=y

# enable console
CONFIG_CONSOLE=y
CONFIG_UART_CONSOLE=y

CONFIG_PINCTRL=y
```

## boards/arm/thingy91x_nrf9151/Kconfig
```kconfig
# Thingy:91 X nRF9151 board configuration
#
# Copyright (c) 2024 Nordic Semiconductor ASA
#
# SPDX-License-Identifier: LicenseRef-Nordic-5-Clause

module=BOARD
module-dep=LOG
module-str=Log level for board
source "${ZEPHYR_BASE}/subsys/logging/Kconfig.template.log_config"
```

## boards/arm/thingy91x_nrf9151/Kconfig.board
```kconfig
# Thingy:91 X nRF9151 board configuration
#
# Copyright (c) 2024 Nordic Semiconductor
# SPDX-License-Identifier: LicenseRef-Nordic-5-Clause

if SOC_NRF9151_LACA

config BOARD_THINGY91X_NRF9151
	bool "nRF9151 THINGY91X"

config BOARD_THINGY91X_NRF9151_NS
	bool "nRF9151 THINGY91X non-secure"

endif # SOC_NRF9151_LACA
```

## boards/arm/thingy91x_nrf9151/thingy91x_nrf9151_defconfig
```kconfig
# Copyright (c) 2024 Nordic Semiconductor
# SPDX-License-Identifier: LicenseRef-Nordic-5-Clause

CONFIG_SOC_SERIES_NRF91X=y
CONFIG_SOC_NRF9151_LACA=y
CONFIG_BOARD_THINGY91X_NRF9151=y

# Enable MPU
CONFIG_ARM_MPU=y

# Enable TrustZone-M
CONFIG_ARM_TRUSTZONE_M=y

# Enable PINCTRL
CONFIG_PINCTRL=y

# Enable GPIO
CONFIG_GPIO=y

# Enable UARTE
CONFIG_SERIAL=y

# Enable console
CONFIG_CONSOLE=y
CONFIG_UART_CONSOLE=y

# Disable entropy driver, as it's not yet implemented for nRF9151
CONFIG_ENTROPY_NRF5_RNG=n
```

## boards/nordic/nrf52810dmouse/Kconfig.defconfig
```kconfig
#
# Copyright (c) 2019 Nordic Semiconductor
#
# SPDX-License-Identifier: LicenseRef-Nordic-5-Clause
#

if BOARD_NRF52810DMOUSE

config BT_CTLR
	default BT

config HW_STACK_PROTECTION
	default ARCH_HAS_STACK_PROTECTION

endif # BOARD_NRF52810DMOUSE
```

## boards/nordic/nrf52810dmouse/Kconfig.nrf52810dmouse
```kconfig
# Copyright (c) 2019 Nordic Semiconductor
# SPDX-License-Identifier: LicenseRef-Nordic-5-Clause

config BOARD_NRF52810DMOUSE
	select SOC_NRF52810_QFAA
```

## boards/nordic/nrf52820dongle/Kconfig
```kconfig
#
# Copyright (c) 2020 Nordic Semiconductor ASA
#
# SPDX-License-Identifier: LicenseRef-Nordic-5-Clause
#

if BOARD_NRF52820DONGLE_NRF52820

config BOARD_ENABLE_DCDC
	bool "Enable DCDC mode"
	select SOC_DCDC_NRF52X
	default y

endif # BOARD_NRF52820DONGLE_NRF52820
```

## boards/nordic/nrf52820dongle/Kconfig.nrf52820dongle
```kconfig
# Copyright (c) 2020 Nordic Semiconductor ASA
# SPDX-License-Identifier: LicenseRef-Nordic-5-Clause

config BOARD_NRF52820DONGLE
	select SOC_NRF52820_QDAA
```

## boards/nordic/nrf52820dongle/board.yml
```yaml
board:
  name: nrf52820dongle
  full_name: nRF52820 Dongle
  vendor: nordic
  socs:
    - name: nrf52820
```

## boards/nordic/nrf52833dongle/Kconfig.defconfig
```kconfig
#
# Copyright (c) 2020 Nordic Semiconductor ASA
#
# SPDX-License-Identifier: LicenseRef-Nordic-5-Clause
#

if BOARD_NRF52833DONGLE

config BT_CTLR
	default BT

config HW_STACK_PROTECTION
	default ARCH_HAS_STACK_PROTECTION

endif # BOARD_NRF52833DONGLE
```

## boards/nordic/nrf52833dongle/Kconfig.nrf52833dongle
```kconfig
# Copyright (c) 2020 Nordic Semiconductor ASA
# SPDX-License-Identifier: LicenseRef-Nordic-5-Clause

config BOARD_NRF52833DONGLE
	select SOC_NRF52833_QIAA
```

## boards/nordic/nrf52833dongle/board.yml
```yaml
board:
  name: nrf52833dongle
  full_name: nRF52833 Dongle
  vendor: nordic
  socs:
    - name: nrf52833
```

## boards/nordic/nrf52840dk/board.yml
```yaml
board:
  extend: nrf52840dk
  variants:
    - name: matter
      qualifier: nrf52840
runners:
  run_once:
    '--recover':
      - runners:
          - nrfjprog
          - nrfutil
        run: first
        groups:
          - boards:
              - nrf52840dk/nrf52840/matter
    '--erase':
      - runners:
          - nrfjprog
          - jlink
          - nrfutil
        run: first
        groups:
          - boards:
              - nrf52840dk/nrf52840/matter
    '--reset':
      - runners:
          - nrfjprog
          - jlink
          - nrfutil
        run: last
        groups:
          - boards:
              - nrf52840dk/nrf52840/matter
```

## boards/nordic/nrf52840dk/compress/Kconfig.nrf52840dk
```kconfig
# Copyright (c) 2025 Nordic Semiconductor ASA
# SPDX-License-Identifier: LicenseRef-Nordic-5-Clause

config BOARD_NRF52840DK
	select SOC_NRF52840_QIAA if BOARD_NRF52840DK_NRF52840_COMPRESS
```

## boards/nordic/nrf52840dk/compress/board.yml
```yaml
board:
  extend: nrf52840dk
  variants:
    - name: compress
      qualifier: nrf52840
runners:
  run_once:
    '--recover':
      - runners:
          - nrfjprog
          - nrfutil
        run: first
        groups:
          - boards:
              - nrf52840dk/nrf52840/compress
    '--erase':
      - runners:
          - nrfjprog
          - jlink
          - nrfutil
        run: first
        groups:
          - boards:
              - nrf52840dk/nrf52840/compress
    '--reset':
      - runners:
          - nrfjprog
          - jlink
          - nrfutil
        run: last
        groups:
          - boards:
              - nrf52840dk/nrf52840/compress
```

## boards/nordic/nrf52840gmouse/Kconfig.defconfig
```kconfig
#
# Copyright (c) 2018 Nordic Semiconductor
#
# SPDX-License-Identifier: LicenseRef-Nordic-5-Clause
#

if BOARD_NRF52840GMOUSE

if IEEE802154

config IEEE802154_NRF5
	def_bool n

endif # IEEE802154

config BT_CTLR
	default BT

config HW_STACK_PROTECTION
	default ARCH_HAS_STACK_PROTECTION

endif # BOARD_NRF52840GMOUSE
```

## boards/nordic/nrf52840gmouse/Kconfig.nrf52840gmouse
```kconfig
# Copyright (c) 2018 Nordic Semiconductor
# SPDX-License-Identifier: LicenseRef-Nordic-5-Clause

config BOARD_NRF52840GMOUSE
	select SOC_NRF52840_QIAA
```

## boards/nordic/nrf52840gmouse/board.yml
```yaml
board:
  name: nrf52840gmouse
  full_name: nRF52840 Gaming Mouse
  vendor: nordic
  socs:
    - name: nrf52840
```

## boards/nordic/nrf52dmouse/board.yml
```yaml
board:
  name: nrf52dmouse
  full_name: nRF52 Desktop Mouse
  vendor: nordic
  socs:
    - name: nrf52832
```
