/*
 * Copyright (c) 2019 Nordic Semiconductor ASA
 *
 * SPDX-License-Identifier: LicenseRef-Nordic-5-Clause
 */

/dts-v1/;
#include <nordic/nrf9160ns_sica.dtsi>
#include "thingy91_nrf9160_common.dts"

/ {
	chosen {
		zephyr,flash = &flash0;
		zephyr,sram = &sram0_ns;
		zephyr,code-partition = &slot0_ns_partition;
	};
};

/* Disable Zephyr driver for UART1. The nrfx driver is used for interfacing with UART1
 * for sending modem traces.
 */
&uart1 {
	status = "disabled";
};
