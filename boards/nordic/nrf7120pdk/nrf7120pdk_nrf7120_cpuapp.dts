/*
 * Copyright (c) 2025 Nordic Semiconductor ASA
 *
 * SPDX-License-Identifier: LicenseRef-Nordic-5-Clause
 */

/dts-v1/;

#include "nrf7120_cpuapp_common.dtsi"

/ {
	compatible = "nordic,nrf7120pdk_nrf7120-cpuapp";
	model = "Nordic nRF7120 PDK nRF7120 Application MCU";

	chosen {
		zephyr,sram = &cpuapp_sram;
		zephyr,console = &uart00;
		zephyr,shell-uart = &uart00;
	};
};

&uart00 {
	status = "okay";
	current-speed = <115200>;
	pinctrl-0 = <&uart00_default>;
	pinctrl-1 = <&uart00_sleep>;
	pinctrl-names = "default", "sleep";
};
