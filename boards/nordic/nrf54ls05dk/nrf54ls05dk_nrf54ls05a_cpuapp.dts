/*
 * Copyright (c) 2026 Nordic Semiconductor ASA
 *
 * SPDX-License-Identifier: LicenseRef-Nordic-5-Clause
 */

/dts-v1/;

#include <nordic/nrf54ls05a_cpuapp.dtsi>
#include "nrf54ls05_a_b_cpuapp_common.dtsi"

/ {
	compatible = "nordic,nrf54ls05dk_nrf54ls05a-cpuapp";
	model = "Nordic nRF54LS05 DK nRF54LS05A Application MCU";

	chosen {
		zephyr,code-partition = &slot0_partition;
		zephyr,sram = &cpuapp_sram;
		zephyr,bt-hci = &bt_hci_sdc;
	};
};

&bt_hci_sdc {
	status = "okay";
};

&bt_hci_controller {
	status = "disabled";
};
