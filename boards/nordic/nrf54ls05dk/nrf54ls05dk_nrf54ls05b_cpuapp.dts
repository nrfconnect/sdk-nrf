/*
 * Copyright (c) 2025 Nordic Semiconductor ASA
 *
 * SPDX-License-Identifier: LicenseRef-Nordic-5-Clause
 */

/dts-v1/;

#include "nrf54ls05b_cpuapp_common.dtsi"

/ {
	compatible = "nordic,nrf54ls05dk_nrf54ls05b-cpuapp";
	model = "Nordic nRF54LS05 DK nRF54LS05B Application MCU";

	chosen {
		zephyr,code-partition = &slot0_partition;
		zephyr,sram = &cpuapp_sram;
		zephyr,bt-hci = &bt_hci_sdc;
	};
};

&bt_hci_sdc {
	status = "okay";
};

&bt_hci_controller {
	status = "disabled";
};
