/*
 * Copyright (c) 2026 Nordic Semiconductor ASA
 *
 * SPDX-License-Identifier: LicenseRef-Nordic-5-Clause
 */

/dts-v1/;

#include "nrf54lc10a_cpuapp_common.dtsi"

/ {
	compatible = "nordic,nrf54lc10dk_nrf54lc10a-cpuapp";
	model = "Nordic nRF54CV10 DK nRF54LC10A Application MCU";

	chosen {
		zephyr,code-partition = &slot0_partition;
		zephyr,sram = &cpuapp_sram;
		zephyr,bt-hci = &bt_hci_sdc;
	};
};

&bt_hci_sdc {
	status = "okay";
};

&bt_hci_controller {
	status = "disabled";
};

/* Include default memory partition configuration file */
#include <common/nordic/nrf54lc10a_cpuapp_partition.dtsi>
