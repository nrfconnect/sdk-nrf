## boards/nordic/nrf93m1dk_lm20b/Kconfig.nrf93m1dk_lm20b
```kconfig
# Copyright (c) 2026 Nordic Semiconductor ASA
# SPDX-License-Identifier: LicenseRef-Nordic-5-Clause

config BOARD_NRF93M1DK_LM20B
	select SOC_NRF54LM20B_CPUAPP if BOARD_NRF93M1DK_LM20B_NRF54LM20B_CPUAPP || \
		BOARD_NRF93M1DK_LM20B_NRF54LM20B_CPUAPP_NS
	select SOC_NRF54LM20B_CPUFLPR if BOARD_NRF93M1DK_LM20B_NRF54LM20B_CPUFLPR
```

## dts/bindings/pulse_meas/nordic,pulse-meas.yaml
```yaml
# Copyright (c) 2026 Nordic Semiconductor ASA
# SPDX-License-Identifier: LicenseRef-Nordic-5-Clause

description: Nordic nRF pulse width measurement

compatible: "nordic,pulse-meas"

include: base.yaml

properties:

  timer-instance:
    required: true
    type: phandle
    description: TIMER instance used for pulse width capture.

  assert-gpios:
    type: phandle-array
    required: true
    description:
      GPIO for detecting start of impulse if deassert-gpios is provided. If it is not
      provided (single pin mode), both edges of the pulse are detected on this pin.

  deassert-gpios:
    type: phandle-array
    required: false
    description:
      Optional GPIO for detecting end of impulse. If not provided, the pulse is measured
      on the assert-gpios pin only (single pin mode).
```

## lib/sfloat/Kconfig
```kconfig
#
# Copyright (c) 2022 Nordic Semiconductor ASA
#
# SPDX-License-Identifier: LicenseRef-Nordic-5-Clause
#

config SFLOAT
	bool "SFLOAT type [EXPERIMENTAL]"
	select EXPERIMENTAL
	help
	  A library for managing SFLOAT type.
```

## modules/g722/Kconfig
```kconfig
#
# Copyright (c) 2026 Nordic Semiconductor
#
# SPDX-License-Identifier: LicenseRef-Nordic-5-Clause
#

module=G722
module-str=G.722 Codec

config SW_CODEC_G722
	bool
```

## modules/mcuboot/boot/zephyr/Kconfig
```kconfig
#
# Copyright (c) 2021 Nordic Semiconductor ASA
#
# SPDX-License-Identifier: LicenseRef-Nordic-5-Clause
#

# NCS-only MCUboot boot-image options (IronSide SE / PERIPHCONF / MPCCONF).
# Sourced from [mcuboot_dir]/boot/zephyr/Kconfig.
# Sysbuild-facing mirrors live in nrf/sysbuild/Kconfig.mcuboot.

if IRONSIDE_SE_CALL

choice IRONSIDE_SE_CALL_DRIVER
	default IRONSIDE_SE_CALL_MINIMAL
endchoice

endif

config NCS_MCUBOOT_LOAD_PERIPHCONF
	bool "Load new peripheral configuration before jumping to the application"
	depends on HAS_IRONSIDE_SE
	depends on IRONSIDE_SE_CALL_MINIMAL
	help
	  When enabled, MCUboot looks for a TLV pointing to a slot specific list of
	  peripheral configurations (PERIPHCONF) to initialize peripherals with before
	  booting that slot. The actual initialization happens via a IronSide SE IPC call.

if NCS_MCUBOOT_LOAD_PERIPHCONF

config NCS_MCUBOOT_LOAD_PERIPHCONF_MAX_BLOBS
	int "Max PERIPHCONF blobs to load"
	default 8
	help
	  The maximum number of PERIPHCONF blobs loaded by MCUboot for a slot.

endif

config NCS_MCUBOOT_MPCCONF_STATIC_WRITE_PROTECTION
	bool "Write protect partitions using MPCCONF"
	select NRF_MPCCONF_SECTION
	depends on HAS_IRONSIDE_SE
	depends on IRONSIDE_SE_CALL_MINIMAL
	help
	  Remove write permissions from the bootloader partition and all booted images
	  by configuring the global domain Memory Privilege Controllers (MPCs) using the
	  UICR.MPCCONF setting and the MPCCONF service provided by IronSide SE.
	  When this option is enabled, MCUboot will contain static UICR MPCCONF
	  entries which are extracted by the UICR generator image and placed into the
	  mpcconf_partition area. Before booting the application, MCUboot uses the MPCCONF
	  service to update the MPCs to write protect the slot being booted.

if NCS_MCUBOOT_MPCCONF_STATIC_WRITE_PROTECTION

DT_CHOSEN_Z_CODE_PARTITION := zephyr,code-partition

config NCS_MCUBOOT_MPCCONF_STATIC_WRITE_PROTECTION_INITIAL_REGION_SIZE
	hex "Size of the initial write protected region"
	default $(dt_chosen_reg_size_hex,$(DT_CHOSEN_Z_CODE_PARTITION))
	help
	  Size in bytes of the first write protected region, which begins at the start
	  of the application MRAM. It defaults to the size of the code partition region of the
	  bootloader, but can be increased in order to span subsequent partitions, for example
	  to write protect a PERIPHCONF partition and/or MPCCONF partition together with
	  integrity checking the region at boot using the UICR.PROTECTEDMEM feature.

endif

if NCS_MCUBOOT_LOAD_PERIPHCONF || NCS_MCUBOOT_MPCCONF_STATIC_WRITE_PROTECTION

config NCS_MCUBOOT_LOAD_IRONSIDE_SE_CONF_RESET_ON_ERROR
	bool "Reset if loading PERIPHCONF or MPCCONF fails"
	default y
	help
	  Trigger a system reset on failure to load new peripheral configurations
	  via IronSide SE IPC. A failure to load the configuration in most cases means
	  that it was rejected by IronSide SE, either because it contained invalid register values,
	  or different parts of the configuration was in conflict with each other.
	  If this option is disabled, MCUboot will instead loop indefinitely on failure.

endif
```

## samples/benchmarks/power_consumption/Kconfig
```kconfig
#
# Copyright (c) 2026 Nordic Semiconductor ASA
#
# SPDX-License-Identifier: LicenseRef-Nordic-5-Clause
#

mainmenu "nRF7120 System ON Idle power consumption benchmark"

config SAMPLE_POWER_CONSUMPTION_IDLE_SECONDS
	int "System ON idle duration in seconds"
	range 1 3600
	default 10
	help
	  Duration of the sleep period (through k_sleep(), on this SoC's default
	  GRTC-backed system timer) before waking up, printing the wake
	  counter, and sleeping again.

source "Kconfig.zephyr"
```

## samples/bluetooth/iso_time_sync/Kconfig
```kconfig
#
# Copyright (c) 2024 Nordic Semiconductor
#
# SPDX-License-Identifier: LicenseRef-Nordic-5-Clause
#

menu "Bluetooth ISO time sync sample"

config SDU_INTERVAL_US
	int "SDU interval to be used in microseconds"
	default 10000
	help
	  The SDU interval determines how often the button
	  value will be transmitted to the receiving devices.

config TIMED_LED_PRESENTATION_DELAY_US
	int "The delay of presenting the new value of the LED"
	default 5000
	help
	  The presentation delay of the LED represents the time
	  from the SDU synchronization reference until the value
	  is applied.
	  The application needs to ensure it can process the
	  received SDU within this amount of time.
	  The end-to-end latency will be at least the sum
	  of the configured transport latency and presentation delay

config LED_TOGGLE_IMMEDIATELY_ON_SEND_OR_RECEIVE
	bool "Enable immediate LED toggling upon sending or receiving data"
	help
	  Enable immediate toggling of LED2 when isochronous
	  data is sent or received. This allows for measurment
	  of the mimimum end-to-end latency.

endmenu

# The controller options apply only where the controller is part of this image.
configdefault BT_CTLR_SDC_PERIPHERAL_COUNT
	default 1

configdefault BT_CTLR_SDC_ISO_TX_HCI_BUFFER_COUNT
	default 4

configdefault BT_CTLR_ADV_ISO_STREAM_COUNT
	default 4

configdefault BT_CTLR_SYNC_ISO_STREAM_COUNT
	default 4

configdefault BT_CTLR_CONN_ISO_STREAMS
	default 4

source "Kconfig.zephyr"
```

## samples/cellular/at_monitor/sample.yaml
```yaml
sample:
  name: AT monitor sample
tests:
  sample.cellular.at_monitor:
    sysbuild: true
    build_only: true
    integration_platforms:
      - nrf9151dk/nrf9151/ns
      - nrf9251dk/nrf9251/cpuapp
    platform_allow:
      - nrf9151dk/nrf9151/ns
      - nrf9251dk/nrf9251/cpuapp
    tags:
      - ci_build
      - sysbuild
      - ci_samples_cellular
```

## samples/cellular/battery/Kconfig
```kconfig
menu "Battery sample"

config HIGH_BAT_REFRESH_INTERVAL_SEC
	int "Refresh interval (sec) while battery voltage is high"
	default 5

config LOW_BAT_REFRESH_INTERVAL_SEC
	int "Refresh interval (sec) while battery voltage is low"
	default 60

config POFWARN_REFRESH_INTERVAL_SEC
	int "Refresh interval (sec) after receiving power-off warning"
	default 120

endmenu

if BUILD_WITH_TFM

choice TFM_PROFILE_TYPE
	default TFM_PROFILE_TYPE_MINIMAL
endchoice

endif # BUILD_WITH_TFM

menu "Zephyr Kernel"
source "Kconfig.zephyr"

module = BATTERY_SAMPLE
module-str = Battery sample
source "$(ZEPHYR_BASE)/subsys/logging/Kconfig.template.log_config"

endmenu
```

## samples/cellular/battery/sample.yaml
```yaml
sample:
  name: battery
tests:
  sample.cellular.battery:
    sysbuild: true
    build_only: true
    integration_platforms:
      - nrf9151dk/nrf9151/ns
      - nrf9251dk/nrf9251/cpuapp
    platform_allow:
      - nrf9151dk/nrf9151/ns
      - nrf9251dk/nrf9251/cpuapp
    tags:
      - ci_build
      - sysbuild
      - ci_samples_cellular
```

## samples/cellular/location/Kconfig
```kconfig
#
# Copyright (c) 2021 Nordic Semiconductor ASA
#
# SPDX-License-Identifier: LicenseRef-Nordic-5-Clause
#

menu "Location sample"

endmenu

if NRF_CLOUD_PGPS

configdefault ZMS
	default y if SOC_FLASH_NRF_MRAM

configdefault NVS
	default y if !SOC_FLASH_NRF_MRAM

if ZMS

choice ZMS_LOG_LEVEL_CHOICE
	default ZMS_LOG_LEVEL_WRN
endchoice

endif # ZMS

if NVS

choice NVS_LOG_LEVEL_CHOICE
	default NVS_LOG_LEVEL_WRN
endchoice

endif # NVS

endif # NRF_CLOUD_PGPS

if BUILD_WITH_TFM

choice TFM_PROFILE_TYPE
	default TFM_PROFILE_TYPE_MINIMAL
endchoice

endif # BUILD_WITH_TFM

menu "Zephyr Kernel"
source "Kconfig.zephyr"
endmenu
```

## samples/cellular/lwm2m_carrier/Kconfig
```kconfig
#
# Copyright (c) 2022 Nordic Semiconductor ASA
#
# SPDX-License-Identifier: LicenseRef-Nordic-5-Clause
#

menu "Custom PSK"
config CARRIER_APP_PSK
	string "LwM2M Pre-Shared Key (PSK)"
	default ""
	help
	  Hexadecimal PSK used to connect to the LwM2M server.

endmenu

if BUILD_WITH_TFM

choice TFM_PROFILE_TYPE
	default TFM_PROFILE_TYPE_MINIMAL
endchoice

endif # BUILD_WITH_TFM

menu "Zephyr Kernel"
source "Kconfig.zephyr"
endmenu
```

## samples/cellular/modem_callbacks/sample.yaml
```yaml
sample:
  name: modem callbacks
tests:
  sample.cellular.modem_callbacks:
    sysbuild: true
    build_only: true
    integration_platforms:
      - nrf9151dk/nrf9151/ns
      - nrf9251dk/nrf9251/cpuapp
    platform_allow:
      - nrf9151dk/nrf9151/ns
      - nrf9251dk/nrf9251/cpuapp
    tags:
      - ci_build
      - sysbuild
      - ci_samples_cellular
```

## samples/cellular/modem_trace_backend/Kconfig
```kconfig
#
# Copyright (c) 2022 Nordic Semiconductor
#
# SPDX-License-Identifier: LicenseRef-Nordic-5-Clause
#

menu "Modem trace backend sample"

endmenu

rsource "Kconfig.trace_print_stats"

if BUILD_WITH_TFM

choice TFM_PROFILE_TYPE
	default TFM_PROFILE_TYPE_MINIMAL
endchoice

endif # BUILD_WITH_TFM

menu "Zephyr Kernel"
source "Kconfig.zephyr"
endmenu
```

## samples/cellular/modem_trace_backend/sample.yaml
```yaml
sample:
  name: Modem trace backend
tests:
  sample.cellular.modem_trace_backend:
    sysbuild: true
    build_only: true
    integration_platforms:
      - nrf9151dk/nrf9151/ns
      - nrf9251dk/nrf9251/cpuapp
    platform_allow:
      - nrf9151dk/nrf9151/ns
      - nrf9251dk/nrf9251/cpuapp
    tags:
      - ci_build
      - sysbuild
      - ci_samples_cellular
```

## samples/cellular/modem_trace_flash/Kconfig
```kconfig
#
# Copyright (c) 2022 Nordic Semiconductor
#
# SPDX-License-Identifier: LicenseRef-Nordic-5-Clause
#

menu "Modem trace flash backend sample"

endmenu

module = MODEM_TRACE_FLASH_SAMPLE
module-str = Modem trace flash backend
source "$(ZEPHYR_BASE)/subsys/logging/Kconfig.template.log_config"

if BUILD_WITH_TFM

choice TFM_PROFILE_TYPE
	default TFM_PROFILE_TYPE_MINIMAL
endchoice

endif # BUILD_WITH_TFM

menu "Zephyr Kernel"
source "Kconfig.zephyr"
endmenu
```

## samples/cellular/nidd/Kconfig
```kconfig
#
# Copyright (c) 2022 Nordic Semiconductor ASA
#
# SPDX-License-Identifier: LicenseRef-Nordic-5-Clause
#

menu "NIDD Sample Settings"

config NIDD_APN
	string "APN used for NIDD connection"
	default ""

config NIDD_ALLOC_NEW_CID
	bool "Allocate new context identifier for NIDD connection"

config NIDD_PAYLOAD
	string "Payload for NIDD transmission"
	default "Hello, World!"

endmenu

module = NIDD
module-str = NIDD sample

if BUILD_WITH_TFM

choice TFM_PROFILE_TYPE
	default TFM_PROFILE_TYPE_MINIMAL
endchoice

endif # BUILD_WITH_TFM

menu "Zephyr Kernel"
source "Kconfig.zephyr"
endmenu
```

## samples/cellular/nrf_cloud_coap_device_message/Kconfig
```kconfig
#
# Copyright (c) 2025 Nordic Semiconductor ASA
#
# SPDX-License-Identifier: LicenseRef-Nordic-5-Clause
#

menu "nRF Cloud CoAP Device Message Sample"

module = NRF_CLOUD_COAP_DEVICE_MESSAGE_SAMPLE
module-str = nRF Cloud CoAP Sample
source "${ZEPHYR_BASE}/subsys/logging/Kconfig.template.log_config"

endmenu

if BUILD_WITH_TFM

choice TFM_PROFILE_TYPE
	default TFM_PROFILE_TYPE_MINIMAL
endchoice

endif # BUILD_WITH_TFM

menu "Zephyr Kernel"
source "Kconfig.zephyr"
endmenu
```
