/*
 * Copyright (c) 2026 Nordic Semiconductor ASA
 *
 * SPDX-License-Identifier: LicenseRef-Nordic-5-Clause
 */

/dts-v1/;

#include <nordic/nrf54lm20b_cpuapp.dtsi>
#include "nrf93m1dk_lm20b_nrf54lm20b_cpuapp_common.dtsi"

/ {
	compatible = "nordic,nrf93m1dk_lm20b_nrf54lm20b-cpuapp";
	model = "Nordic nRF93M1 DK nRF54LM20B Application MCU";

	chosen {
		zephyr,code-partition = &slot0_partition;
		zephyr,sram = &cpuapp_sram_app;
	};
};

/* Include default memory partition configuration file */
#include <vendor/nordic/nrf54lm20b_cpuapp_partition.dtsi>
