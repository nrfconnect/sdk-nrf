## boards/nordic/thingy91x/thingy91x_nrf5340_cpuapp_defconfig
```kconfig
# Copyright (c) 2024 Nordic Semiconductor
# SPDX-License-Identifier: LicenseRef-Nordic-5-Clause

# Enable MPU
CONFIG_ARM_MPU=y

# Enable hardware stack protection
CONFIG_HW_STACK_PROTECTION=y

# Enable TrustZone-M
CONFIG_ARM_TRUSTZONE_M=y

# enable GPIO
CONFIG_GPIO=y

# Enable uart driver
CONFIG_SERIAL=y

# enable console
CONFIG_CONSOLE=y
CONFIG_UART_CONSOLE=y

CONFIG_PINCTRL=y

CONFIG_RETENTION=y
CONFIG_RETAINED_MEM=y
CONFIG_RETAINED_MEM_ZEPHYR_RAM=y
CONFIG_RETENTION_BOOT_MODE=y

CONFIG_SECURE_BOOT_DEBUG_RTT=y
```

## boards/nordic/thingy91x/thingy91x_nrf5340_cpunet_defconfig
```kconfig
# Copyright (c) 2024 Nordic Semiconductor
# SPDX-License-Identifier: LicenseRef-Nordic-5-Clause

# Enable MPU
CONFIG_ARM_MPU=y

# Enable hardware stack protection
CONFIG_HW_STACK_PROTECTION=y

# Enable GPIO
CONFIG_GPIO=y
```

## boards/nordic/thingy91x/thingy91x_nrf9151_defconfig
```kconfig
# Copyright (c) 2024 Nordic Semiconductor
# SPDX-License-Identifier: LicenseRef-Nordic-5-Clause

# Enable MPU
CONFIG_ARM_MPU=y

# Enable TrustZone-M
CONFIG_ARM_TRUSTZONE_M=y

# Enable PINCTRL
CONFIG_PINCTRL=y

# Enable GPIO
CONFIG_GPIO=y

# Enable UARTE
CONFIG_SERIAL=y

# Enable console
CONFIG_CONSOLE=y
CONFIG_UART_CONSOLE=y

# Disable entropy driver, as it's not yet implemented for nRF9151
CONFIG_ENTROPY_NRF5_RNG=n
```

## boards/nordic/thingy91x/thingy91x_nrf9151_ns_defconfig
```kconfig
# Copyright (c) 2024 Nordic Semiconductor
# SPDX-License-Identifier: LicenseRef-Nordic-5-Clause

# Enable MPU
CONFIG_ARM_MPU=y

# Enable TrustZone-M
CONFIG_ARM_TRUSTZONE_M=y

# This Board implies building Non-Secure firmware
CONFIG_TRUSTED_EXECUTION_NONSECURE=y

# Enable PINCTRL
CONFIG_PINCTRL=y

# Enable GPIO
CONFIG_GPIO=y

# Enable UARTE
CONFIG_SERIAL=y

# Enable console
CONFIG_CONSOLE=y
CONFIG_UART_CONSOLE=y

# Enable I2C
CONFIG_I2C=y

# Enable SPI
CONFIG_SPI=y

# Enable Flash
CONFIG_FLASH=y
CONFIG_SPI_NOR=y
CONFIG_SPI_NOR_SFDP_DEVICETREE=y
CONFIG_SPI_NOR_FLASH_LAYOUT_PAGE_SIZE=4096
CONFIG_PM_DEVICE_RUNTIME=y

# Enable sensor (for nPM1300 charger)
CONFIG_SENSOR=y

# Disable entropy driver, as it's not yet implemented for nRF9151
CONFIG_ENTROPY_NRF5_RNG=n
```

## boards/sercomm/tpm530mevk/Kconfig.defconfig
```kconfig
# TPM530M EVK TPM530M board configuration

# Copyright (c) 2025 Nordic Semiconductor ASA
# SPDX-License-Identifier: LicenseRef-Nordic-5-Clause

config HW_STACK_PROTECTION
	default ARCH_HAS_STACK_PROTECTION

if BOARD_TPM530MEVK_TPM530M || BOARD_TPM530MEVK_TPM530M_NS

choice TFM_PROFILE_TYPE
	default TFM_PROFILE_TYPE_MINIMAL
endchoice

config BOARD_TPM530MEVK
	select USE_DT_CODE_PARTITION if BOARD_TPM530MEVK_TPM530M_NS

endif # BOARD_TPM530MEVK_TPM530M || BOARD_TPM530MEVK_TPM530M_NS
```

## boards/sercomm/tpm530mevk/Kconfig.tpm530mevk
```kconfig
# TPM530M EVK TPM530M board configuration

# Copyright (c) 2025 Nordic Semiconductor ASA
# SPDX-License-Identifier: LicenseRef-Nordic-5-Clause

config BOARD_TPM530MEVK
	select SOC_TPM530M
```

## boards/sercomm/tpm530mevk/board.yml
```yaml
board:
  name: tpm530mevk
  full_name: TPM530M EVK
  vendor: sercomm
  socs:
  - name: tpm530m
    variants:
    - name: ns
```

## boards/shields/coverage_support/Kconfig.shield
```kconfig
#
# Copyright (c) 2024 Nordic Semiconductor ASA
#
# SPDX-License-Identifier: LicenseRef-Nordic-5-Clause
#
config SHIELD_COVERAGE_SUPPORT
	def_bool $(shields_list_contains,coverage_support)
```

## boards/shields/nrf21540_ek/Kconfig.shield
```kconfig
#
# Copyright (c) 2021 Nordic Semiconductor ASA
#
# SPDX-License-Identifier: LicenseRef-Nordic-5-Clause
#

config SHIELD_NRF21540_EK
	def_bool $(shields_list_contains,nrf21540_ek)
```

## boards/shields/nrf21540ek/Kconfig.defconfig
```kconfig
#
# Copyright (c) 2021 Nordic Semiconductor ASA
#
# SPDX-License-Identifier: LicenseRef-Nordic-5-Clause
#

if SHIELD_NRF21540EK

if BT_CTLR

config BT_CTLR_TX_PWR_ANTENNA
	default MPSL_FEM_NRF21540_TX_GAIN_DB

endif # BT_CTLR

endif # SHIELD_NRF21540EK
```

## boards/shields/nrf21540ek/Kconfig.shield
```kconfig
#
# Copyright (c) 2021 Nordic Semiconductor ASA
#
# SPDX-License-Identifier: LicenseRef-Nordic-5-Clause
#

config SHIELD_NRF21540EK
	def_bool $(shields_list_contains,nrf21540ek)
```
