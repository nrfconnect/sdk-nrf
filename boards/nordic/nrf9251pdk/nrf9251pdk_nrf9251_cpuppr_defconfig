## boards/nordic/nrf9251pdk/nrf9251pdk_nrf9251_cpuppr_defconfig
```kconfig
# Copyright (c) 2026 Nordic Semiconductor ASA
# SPDX-License-Identifier: Apache-2.0

CONFIG_SERIAL=y

# Enable console
CONFIG_CONSOLE=y
CONFIG_UART_CONSOLE=y

CONFIG_USE_DT_CODE_PARTITION=y

# Execute from RAM
CONFIG_XIP=n
```

## boards/nordic/thingy91/Kconfig
```kconfig
# Thingy:91 nRF52840 board configuration
#
# Copyright (c) 2019 Nordic Semiconductor ASA
#
# SPDX-License-Identifier: LicenseRef-Nordic-5-Clause

if BOARD_THINGY91_NRF52840

config BOARD_ENABLE_DCDC
	bool "Enable DCDC mode"
	select SOC_DCDC_NRF52X
	default y

endif # BOARD_THINGY91_NRF52840

if BOARD_THINGY91_NRF9160 || BOARD_THINGY91_NRF9160_NS

config BOARD_INIT_PRIORITY
	int "Initialization priority for board configuration"
	default 80
	help
	  The Thingy:91 board contains an ADP5360 PMIC that needs to be configured to
	  set up the power domains on the board correctly. This happens during sys_init,
	  and the PMIC setup must happen before the sensors are initialized in order
	  to power them up in time.

if BOARD_THINGY91_NRF9160_NS

choice
	prompt "Pre-defined Thingy:91 partition layout"
	default THINGY91_STATIC_PARTITIONS_SECURE_BOOT if SECURE_BOOT
	default THINGY91_STATIC_PARTITIONS_LWM2M_CARRIER if LWM2M_CARRIER
	default THINGY91_STATIC_PARTITIONS_FACTORY

config THINGY91_STATIC_PARTITIONS_FACTORY
	bool "Factory Thingy:91 partition layout"
	help
	   The default Thingy:91 partition layout used in the factory firmware. This ensures
	   firmware updates are compatible with Thingy:91 when flashing firmware over USB or over
	   the air.

config THINGY91_STATIC_PARTITIONS_SECURE_BOOT
	bool "Secure boot Thingy:91 partition layout [EXPERIMENTAL]"
	depends on SECURE_BOOT
	select EXPERIMENTAL
	help
	   Similar to the factory partition layout, but also has space for the Immutable Bootloader
	   and two MCUboot slots. A debugger is needed to flash Thingy:91 the first time.
	   This layout is still under development and should not be used in production.

config THINGY91_STATIC_PARTITIONS_LWM2M_CARRIER
	bool "LWM2M Carrier  partition layout"
	depends on LWM2M_CARRIER
	help
	  Use a partition layout including a storage partition needed for the lwm2m carrier library.

config THINGY91_NO_PREDEFINED_LAYOUT
	bool "None [EXPERIMENTAL]"
	select EXPERIMENTAL
	help
	   Disable pre-defined static partition layout. This allows the application to use a dynamic
	   layout or define a custom static partition layout for the application. A debugger is
	   needed to flash Thingy:91 with a different partition layout.

endchoice
endif # if BOARD_THINGY91_NRF9160_NS

endif # BOARD_THINGY91_NRF9160 || BOARD_THINGY91_NRF9160_NS

module=BOARD
module-dep=LOG
module-str=Log level for board
source "${ZEPHYR_BASE}/subsys/logging/Kconfig.template.log_config"
```

## boards/nordic/thingy91/Kconfig.defconfig
```kconfig
# nRF52840 THINGY91 board configuration
#
# Copyright (c) 2019 Nordic Semiconductor ASA
#
# SPDX-License-Identifier: LicenseRef-Nordic-5-Clause

if BOARD_THINGY91

config HW_STACK_PROTECTION
	default ARCH_HAS_STACK_PROTECTION

endif # BOARD_THINGY91

if BOARD_THINGY91_NRF9160 || BOARD_THINGY91_NRF9160_NS

# Enable Zephyr power regulator ADP536x
config REGULATOR
	default y
	depends on !IS_BOOTLOADER_IMG

# By default, if we build for a Non-Secure version of the board,
# enable building with TF-M as the Secure Execution Environment.
config BUILD_WITH_TFM
	default y if BOARD_THINGY91_NRF9160_NS

if BUILD_WITH_TFM

# By default, if we build with TF-M, instruct build system to
# flash the combined TF-M (Secure) & Zephyr (Non Secure) image
config TFM_FLASH_MERGED_BINARY
	bool
	default y

choice TFM_PROFILE_TYPE
	default TFM_PROFILE_TYPE_MINIMAL
endchoice

endif # BUILD_WITH_TFM

config BT_HCI_VS
	default y if BT

endif # BOARD_THINGY91_NRF9160 || BOARD_THINGY91_NRF9160_NS
```

## boards/nordic/thingy91/Kconfig.thingy91
```kconfig
# Copyright (c) 2019 Nordic Semiconductor ASA
# SPDX-License-Identifier: LicenseRef-Nordic-5-Clause

config BOARD_THINGY91
	select SOC_NRF52840_QIAA if BOARD_THINGY91_NRF52840
	select SOC_NRF9160_SICA if BOARD_THINGY91_NRF9160 || BOARD_THINGY91_NRF9160_NS
```

## boards/nordic/thingy91/board.yml
```yaml
board:
  name: thingy91
  full_name: "Thingy:91"
  vendor: nordic
  socs:
    - name: nrf52840
    - name: nrf9160
      variants:
        - name: ns
```

## boards/nordic/thingy91/dts/bindings/nordic,thingy91-nrf52840-reset.yaml
```yaml
# Copyright (c) 2021 Nordic Semiconductor ASA
# SPDX-License-Identifier: LicenseRef-Nordic-5-Clause

description: GPIO used to reset nRF52840 on Thingy:91

compatible: "nordic,thingy91-nrf52840-reset"

include: base.yaml

properties:
  status:
    required: true

  gpios:
    type: phandle-array
    required: true
    description: |
      GPIO to use as nRF52840 reset line: output in nRF9160, input in nRF52840.
```

## boards/nordic/thingy91/thingy91_nrf52840_defconfig
```kconfig
# Enable MPU
CONFIG_ARM_MPU=y

# Enable UART driver
CONFIG_SERIAL=y

# Enable console
CONFIG_CONSOLE=y

# Enable USB
CONFIG_USB_DEVICE_STACK=y

CONFIG_BOOTLOADER_MCUBOOT=y

# BT
CONFIG_BT_BUF_CMD_TX_COUNT=3
```

## boards/nordic/thingy91/thingy91_nrf9160_defconfig
```kconfig
# Enable MPU
CONFIG_ARM_MPU=y

# Enable TrustZone-M
CONFIG_ARM_TRUSTZONE_M=y

# Enable PINCTRL
CONFIG_PINCTRL=y

# Enable GPIO
CONFIG_GPIO=y

# Enable UARTE
CONFIG_SERIAL=y

# Enable console
CONFIG_CONSOLE=y
CONFIG_UART_CONSOLE=y

# Disable entropy driver, as it's not yet implemented for nRF9160
CONFIG_ENTROPY_NRF5_RNG=n
```

## boards/nordic/thingy91x/Kconfig.defconfig
```kconfig
# Thingy:91 X board configuration
#
# Copyright (c) 2024 Nordic Semiconductor
# SPDX-License-Identifier: LicenseRef-Nordic-5-Clause

rsource "Kconfig.defconfig.nrf9151"
rsource "Kconfig.defconfig.nrf5340"

if !IS_BOOTLOADER_IMG

# For on-board regulators
config REGULATOR
	default y

# nPM6001 must be initialized after it is powered from nPM1300 (REGULATOR_NPM1300_INIT_PRIORITY)
config MFD_NPM6001_INIT_PRIORITY
	default 87
config REGULATOR_NPM6001_INIT_PRIORITY
	default 88
config WIFI_INIT_PRIORITY
	default 89

# GPIO hogs must be initialized after nPM1300 (GPIO_NPM1300_INIT_PRIORITY)
config GPIO_HOGS_INIT_PRIORITY
	default 86

endif # !IS_BOOTLOADER_IMG
```

## boards/nordic/thingy91x/Kconfig.defconfig.nrf5340
```kconfig
# Thingy:91 X nRF5340 board configuration

# Copyright (c) 2024 Nordic Semiconductor
# SPDX-License-Identifier: LicenseRef-Nordic-5-Clause

if  BOARD_THINGY91X_NRF5340_CPUAPP || BOARD_THINGY91X_NRF5340_CPUAPP_NS

# By default, if we build for a Non-Secure version of the board,
# enable building with TF-M as the Secure Execution Environment.
config BUILD_WITH_TFM
	default y if BOARD_THINGY91X_NRF5340_CPUAPP_NS

if BUILD_WITH_TFM

# By default, if we build with TF-M, instruct build system to
# flash the combined TF-M (Secure) & Zephyr (Non Secure) image
config TFM_FLASH_MERGED_BINARY
	bool
	default y

endif # BUILD_WITH_TFM

# Code Partition:
#
# For the secure version of the board the firmware is linked at the beginning
# of the flash, or into the code-partition defined in DT if it is intended to
# be loaded by MCUboot. If the secure firmware is to be combined with a non-
# secure image (TRUSTED_EXECUTION_SECURE=y), the secure FW image shall always
# be restricted to the size of its code partition.
#
# For the non-secure version of the board, the firmware
# must be linked into the code-partition (non-secure) defined in DT, regardless.
# Apply this configuration below by setting the Kconfig symbols used by
# the linker according to the information extracted from DT partitions.

# SRAM Partition:
#
# If the secure firmware is to be combined with a non-secure image
# (TRUSTED_EXECUTION_SECURE=y), the secure FW image SRAM shall always
# be restricted to the secure image SRAM partition (sram-secure-partition).
# Otherwise (if TRUSTED_EXECUTION_SECURE is not set) the whole zephyr,sram
# may be used by the image.
#
# For the non-secure version of the board, the firmware image SRAM is
# always restricted to the allocated non-secure SRAM partition.
#
# Workaround for not being able to have commas in macro arguments
DT_CHOSEN_Z_CODE_PARTITION := zephyr,code-partition
DT_CHOSEN_Z_SRAM_PARTITION := zephyr,sram-secure-partition

if BOARD_THINGY91X_NRF5340_CPUAPP && TRUSTED_EXECUTION_SECURE

config FLASH_LOAD_SIZE
	default $(dt_chosen_reg_size_hex,$(DT_CHOSEN_Z_CODE_PARTITION))

config SRAM_SIZE
	default $(dt_chosen_reg_size_int,$(DT_CHOSEN_Z_SRAM_PARTITION),0,K)

endif # BOARD_THINGY91X_NRF5340_CPUAPP && TRUSTED_EXECUTION_SECURE

config FLASH_LOAD_OFFSET
	default $(dt_chosen_reg_addr_hex,$(DT_CHOSEN_Z_CODE_PARTITION))

config FLASH_LOAD_SIZE
	default $(dt_chosen_reg_size_hex,$(DT_CHOSEN_Z_CODE_PARTITION))

choice BT_HCI_BUS_TYPE
	default BT_HCI_IPC if BT
endchoice

config HEAP_MEM_POOL_SIZE
	default 4096 if BT_HCI_IPC

endif # BOARD_THINGY91X_NRF5340_CPUAPP || BOARD_THINGY91X_NRF5340_CPUAPP_NS

config MBOX_NRFX_IPC
	default MBOX

if BOARD_THINGY91X_NRF5340_CPUNET

config BT_CTLR
	default y if BT

endif # BOARD_THINGY91X_NRF5340_CPUNET

config USE_SEGGER_RTT
	default y if BOARD_THINGY91X_NRF5340_CPUAPP || BOARD_THINGY91X_NRF5340_CPUAPP_NS || BOARD_THINGY91X_NRF5340_CPUNET

config RTT_CONSOLE
	default y if BOARD_THINGY91X_NRF5340_CPUAPP || BOARD_THINGY91X_NRF5340_CPUAPP_NS || BOARD_THINGY91X_NRF5340_CPUNET

if !IS_BOOTLOADER_IMG

config SECURE_BOOT
	default y if BOARD_THINGY91X_NRF5340_CPUAPP || BOARD_THINGY91X_NRF5340_CPUAPP_NS || BOARD_THINGY91X_NRF5340_CPUNET

config BOOTLOADER_MCUBOOT
	default y if BOARD_THINGY91X_NRF5340_CPUAPP || BOARD_THINGY91X_NRF5340_CPUAPP_NS

config ADD_MCUBOOT_MEDIATE_SIM_FLASH_DTS
	default y if BOARD_THINGY91X_NRF5340_CPUAPP || BOARD_THINGY91X_NRF5340_CPUAPP_NS

config NRF53_UPGRADE_NETWORK_CORE
	default y if BOARD_THINGY91X_NRF5340_CPUAPP || BOARD_THINGY91X_NRF5340_CPUAPP_NS

config UPDATEABLE_IMAGE_NUMBER
	default 2 if BOARD_THINGY91X_NRF5340_CPUAPP || BOARD_THINGY91X_NRF5340_CPUAPP_NS

config SB_SIGNING_KEY_FILE
	default "$(ZEPHYR_NRF_MODULE_DIR)/boards/nordic/thingy91x/nsib_signing_key_nrf5340.pem" if BOARD_THINGY91X_NRF5340_CPUAPP || BOARD_THINGY91X_NRF5340_CPUAPP_NS || BOARD_THINGY91X_NRF5340_CPUNET

endif # !IS_BOOTLOADER_IMG
```

## boards/nordic/thingy91x/Kconfig.defconfig.nrf9151
```kconfig
# Thingy:91 X nRF9151 board configuration
#
# Copyright (c) 2024 Nordic Semiconductor
# SPDX-License-Identifier: LicenseRef-Nordic-5-Clause

if BOARD_THINGY91X_NRF9151 || BOARD_THINGY91X_NRF9151_NS

# By default, if we build for a Non-Secure version of the board,
# enable building with TF-M as the Secure Execution Environment.
config BUILD_WITH_TFM
	default y if BOARD_THINGY91X_NRF9151_NS

if BUILD_WITH_TFM

# By default, if we build with TF-M, instruct build system to
# flash the combined TF-M (Secure) & Zephyr (Non Secure) image
config TFM_FLASH_MERGED_BINARY
	bool
	default y

config PM_PARTITION_SIZE_TFM_SRAM
	hex
	default 0xa000

endif # BUILD_WITH_TFM

# For the secure version of the board the firmware is linked at the beginning
# of the flash, or into the code-partition defined in DT if it is intended to
# be loaded by MCUboot. If the secure firmware is to be combined with a non-
# secure image (TRUSTED_EXECUTION_SECURE=y), the secure FW image shall always
# be restricted to the size of its code partition.
# For the non-secure version of the board, the firmware
# must be linked into the code-partition (non-secure) defined in DT, regardless.
# Apply this configuration below by setting the Kconfig symbols used by
# the linker according to the information extracted from DT partitions.

if BOARD_THINGY91X && TRUSTED_EXECUTION_SECURE

config FLASH_LOAD_SIZE
	default $(dt_chosen_reg_size_hex,$(DT_CHOSEN_Z_CODE_PARTITION))

endif # BOARD_THINGY91X && TRUSTED_EXECUTION_SECURE

if BOARD_THINGY91X_NRF9151_NS

config FLASH_LOAD_OFFSET
	default $(dt_chosen_reg_addr_hex,$(DT_CHOSEN_Z_CODE_PARTITION))

config FLASH_LOAD_SIZE
	default $(dt_chosen_reg_size_hex,$(DT_CHOSEN_Z_CODE_PARTITION))

endif # BOARD_THINGY91X_NRF9151_NS

config BT_HCI_VS
	default y if BT

config HW_STACK_PROTECTION
	default ARCH_HAS_STACK_PROTECTION

# check if we are building for any bootloader
if !IS_BOOTLOADER_IMG

config SECURE_BOOT
	default y

config BOOTLOADER_MCUBOOT
	default y

# Do not use these keys for own custom boards!
# These are meant as examples and therefore public.
# The documentation of the nRF Secure Immutable Bootloader and MCUBoot detail on how
# to set up your own keys.

config SB_SIGNING_KEY_FILE
	default "$(ZEPHYR_NRF_MODULE_DIR)/boards/nordic/thingy91x/nsib_signing_key.pem"

config I2C
	default y

config MODEM_ANTENNA
	depends on NRF_MODEM_LIB
	default y

if MODEM_ANTENNA

config MODEM_ANTENNA_AT_MIPIRFFEDEV
	default "AT%XMIPIRFFEDEV=1,4,71,198,248"
config MODEM_ANTENNA_AT_MIPIRFFECTRL_INIT
	default "AT%XMIPIRFFECTRL=1,0,1,28,248"
config MODEM_ANTENNA_AT_MIPIRFFECTRL_ON
	default "AT%XMIPIRFFECTRL=1,1,1,28,56,13,0,0,8,8,715,4,4,770,12,12,829,11,11,863,130,130,892,1,1,939,129,129,978,26,26,1042,8,8,1118,4,4,1270,12,12,1386,14,14,1523,130,130,2200"
config MODEM_ANTENNA_AT_MIPIRFFECTRL_OFF
	default "AT%XMIPIRFFECTRL=1,2,1,28,184"
config MODEM_ANTENNA_AT_MIPIRFFECTRL_PWROFF
	default "AT%XMIPIRFFECTRL=1,3,1,28,184"
config MODEM_ANTENNA_AT_COEX0
	default "AT\%XCOEX0=1,1,1565,1586"

endif # MODEM_ANTENNA

endif # !IS_BOOTLOADER_IMG

# disable interfaces that should not be included in bootloaders
if IS_BOOTLOADER_IMG

config I2C
	default n

config GPIO_HOGS
	default n

config GPIO_NPM1300
	default n

endif # IS_BOOTLOADER_IMG

endif # BOARD_THINGY91X_NRF9151 || BOARD_THINGY91X_NRF9151_NS
```

## boards/nordic/thingy91x/Kconfig.sysbuild
```kconfig
# Copyright (c) 2024 Nordic Semiconductor ASA
# SPDX-License-Identifier: LicenseRef-Nordic-5-Clause

choice BOOTLOADER
	default BOOTLOADER_MCUBOOT
endchoice

if BOARD_THINGY91X_NRF5340_CPUAPP

config SECURE_BOOT_NETCORE
	default y

config SECURE_BOOT_APPCORE
	default y

config NETCORE_APP_UPDATE
	default y

config NRF_DEFAULT_EMPTY
	default y

endif # BOARD_THINGY91X_NRF5340_CPUAPP

if BOARD_THINGY91X_NRF5340_CPUAPP || BOARD_THINGY91X_NRF5340_CPUNET

# Do not use these keys for own custom boards!
# These are meant as examples and therefore public.
# The documentation of the nRF Secure Immutable Bootloader and MCUBoot detail on how
# to set up your own keys.

config SECURE_BOOT_SIGNING_KEY_FILE
	default "$(ZEPHYR_NRF_MODULE_DIR)/boards/nordic/thingy91x/nsib_signing_key_nrf5340.pem"

endif # BOARD_THINGY91X_NRF5340_CPUAPP || BOARD_THINGY91X_NRF5340_CPUNET

if BOARD_THINGY91X_NRF9151 || BOARD_THINGY91X_NRF9151_NS

config SECURE_BOOT_APPCORE
	default y

config PM_EXTERNAL_FLASH_MCUBOOT_SECONDARY
	default y if BOOTLOADER_MCUBOOT

config PM_OVERRIDE_EXTERNAL_DRIVER_CHECK
	default y if BOOTLOADER_MCUBOOT

config MCUBOOT_USE_ALL_AVAILABLE_RAM
	default y if BOARD_THINGY91X_NRF9151_NS && BOOTLOADER_MCUBOOT

config SECURE_BOOT_SIGNING_KEY_FILE
	default "$(ZEPHYR_NRF_MODULE_DIR)/boards/nordic/thingy91x/nsib_signing_key.pem"

endif # BOARD_THINGY91X_NRF9151 || BOARD_THINGY91X_NRF9151_NS
```

## boards/nordic/thingy91x/Kconfig.thingy91x
```kconfig
# Copyright (c) 2024 Nordic Semiconductor
# SPDX-License-Identifier: LicenseRef-Nordic-5-Clause

config BOARD_THINGY91X
	select SOC_NRF9151_LACA if BOARD_THINGY91X_NRF9151 || BOARD_THINGY91X_NRF9151_NS
	select SOC_NRF5340_CPUNET_QKAA if BOARD_THINGY91X_NRF5340_CPUNET
	select SOC_NRF5340_CPUAPP_QKAA if BOARD_THINGY91X_NRF5340_CPUAPP || BOARD_THINGY91X_NRF5340_CPUAPP_NS
```

## boards/nordic/thingy91x/board.yml
```yaml
board:
  name: thingy91x
  full_name: "Thingy:91 X"
  vendor: nordic
  socs:
    - name: nrf9151
      variants:
        - name: ns
    - name: nrf5340
      variants:
        - name: ns
          cpucluster: 'cpuapp'
```
