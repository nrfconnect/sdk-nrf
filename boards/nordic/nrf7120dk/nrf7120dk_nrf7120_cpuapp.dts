/*
 * Copyright (c) 2025 Nordic Semiconductor ASA
 *
 * SPDX-License-Identifier: LicenseRef-Nordic-5-Clause
 */

/dts-v1/;

#include "nrf7120_cpuapp_common.dtsi"

/ {
	compatible = "nordic,nrf7120dk_nrf7120-cpuapp";
	model = "Nordic nRF7120 DK nRF7120 Application MCU";

	chosen {
		zephyr,sram = &cpuapp_sram;
	};
};
