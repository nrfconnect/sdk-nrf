/*
 * Copyright (c) 2026 Nordic Semiconductor ASA
 *
 * SPDX-License-Identifier: LicenseRef-Nordic-5-Clause
 */

#include "nrf9251dk_nrf9251-memory_map_0_1_0.dtsi"

boot_partition: &cpuapp_boot_partition {
	label = "mcuboot";
};

slot0_partition: &cpuapp_slot0_partition {
	label = "image-0";
};

slot1_partition: &cpuapp_slot1_partition {
	label = "image-1";
};
