## boards/nordic/nrf52kbd/Kconfig.nrf52kbd
```kconfig
# Copyright (c) 2019 Nordic Semiconductor
# SPDX-License-Identifier: LicenseRef-Nordic-5-Clause

config BOARD_NRF52KBD
	select SOC_NRF52832_QFAA
```

## boards/nordic/nrf52kbd/board.yml
```yaml
board:
  name: nrf52kbd
  full_name: nRF52 Keyboard
  vendor: nordic
  socs:
    - name: nrf52832
```

## boards/nordic/nrf5340dk/compress/Kconfig.nrf5340dk
```kconfig
# Copyright (c) 2025 Nordic Semiconductor ASA
# SPDX-License-Identifier: LicenseRef-Nordic-5-Clause

config BOARD_NRF5340DK
	select SOC_NRF5340_CPUAPP_QKAA if BOARD_NRF5340DK_NRF5340_CPUAPP_COMPRESS
```

## boards/nordic/nrf5340dk/compress/board.yml
```yaml
board:
  extend: nrf5340dk
  variants:
    - name: compress
      qualifier: nrf5340/cpuapp
    - name: compress
      qualifier: nrf5340/cpunet
runners:
  run_once:
    '--recover':
      - runners:
          - nrfjprog
          - nrfutil
        run: first
        groups:
          - boards:
              - nrf5340dk/nrf5340/cpunet
              - nrf5340dk/nrf5340/cpuapp/compress
    '--erase':
      - runners:
          - nrfjprog
          - jlink
          - nrfutil
        run: first
        groups:
          - boards:
              - nrf5340dk/nrf5340/cpunet
          - boards:
              - nrf5340dk/nrf5340/cpuapp/compress
    '--reset':
      - runners:
          - nrfjprog
          - jlink
          - nrfutil
        run: last
        groups:
          - boards:
              - nrf5340dk/nrf5340/cpunet
          - boards:
              - nrf5340dk/nrf5340/cpuapp/compress
```

## boards/nordic/nrf54h20dk/Kconfig.defconfig
```kconfig
# Copyright (c) 2025 Nordic Semiconductor
# SPDX-License-Identifier: LicenseRef-Nordic-5-Clause

if BOARD_NRF54H20DK_NRF54H20_CPUAPP_IRON_B0_MCUBOOT

config ROM_START_OFFSET
	default 0x800 if BOOTLOADER_MCUBOOT || (MCUBOOT && SECURE_BOOT)

endif # BOARD_NRF54H20DK_NRF54H20_CPUAPP_IRON_B0_MCUBOOT
```

## boards/nordic/nrf54h20dk/Kconfig.nrf54h20dk
```kconfig
# Copyright (c) 2025 Nordic Semiconductor
# SPDX-License-Identifier: LicenseRef-Nordic-5-Clause

config BOARD_NRF54H20DK
	select SOC_NRF54H20_CPUAPP if (BOARD_NRF54H20DK_NRF54H20_CPUAPP_IRON_B0_MCUBOOT)
	select SOC_NRF54H20_IRON if (BOARD_NRF54H20DK_NRF54H20_CPUAPP_IRON_B0_MCUBOOT)
```

## boards/nordic/nrf54h20dk/Kconfig.sysbuild
```kconfig
# Copyright (c) 2025 Nordic Semiconductor
# SPDX-License-Identifier: LicenseRef-Nordic-5-Clause

config SECURE_BOOT_APPCORE
	default y if BOARD_NRF54H20DK_NRF54H20_CPUAPP_IRON_B0_MCUBOOT

choice BOOTLOADER
	default BOOTLOADER_MCUBOOT if BOARD_NRF54H20DK_NRF54H20_CPUAPP_IRON_B0_MCUBOOT

endchoice
```

## boards/nordic/nrf54h20dk/board.yml
```yaml
board:
  extend: nrf54h20dk
  variants:
  - name: b0/mcuboot
    qualifier: nrf54h20/cpuapp/iron
```

## boards/nordic/nrf54l15dk/Kconfig.nrf54l15dk
```kconfig
# Copyright (c) 2025 Nordic Semiconductor ASA
# SPDX-License-Identifier: LicenseRef-Nordic-5-Clause

config BOARD_NRF54L15DK
	select SOC_NRF54L15_CPUAPP if BOARD_NRF54L15DK_NRF54L15_CPUAPP_MATTER
```

## boards/nordic/nrf54l15dk/board.yml
```yaml
board:
  extend: nrf54l15dk
  variants:
    - name: matter
      qualifier: nrf54l15/cpuapp
runners:
  run_once:
    '--recover':
      - runners:
          - nrfjprog
          - nrfutil
        run: first
        groups:
          - boards:
              - nrf54l15dk/nrf54l15/cpuapp/matter
              - nrf54l15dk/nrf54l15/cpuflpr
    '--erase':
      - runners:
          - nrfjprog
          - jlink
          - nrfutil
        run: first
        groups:
          - boards:
              - nrf54l15dk/nrf54l15/cpuapp/matter
              - nrf54l15dk/nrf54l15/cpuflpr
    '--reset':
      - runners:
          - nrfjprog
          - jlink
          - nrfutil
        run: last
        groups:
          - boards:
              - nrf54l15dk/nrf54l15/cpuapp/matter
              - nrf54l15dk/nrf54l15/cpuflpr
```

## boards/nordic/nrf54l15dk/compress/board.yml
```yaml
board:
  extend: nrf54l15dk
  variants:
    - name: compress
      qualifier: nrf54l15/cpuapp
runners:
  run_once:
    '--recover':
      - runners:
          - nrfjprog
          - nrfutil
        run: first
        groups:
          - boards:
              - nrf54l15dk/nrf54l15/cpuapp/compress
              - nrf54l15dk/nrf54l15/cpuflpr
    '--erase':
      - runners:
          - nrfjprog
          - jlink
          - nrfutil
        run: first
        groups:
          - boards:
              - nrf54l15dk/nrf54l15/cpuapp/compress
              - nrf54l15dk/nrf54l15/cpuflpr
    '--reset':
      - runners:
          - nrfjprog
          - jlink
          - nrfutil
        run: last
        groups:
          - boards:
              - nrf54l15dk/nrf54l15/cpuapp/compress
              - nrf54l15dk/nrf54l15/cpuflpr
```

## boards/nordic/nrf54lc10dk/Kconfig.nrf54lc10dk
```kconfig
# Copyright (c) 2026 Nordic Semiconductor ASA
# SPDX-License-Identifier: LicenseRef-Nordic-5-Clause

config BOARD_NRF54LC10DK
	select SOC_NRF54LC10A_CPUAPP if BOARD_NRF54LC10DK_NRF54LC10A_CPUAPP || BOARD_NRF54LC10DK_NRF54LC10A_CPUAPP_NS
	select SOC_NRF54LC10A_CPUFLPR if BOARD_NRF54LC10DK_NRF54LC10A_CPUFLPR
```

## boards/nordic/nrf54lm20apdk/Kconfig.defconfig
```kconfig
# Copyright (c) 2024 Nordic Semiconductor ASA
# SPDX-License-Identifier: LicenseRef-Nordic-5-Clause

if BOARD_NRF54LM20APDK_NRF54LM20A_CPUAPP

config ROM_START_OFFSET
	default 0x800 if BOOTLOADER_MCUBOOT

config SOC_NRF54LX_SKIP_GLITCHDETECTOR_DISABLE
	default y

endif # BOARD_NRF54LM20APDK_NRF54LM20A_CPUAPP
```

## boards/nordic/nrf54lm20apdk/Kconfig.nrf54lm20apdk
```kconfig
# Copyright (c) 2024 Nordic Semiconductor ASA
# SPDX-License-Identifier: LicenseRef-Nordic-5-Clause

config BOARD_NRF54LM20APDK
	select SOC_NRF54LM20A_ENGA_CPUAPP if BOARD_NRF54LM20APDK_NRF54LM20A_CPUAPP
```

## boards/nordic/nrf54lm20apdk/board.yml
```yaml
board:
  name: nrf54lm20apdk
  full_name: nRF54LM20A PDK
  vendor: nordic
  socs:
  - name: nrf54lm20a
    variants:
    - name: xip
      cpucluster: cpuflpr
  revision:
    format: custom
    default: "0.0.0"
    revisions:
    - name: "0.0.0"
    - name: "0.2.0"
    - name: "0.2.0.csp"
runners:
  run_once:
    '--recover':
    - runners:
      - nrfjprog
      - nrfutil
      run: first
      groups:
      - boards:
        - nrf54lm20apdk/nrf54lm20a/cpuapp
        - nrf54lm20apdk/nrf54lm20a/cpuflpr
        - nrf54lm20apdk/nrf54lm20a/cpuflpr/xip
    '--erase':
    - runners:
      - nrfjprog
      - jlink
      - nrfutil
      run: first
      groups:
      - boards:
        - nrf54lm20apdk/nrf54lm20a/cpuapp
        - nrf54lm20apdk/nrf54lm20a/cpuflpr
        - nrf54lm20apdk/nrf54lm20a/cpuflpr/xip
    '--reset':
    - runners:
      - nrfjprog
      - jlink
      - nrfutil
      run: last
      groups:
      - boards:
        - nrf54lm20apdk/nrf54lm20a/cpuapp
        - nrf54lm20apdk/nrf54lm20a/cpuflpr
        - nrf54lm20apdk/nrf54lm20a/cpuflpr/xip
```

## boards/nordic/nrf54lm20dk/Kconfig.nrf54lm20dk
```kconfig
# Copyright (c) 2025 Nordic Semiconductor ASA
# SPDX-License-Identifier: LicenseRef-Nordic-5-Clause

config BOARD_NRF54LM20DK
	select SOC_NRF54LM20A_ENGA_CPUAPP if BOARD_NRF54LM20DK_NRF54LM20A_CPUAPP_MATTER
```

## boards/nordic/nrf54lm20dk/compress/board.yml
```yaml
board:
  extend: nrf54lm20dk
  variants:
    - name: compress
      qualifier: nrf54lm20a/cpuapp
runners:
  run_once:
    '--recover':
      - runners:
          - nrfjprog
          - nrfutil
        run: first
        groups:
          - boards:
              - nrf54lm20dk/nrf54lm20a/cpuapp/compress
              - nrf54lm20dk/nrf54lm20a/cpuflpr
    '--erase':
      - runners:
          - nrfjprog
          - jlink
          - nrfutil
        run: first
        groups:
          - boards:
              - nrf54lm20dk/nrf54lm20a/cpuapp/compress
              - nrf54lm20dk/nrf54lm20a/cpuflpr
    '--reset':
      - runners:
          - nrfjprog
          - jlink
          - nrfutil
        run: last
        groups:
          - boards:
              - nrf54lm20dk/nrf54lm20a/cpuapp/compress
              - nrf54lm20dk/nrf54lm20a/cpuflpr
```

## boards/nordic/nrf54lm20dongle/Kconfig
```kconfig
# Copyright (c) 2026 Nordic Semiconductor ASA
# SPDX-License-Identifier: LicenseRef-Nordic-5-Clause

config BOARD_NRF54LM20DONGLE
	select EXPERIMENTAL

if BOARD_NRF54LM20DONGLE_NRF54LM20B_CPUAPP || BOARD_NRF54LM20DONGLE_NRF54LM20B_CPUAPP_NS

config NRF54LM20DONGLE_MCUMGR_RESET
	bool "Reset using MCUmgr command over USB CDC ACM"
	default y
	imply CDC_ACM_SERIAL_MULTIPLE_INSTANCES if CDC_ACM_SERIAL_INITIALIZE_AT_BOOT
	select BASE64
	select CRC
	select MCUMGR
	select MCUMGR_GRP_OS
	select MCUMGR_GRP_OS_RESET_BOOT_MODE
	select MCUMGR_TRANSPORT_UART
	select NET_BUF
	select RETAINED_MEM
	select RETENTION
	select RETENTION_BOOT_MODE
	select ZCBOR
	help
	  Enables the support for MCUmgr reset command sent over a dedicated
	  USB CDC ACM instance with label "nRF54LM20 Dongle MCUmgr".
	  When the reset command is sent with the boot mode 1, the device is
	  reset to the bootloader that can accept a firmware update.

endif # BOARD_NRF54LM20DONGLE_NRF54LM20B_CPUAPP || BOARD_NRF54LM20DONGLE_NRF54LM20B_CPUAPP_NS
```

## boards/nordic/nrf54lm20dongle/Kconfig.defconfig
```kconfig
# Copyright (c) 2026 Nordic Semiconductor ASA
# SPDX-License-Identifier: LicenseRef-Nordic-5-Clause

if BOARD_NRF54LM20DONGLE_NRF54LM20B_CPUAPP

config HW_STACK_PROTECTION
	default ARCH_HAS_STACK_PROTECTION

endif # BOARD_NRF54LM20DONGLE_NRF54LM20B_CPUAPP

if BOARD_NRF54LM20DONGLE_NRF54LM20B_CPUAPP_NS

# By default, if we build for a Non-Secure version of the board,
# enable building with TF-M as the Secure Execution Environment.
config BUILD_WITH_TFM
	default y

endif # BOARD_NRF54LM20DONGLE_NRF54LM20B_CPUAPP_NS

if BOARD_NRF54LM20DONGLE_NRF54LM20B_CPUAPP || BOARD_NRF54LM20DONGLE_NRF54LM20B_CPUAPP_NS

source "boards/common/usb/Kconfig.cdc_acm_serial.defconfig"

endif # (BOARD_NRF54LM20DONGLE_NRF54LM20B_CPUAPP || BOARD_NRF54LM20DONGLE_NRF54LM20B_CPUAPP_NS
```

## boards/nordic/nrf54lm20dongle/Kconfig.nrf54lm20dongle
```kconfig
# Copyright (c) 2026 Nordic Semiconductor ASA
# SPDX-License-Identifier: LicenseRef-Nordic-5-Clause

config BOARD_NRF54LM20DONGLE
	select SOC_NRF54LM20B_CPUAPP if BOARD_NRF54LM20DONGLE_NRF54LM20B_CPUAPP || BOARD_NRF54LM20DONGLE_NRF54LM20B_CPUAPP_NS
	select SOC_NRF54LM20B_CPUFLPR if BOARD_NRF54LM20DONGLE_NRF54LM20B_CPUFLPR
```

## boards/nordic/nrf54lm20dongle/Kconfig.sysbuild
```kconfig
# Copyright (c) 2026 Nordic Semiconductor ASA
#
# SPDX-License-Identifier: LicenseRef-Nordic-5-Clause

if BOARD_NRF54LM20DONGLE_NRF54LM20B_CPUAPP

choice BOOTLOADER
	default BOOTLOADER_MCUBOOT
endchoice

choice MCUBOOT_MODE
	default MCUBOOT_MODE_FIRMWARE_UPDATER
endchoice

choice FIRMWARE_LOADER
	default FIRMWARE_LOADER_IMAGE_USB_MCUMGR
endchoice

configdefault MCUBOOT_SIGNATURE_USING_KMU
	default y

configdefault MCUBOOT_GENERATE_DEFAULT_KEY_FILE
	default y

configdefault BOOT_SIGNATURE_TYPE_PURE
	default y

configdefault MCUBOOT_MODE_FIRMWARE_UPDATER_BOOT_MODE_ENTRANCE
	default y

endif # BOARD_NRF54LM20DONGLE_NRF54LM20B_CPUAPP
```

## boards/nordic/nrf54lm20dongle/board.yml
```yaml
# Copyright (c) 2026 Nordic Semiconductor ASA
# SPDX-License-Identifier: LicenseRef-Nordic-5-Clause

board:
  name: nrf54lm20dongle
  full_name: nRF54LM20 Dongle
  vendor: nordic
  socs:
  - name: nrf54lm20b
    variants:
    - name: ns
      cpucluster: cpuapp
    - name: xip
      cpucluster: cpuflpr
```

## boards/nordic/nrf54lm20dongle/nrf54lm20dongle_nrf54lm20b_cpuapp_defconfig
```kconfig
# Copyright (c) 2026 Nordic Semiconductor ASA
# SPDX-License-Identifier: LicenseRef-Nordic-5-Clause

# Enable UART driver
CONFIG_SERIAL=y

# Enable console
CONFIG_CONSOLE=y
CONFIG_UART_CONSOLE=y

# Enable GPIO
CONFIG_GPIO=y

# Enable MPU
CONFIG_ARM_MPU=y

# MPU-based null-pointer dereferencing detection cannot
# be applied as the (0x0 - 0x400) is unmapped for this target.
CONFIG_NULL_POINTER_EXCEPTION_DETECTION_NONE=y

# Enable Cache
CONFIG_CACHE_MANAGEMENT=y
CONFIG_EXTERNAL_CACHE=y

# Start SYSCOUNTER on driver init
CONFIG_NRF_GRTC_START_SYSCOUNTER=y

# Board Kconfig.defconfig enables USB CDC ACM and should disable USB remote
# wakeup by default. It needs to be disabled here, because the USB nrfx
# driver always overwrites option from Kconfig mentioned above with the
# imply from CONFIG_USB_NRFX.
CONFIG_USB_DEVICE_REMOTE_WAKEUP=n
```

## boards/nordic/nrf54lm20pdk/Kconfig.nrf54lm20pdk
```kconfig
# Copyright (c) 2025 Nordic Semiconductor ASA
# SPDX-License-Identifier: LicenseRef-Nordic-5-Clause

config BOARD_NRF54LM20PDK
	select SOC_NRF54LM20A_ENGA_CPUAPP if BOARD_NRF54LM20PDK_NRF54LM20A_CPUAPP
	select SOC_NRF54LM20A_ENGA_CPUFLPR if BOARD_NRF54LM20PDK_NRF54LM20A_CPUFLPR
```
