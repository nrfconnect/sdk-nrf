/*
 * Copyright (c) 2024 Nordic Semiconductor
 * SPDX-License-Identifier: LicenseRef-Nordic-5-Clause
 */

/dts-v1/;
#include <arm/nordic/nrf9151_ns_laca.dtsi>
#include "thingy91x_nrf9151_common.dtsi"

/ {
	chosen {
		zephyr,flash = &flash0;
		zephyr,sram = &sram0_ns_app;
		zephyr,code-partition = &slot0_ns_partition;
		zephyr,wifi = &nordic_wlan0;
	};
};

/* Disable Zephyr driver for UART1. This port is reserved for modem traces and T-FM logging.
 */
&uart1 {
	status = "disabled";
};
