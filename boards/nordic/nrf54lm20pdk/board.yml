## boards/nordic/nrf54lm20pdk/board.yml
```yaml
board:
  name: nrf54lm20pdk
  full_name: nRF54LM20 PDK
  vendor: nordic
  socs:
  - name: nrf54lm20a
  revision:
    format: custom
    default: "0.0.0"
    revisions:
    - name: "0.0.0"
    - name: "0.2.0"
    - name: "0.2.0.csp"
```

## boards/nordic/nrf54ls05dk/Kconfig
```kconfig
# Copyright (c) 2026 Nordic Semiconductor ASA
# SPDX-License-Identifier: LicenseRef-Nordic-5-Clause

config BOARD_NRF54LS05DK
	select SOC_NRF54LS05A_DEVELOP_IN_NRF54LS05B if SOC_NRF54LS05A_CPUAPP
```

## boards/nordic/nrf54ls05dk/Kconfig.defconfig
```kconfig
# Copyright (c) 2025 Nordic Semiconductor ASA
# SPDX-License-Identifier: LicenseRef-Nordic-5-Clause

if BOARD_NRF54LS05DK_NRF54LS05A_CPUAPP || BOARD_NRF54LS05DK_NRF54LS05B_CPUAPP

config SOC_NRF54LX_SKIP_GLITCHDETECTOR_DISABLE
	default y

config NRF_RRAM_WRITE_BUFFER_SIZE
	default 8
	range 0 8

endif # BOARD_NRF54LS05DK_NRF54LS05A_CPUAPP || BOARD_NRF54LS05DK_NRF54LS05B_CPUAPP
```

## boards/nordic/nrf54ls05dk/Kconfig.nrf54ls05dk
```kconfig
# Copyright (c) 2025 Nordic Semiconductor ASA
# SPDX-License-Identifier: LicenseRef-Nordic-5-Clause

config BOARD_NRF54LS05DK
	select SOC_NRF54LS05B_CPUAPP if BOARD_NRF54LS05DK_NRF54LS05B_CPUAPP
```

## boards/nordic/nrf54ls05pdk/board.yml
```yaml
board:
  name: nrf54ls05pdk
  full_name: nRF54LS05B PDK
  vendor: nordic
  socs:
  - name: nrf54ls05b
  revision:
    format: major.minor.patch
    default: "0.0.0"
    revisions:
    - name: "0.0.0"
```

## boards/nordic/nrf54lv10apdk/Kconfig.nrf54lv10apdk
```kconfig
# Copyright (c) 2024 Nordic Semiconductor ASA
# SPDX-License-Identifier: LicenseRef-Nordic-5-Clause

config BOARD_NRF54LV10APDK
	select SOC_NRF54LV10A_ENGA_CPUAPP if BOARD_NRF54LV10APDK_NRF54LV10A_CPUAPP
	select SOC_NRF54LV10A_ENGA_CPUFLPR if BOARD_NRF54LV10APDK_NRF54LV10A_CPUFLPR
```

## boards/nordic/nrf54lv10apdk/board.yml
```yaml
board:
  name: nrf54lv10apdk
  full_name: nRF54LV10A PDK
  vendor: nordic
  socs:
  - name: nrf54lv10a
```

## boards/nordic/nrf54lv10dk/Kconfig
```kconfig
# Copyright (c) 2025 Nordic Semiconductor ASA
# SPDX-License-Identifier: LicenseRef-Nordic-5-Clause

# nRF54LV10 DK board configuration

if BOARD_NRF54LV10DK_NRF54LV10A_CPUAPP_NS

DT_NRF_MPC := $(dt_nodelabel_path,nrf_mpc)

config NRF_TRUSTZONE_FLASH_REGION_SIZE
	hex
	default $(dt_node_int_prop_hex,$(DT_NRF_MPC),override-granularity)
	help
	  This defines the flash region size from the TrustZone perspective.
	  It is used when configuring TrustZone and when setting alignment
	  requirements for the partitions.
	  This abstraction allows you to configure TrustZone without depending
	  on peripheral-specific symbols.

config NRF_TRUSTZONE_RAM_REGION_SIZE
	hex
	default $(dt_node_int_prop_hex,$(DT_NRF_MPC),override-granularity)
	help
	  This defines the RAM region size from the TrustZone perspective.
	  It is used when configuring TrustZone and when setting alignment
	  requirements for the partitions.
	  This abstraction allows you to configure TrustZone without depending
	  on peripheral-specific symbols.

endif  # BOARD_NRF54LV10DK_NRF54LV10A_CPUAPP_NS
```

## boards/nordic/nrf54lv10dk/Kconfig.defconfig
```kconfig
# Copyright (c) 2025 Nordic Semiconductor ASA
# SPDX-License-Identifier: LicenseRef-Nordic-5-Clause

# Workaround for not being able to have commas in macro arguments
DT_CHOSEN_Z_CODE_PARTITION := zephyr,code-partition
DT_CHOSEN_Z_SRAM_PARTITION := zephyr,sram-secure-partition

config HAS_BT_CTLR
	default BT

config SOC_NRF54LX_SKIP_GLITCHDETECTOR_DISABLE
	default y

config NRF_RRAM_WRITE_BUFFER_SIZE
	default 16

if BOARD_NRF54LV10DK_NRF54LV10A_CPUAPP

config ROM_START_OFFSET
	default 0 if PARTITION_MANAGER_ENABLED
	default 0x800 if BOOTLOADER_MCUBOOT

endif # BOARD_NRF54LV10DK_NRF54LV10A_CPUAPP

if BOARD_NRF54LV10DK_NRF54LV10A_CPUAPP_NS

# By default, if building for the /ns variant of the board,
# enable building with TF-M as the Secure Processing Environment.
config BUILD_WITH_TFM
	default y

endif # BOARD_NRF54LV10DK_NRF54LV10A_CPUAPP_NS
```

## boards/nordic/nrf54lv10dk/Kconfig.nrf54lv10dk
```kconfig
# Copyright (c) 2025 Nordic Semiconductor ASA
# SPDX-License-Identifier: LicenseRef-Nordic-5-Clause

config BOARD_NRF54LV10DK
	select SOC_NRF54LV10A_CPUAPP if BOARD_NRF54LV10DK_NRF54LV10A_CPUAPP || BOARD_NRF54LV10DK_NRF54LV10A_CPUAPP_NS
	select SOC_NRF54LV10A_CPUFLPR if BOARD_NRF54LV10DK_NRF54LV10A_CPUFLPR
```

## boards/nordic/nrf7002dk/Kconfig.nrf7002dk
```kconfig
# Copyright (c) 2024 Nordic Semiconductor
# SPDX-License-Identifier: LicenseRef-Nordic-5-Clause

config BOARD_NRF7002DK
	select SOC_NRF5340_CPUNET_QKAA if BOARD_NRF7002DK_NRF5340_CPUNET \
	       || BOARD_NRF7002DK_NRF5340_CPUNET_NRF7001
	select SOC_NRF5340_CPUAPP_QKAA if BOARD_NRF7002DK_NRF5340_CPUAPP \
	       || BOARD_NRF7002DK_NRF5340_CPUAPP_NS \
	       || BOARD_NRF7002DK_NRF5340_CPUAPP_NRF7001 \
	       || BOARD_NRF7002DK_NRF5340_CPUAPP_NRF7001_NS
```

## boards/nordic/nrf7002dk/Kconfig.sysbuild
```kconfig
# Copyright (c) 2024 Nordic Semiconductor ASA
# SPDX-License-Identifier: LicenseRef-Nordic-5-Clause

config WIFI_NRF70
	default y if SOC_NRF5340_CPUAPP_QKAA
```

## boards/nordic/nrf7002dk/board.yml
```yaml
board:
  name: nrf7002dk
  vendor: nordic
  socs:
    - name: nrf5340
      variants:
        - name: ns
          cpucluster: cpuapp
          # nRF7002 companion IC in nRF7001 emulation mode on nRF7002dk
        - name: nrf7001
          cpucluster: cpuapp
          variants:
            - name: ns
        - name: nrf7001
          cpucluster: cpunet
```

## boards/nordic/nrf7120dk/board.yml
```yaml
board:
  name: nrf7120dk
  full_name: nRF7120 DK
  vendor: nordic
  socs:
  - name: nrf7120
    variants:
    - name: xip
      cpucluster: cpuflpr
    - name: ns
      cpucluster: cpuapp
    - name: emu
      cpucluster: cpuapp
    - name: fpga
      cpucluster: cpuapp
```

## boards/nordic/nrf7120pdk/Kconfig
```kconfig
# Copyright (c) 2025 Nordic Semiconductor ASA
# SPDX-License-Identifier: LicenseRef-Nordic-5-Clause

config BOARD_NRF7120PDK
	select BOARD_EARLY_INIT_HOOK if BOARD_NRF7120PDK_NRF7120_CPUAPP_EMU
	select BOARD_EARLY_INIT_HOOK if BOARD_NRF7120PDK_NRF7120_CPUAPP
```

## boards/nordic/nrf7120pdk/Kconfig.defconfig
```kconfig
# Copyright (c) 2025 Nordic Semiconductor ASA
# SPDX-License-Identifier: LicenseRef-Nordic-5-Clause

if BOARD_NRF7120PDK_NRF7120_CPUAPP

config HAS_BT_CTLR
	default BT

config ROM_START_OFFSET
	default 0 if PARTITION_MANAGER_ENABLED
	default 0x800 if BOOTLOADER_MCUBOOT

endif # BOARD_NRF7120PDK_NRF7120_CPUAPP

if BOARD_NRF7120PDK_NRF7120_CPUAPP_NS

config HAS_BT_CTLR
	default BT

# By default, if we build for a Non-Secure version of the board,
# enable building with TF-M as the Secure Execution Environment.
config BUILD_WITH_TFM
	default y

# By default, if we build with TF-M, instruct build system to
# flash the combined TF-M (Secure) & Zephyr (Non Secure) image
config TFM_FLASH_MERGED_BINARY
	default y
	depends on BUILD_WITH_TFM

endif # BOARD_NRF7120PDK_NRF7120_CPUAPP_NS
```

## boards/nordic/nrf7120pdk/Kconfig.nrf7120pdk
```kconfig
# Copyright (c) 2025 Nordic Semiconductor ASA
# SPDX-License-Identifier: LicenseRef-Nordic-5-Clause
config BOARD_NRF7120PDK
	select SOC_NRF7120_ENGA_CPUAPP if BOARD_NRF7120PDK_NRF7120_CPUAPP  || \
						BOARD_NRF7120PDK_NRF7120_CPUAPP_NS || \
						BOARD_NRF7120PDK_NRF7120_CPUAPP_EMU || \
						BOARD_NRF7120PDK_NRF7120_CPUAPP_FPGA
	select SOC_NRF7120_PREENG if BOARD_NRF7120PDK_NRF7120_CPUAPP_EMU || \
						BOARD_NRF7120PDK_NRF7120_CPUAPP_FPGA
	select SOC_NRF7120_ENGA_CPUFLPR if BOARD_NRF7120PDK_NRF7120_CPUFLPR || \
					    BOARD_NRF7120PDK_NRF7120_CPUFLPR_XIP
```

## boards/nordic/nrf7120pdk/board.yml
```yaml
board:
  name: nrf7120pdk
  vendor: nordic
  socs:
  - name: nrf7120
    variants:
    - name: xip
      cpucluster: cpuflpr
    - name: ns
      cpucluster: cpuapp
```

## boards/nordic/nrf7120pdk/nrf7120pdk_nrf7120_cpuapp_fpga_defconfig
```kconfig
# Copyright (c) 2025 Nordic Semiconductor ASA
# SPDX-License-Identifier: LicenseRef-Nordic-5-Clause

# Enable UART driver
CONFIG_SERIAL=y

# Enable console
CONFIG_CONSOLE=y
CONFIG_UART_CONSOLE=y

# Enable GPIO
CONFIG_GPIO=y

# Enable MPU
CONFIG_ARM_MPU=y

# Enable hardware stack protection
CONFIG_HW_STACK_PROTECTION=y

# MPU-based null-pointer dereferencing detection cannot
# be applied as the (0x0 - 0x400) is unmapped for this target.
CONFIG_NULL_POINTER_EXCEPTION_DETECTION_NONE=y

# Start SYSCOUNTER on driver init
CONFIG_NRF_GRTC_TIMER_APP_DEFINED_INIT=n
CONFIG_NRF_GRTC_START_SYSCOUNTER=y

# LFRC is not working in EMU at the moment
# CONFIG_CLOCK_CONTROL_NRF_K32SRC_RC=y

# CRACEN not available on emulator
CONFIG_CRACEN_LIB_KMU=n

# Enable Debugging when working with emulator
CONFIG_OUTPUT_DISASSEMBLY=y
CONFIG_DEBUG=y
CONFIG_LOG=y
```

## boards/nordic/nrf9251dk/Kconfig.nrf9251dk
```kconfig
# Copyright (c) 2026 Nordic Semiconductor ASA
# SPDX-License-Identifier: LicenseRef-Nordic-5-Clause

config BOARD_NRF9251DK
	select SOC_NRF9251_CPUAPP if BOARD_NRF9251DK_NRF9251_CPUAPP
	select SOC_NRF9251_CPUPPR if (BOARD_NRF9251DK_NRF9251_CPUPPR  || \
		BOARD_NRF9251DK_NRF9251_CPUPPR_XIP)
	select SOC_NRF9251_CPUFLPR if (BOARD_NRF9251DK_NRF9251_CPUFLPR  || \
		BOARD_NRF9251DK_NRF9251_CPUFLPR_XIP)
```

## boards/nordic/nrf9251dk/board.yml
```yaml
board:
  full_name: nRF9251 DK
  name: nrf9251dk
  vendor: nordic
  socs:
  - name: nrf9251
    variants:
    - name: xip
      cpucluster: cpuppr
    - name: xip
      cpucluster: cpuflpr
  revision:
    format: major.minor.patch
    default: "0.1.0"
    revisions:
    - name: "0.1.0"
runners:
  run_once:
    '--recover':
    - runners:
      - nrfutil
      run: first
      groups:
      - boards:
        - nrf9251dk@0.1.0/nrf9251/cpuapp
        - nrf9251dk@0.1.0/nrf9251/cpuppr
        - nrf9251dk@0.1.0/nrf9251/cpuppr/xip
        - nrf9251dk@0.1.0/nrf9251/cpuflpr
        - nrf9251dk@0.1.0/nrf9251/cpuflpr/xip
    '--erase':
    - runners:
      - jlink
      - nrfutil
      run: first
      groups:
      - boards:
        - nrf9251dk@0.1.0/nrf9251/cpuapp
        - nrf9251dk@0.1.0/nrf9251/cpuppr
        - nrf9251dk@0.1.0/nrf9251/cpuppr/xip
        - nrf9251dk@0.1.0/nrf9251/cpuflpr
        - nrf9251dk@0.1.0/nrf9251/cpuflpr/xip
    '--reset':
    - runners:
      - jlink
      - nrfutil
      run: last
      groups:
      - boards:
        - nrf9251dk@0.1.0/nrf9251/cpuapp
        - nrf9251dk@0.1.0/nrf9251/cpuppr
        - nrf9251dk@0.1.0/nrf9251/cpuppr/xip
        - nrf9251dk@0.1.0/nrf9251/cpuflpr
        - nrf9251dk@0.1.0/nrf9251/cpuflpr/xip
```

## boards/nordic/nrf9251dk/nrf9251dk_nrf9251_cpuflpr_defconfig
```kconfig
# Copyright (c) 2026 Nordic Semiconductor ASA
# SPDX-License-Identifier: LicenseRef-Nordic-5-Clause

# Enable UART driver
CONFIG_SERIAL=y

# Enable console
CONFIG_CONSOLE=y
CONFIG_UART_CONSOLE=y

CONFIG_XIP=n
```

## boards/nordic/nrf9251dk/nrf9251dk_nrf9251_cpuppr_defconfig
```kconfig
# Copyright (c) 2026 Nordic Semiconductor ASA
# SPDX-License-Identifier: LicenseRef-Nordic-5-Clause

CONFIG_SERIAL=y

# Enable console
CONFIG_CONSOLE=y
CONFIG_UART_CONSOLE=y

CONFIG_USE_DT_CODE_PARTITION=y

# Execute from RAM
CONFIG_XIP=n
```

## boards/nordic/nrf9251pdk/Kconfig.nrf9251pdk
```kconfig
# Copyright (c) 2026 Nordic Semiconductor ASA
# SPDX-License-Identifier: Apache-2.0

config BOARD_NRF9251PDK
	select SOC_NRF9251_CPUAPP if (BOARD_NRF9251PDK_NRF9251_CPUAPP)
	select SOC_NRF9251_CPUPPR if (BOARD_NRF9251PDK_NRF9251_CPUPPR)
	select SOC_NRF9251_CPUFLPR if (BOARD_NRF9251PDK_NRF9251_CPUFLPR)
```

## boards/nordic/nrf9251pdk/board.yml
```yaml
board:
  full_name: nRF9251 PDK
  name: nrf9251pdk
  vendor: nordic
  socs:
  - name: nrf9251
    variants:
    - name: ppr
      cpucluster: cpuppr
    - name: flpr
      cpucluster: cpuflpr
    - name: app
      cpucluster: cpuapp
  revision:
    format: major.minor.patch
    default: "0.1.0"
    revisions:
    - name: "0.1.0"
```
