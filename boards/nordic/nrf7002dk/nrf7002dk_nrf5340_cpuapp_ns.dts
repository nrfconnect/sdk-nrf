/*
 * Copyright (c) 2022 Nordic Semiconductor ASA
 *
 * SPDX-License-Identifier: LicenseRef-Nordic-5-Clause
 */

/dts-v1/;
#include <nordic/nrf5340_cpuappns_qkaa.dtsi>
#include "nrf5340_cpuapp_common.dtsi"

/ {
	model = "Nordic NRF5340 DK NRF5340 Application";
	compatible = "nordic,nrf5340-dk-nrf5340-cpuapp";

	chosen {
		zephyr,sram = &sram0_ns;
		zephyr,flash = &flash0;
		zephyr,code-partition = &slot0_ns_partition;
		zephyr,entropy = &psa_rng;
		zephyr,wifi = &nordic_wlan0;
	};

	psa_rng: psa-rng {
		compatible = "zephyr,psa-crypto-rng";
		status = "okay";
	};

	nrf70_tx_power_ceiling: nrf70_tx_power_ceiling_node {
		status = "okay";
		compatible = "nordic,nrf700x-tx-power-ceiling";
		max-pwr-2g-dsss = <0x54>;
		max-pwr-2g-mcs0 = <0x40>;
		max-pwr-2g-mcs7 = <0x40>;
		max-pwr-5g-low-mcs0 = <0x24>;
		max-pwr-5g-low-mcs7 = <0x24>;
		max-pwr-5g-mid-mcs0 = <0x2C>;
		max-pwr-5g-mid-mcs7 = <0x2C>;
		max-pwr-5g-high-mcs0 = <0x34>;
		max-pwr-5g-high-mcs7 = <0x34>;
	};
};
