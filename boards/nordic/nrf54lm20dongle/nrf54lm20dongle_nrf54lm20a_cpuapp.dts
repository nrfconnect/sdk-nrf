/*
 * Copyright (c) 2026 Nordic Semiconductor ASA
 *
 * SPDX-License-Identifier: LicenseRef-Nordic-5-Clause
 */

/dts-v1/;

#include "nrf54lm20a_cpuapp_common.dtsi"
#include <vendor/nordic/nrf54lm20a_cpuapp_partition.dtsi>

/ {
	compatible = "nordic,nrf54lm20dongle_nrf54lm20a-cpuapp";
	model = "Nordic nRF54LM20 Dongle nRF54LM20A Application MCU";

	chosen {
		zephyr,code-partition = &slot0_partition;
		zephyr,sram = &cpuapp_sram;
	};
};
