/*
 * Copyright (c) 2026 Nordic Semiconductor ASA
 *
 * SPDX-License-Identifier: LicenseRef-Nordic-5-Clause
 */

#include "nrf54lv10dk_nrf54lv10a_cpuflpr.dts"

&cpuflpr_sram {
	reg = <0x2001fc00 DT_SIZE_K(64)>;
	ranges = <0x0 0x2001fc00 DT_SIZE_K(64)>;
};
