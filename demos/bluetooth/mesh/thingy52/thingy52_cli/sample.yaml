## demos/bluetooth/mesh/thingy52/thingy52_cli/sample.yaml
```yaml
sample:
  name: Bluetooth mesh Thingy:52 client
  description: Bluetooth mesh Thingy:52 client
tests:
  demos.bluetooth.mesh.thingy52.thingy52_cli:
    build_only: true
    build_on_all: true
    platform_whitelist: thingy52_nrf52832
    tags: bluetooth ci_build
```

## demos/bluetooth/mesh/thingy52/thingy52_music_cli/sample.yaml
```yaml
sample:
  name: Bluetooth mesh Thingy:52 music client
  description: Bluetooth mesh Thingy:52 music client
tests:
  samples.bluetooth.mesh.thingy52_music_cli:
    build_only: true
    build_on_all: true
    platform_whitelist: thingy52_nrf52832
    tags: bluetooth ci_build
```

## demos/bluetooth/mesh/thingy52/thingy52_srv/sample.yaml
```yaml
sample:
  name: Bluetooth mesh Thingy:52 server
  description: Bluetooth mesh Thingy:52 server
tests:
  samples.bluetooth.mesh.thingy52_srv:
    build_only: true
    build_on_all: true
    platform_whitelist: thingy52_nrf52832
    tags: bluetooth ci_build
```

## drivers/Kconfig
```kconfig
#
# Copyright (c) 2018-2020 Nordic Semiconductor ASA
#
# SPDX-License-Identifier: LicenseRef-Nordic-5-Clause
#

menu "Device Drivers"

rsource "bluetooth/Kconfig"
rsource "entropy/Kconfig"
rsource "flash/Kconfig"
rsource "gpio/Kconfig"
rsource "hw_cc3xx/Kconfig"
rsource "dect/Kconfig"

if CLOCK_CONTROL

rsource "clock_control/Kconfig"

endif

if !MPSL_FEM_ONLY

rsource "mpsl/Kconfig"

endif

rsource "mspi/Kconfig"
rsource "net/Kconfig"
rsource "ppi_seq/Kconfig"
rsource "regulator/Kconfig"
rsource "sdhc/Kconfig"
rsource "sensor/Kconfig"
rsource "serial/Kconfig"
rsource "vtf_monitoring/Kconfig"
rsource "wifi/Kconfig"

config HPF
	bool
	default y if GPIO_HPF
	default y if MSPI_HPF
	# Temporary kconfig to include DPPI channel allocation for HPF

endmenu
```

## drivers/at_cmd/Kconfig
```kconfig
#
# Copyright (c) 2019 Nordic Semiconductor
#
# SPDX-License-Identifier: LicenseRef-BSD-5-Clause-Nordic
#

menu "AT Command driver"

config AT_CMD
	bool "AT Command driver"
	depends on BSD_LIBRARY

if AT_CMD

config AT_CMD_SYS_INIT
	bool "Initialize the AT Command driver during system init"
	default y if BSD_LIBRARY_SYS_INIT

if AT_CMD_SYS_INIT

config AT_CMD_INIT_PRIORITY
	int "AT Command driver init priority"
	default 40

endif

config AT_CMD_THREAD_PRIO
	int "AT thread priority level"
	range 0 NUM_PREEMPT_PRIORITIES
	default 0 if !MULTITHREADING
	default 10

config AT_CMD_THREAD_STACK_SIZE
	int "AT thread stack size"
	default 1024

config AT_CMD_RESPONSE_MAX_LEN
	int "Maximum AT command response length"
	default 2700

config AT_CMD_RESPONSE_BUFFER_COUNT
	int "Number of buffers provided by AT command driver."
	default 2

module = AT_CMD
module-str = AT command driver
source "${ZEPHYR_BASE}/subsys/logging/Kconfig.template.log_config"

endif # AT_CMD

endmenu
```

## drivers/bluetooth/hci/Kconfig
```kconfig
#
# Copyright (c) 2020 Nordic Semiconductor ASA
#
# SPDX-License-Identifier: LicenseRef-Nordic-5-Clause
#

# Override default value from zephyr to avoid
# issuing a second data length update after connection
# establishment.
config BT_DRIVER_QUIRK_NO_AUTO_DLE
	bool "Host auto-initiated Data Length Update quirk"
	default n if !BT_LL_SW_SPLIT
	help
	  Enable the quirk wherein BT Host stack will auto-initiate Data Length
	  Update procedure for new connections for controllers that do not
	  auto-initiate the procedure if the default data length parameters are
	  not equal to the initial parameters.

	  This has to be enabled when the BLE controller connected is Zephyr
	  open source controller.
```

## drivers/bt_ll_nrfxlib/Kconfig
```kconfig
#
# Copyright (c) 2019 Nordic Semiconductor ASA
#
# SPDX-License-Identifier: LicenseRef-BSD-5-Clause-Nordic
#

rsource "entropy/Kconfig"
rsource "flash/Kconfig"
rsource "clock_control/Kconfig"
```

## drivers/bt_ll_nrfxlib/entropy/Kconfig
```kconfig
#
# Copyright (c) 2018 Nordic Semiconductor ASA
#
# SPDX-License-Identifier: LicenseRef-BSD-5-Clause-Nordic
#

if ENTROPY_GENERATOR

config ENTROPY_NRF_LL_NRFXLIB
	bool "nRF BLE Controller entropy driver"
	default y
	select ENTROPY_NRF_FORCE_ALT
	select ENTROPY_HAS_DRIVER
	select MULTITHREADING_LOCK
	help
	  This option enables the RNG peripheral, which is a random number
	  generator, based on internal thermal noise, that provides a
	  random 8-bit value to the host when read.

config ENTROPY_NRF_PRI
	int "RNG interrupt priority"
	range 0 5
	default 5
	help
	  nRF5X RNG IRQ priority.

endif # ENTROPY_GENERATOR
```

## drivers/bt_ll_softdevice/Kconfig
```kconfig
#
# Copyright (c) 2019 - 2020 Nordic Semiconductor ASA
#
# SPDX-License-Identifier: LicenseRef-Nordic-5-Clause
#

rsource "entropy/Kconfig"
rsource "flash/Kconfig"
```

## drivers/bt_ll_softdevice/entropy/Kconfig
```kconfig
#
# Copyright (c) 2018 Nordic Semiconductor ASA
#
# SPDX-License-Identifier: LicenseRef-Nordic-5-Clause
#

if ENTROPY_GENERATOR

config ENTROPY_NRF_LL_SOFTDEVICE
	bool "SoftDevice Controller entropy driver"
	default y
	select ENTROPY_NRF_FORCE_ALT
	select ENTROPY_HAS_DRIVER
	select MULTITHREADING_LOCK
	help
	  This option enables the RNG peripheral, which is a random number
	  generator, based on internal thermal noise, that provides a
	  random 8-bit value to the host when read.

config ENTROPY_NRF_PRI
	int "RNG interrupt priority"
	range 0 5
	default 5
	help
	  nRF5X RNG IRQ priority.

endif # ENTROPY_GENERATOR
```

## drivers/bt_ll_softdevice/flash/Kconfig
```kconfig
#
# Copyright (c) 2018 Nordic Semiconductor ASA
#
# SPDX-License-Identifier: LicenseRef-Nordic-5-Clause
#

if FLASH

config SOC_FLASH_NRF_LL_SOFTDEVICE
	bool "SoftDevice Controller flash driver"
	default y
	select FLASH_NRF_FORCE_ALT
	select FLASH_HAS_PAGE_LAYOUT
	select FLASH_HAS_DRIVER_ENABLED
	select NRFX_NVMC
	select MPU_ALLOW_FLASH_WRITE if ARM_MPU
	select MULTITHREADING_LOCK
	help
	  Enables SoftDevice Controller flash driver.

endif # FLASH
```

## drivers/clock_control/Kconfig
```kconfig
# Copyright (c) 2026 Nordic Semiconductor ASA
# SPDX-License-Identifier: LicenseRef-Nordic-5-Clause

config CLOCK_CONTROL_NRF92_HFXO
	bool "NRF92 HFXO driver support"
	depends on DT_HAS_NORDIC_NRF92_HFXO_ENABLED
	select CLOCK_CONTROL_NRF2_COMMON
	default y

config CLOCK_CONTROL_NRF92_HSFLL_LOCAL
	bool "NRF92 local HSFLL driver support"
	depends on DT_HAS_NORDIC_NRF92_HSFLL_LOCAL_ENABLED
	select CLOCK_CONTROL_NRF2_COMMON
	default y
```

## drivers/crypto/Kconfig
```kconfig
#
# Copyright (c) 2020 Nordic Semiconductor ASA
#
# SPDX-License-Identifier: LicenseRef-BSD-5-Clause-Nordic
#

if CRYPTO

rsource "Kconfig.nrf_ecb"

endif # CRYPTO
```

## drivers/crypto/Kconfig.nrf_ecb
```kconfig
# NRF AES ECB configuration options

# Copyright (c) 2020 Nordic Semiconductor ASA
# SPDX-License-Identifier: LicenseRef-BSD-5-Clause-Nordic

menuconfig CRYPTO_NRF_ECB
	bool "nRF AES electronic codebook mode encryption"
	depends on HAS_HW_NRF_ECB
	help
	  Enable nRF HAL-based AES ECB encryption driver

config CRYPTO_NRF_ECB_DEV_NAME
	string "nRF AES ECB device name"
	default "CRYPTO_NRF_ECB"
	depends on CRYPTO_NRF_ECB
	help
	  Device name for nRF AES ECB
```

## drivers/dect/Kconfig
```kconfig
# Copyright (c) 2025 Nordic Semiconductor ASA
#
# SPDX-License-Identifier: LicenseRef-Nordic-5-Clause

menu "Configure DECT NR+ stack below DECT NR+ HAL"

config DECT
	bool "DECT NR+"
	help
	  Main feature flag for DECT NR+.

if DECT

# Select architecture
choice DECT_ARCH
	prompt "Select DECT architecture for DECT NR+ stack below DECT NR+ HAL"
	default DECT_MDM

config DECT_MDM
	bool "DECT MDM architecture"
	depends on SETTINGS
	select NET_L2_DECT
	select NET_L2_DECT_MGMT
	select DECT_UTILS_LIB
	help
	  DECT NR+ architecture where, for example, MAC is running on the modem.

# Note: DECT_PHY is not supported.

endchoice

config DECT_CLUSTER_MAX_CHILD_ASSOCIATION_COUNT
	int "Maximum number of associations"
	default 20
	help
	  Maximum number of supported child associations.
	  Should be aligned with CONFIG_NET_IPV6_MAX_NEIGHBORS.

config DECT_DEFAULT_NW_ID
	hex "Default network ID"
	default 0x87654321
	help
	  Default network ID.

choice DECT_DEFAULT_LONG_RD_ID_TYPE
	prompt "Select default long RD ID type"
	default DECT_DEFAULT_LONG_RD_ID_TYPE_RANDOM

config DECT_DEFAULT_LONG_RD_ID_TYPE_HARD_CODED
	bool "Default long RD ID as hard coded"
	help
	  Default long RD (Radio Device) ID is hard coded.

config DECT_DEFAULT_LONG_RD_ID_TYPE_RANDOM
	bool "Default long RD ID as random generated"
	help
	  Default long RD (Radio Device) ID is randomly generated at 1st bootup
	  and later in settings reset.

endchoice

config DECT_DEFAULT_LONG_RD_ID
	int "Default long RD ID"
	range 1 4294967293
	default 666
	help
	  Default long RD (Radio Device) ID used if
	  DECT_DEFAULT_LONG_RD_ID_TYPE_HARD_CODED is selected.

choice DECT_DEFAULT_DEV_TYPE
	prompt "Select default device type"
	default DECT_DEFAULT_DEV_TYPE_PT

config DECT_DEFAULT_DEV_TYPE_PT
	bool "PT device type"

config DECT_DEFAULT_DEV_TYPE_FT
	bool "FT device type"

endchoice

if DECT_MDM

# Select actual driver for DECT_MDM
choice DECT_MDM_DRIVER
	prompt "Select DECT NR+ driver for DECT_MDM architecture"
	default DECT_MDM_DRIVER_NRF

config DECT_MDM_DRIVER_NRF
	bool "nRF91x1 driver"

endchoice

config DECT_MDM_DEVICE_NAME
	string "DECT NR+ device name"
	default "dect0" if DECT_MDM_DRIVER_NRF
	default "dect_none" if !DECT_MDM_DRIVER_NRF
	help
	  DECT NR+ device name.

config DECT_MDM_DEFAULT_RSSI_SCAN_SUITABLE_PERCENT
	int "Default RSSI scan suitable percentage"
	range 0 100
	default 75
	help
	  RSSI scan suitable percentage (SCAN_SUITABLE according to the MAC spec),
	  which is the threshold when an operating channel can be considered
	  fulfilling the operating conditions. Channel is considered as suitable if RSSI scanning
	  results show that there are minimum of SCAN_SUITABLE percent of subslots free or
	  possible.

config DECT_MDM_DEFAULT_FT_CLUSTER_CHANNEL_LOADED_PERCENT
	int "Default channel loaded percentage on FT side"
	range 0 100
	default 80
	help
	  Channel loaded percentage (CHANNEL_LOADED per MAC spec), which impacts
	  on triggering cluster channel and subslot reselection procedure. If current cluster channel
	  load is above this value, then cluster channel is considered as too loaded for running
	  a cluster.

config DECT_MDM_DEFAULT_FT_NEIGHBOR_INACTIVITY_DISCONNECT_TIMER_MS
	int "Default neighbor inactivity disconnect timer on FT side"
	range 0 4294967293
	default 1800000
	help
	  Neighbor inactivity timer that triggers association releasing.
	  Time in milliseconds, 30 minutes as a default value.
	  Use 0 to disable timer.

config DECT_MDM_DEFAULT_PT_ASSOCIATION_MAX_BEACON_RX_FAILURES
	int "Default max beacon RX failures on PT side"
	range 0 255
	default 10
	help
	  Maximum number of consecutive cluster beacon misses before triggering
	  procedures for a release of association.

config DECT_MDM_DEFAULT_PT_ASSOCIATION_MIN_SENSITIVITY_DBM
	int "Default min sensitivity on PT side"
	range -128 0
	default -95
	help
	  MIN_SENSITIVITY_LEVEL per MAC spec.
	  Minimum RX sensitivity, which impacts cluster beacon RSSI, if it is
	  below this value, then cluster beacon RSSI is considered as too low
	  for an association.

config DECT_MDM_RANDOM_RANGE_START
	int "Random long RD ID range start"
	range 1 4294967293
	default 1
	help
	  Random long RD (Radio Device) ID range start.

config DECT_MDM_RANDOM_RANGE_END
	int "Random long RD ID range end"
	range 1 4294967293
	default 4294967293
	help
	  Random long RD (Radio Device) ID range end.

config DECT_MDM_NET_IF_NO_AUTO_START
	bool "DECT NR+ interface without auto-start"
	help
	  This option allows you to disable autostarting of the net interface
	  immediately after initialization and instead call for net_if_up()
	  manually.

module = DECT_MDM
module-str = Log level for DECT MDM driver
source "${ZEPHYR_BASE}/subsys/logging/Kconfig.template.log_config"

# Include vendor specifics

if DECT_MDM_DRIVER_NRF

rsource "dect_mdm/Kconfig"

endif # DECT_MDM_DRIVER_NRF

endif # DECT_MDM

endif # DECT

endmenu
```

## drivers/dect/dect_mdm/Kconfig
```kconfig
# Copyright (c) 2025 Nordic Semiconductor ASA
#
# SPDX-License-Identifier: LicenseRef-Nordic-5-Clause

menu "Nordic driver specific configs for DECT NR+"

config DECT_MDM_NRF
	bool "Nordic-specific DECT MDM driver configurations"
	depends on DECT_MDM
	default y if DECT_MDM_DRIVER_NRF
	help
	  Enable Nordic-specific configuration options for the DECT MDM driver.
	  This includes RX RSSI settings, TX flow control, and thread stack sizes
	  optimized for Nordic nRF91-based DECT modems.

if DECT_MDM_NRF

config DECT_MDM_NRF_RX_MCS1_EXPECTED_RSSI_LEVEL
	int "Expected RSSI level for MCS1"
	default -68
	range -128 0
	help
	  RX RSSI level for power control in modem, value in dBm.
	  Device expects to receive transmissions (MCS#1) at this RSSI level.

config NET_LINK_ADDR_CUSTOM_LENGTH
	int "Size of custom link layer address length for DECT NR+"
	default 8

config DECT_MDM_NRF_TX_FLOW_CTRL_BASED_ON_MDM_TX_DLC_REQS
	bool "TX flow control support"
	default y
	help
	  Enable TX window based flow ctrl on unacked mdm TX DLC data requests.

config DECT_MDM_NRF_CTRL_THREAD_STACK_SIZE
	int "Driver's internal ctrl thread stack size"
	default 3072
	help
	  This option sets the driver's stack size for its internal ctrl thread.
	  Note: Most probably, you might decrease this if size of net mgmt events
	  are decreased.

rsource "Kconfig.rx"

endif # DECT_MDM_NRF

endmenu
```

## drivers/entropy/Kconfig
```kconfig
# Arm CC3xx entropy driver for nRF52840 and nRF9160
#
# Copyright (c) 2019 Nordic Semiconductor
#
# SPDX-License-Identifier: LicenseRef-Nordic-5-Clause

config ENTROPY_CC3XX
	bool "Arm CC3XX RNG driver for Nordic devices"
	depends on HAS_HW_NRF_CC3XX && !BUILD_WITH_TFM
	depends on ENTROPY_GENERATOR
	select ENTROPY_HAS_DRIVER
	default y
	help
	  This option enables the Arm CC3xx RNG devices in nRF52840, nRF5340,
	  and nRF9160 for targets that don't use TF-M.
	  This is dependent on CC3xx being enabled in nrf_security.
```

## drivers/entropy/Kconfig.nrf_prng
```kconfig
# nRF fake entropy prng generator driver configuration
#
# Copyright (c) 2025 Nordic Semiconductor ASA
#
# SPDX-License-Identifier: LicenseRef-Nordic-5-Clause

if ENTROPY_GENERATOR

config FAKE_ENTROPY_NRF_PRNG
	bool "A fake nRF entropy driver"
	default y
	depends on DT_HAS_NORDIC_ENTROPY_PRNG_ENABLED
	depends on (SOC_SERIES_NRF54HX || SOC_SERIES_NRF92X || SOC_SERIES_NRF54LX || SOC_SERIES_NRF71X)
	select ENTROPY_HAS_DRIVER
	help
	  This is a super simple PRNG driver that can be used on nRF platforms that
	  do not have an entropy source.
	  This is NOT SAFE to use for cryptographic operations!

endif
```

## drivers/flash/Kconfig
```kconfig
if FLASH

# zephyr-keep-sorted-start
rsource "Kconfig.flash_rpc"
# zephyr-keep-sorted-stop

endif # FLASH
```

## drivers/flash/flash_nop_device/Kconfig
```kconfig
# Flash nop device config

# Copyright (c) 2021 Nordic Semiconductor ASA
#
# SPDX-License-Identifier: LicenseRef-Nordic-5-Clause

config FLASH_NOP_DEVICE
	bool "Flash no operation device"
	depends on !FLASH_SIMULATOR
	select FLASH_HAS_PAGE_LAYOUT
	select FLASH_HAS_DRIVER_ENABLED
	help
	  This is zephyr,sim-flash compatible device that does not allocate any RAM; all reads
	  from the device are erase_value and all writes/erases operations are doing nothing.
	  The device respects DTS configuration of flash simulator device it replaces regarding
	  regarding size, offset, write alignment, etc.
```

## drivers/flash_patch/Kconfig
```kconfig
#
# Copyright (c) 2019 Nordic Semiconductor ASA
#
# SPDX-License-Identifier: LicenseRef-BSD-5-Clause-Nordic
#

config DISABLE_FLASH_PATCH
	bool "Disable Cortex-M4 Flash Patch capabilities"
	depends on SOC_NRF52840
	depends on REBOOT
	help
	  The flash patch can be used by malicious code to circumvent secure
	  boot checks. Note that disabling flash patching also disables
	  breakpoints.
```
