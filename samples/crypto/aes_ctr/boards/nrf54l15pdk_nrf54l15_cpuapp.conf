## samples/crypto/ecdsa/sample.yaml
```yaml
sample:
  description: |
    This app provides an example of signing/verifying using ECDSA signatures
  name: ECDSA example
tests:
  sample.ecdsa:
    tags: introduction psa cc3xx
    platform_allow: >
      nrf5340dk/nrf5340/cpuapp/ns nrf5340dk/nrf5340/cpuapp nrf9160dk/nrf9160/ns
      nrf9160dk/nrf9160 nrf52840dk/nrf52840 nrf9161dk/nrf9161 nrf9161dk/nrf9161/ns
      nrf54h20dk/nrf54h20/cpuapp
      nrf54l15pdk/nrf54l15/cpuapp
      nrf54l15pdk_nrf54l15_cpuapp_ns
    harness: console
    harness_config:
      type: multi_line
      regex:
        - ".*Example finished successfully!.*"
    integration_platforms:
      - nrf5340dk/nrf5340/cpuapp/ns
      - nrf5340dk/nrf5340/cpuapp
      - nrf9160dk/nrf9160/ns
      - nrf9160dk/nrf9160
      - nrf52840dk/nrf52840
      - nrf9161dk/nrf9161
      - nrf9161dk/nrf9161/ns
      - nrf54l15pdk/nrf54l15/cpuapp
      - nrf54l15pdk_nrf54l15_cpuapp_ns
      - nrf54h20dk/nrf54h20/cpuapp
```

## samples/crypto/ecjpake/boards/nrf54l15pdk_nrf54l15_cpuapp.conf
```kconfig
CONFIG_PSA_CRYPTO_DRIVER_OBERON=y

# Use Oberon until until NCSDK-26303 is complete
```

## samples/crypto/ecjpake/boards/nrf9151dk_nrf9151.conf
```kconfig
#
# Copyright (c) 2024 Nordic Semiconductor ASA
#
# SPDX-License-Identifier: LicenseRef-Nordic-5-Clause
#
# Using software crypto
CONFIG_PSA_CRYPTO_DRIVER_OBERON=y
CONFIG_PSA_CRYPTO_DRIVER_CC3XX=n

# Mbedtls configuration
CONFIG_MBEDTLS_ENABLE_HEAP=y
CONFIG_MBEDTLS_HEAP_SIZE=8192
```

## samples/crypto/ecjpake/boards/nrf9161dk_nrf9161.conf
```kconfig
#
# Copyright (c) 2024 Nordic Semiconductor ASA
#
# SPDX-License-Identifier: LicenseRef-Nordic-5-Clause
#

# Using software crypto
CONFIG_PSA_CRYPTO_DRIVER_OBERON=y
CONFIG_PSA_CRYPTO_DRIVER_CC3XX=n
```

## samples/crypto/ecjpake/sample.yaml
```yaml
sample:
  description: This app provides an example of EC J-PAKE
  name: EC J-PAKE example
tests:
  sample.ecjpake.oberon:
    tags: introduction psa oberon
    platform_allow: >
      nrf5340dk_nrf5340_cpuapp
      nrf5340dk_nrf5340_cpuapp_ns
      nrf9160dk_nrf9160
      nrf9160dk_nrf9160_ns
      nrf52840dk_nrf52840
      nrf9161dk_nrf9161
      nrf9161dk_nrf9161_ns
    harness: console
    harness_config:
      type: multi_line
      regex:
        - ".*Example finished successfully!.*"
    integration_platforms:
      - nrf5340dk_nrf5340_cpuapp
      - nrf5340dk_nrf5340_cpuapp_ns
      - nrf9160dk_nrf9160
      - nrf9160dk_nrf9160_ns
      - nrf9161dk_nrf9161
      - nrf9161dk_nrf9161_ns
      - nrf52840dk_nrf52840
  sample.ecjpake.cracen:
    tags: introduction psa cracen
    platform_allow: >
      nrf54l15pdk_nrf54l15_cpuapp
      nrf54l15pdk_nrf54l15_cpuapp_ns
      nrf54h20dk_nrf54h20_cpuapp
    harness: console
    harness_config:
      type: multi_line
      regex:
        - ".*Example finished successfully!.*"
    integration_platforms:
      - nrf54l15pdk_nrf54l15_cpuapp
      - nrf54l15pdk_nrf54l15_cpuapp_ns
      # nRF54H uses Oberon+fake entropy until crypto service is available from SDFW
      - nrf54h20dk_nrf54h20_cpuapp
```

## samples/crypto/eddsa/boards/nrf5340dk_nrf5340_cpuapp.conf
```kconfig
# SHA-512 only supported by Oberon driver
CONFIG_PSA_CRYPTO_DRIVER_OBERON=y

# Using hardware crypto accelerator
CONFIG_PSA_CRYPTO_DRIVER_CC3XX=y
```

## samples/crypto/eddsa/boards/nrf9151dk_nrf9151.conf
```kconfig
#
# Copyright (c) 2024 Nordic Semiconductor ASA
#
# SPDX-License-Identifier: LicenseRef-Nordic-5-Clause
#
# SHA-512 only supported by Oberon driver
CONFIG_PSA_CRYPTO_DRIVER_OBERON=y
# Using hardware crypto accelerator
CONFIG_PSA_CRYPTO_DRIVER_CC3XX=y

# Mbedtls configuration
CONFIG_MBEDTLS_ENABLE_HEAP=y
CONFIG_MBEDTLS_HEAP_SIZE=8192
```

## samples/crypto/eddsa/boards/nrf9160dk_nrf9160.conf
```kconfig
#
# Copyright (c) 2024 Nordic Semiconductor ASA
#
# SPDX-License-Identifier: LicenseRef-Nordic-5-Clause
#
# SHA-512 only supported by Oberon driver
CONFIG_PSA_CRYPTO_DRIVER_OBERON=y
# Using hardware crypto accelerator
CONFIG_PSA_CRYPTO_DRIVER_CC3XX=y
```
