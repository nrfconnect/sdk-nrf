## CMakeLists.txt
```
#
# Copyright (c) 2024 Nordic Semiconductor ASA
#
# SPDX-License-Identifier: LicenseRef-Nordic-5-Clause
#
cmake_minimum_required(VERSION 3.20.0)

if(NOT crypto_service IN_LIST SNIPPET)
  set(SNIPPET crypto_service ${SNIPPET} CACHE STRING "" FORCE)
endif()

find_package(Zephyr REQUIRED HINTS $ENV{ZEPHYR_BASE})
project(ecjpake)

target_sources(app PRIVATE src/main.c)
```

## sample.yaml
```
sample:
  description: |
    This sample demonstrates EC J-PAKE key exchange using the EC J-PAKE algorithm.
  name: EC J-PAKE sample

common:
  sysbuild: true
  tags:
    - introduction
    - psa
    - sysbuild
    - ci_samples_crypto
    - crypto
  harness: console
  harness_config:
    type: multi_line
    regex:
      - ".*Example finished successfully!.*"

tests:
  sample.ecjpake.oberon:
    sysbuild: true
    tags:
      - oberon
    platform_allow:
      - nrf5340dk/nrf5340/cpuapp
      - nrf5340dk/nrf5340/cpuapp/ns
      - nrf52840dk/nrf52840
      - nrf9151dk/nrf9151
      - nrf9151dk/nrf9151/ns
    integration_platforms:
      - nrf5340dk/nrf5340/cpuapp
      - nrf5340dk/nrf5340/cpuapp/ns
      - nrf52840dk/nrf52840
      - nrf9151dk/nrf9151
      - nrf9151dk/nrf9151/ns
  sample.ecjpake.cracen:
    tags:
      - cracen
    platform_allow:
      - nrf54l15dk/nrf54l15/cpuapp
      - nrf54l15dk/nrf54l15/cpuapp/ns
      - nrf54l15dk/nrf54l10/cpuapp
      - nrf54l15dk/nrf54l10/cpuapp/ns
      - nrf54l15dk/nrf54l05/cpuapp
      - nrf54ls05dk/nrf54ls05a/cpuapp
      - nrf54ls05dk/nrf54ls05b/cpuapp
      - nrf54lm20dk/nrf54lm20a/cpuapp
      - nrf54lm20dk/nrf54lm20a/cpuapp/ns
      - nrf54lm20dk/nrf54lm20b/cpuapp
      - nrf54lm20dk/nrf54lm20b/cpuapp/ns
      - nrf54lv10dk/nrf54lv10a/cpuapp
      - nrf54lv10dk/nrf54lv10a/cpuapp/ns
      - nrf54lc10dk/nrf54lc10a/cpuapp
      - nrf54lc10dk/nrf54lc10a/cpuapp/ns
      - nrf7120dk/nrf7120/cpuapp
      - nrf7120dk/nrf7120/cpuapp/ns
    integration_platforms:
      - nrf54l15dk/nrf54l15/cpuapp
      - nrf54l15dk/nrf54l15/cpuapp/ns
      - nrf54l15dk/nrf54l10/cpuapp
      - nrf54l15dk/nrf54l10/cpuapp/ns
      - nrf54l15dk/nrf54l05/cpuapp
      - nrf54ls05dk/nrf54ls05a/cpuapp
      - nrf54ls05dk/nrf54ls05b/cpuapp
      - nrf54lm20dk/nrf54lm20a/cpuapp
      - nrf54lm20dk/nrf54lm20a/cpuapp/ns
      - nrf54lm20dk/nrf54lm20b/cpuapp
      - nrf54lm20dk/nrf54lm20b/cpuapp/ns
      - nrf54lv10dk/nrf54lv10a/cpuapp
      - nrf54lv10dk/nrf54lv10a/cpuapp/ns
      - nrf54lc10dk/nrf54lc10a/cpuapp
      - nrf54lc10dk/nrf54lc10a/cpuapp/ns
      - nrf7120dk/nrf7120/cpuapp
      - nrf7120dk/nrf7120/cpuapp/ns
  sample.ecjpake.cracen.crypto_service:
    tags:
      - cracen
    platform_allow:
      - nrf54h20dk/nrf54h20/cpuapp
    integration_platforms:
      - nrf54h20dk/nrf54h20/cpuapp
```

## prj.conf
```kconfig
#
# Copyright (c) 2024 Nordic Semiconductor ASA
#
# SPDX-License-Identifier: LicenseRef-Nordic-5-Clause
#
CONFIG_LOG=y
CONFIG_CONSOLE=y
CONFIG_PSA_CRYPTO=y
# Ineffective here: PSA_CRYPTO_DRIVER_OBERON has no prompt once TF-M protected storage or built-in
# keys are in use, so it keeps its default and cannot be assigned.
# CONFIG_PSA_CRYPTO_DRIVER_OBERON=y
CONFIG_PSA_WANT_ALG_JPAKE=y
CONFIG_PSA_WANT_ALG_TLS12_ECJPAKE_TO_PMS=y
CONFIG_PSA_WANT_GENERATE_RANDOM=y
CONFIG_PSA_WANT_ALG_SHA_256=y
CONFIG_PSA_WANT_ECC_SECP_R1_256=y
CONFIG_PSA_WANT_KEY_TYPE_ECC_PUBLIC_KEY=y
CONFIG_PSA_WANT_KEY_TYPE_PASSWORD=y

CONFIG_MAIN_STACK_SIZE=8192
```

## boards/nrf5340dk_nrf5340_cpuapp.conf
```kconfig
# Using software crypto
CONFIG_PSA_CRYPTO_DRIVER_OBERON=y
CONFIG_PSA_CRYPTO_DRIVER_CC3XX=n
```

## boards/nrf54l15pdk_nrf54l15_cpuapp.conf
```kconfig
CONFIG_PSA_CRYPTO_DRIVER_OBERON=y

# Use Oberon until until NCSDK-26303 is complete
```

## boards/nrf9151dk_nrf9151.conf
```kconfig
#
# Copyright (c) 2024 Nordic Semiconductor ASA
#
# SPDX-License-Identifier: LicenseRef-Nordic-5-Clause
#
# Using software crypto
CONFIG_PSA_CRYPTO_DRIVER_OBERON=y
CONFIG_PSA_CRYPTO_DRIVER_CC3XX=n

# Mbedtls configuration
CONFIG_MBEDTLS_ENABLE_HEAP=y
CONFIG_MBEDTLS_HEAP_SIZE=8192
```

## boards/nrf9161dk_nrf9161.conf
```kconfig
#
# Copyright (c) 2024 Nordic Semiconductor ASA
#
# SPDX-License-Identifier: LicenseRef-Nordic-5-Clause
#

# Using software crypto
CONFIG_PSA_CRYPTO_DRIVER_OBERON=y
CONFIG_PSA_CRYPTO_DRIVER_CC3XX=n

# Mbedtls configuration
CONFIG_MBEDTLS_ENABLE_HEAP=y
CONFIG_MBEDTLS_HEAP_SIZE=8192
```

## boards/nrf54h20dk_nrf54h20_cpuapp.overlay
```dts
/*
 * Copyright (c) 2024 Nordic Semiconductor ASA
 *
 * SPDX-License-Identifier: LicenseRef-Nordic-5-Clause
 */

&cpusec_cpuapp_ipc {
	status = "okay";
};

&cpuapp_ram0x_region {
	status = "okay";
};

&cpusec_bellboard {
	status = "okay";
};

&cpuapp_bellboard {
	status = "okay";
};
```

## src/main.c
```c
/*
 * Copyright (c) 2023 Nordic Semiconductor ASA
 *
 * SPDX-License-Identifier: LicenseRef-Nordic-5-Clause
 */

#include <psa/crypto.h>
#include <stdint.h>
#include <zephyr/kernel.h>
#include <zephyr/sys/printk.h>
#include <zephyr/logging/log.h>
#include <zephyr/sys/util.h>

LOG_MODULE_REGISTER(ecjpake, LOG_LEVEL_DBG);

#define PRINT_HEX(p_label, p_text, len)                                                            \
	({                                                                                         \
		LOG_INF("---- %s (len: %u): ----", p_label, len);                                  \
		LOG_HEXDUMP_INF(p_text, len, "Content:");                                          \
		LOG_INF("---- %s end  ----", p_label);                                             \
	})

#define APP_SUCCESS	    (0)
#define APP_ERROR	    (-1)
#define APP_SUCCESS_MESSAGE "Example finished successfully!"
#define APP_ERROR_MESSAGE   "Example exited with error!"

psa_status_t do_rounds(psa_pake_operation_t *server, psa_pake_operation_t *client)
{
	psa_pake_step_t round1_steps[] = {PSA_PAKE_STEP_KEY_SHARE, PSA_PAKE_STEP_ZK_PUBLIC,
					  PSA_PAKE_STEP_ZK_PROOF,  PSA_PAKE_STEP_KEY_SHARE,
					  PSA_PAKE_STEP_ZK_PUBLIC, PSA_PAKE_STEP_ZK_PROOF};
	uint8_t buffer[128];
	size_t outlen;
	psa_status_t status = PSA_ERROR_GENERIC_ERROR;

	/* Server provides data to client */
	for (uint32_t i = 0; i < ARRAY_SIZE(round1_steps); i++) {
		status = psa_pake_output(server, round1_steps[i], buffer, sizeof(buffer), &outlen);
		if (status != PSA_SUCCESS) {
			LOG_INF("psa_pake_output failed. (Error: %d)", status);
			return status;
		}

		status = psa_pake_input(client, round1_steps[i], buffer, outlen);
		if (status != PSA_SUCCESS) {
			LOG_INF("psa_pake_input failed. (Error: %d)", status);
			return status;
		}
	}

	/* Client provides data to server. */
	for (uint32_t i = 0; i < ARRAY_SIZE(round1_steps); i++) {
		status = psa_pake_output(client, round1_steps[i], buffer, sizeof(buffer), &outlen);
		if (status != PSA_SUCCESS) {
			LOG_INF("psa_pake_output failed. (Error: %d)", status);
			return status;
		}

		status = psa_pake_input(server, round1_steps[i], buffer, outlen);
		if (status != PSA_SUCCESS) {
			LOG_INF("psa_pake_input failed. (Error: %d)", status);
			return status;
		}
	}

	psa_pake_step_t round2_steps[] = {PSA_PAKE_STEP_KEY_SHARE, PSA_PAKE_STEP_ZK_PUBLIC,
					  PSA_PAKE_STEP_ZK_PROOF};

	/* Server provides data to client */
	for (uint32_t i = 0; i < ARRAY_SIZE(round2_steps); i++) {
		status = psa_pake_output(server, round2_steps[i], buffer, sizeof(buffer), &outlen);
		if (status != PSA_SUCCESS) {
			LOG_INF("psa_pake_output failed. (Error: %d)", status);
			return status;
		}

		status = psa_pake_input(client, round2_steps[i], buffer, outlen);
		if (status != PSA_SUCCESS) {
			LOG_INF("psa_pake_input failed. (Error: %d)", status);
			return status;
		}
	}

	/* Client provides data to server. */
	for (uint32_t i = 0; i < ARRAY_SIZE(round2_steps); i++) {
		status = psa_pake_output(client, round2_steps[i], buffer, sizeof(buffer), &outlen);
		if (status != PSA_SUCCESS) {
			LOG_INF("psa_pake_output failed. (Error: %d)", status);
			return status;
		}

		status = psa_pake_input(server, round2_steps[i], buffer, outlen);
		if (status != PSA_SUCCESS) {
			LOG_INF("psa_pake_input failed. (Error: %d)", status);
			return status;
		}
	}

	return status;
}

psa_status_t pake_setup(psa_pake_operation_t *op, psa_pake_cipher_suite_t *cs, const char *user,
			const char *peer, psa_key_id_t password)
{
	psa_status_t status = psa_pake_setup(op, password, cs);

	if (status != PSA_SUCCESS) {
		LOG_INF("psa_pake_setup failed. (Error: %d)", status);
		return status;
	}

	status = psa_pake_set_user(op, user, strlen(user));
	if (status != PSA_SUCCESS) {
		LOG_INF("psa_pake_set_user failed. (Error: %d)", status);
		return status;
	}

	status = psa_pake_set_peer(op, peer, strlen(peer));
	if (status != PSA_SUCCESS) {
		LOG_INF("psa_pake_set_peer failed. (Error: %d)", status);
		return status;
	}

	return PSA_SUCCESS;
}

psa_status_t do_key_derivation(psa_pake_operation_t *op, uint8_t *key_buffer,
			       size_t key_buffer_size)
{
	psa_status_t status = PSA_ERROR_CORRUPTION_DETECTED;
	psa_key_id_t key;
	psa_key_attributes_t attributes = PSA_KEY_ATTRIBUTES_INIT;
	psa_key_derivation_operation_t kdf = PSA_KEY_DERIVATION_OPERATION_INIT;

	psa_set_key_type(&attributes, PSA_KEY_TYPE_DERIVE);
	psa_set_key_usage_flags(&attributes, PSA_KEY_USAGE_DERIVE);
	psa_set_key_algorithm(&attributes, PSA_ALG_TLS12_ECJPAKE_TO_PMS);

	status = psa_pake_get_shared_key(op, &attributes, &key);
	if (status != PSA_SUCCESS) {
		LOG_INF("psa_pake_get_shared_key failed. (Error: %d)", status);
		return status;
	}

	status = psa_key_derivation_setup(&kdf, PSA_ALG_TLS12_ECJPAKE_TO_PMS);
	if (status != PSA_SUCCESS) {
		LOG_INF("psa_key_derivation_setup failed. (Error: %d)", status);
		return status;
	}

	status = psa_key_derivation_input_key(&kdf, PSA_KEY_DERIVATION_INPUT_SECRET, key);
	if (status != PSA_SUCCESS) {
		LOG_INF("psa_key_derivation_input_key failed. (Error: %d)", status);
		psa_key_derivation_abort(&kdf);
		return status;
	}

	status = psa_key_derivation_output_bytes(&kdf, key_buffer, key_buffer_size);
	if (status != PSA_SUCCESS) {
		LOG_INF("psa_key_derivation_output_bytes failed. (Error: %d)", status);
		psa_key_derivation_abort(&kdf);
		return status;
	}

	return PSA_SUCCESS;
}

int main(void)
{
	psa_status_t status = psa_crypto_init();

	LOG_INF("Starting EC J-PAKE example...");

	if (status != PSA_SUCCESS) {
		LOG_INF("psa_crypto_init failed. (Error: %d)", status);
	}

	psa_pake_cipher_suite_t cipher_suite = PSA_PAKE_CIPHER_SUITE_INIT;
	psa_pake_cs_set_algorithm(&cipher_suite, PSA_ALG_JPAKE(PSA_ALG_SHA_256));
	psa_pake_cs_set_primitive(&cipher_suite, PSA_PAKE_PRIMITIVE(PSA_PAKE_PRIMITIVE_TYPE_ECC,
								    PSA_ECC_FAMILY_SECP_R1, 256));
	psa_pake_cs_set_key_confirmation(&cipher_suite, PSA_PAKE_UNCONFIRMED_KEY);

	psa_key_attributes_t key_attributes = PSA_KEY_ATTRIBUTES_INIT;
	psa_set_key_usage_flags(&key_attributes, PSA_KEY_USAGE_DERIVE);
	psa_set_key_algorithm(&key_attributes, PSA_ALG_JPAKE(PSA_ALG_SHA_256));
	psa_set_key_type(&key_attributes, PSA_KEY_TYPE_PASSWORD);

	psa_key_id_t key;

	LOG_INF("Importing password key...");
	status = psa_import_key(&key_attributes, "password", 8, &key);
	if (status != PSA_SUCCESS) {
		LOG_INF("psa_import_key failed. (Error: %d)", status);
		goto error;
	}
	LOG_INF("Password key imported successfully!");

	/* Initialize PAKE operation object for the client.*/
	psa_pake_operation_t client = PSA_PAKE_OPERATION_INIT;

	status = pake_setup(&client, &cipher_suite, "client", "server", key);
	if (status != PSA_SUCCESS) {
		goto error;
	}

	/* Initialize PAKE operation object for the server. */
	psa_pake_operation_t server = PSA_PAKE_OPERATION_INIT;

	status = pake_setup(&server, &cipher_suite, "server", "client", key);
	if (status != PSA_SUCCESS) {
		goto error;
	}

	/* Perform the data exchange rounds */
	LOG_INF("Performing EC J-PAKE key exchange rounds...");
	status = do_rounds(&server, &client);
	if (status != PSA_SUCCESS) {
		LOG_INF("EC J-PAKE rounds failed. (Error: %d)", status);
		goto error;
	}
	LOG_INF("EC J-PAKE key exchange completed successfully!");

	/* Retrieve keys from J-PAKE results. */
	LOG_INF("Deriving shared secrets...");
	uint8_t server_secret[32];
	uint8_t client_secret[32];

	status = do_key_derivation(&server, server_secret, sizeof(server_secret));
	if (status != PSA_SUCCESS) {
		goto error;
	}

	status = do_key_derivation(&client, client_secret, sizeof(client_secret));
	if (status != PSA_SUCCESS) {
		goto error;
	}
	LOG_INF("Shared secrets derived successfully!");

	PRINT_HEX("server_secret", server_secret, sizeof(server_secret));
	PRINT_HEX("client_secret", client_secret, sizeof(client_secret));

	bool compare_eq = true;

	for (size_t i = 0; i < sizeof(server_secret); i++) {
		if (server_secret[i] != client_secret[i]) {
			compare_eq = false;
		}
	}

	if (!compare_eq) {
		LOG_ERR("Derived keys for server and client are not equal.");
		goto error;
	}

	LOG_INF("Shared secrets match!");
	LOG_INF(APP_SUCCESS_MESSAGE);
	return APP_SUCCESS;

error:
	LOG_INF(APP_ERROR_MESSAGE);
	psa_destroy_key(key);
	psa_pake_abort(&client);
	psa_pake_abort(&server);

	return APP_ERROR;
}
```
