## CMakeLists.txt
```
#
# Copyright (c) 2024 Nordic Semiconductor ASA
#
# SPDX-License-Identifier: LicenseRef-Nordic-5-Clause
#

cmake_minimum_required(VERSION 3.20.0)

find_package(Zephyr REQUIRED HINTS $ENV{ZEPHYR_BASE})

project(psa_its)

target_sources(app PRIVATE
  src/main.c
)

target_sources_ifdef(CONFIG_TRUSTED_STORAGE app PRIVATE
        src/trusted_storage_init.c
        )
```

## sample.yaml
```
sample:
  description: |
    This app provides an example of using ITS with the
    PSA APIs.
  name: ITS example
tests:
  sample.psa_its.cc3xx:
    sysbuild: true
    tags: introduction psa cc3xx sysbuild
    platform_allow: >
      nrf5340dk/nrf5340/cpuapp/ns nrf5340dk/nrf5340/cpuapp nrf9160dk/nrf9160/ns
      nrf9160dk/nrf9160 nrf52840dk/nrf52840 nrf9161dk/nrf9161 nrf9161dk/nrf9161/ns
      nrf9151dk/nrf9151 nrf9151dk/nrf9151/ns
    harness: console
    harness_config:
      type: multi_line
      regex:
        - ".*Example finished successfully!.*"
    integration_platforms:
      - nrf5340dk/nrf5340/cpuapp/ns
      - nrf5340dk/nrf5340/cpuapp
      - nrf9160dk/nrf9160/ns
      - nrf9160dk/nrf9160
      - nrf52840dk/nrf52840
      - nrf9161dk/nrf9161
      - nrf9161dk/nrf9161/ns
      - nrf9151dk/nrf9151
      - nrf9151dk/nrf9151/ns
  sample.psa_its.cracen:
    sysbuild: true
    tags: introduction psa cracen sysbuild
    platform_allow: >
      nrf54l15pdk/nrf54l15/cpuapp
      nrf54l15pdk/nrf54l15/cpuapp/ns
    harness: console
    harness_config:
      type: multi_line
      regex:
        - ".*Example finished successfully!.*"
    integration_platforms:
      - nrf54l15pdk/nrf54l15/cpuapp
      - nrf54l15pdk/nrf54l15/cpuapp/ns
```

## prj.conf
```kconfig
CONFIG_LOG=y

CONFIG_NRF_SECURITY=y
CONFIG_MBEDTLS_PSA_CRYPTO_C=y
CONFIG_MBEDTLS_PSA_CRYPTO_STORAGE_C=y

# The HW_UNIQUE_KEY library uses a lot of the main threads stack
CONFIG_MAIN_STACK_SIZE=4096
```

## boards/nrf52840dk_nrf52840.conf
```kconfig
#
# Copyright (c) 2024 Nordic Semiconductor ASA
#
# SPDX-License-Identifier: LicenseRef-Nordic-5-Clause
#
# Using hardware crypto accelerator
CONFIG_PSA_CRYPTO_DRIVER_OBERON=n
CONFIG_PSA_CRYPTO_DRIVER_CC3XX=y

CONFIG_FLASH=y
CONFIG_FLASH_PAGE_LAYOUT=y
CONFIG_FLASH_MAP=y
CONFIG_NVS=y
CONFIG_SETTINGS=y
CONFIG_SETTINGS_NVS=y
CONFIG_TRUSTED_STORAGE=y

CONFIG_REBOOT=y
```

## boards/nrf54l15pdk_nrf54l15_cpuapp.conf
```kconfig
#
# Copyright (c) 2024 Nordic Semiconductor ASA
#
# SPDX-License-Identifier: LicenseRef-Nordic-5-Clause
#
# Using hardware crypto accelerator
CONFIG_PSA_CRYPTO_DRIVER_OBERON=n
CONFIG_PSA_CRYPTO_DRIVER_CRACEN=y

CONFIG_FLASH=y
CONFIG_FLASH_PAGE_LAYOUT=y
CONFIG_FLASH_MAP=y
CONFIG_NVS=y
CONFIG_SETTINGS=y
CONFIG_SETTINGS_NVS=y
CONFIG_TRUSTED_STORAGE=y

# Comment out for more detailed NVS logging
CONFIG_NVS_LOG_LEVEL_ERR=y
```

## boards/nrf9160dk_nrf9160.conf
```kconfig
#
# Copyright (c) 2024 Nordic Semiconductor ASA
#
# SPDX-License-Identifier: LicenseRef-Nordic-5-Clause
#
# Using hardware crypto accelerator
CONFIG_PSA_CRYPTO_DRIVER_OBERON=n
CONFIG_PSA_CRYPTO_DRIVER_CC3XX=y

CONFIG_FLASH=y
CONFIG_FLASH_PAGE_LAYOUT=y
CONFIG_FLASH_MAP=y
CONFIG_NVS=y
CONFIG_SETTINGS=y
CONFIG_SETTINGS_NVS=y
CONFIG_TRUSTED_STORAGE=y

# Comment out for more detailed NVS logging
CONFIG_NVS_LOG_LEVEL_ERR=y
```

## src/main.c
```c
/*
 * Copyright (c) 2024 Nordic Semiconductor ASA
 *
 * SPDX-License-Identifier: LicenseRef-Nordic-5-Clause
 */

#include <psa/crypto.h>
#include <psa/internal_trusted_storage.h>
#include <zephyr/logging/log.h>

#include "trusted_storage_init.h"

#define APP_SUCCESS	    (0)
#define APP_ERROR	    (-1)
#define APP_SUCCESS_MESSAGE "Example finished successfully!"

LOG_MODULE_REGISTER(psa_its, LOG_LEVEL_DBG);

int write_wrong_uid(void)
{
	psa_status_t status;

	LOG_INF("Verify that reading the wrong UID will fail");

	psa_storage_uid_t non_existent_uid = 0x5EB01234;

	/* Read from the start of the entry */
	uint32_t data_offset = 0;

	/* Read 4 bytes */
	uint32_t data_length = 4;

	/* Write the result from psa_its_get to p_data */
	uint8_t p_data[4];

	/* Number of bytes written to p_data */
	size_t p_data_length = 0x5EB0;

	status = psa_its_get(non_existent_uid, data_offset, data_length, p_data, &p_data_length);

	if (status == 0) {
		LOG_ERR("Expected psa_its_get with the wrong UID to fail, but it "
			"succeeded.");
		return APP_ERROR;
	}

	LOG_INF("psa_its_get correctly returned an error code when we intentionally read "
		"the wrong UID");

	return APP_SUCCESS;
}

int write_and_read(void)
{
	psa_status_t status;

	LOG_INF("Write to ITS and then check that we can read it back");

	psa_storage_uid_t new_uid = 0x5EB00000;

	/* Data to be written to ITS */
	uint8_t p_data_write[1] = {42};

	/* permission flags for ITS entry */
	psa_storage_create_flags_t create_flags = PSA_STORAGE_FLAG_NONE;

	status = psa_its_set(new_uid, sizeof(p_data_write), p_data_write, create_flags);

	if (status) {
		LOG_ERR("Unable to write to ITS");
		LOG_ERR("psa_its_get returned psa_status_t: %d", status);
		return APP_ERROR;
	}

	/* Write the 'new_uid' entry in ITS to this buffer */
	uint8_t p_data_read[1];

	/* Read from the start of the entry */
	uint32_t data_offset = 0;

	/* Read 1 byte */
	uint32_t data_length = 1;

	/* Number of bytes written to p_data */
	size_t p_data_length = 0xc0ffe;

	status = psa_its_get(new_uid, data_offset, data_length, p_data_read, &p_data_length);
	if (status) {
		LOG_ERR("Unable to read back from ITS");
		LOG_ERR("psa_its_get returned psa_status_t: %d", status);
		return APP_ERROR;
	}

	if (p_data_length != 1) {
		LOG_ERR("Unable to read the correct amount of bytes from ITS");
	}

	if (p_data_read[0] != 42) {
		LOG_ERR("Read the wrong value back from ITS");
	}

	LOG_INF("Successfully wrote to ITS and read back what was written");

	return APP_SUCCESS;
}

int main(void)
{
	LOG_INF("Starting PSA ITS example...");

#ifdef CONFIG_TRUSTED_STORAGE_BACKEND_AEAD_KEY_DERIVE_FROM_HUK
	write_huk();
#endif /* CONFIG_TRUSTED_STORAGE_BACKEND_AEAD_KEY_DERIVE_FROM_HUK */

	psa_status_t status = psa_crypto_init();

	if (status) {
		LOG_INF("psa_crypto_init failed");
		return 1;
	}

	status = write_wrong_uid();
	if (status) {
		return APP_ERROR;
	}

	status = write_and_read();
	if (status) {
		return APP_ERROR;
	}

	LOG_INF(APP_SUCCESS_MESSAGE);

	return APP_SUCCESS;
}
```

## src/trusted_storage_init.c
```c
/*
 * Copyright (c) 2024 Nordic Semiconductor ASA
 *
 * SPDX-License-Identifier: LicenseRef-Nordic-5-Clause
 */

#include "settings/settings_file.h"
#include <zephyr/device.h>
#include <zephyr/logging/log.h>

LOG_MODULE_REGISTER(psa_its_trusted_storage, LOG_LEVEL_DBG);

static int setup_settings_backend(void)
{
	int rc = settings_subsys_init();

	if (rc != 0) {
		LOG_ERR("%s failed (ret %d)", __func__, rc);
		return rc;
	}

	return 0;
}

SYS_INIT(setup_settings_backend, APPLICATION, CONFIG_APPLICATION_INIT_PRIORITY);

#ifdef CONFIG_TRUSTED_STORAGE_BACKEND_AEAD_KEY_DERIVE_FROM_HUK
#include <hw_unique_key.h>

#ifndef HUK_HAS_KMU
#include <zephyr/sys/reboot.h>
#endif

int write_huk(void)
{
	if (!hw_unique_key_are_any_written()) {
		LOG_INF("Writing random keys to KMU");
		int result = hw_unique_key_write_random();

		if (result != HW_UNIQUE_KEY_SUCCESS) {
			LOG_ERR("hw_unique_key_write_random returned error: %d", result);
			return 0;
		}
		LOG_INF("Success!");
#if !defined(HUK_HAS_KMU)
		/* Reboot to allow the bootloader to load the key into CryptoCell. */
		sys_reboot(0);
#endif /* !defined(HUK_HAS_KMU) */
	}

	return 0;
}
#endif /* CONFIG_TRUSTED_STORAGE_BACKEND_AEAD_KEY_DERIVE_FROM_HUK */
```

## src/trusted_storage_init.h
```c
/*
 * Copyright (c) 2024 Nordic Semiconductor ASA
 *
 * SPDX-License-Identifier: LicenseRef-Nordic-5-Clause
 */

#ifndef __TRUSTED_STORAGE_INIT_H_
#define __TRUSTED_STORAGE_INIT_H_

/* In case a HUK is used for the trusted_storage key */
#ifdef CONFIG_TRUSTED_STORAGE_BACKEND_AEAD_KEY_DERIVE_FROM_HUK
int write_huk(void);
#endif /* CONFIG_TRUSTED_STORAGE_BACKEND_AEAD_KEY_DERIVE_FROM_HUK */

#endif /* __TRUSTED_STORAGE_INIT_H_ */
```
