## samples/crypto/sha256/sample.yaml
```yaml
sample:
  description: |
    This sample demonstrates hash computation and verification using the SHA-256 hash algorithm.
  name: SHA-256 sample
tests:
  sample.sha256.cc3xx:
    sysbuild: true
    tags:
      - introduction
      - psa
      - cc3xx
      - sysbuild
      - ci_samples_crypto
    platform_allow:
      - nrf5340dk/nrf5340/cpuapp/ns
      - nrf5340dk/nrf5340/cpuapp
      - nrf9160dk/nrf9160/ns
      - nrf9160dk/nrf9160
      - nrf52840dk/nrf52840
      - nrf9161dk/nrf9161
      - nrf9161dk/nrf9161/ns
      - nrf9151dk/nrf9151
      - nrf9151dk/nrf9151/ns
    harness: console
    harness_config:
      type: multi_line
      regex:
        - ".*Example finished successfully!.*"
    integration_platforms:
      - nrf5340dk/nrf5340/cpuapp/ns
      - nrf5340dk/nrf5340/cpuapp
      - nrf9160dk/nrf9160/ns
      - nrf9160dk/nrf9160
      - nrf9161dk/nrf9161/ns
      - nrf9161dk/nrf9161
      - nrf52840dk/nrf52840
      - nrf9151dk/nrf9151
      - nrf9151dk/nrf9151/ns
  sample.sha256.oberon:
    sysbuild: true
    extra_args:
      - CONFIG_PSA_CRYPTO_DRIVER_OBERON=y
      - CONFIG_PSA_CRYPTO_DRIVER_CRACEN=n
    tags:
      - introduction
      - psa
      - oberon
      - sysbuild
      - ci_samples_crypto
    platform_allow:
      - nrf5340dk/nrf5340/cpunet
      - nrf54l15dk/nrf54l15/cpuapp
    harness: console
    harness_config:
      type: multi_line
      regex:
        - .*Example finished successfully!.*
    integration_platforms:
      - nrf5340dk/nrf5340/cpunet
      - nrf54l15dk/nrf54l15/cpuapp
  sample.sha256.cracen:
    sysbuild: true
    tags:
      - introduction
      - psa
      - cracen
      - sysbuild
      - ci_samples_crypto
    platform_allow:
      - nrf54l15dk/nrf54l15/cpuapp
      - nrf54l15dk/nrf54l15/cpuapp/ns
      - nrf54l15dk/nrf54l10/cpuapp
      - nrf54l15dk/nrf54l10/cpuapp/ns
      - nrf54l15dk/nrf54l05/cpuapp
      - nrf54ls05dk/nrf54ls05b/cpuapp
      - nrf54lm20dk/nrf54lm20a/cpuapp
      - nrf54lm20dk/nrf54lm20a/cpuapp/ns
      - nrf54lm20dk/nrf54lm20b/cpuapp
      - nrf54lm20dk/nrf54lm20b/cpuapp/ns
      - nrf54lv10dk/nrf54lv10a/cpuapp
      - nrf54lv10dk/nrf54lv10a/cpuapp/ns
      - nrf7120dk/nrf7120/cpuapp
      - nrf7120dk/nrf7120/cpuapp/ns
    harness: console
    harness_config:
      type: multi_line
      regex:
        - ".*Example finished successfully!.*"
    integration_platforms:
      - nrf54l15dk/nrf54l15/cpuapp
      - nrf54l15dk/nrf54l15/cpuapp/ns
      - nrf54l15dk/nrf54l10/cpuapp
      - nrf54l15dk/nrf54l10/cpuapp/ns
      - nrf54l15dk/nrf54l05/cpuapp
      - nrf54ls05dk/nrf54ls05b/cpuapp
      - nrf54lm20dk/nrf54lm20a/cpuapp
      - nrf54lm20dk/nrf54lm20a/cpuapp/ns
      - nrf54lm20dk/nrf54lm20b/cpuapp
      - nrf54lm20dk/nrf54lm20b/cpuapp/ns
      - nrf54lv10dk/nrf54lv10a/cpuapp
      - nrf54lv10dk/nrf54lv10a/cpuapp/ns
      - nrf7120dk/nrf7120/cpuapp
      - nrf7120dk/nrf7120/cpuapp/ns
  # Build integration regression protection.
  sample.nrf_security.sha256.integration:
    sysbuild: true
    build_only: true
    extra_args: SB_CONFIG_BOOTLOADER_MCUBOOT=y
    platform_allow:
      - nrf5340dk/nrf5340/cpuapp/ns
      - nrf52840dk/nrf52840
      - nrf52833dk/nrf52833
    integration_platforms:
      - nrf5340dk/nrf5340/cpuapp/ns
      - nrf52840dk/nrf52840
      - nrf52833dk/nrf52833
    tags:
      - sysbuild
      - ci_samples_crypto
  sample.newlib_libc.sha256:
    sysbuild: true
    build_only: true
    extra_args: CONFIG_NEWLIB_LIBC=y
    platform_allow:
      - nrf5340dk/nrf5340/cpuapp/ns
      - nrf52840dk/nrf52840
      - nrf54h20dk/nrf54h20/cpuapp
    integration_platforms:
      - nrf5340dk/nrf5340/cpuapp/ns
      - nrf52840dk/nrf52840
      - nrf54h20dk/nrf54h20/cpuapp
    tags:
      - sysbuild
      - ci_samples_crypto
  sample.sha256.cracen.crypto_service:
    sysbuild: true
    tags:
      - introduction
      - psa
      - cracen
      - sysbuild
      - crypto
      - ci_samples_crypto
    platform_allow:
      - nrf54h20dk/nrf54h20/cpuapp
    harness: console
    harness_config:
      type: multi_line
      regex:
        - ".*Example finished successfully!.*"
    integration_platforms:
      - nrf54h20dk/nrf54h20/cpuapp
```

## samples/crypto/spake2p/boards/nrf9151dk_nrf9151_ns.conf
```kconfig
#
# Copyright (c) 2024 Nordic Semiconductor ASA
#
# SPDX-License-Identifier: LicenseRef-Nordic-5-Clause
#
CONFIG_TFM_PROFILE_TYPE_NOT_SET=y
```

## samples/crypto/spake2p/boards/nrf9161dk_nrf9161.conf
```kconfig
#
# Copyright (c) 2024 Nordic Semiconductor ASA
#
# SPDX-License-Identifier: LicenseRef-Nordic-5-Clause
#
# Oberon is required for spake2+
CONFIG_PSA_CRYPTO_DRIVER_OBERON=y
CONFIG_PSA_CRYPTO_DRIVER_CC3XX=y

# Mbedtls configuration
CONFIG_MBEDTLS_ENABLE_HEAP=y
CONFIG_MBEDTLS_HEAP_SIZE=8192
```

## samples/crypto/spake2p/sample.yaml
```yaml
sample:
  description: This app provides an example of Spake2+
  name: Spake2+ example
tests:
  sample.spake2p.oberon:
    tags: introduction psa oberon
    platform_allow: >
      nrf5340dk/nrf5340/cpuapp nrf5340dk/nrf5340/cpuapp/ns
      nrf9160dk/nrf9160 nrf52840dk/nrf52840
      nrf9161dk/nrf9161 nrf9160dk/nrf9160/ns
      nrf9161dk/nrf9161/ns
    harness: console
    harness_config:
      type: multi_line
      regex:
        - ".*Example finished successfully!.*"
    integration_platforms:
      - nrf5340dk/nrf5340/cpuapp
      - nrf5340dk/nrf5340/cpuapp/ns
      - nrf9160dk/nrf9160
      - nrf9160dk/nrf9160/ns
      - nrf9161dk/nrf9161
      - nrf9161dk/nrf9161/ns
      - nrf52840dk/nrf52840
  sample.spake2p.cracen:
    tags: introduction psa cracen
    platform_allow: >
      nrf54l15pdk/nrf54l15/cpuapp
      nrf54l15pdk/nrf54l15/cpuapp/ns
      nrf54h20dk/nrf54h20/cpuapp
    harness: console
    harness_config:
      type: multi_line
      regex:
        - ".*Example finished successfully!.*"
    integration_platforms:
      - nrf54l15pdk/nrf54l15/cpuapp
      - nrf54l15pdk/nrf54l15/cpuapp/ns
      # nRF54H uses Oberon+fake entropy until crypto service is available from SDFW
      - nrf54h20dk/nrf54h20/cpuapp
```

## samples/debug/gpio_frontend/sample.yaml
```yaml
sample:
  description: Sample showing GPIO frontend
  name: GPIO frontend sample
tests:
  test_build:
    build_only: true
    build_on_all: true
    platform_whitelist: nrf52_pca10040 nrf52840_pca10056 nrf9160_pca10090
    tags: ci_build
```

## samples/debug/memfault/Kconfig
```kconfig
#
# Copyright (c) 2021 Nordic Semiconductor ASA
#
# SPDX-License-Identifier: LicenseRef-Nordic-5-Clause
#

menu "Zephyr Kernel"
source "Kconfig.zephyr"
endmenu

module = MEMFAULT_SAMPLE
module-str = Memfault sample
source "${ZEPHYR_BASE}/subsys/logging/Kconfig.template.log_config"
```

## samples/debug/memfault/Kconfig.sysbuild
```kconfig
#
# Copyright (c) 2024 Nordic Semiconductor
#
# SPDX-License-Identifier: LicenseRef-Nordic-5-Clause
#

config WIFI_NRF70
	default y if BOARD_NRF7002DK_NRF5340_CPUAPP

config PARTITION_MANAGER
	default n if !BOARD_THINGY91X && !BOARD_THINGY91

source "share/sysbuild/Kconfig"
```

## samples/debug/memfault/boards/nrf7002dk_nrf5340_cpuapp.conf
```kconfig
#
# Copyright (c) 2023 Nordic Semiconductor ASA
#
# SPDX-License-Identifier: LicenseRef-Nordic-5-Clause
#

# General
CONFIG_NEWLIB_LIBC=y
CONFIG_POSIX_CLOCK=y
CONFIG_SYSTEM_WORKQUEUE_STACK_SIZE=4096
CONFIG_HEAP_MEM_POOL_SIZE=153600
CONFIG_HW_STACK_PROTECTION=y
CONFIG_HW_ID_LIBRARY=y
CONFIG_HW_ID_LIBRARY_SOURCE_NET_MAC=y

# Heap and stacks
CONFIG_HEAP_MEM_POOL_SIZE=8192
CONFIG_MAIN_STACK_SIZE=4096
CONFIG_SYSTEM_WORKQUEUE_STACK_SIZE=2048
CONFIG_MAIN_STACK_SIZE=4096
CONFIG_SHELL_STACK_SIZE=4096
CONFIG_SYSTEM_WORKQUEUE_STACK_SIZE=2048
CONFIG_NET_TX_STACK_SIZE=4096
CONFIG_NET_RX_STACK_SIZE=4096

# Network
CONFIG_NET_SOCKETS=y
CONFIG_NET_L2_ETHERNET=y
CONFIG_NET_TCP=y
CONFIG_NET_TCP_WORKQ_STACK_SIZE=2048
CONFIG_NET_UDP=y
CONFIG_NET_SOCKETS_OFFLOAD=n
CONFIG_NET_DHCPV4=y
CONFIG_NET_CONTEXT_SNDTIMEO=y
CONFIG_NET_MGMT_EVENT_STACK_SIZE=4096
CONFIG_NET_SOCKETS_SOCKOPT_TLS=y
CONFIG_NET_STATISTICS=y
CONFIG_NET_STATISTICS_WIFI=y
CONFIG_NET_STATISTICS_USER_API=y
CONFIG_NET_PKT_RX_COUNT=8
CONFIG_NET_PKT_TX_COUNT=8
CONFIG_NET_MAX_CONTEXTS=5
CONFIG_NET_CONTEXT_SYNC_RECV=y

# DNS
CONFIG_DNS_RESOLVER=y

# printing of scan results puts pressure on queues in new locking
# design in net_mgmt. So, use a typical number of networks in a crowded
# environment as the queue depth.
CONFIG_NET_MGMT_EVENT_QUEUE_SIZE=150

# Below section is the primary contributor to SRAM and is currently
# not optimized for size.
CONFIG_NET_BUF_RX_COUNT=16
CONFIG_NET_BUF_TX_COUNT=64
CONFIG_NET_BUF_DATA_SIZE=128
CONFIG_HEAP_MEM_POOL_SIZE=153600
CONFIG_NET_TC_TX_COUNT=1

# Wi-Fi
CONFIG_WIFI=y
CONFIG_WIFI_NRF700X=y
CONFIG_WIFI_NRF700X_LOG_LEVEL_ERR=y
CONFIG_WIFI_MGMT_EXT=y
CONFIG_NET_L2_WIFI_SHELL=y
CONFIG_NET_SHELL=y
CONFIG_WIFI_CREDENTIALS=y

# Shell
CONFIG_SHELL=y
CONFIG_SHELL_STACK_SIZE=6144

# WPA
CONFIG_WPA_SUPP=y
CONFIG_WPA_SUPP_LOG_LEVEL_INF=y

# Settings subsystem
CONFIG_NVS=y
CONFIG_SETTINGS=y
CONFIG_SETTINGS_NVS=y

# Native network stack
CONFIG_NRF_SECURITY=y
CONFIG_PSA_CRYPTO_DRIVER_CC3XX=n
CONFIG_MBEDTLS=y
CONFIG_MBEDTLS_ENABLE_HEAP=y
CONFIG_MBEDTLS_HEAP_SIZE=120000
CONFIG_MBEDTLS_RSA_C=y
CONFIG_MBEDTLS_SSL_SERVER_NAME_INDICATION=y

# Certificate management
CONFIG_MEMFAULT_ROOT_CERT_STORAGE_TLS_CREDENTIAL_STORAGE=y
CONFIG_MEMFAULT_NCS_PROVISION_CERTIFICATES=y

# The sample enables flash storage for coredumps, which depend on the parition manager.
# By default, nRF7002DK builds are for a single image, so the partition manager must be enabled
# also for single image builds.
CONFIG_PM_SINGLE_IMAGE=y

# Zephyr NET Connection Manager Connectivity layer.
CONFIG_L2_WIFI_CONNECTIVITY=y
CONFIG_L2_WIFI_CONNECTIVITY_AUTO_CONNECT=n
CONFIG_L2_WIFI_CONNECTIVITY_AUTO_DOWN=n

CONFIG_NET_CONNECTION_MANAGER_MONITOR_STACK_SIZE=4096
```

## samples/debug/memfault/boards/nrf9160dk_nrf9160_ns.conf
```kconfig
#
# Copyright (c) 2023 Nordic Semiconductor ASA
#
# SPDX-License-Identifier: LicenseRef-Nordic-5-Clause
#

# Network
CONFIG_NET_SOCKETS=y
CONFIG_NET_SOCKETS_OFFLOAD=y

# Modem related configurations
CONFIG_NRF_MODEM_LIB_NET_IF_AUTO_START=n
CONFIG_NRF_MODEM_LIB_ON_FAULT_APPLICATION_SPECIFIC=y

# Memfault
CONFIG_MEMFAULT_NCS_LTE_METRICS=y
CONFIG_MODEM_INFO=y

# Certificate management
CONFIG_MEMFAULT_ROOT_CERT_STORAGE_NRF9160_MODEM=y
CONFIG_MODEM_KEY_MGMT=y

# AT command capability in shell
CONFIG_AT_SHELL=y
CONFIG_SHELL_WILDCARD=n

# Zephyr NET Connection Manager and Connectivity layer.
CONFIG_NRF_MODEM_LIB_NET_IF=y
CONFIG_NRF_MODEM_LIB_NET_IF_AUTO_DOWN=n

# Disable Duplicate Address Detection (DAD)
# due to not being properly implemented for offloaded interfaces.
CONFIG_NET_IPV6_NBR_CACHE=n
CONFIG_NET_IPV6_MLD=n
```

## samples/debug/memfault/boards/nrf9161dk_nrf9161_ns.conf
```kconfig
#
# Copyright (c) 2023 Nordic Semiconductor ASA
#
# SPDX-License-Identifier: LicenseRef-Nordic-5-Clause
#

# Modem library
CONFIG_NRF_MODEM_LIB=y

# LTE link control
CONFIG_LTE_LINK_CONTROL=y
CONFIG_LTE_NETWORK_MODE_LTE_M_NBIOT=y
CONFIG_PDN=y
CONFIG_PDN_ESM_STRERROR=y

# Network
CONFIG_NET_NATIVE=n
CONFIG_NET_SOCKETS=y
CONFIG_NET_SOCKETS_OFFLOAD=y

# Memfault
CONFIG_MEMFAULT_NCS_LTE_METRICS=y

# Certificate management
CONFIG_MEMFAULT_ROOT_CERT_STORAGE_NRF9160_MODEM=y
CONFIG_MODEM_KEY_MGMT=y

# AT command capability in shell
CONFIG_AT_SHELL=y
CONFIG_SHELL_WILDCARD=n
```

## samples/debug/ppi_trace/Kconfig
```kconfig
# Config options for PPI trace sample
#
# Copyright (c) 2019 Nordic Semiconductor ASA
#
# SPDX-License-Identifier: LicenseRef-Nordic-5-Clause
#

mainmenu "PPI trace sample"

menu "PPI trace pins configuration"

config PPI_TRACE_PIN_RTC_COMPARE_EVT
	int "Trace pin for RTC Compare event"
	default 10 if BOARD_NRF9160DK_NRF9160 || BOARD_NRF9160DK_NRF9160_NS
	default 1 if BOARD_NRF51DK_NRF51422
	default 3
	help
	  Pin is toggled when an RTC Compare event occurs.

config PPI_TRACE_PIN_RTC_TICK_EVT
	int "Trace pin for RTC Tick event"
	default 11 if BOARD_NRF9160DK_NRF9160 || BOARD_NRF9160DK_NRF9160_NS
	default 2 if BOARD_NRF51DK_NRF51422
	default 4
	help
	  Pin is toggled when an RTC Tick event occurs.

config PPI_TRACE_PIN_LFCLOCK_STARTED_EVT
	int "Trace pin for LFCLOCK Started event"
	default 12 if BOARD_NRF9160DK_NRF9160 || BOARD_NRF9160DK_NRF9160_NS
	default 3 if BOARD_NRF51DK_NRF51422
	default 28
	help
	  Pin is toggled when an LFCLOCK Started event occurs.

config USE_BLUETOOTH_RADIO_EVENTS
	bool
	default y
	select BT
	depends on SOC_SERIES_NRF52X

if USE_BLUETOOTH_RADIO_EVENTS

config PPI_TRACE_PIN_RADIO_ACTIVE
	int "Trace pin for radio activity"
	default 29
	help
	  Pin is high when the radio is active.

endif # USE_BLUETOOTH_RADIO_EVENTS

endmenu

source "Kconfig.zephyr"
```

## samples/debug/ppi_trace/Kconfig.sysbuild
```kconfig
#
# Copyright (c) 2024 Nordic Semiconductor
#
# SPDX-License-Identifier: LicenseRef-Nordic-5-Clause
#

config PARTITION_MANAGER
	default n if !BOARD_THINGY91X && !BOARD_THINGY91

source "share/sysbuild/Kconfig"
```

## samples/debug/ppi_trace/boards/nrf21540dk_nrf52840.conf
```kconfig
CONFIG_BT_LL_SW_SPLIT=y

# CC310 is disabled to speed up bootup time
CONFIG_HW_CC3XX=n
CONFIG_ENTROPY_CC3XX=n
CONFIG_ENTROPY_NRF5_RNG=y
```

## samples/debug/ppi_trace/boards/nrf52840dk_nrf52840.conf
```kconfig
CONFIG_BT_LL_SW_SPLIT=y

#CC310 is disabled to speed up bootup time
CONFIG_HW_CC3XX=n
```

## samples/debug/ppi_trace/sample.yaml
```yaml
sample:
  description: Sample showing PPI trace
  name: PPI trace sample
tests:
  sample.debug.ppi_trace:
    sysbuild: true
    build_only: true
    integration_platforms:
      - nrf52840dk/nrf52840
      - nrf9160dk/nrf9160
    platform_allow: nrf52dk/nrf52832 nrf52840dk/nrf52840 nrf9160dk/nrf9160 nrf21540dk/nrf52840
    tags: ci_build sysbuild
```

## samples/dect/dect_phy/dect_shell/Kconfig
```kconfig
#
# Copyright (c) 2024 Nordic Semiconductor ASA
#
# SPDX-License-Identifier: LicenseRef-Nordic-5-Clause
#

source "Kconfig.zephyr"

menu "Nordic Dect NR+ Phy Shell config"

config DESH_PRINT_BUFFER_SIZE
	int "Buffer size used when printing shell output"
	default 1024
	help
	  If the printed string exceeds this buffer, an error message is printed first and
	  then the requested string cut into the length of this buffer.

config DESH_DECT_PHY
	bool "DECT NR+ PHY api shell tools"
	default y
	help
	  DECT NR+ PHY api shell tools

config DESH_STARTUP_CMDS
	bool "Possibility to run stored shell commands from settings after bootup"
	default y

endmenu
```

## samples/dect/dect_phy/hello_dect/Kconfig
```kconfig
#
# Copyright (c) 2024 Nordic Semiconductor
#
# SPDX-License-Identifier: LicenseRef-Nordic-5-Clause
#

config CARRIER
	int "Carrier to use"
	default 0
	help
	   The availability of the channels and the exact regulation to use them varies in different countries.
	   See ETSI TS 103 636-2 5.4.2 for the calculation.
	   Band index 1 is set when the carrier is within the range of 525 to 551.
	   This is the only range allowed for band index 1 as other carriers will interfere with other radio devices, including LTE devices.

config NETWORK_ID
	int "Network ID"
	range 1 4294967295
	default 91

config MCS
	int "MCS"
	default 1
	help
	   The MCS impacts how much data can fit into each subslot.

config TX_POWER
	int "TX power"
	range 0 13
	default 13
	help
	   Transmission power, max 19 dBm due to hardware limitations.
	   See table 6.2.1-3 of ETSI TS 103 636-4 v1.5.1.

config TX_TRANSMISSIONS
	int "TX transmissions"
	range 0 4294967295
	default 30
	help
	   Transmissions before sample exits, use 0 to transmit forever.

config RX_PERIOD_S
	int "RX period"
	default 5
	help
	   Receive window period.
	   Time is given in seconds.

module = DECT_PHY_HELLO
module-str = DECT NR+ PHY Hello
source "${ZEPHYR_BASE}/subsys/logging/Kconfig.template.log_config"

menu "Zephyr Kernel"
source "Kconfig.zephyr"
endmenu
```
