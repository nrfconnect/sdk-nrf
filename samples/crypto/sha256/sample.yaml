## samples/dect/dect_shell/Kconfig.native_tls
```kconfig
#
# Copyright (c) 2026 Nordic Semiconductor ASA
#
# SPDX-License-Identifier: LicenseRef-Nordic-5-Clause

config SAMPLE_DESH_NATIVE_TLS
	bool "Custom ``AT%CMNG`` command to store credentials for native TLS"
	default n
	select AT_CMD_CUSTOM
	help
	  Enable the custom ``AT%CMNG`` command to store TLS credentials for native TLS usage.
	  When enabled, you can use the ``AT%CMNG`` command to store TLS credentials
	  (CA certificate, client certificate, private key) in the secure storage or
	  in settings with MQTT/TLS, from where native TLS (Mbed TLS) can load them when
	  establishing a TLS connection.

if SAMPLE_DESH_NATIVE_TLS

config SAMPLE_DESH_NATIVE_TLS_CREDENTIAL_BUFFER_SIZE
	int "Buffer space reserved for loading credentials"
	default 4096
	help
	  Buffer space available for a single ``sec_tag`` when loading credentials for Mbed TLS.

config SAMPLE_DESH_NATIVE_TLS_CREDENTIAL_BUFFER_COUNT
	int "Number of buffers for loading credentials"
	default 1
	range 1 2
	help
	  Number of buffers available for loading ``sec_tag`` credentials for Mbed TLS.
	  The TLS client needs the buffer only when connecting, whereas the TLS server needs
	  the buffer as long as it is running.
	  Increase the value if you need TLS client and server running simultaneously
	  with different ``sec_tags``.

endif
```

## samples/dect/dect_shell/boards/nrf9151dk_nrf9151_ns_sm.conf
```kconfig
# nRF9151 Serial Modem (SM) configuration
# This overlay enables PPP connectivity through a Serial Modem

# UART configuration
CONFIG_UART_ASYNC_API=y
CONFIG_UART_1_ASYNC=y
CONFIG_UART_1_INTERRUPT_DRIVEN=n

# Modem CMUX configuration (aligned with SM application)
CONFIG_MODEM_CMUX_MTU=127
CONFIG_MODEM_CMUX_WORK_BUFFER_SIZE_EXTRA=2048
CONFIG_MODEM_CELLULAR_UART_BUFFER_SIZES=6000

# Modem driver
CONFIG_MODEM=y
CONFIG_MODEM_CELLULAR=y
CONFIG_MODEM_CELLULAR_PERIODIC_SCRIPT_MS=20000
CONFIG_MODEM_BACKEND_UART_ASYNC=y
CONFIG_MODEM_BACKEND_UART_ASYNC_HWFC=y
CONFIG_MODEM_AT_SHELL=n
CONFIG_MODEM_STATS=y

# Power management
CONFIG_PM_DEVICE=y
CONFIG_PM_DEVICE_RUNTIME=y
CONFIG_PM_DEVICE_RUNTIME_USE_DEDICATED_WQ=y
CONFIG_PM_DEVICE_SHELL=y

# Networking
CONFIG_NETWORKING=y
CONFIG_NET_NATIVE=y
CONFIG_NET_L2_PPP=y
CONFIG_NET_UDP=y
CONFIG_NET_SOCKETS=y
CONFIG_NET_CONTEXT_RCVTIMEO=y
CONFIG_NET_SOCKETS_OFFLOAD=n

# Network shell
CONFIG_NET_SHELL=y
CONFIG_NET_STATISTICS_USER_API=y

# Network management
CONFIG_NET_MGMT=y
CONFIG_NET_MGMT_EVENT=y
CONFIG_NET_CONNECTION_MANAGER=y

# DNS (using PPP DNS option)
CONFIG_DNS_RESOLVER=y
CONFIG_NET_L2_PPP_OPTION_DNS_USE=y

# Shell
CONFIG_SHELL=y

# Logging
CONFIG_LOG=y
CONFIG_LOG_BACKEND_UART=y
CONFIG_MODEM_MODULES_LOG_LEVEL_INF=y
CONFIG_MODEM_LOG_LEVEL_INF=y
```

## samples/dect/hello_dect/Kconfig
```kconfig
#
# Copyright (c) 2025 Nordic Semiconductor ASA
#
# SPDX-License-Identifier: LicenseRef-Nordic-5-Clause
#

source "Kconfig.zephyr"

menu "Hello DECT sample configuration"

config HELLO_DECT_MAC_DEMO_INTERVAL
	int "Demo message interval in seconds"
	default 30
	help
	  Interval in seconds for sending demo messages when connected.

module=HELLO_DECT_MAC
module-str=Hello DECT sample application
source "${ZEPHYR_BASE}/subsys/logging/Kconfig.template.log_config"

endmenu
```

## samples/dect/hello_dect/sample.yaml
```yaml
sample:
  name: Hello DECT sample
  description: Simple DECT NR+ sample application demonstrating connection manager usage
common:
  tags:
    - ci_build
    - sysbuild
    - ci_samples_dect
  sysbuild: true
  build_only: true
  integration_platforms:
    - nrf9151dk/nrf9151/ns
  platform_allow:
    - nrf9151dk/nrf9151/ns
tests:
  sample.dect.hello_dect.ft_device_default: {}
  sample.dect.hello_dect.ft_device:
    extra_args: EXTRA_CONF_FILE="ft.conf"
  sample.dect.hello_dect.ft_device_shell:
    extra_args: EXTRA_CONF_FILE="ft.conf;shell.conf"
  sample.dect.hello_dect.pt_device:
    extra_args: EXTRA_CONF_FILE="pt.conf"
```

## samples/dfu/ab/Kconfig.sysbuild
```kconfig
#
# Copyright (c) 2025 Nordic Semiconductor ASA
#
# SPDX-License-Identifier: LicenseRef-Nordic-5-Clause
#

if SOC_SERIES_NRF54H

# Enable radiocore
config NRF_DEFAULT_IPC_RADIO
	default y

config NETCORE_IPC_RADIO_BT_HCI_IPC
	default y

config MCUBOOT_IMAGES_ROM_END_OFFSET_AUTO
	default "ipc_radio;ipc_radio_secondary_app"

endif # SOC_SERIES_NRF54H

source "share/sysbuild/Kconfig"
```

## samples/dfu/ab/boards/nrf54l15dk_nrf54l15_cpuapp.conf
```kconfig
# Enable boot requests through retained memory.
CONFIG_RETAINED_MEM=y
CONFIG_RETENTION=y
```

## samples/dfu/ab/sample.yaml
```yaml
sample:
  description: AB update sample
  name: ab
common:
  sysbuild: true
  build_only: true
  tags:
    - dfu_ab
    - ci_samples_dfu

tests:
  sample.dfu.ab:
    platform_allow:
      - nrf54h20dk/nrf54h20/cpuapp
      - nrf54l15dk/nrf54l15/cpuapp
    integration_platforms:
      - nrf54h20dk/nrf54h20/cpuapp
      - nrf54l15dk/nrf54l15/cpuapp

  sample.dfu.ab.s2ram:
    extra_args:
      - mcuboot_CONFIG_SOC_EARLY_RESET_HOOK=y
      - CONFIG_PM=y
      - CONFIG_PM_DEVICE=y
      - CONFIG_PM_DEVICE_RUNTIME=y
      - CONFIG_POWEROFF=y
    platform_allow:
      - nrf54h20dk/nrf54h20/cpuapp
    integration_platforms:
      - nrf54h20dk/nrf54h20/cpuapp

  sample.dfu.ab.ironside_se_conf:
    platform_allow:
      - nrf54h20dk/nrf54h20/cpuapp
    integration_platforms:
      - nrf54h20dk/nrf54h20/cpuapp
    extra_args:
      - FILE_SUFFIX=ironside_se_conf
```
