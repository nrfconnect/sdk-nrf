## samples/crypto/psa_core_lite/Kconfig
```kconfig
#
# Copyright (c) 2025 Nordic Semiconductor ASA
#
# SPDX-License-Identifier: LicenseRef-Nordic-5-Clause
#
source "Kconfig.zephyr"

config PSA_CORE_LITE_USE_VERIFY_HASH
	bool
	prompt "Force usage of verify-hash"
	help
	  This configures the fake sample to use verify_hash instead of
	  verify_message
```

## samples/crypto/psa_core_lite/boards/nrf54l15dk_nrf54l15_cpuapp.conf
```kconfig
#
# Copyright (c) 2024 Nordic Semiconductor ASA
#
# SPDX-License-Identifier: LicenseRef-Nordic-5-Clause
#
CONFIG_PSA_CRYPTO_DRIVER_OBERON=n
CONFIG_PSA_CRYPTO_DRIVER_CRACEN=y
```

## samples/crypto/psa_core_lite/sample.yaml
```yaml
sample:
  description: |
    This app provides an example of PSA Crypto Lite
  name: PSA crypto lite example
tests:
  # Sample targets using EdDSA for signature validation
  sample.eddsa.cracen_lite:
    tags: introduction psa cracen sysbuild ci_samples_crypto
    platform_allow: >
      nrf54l15dk/nrf54l15/cpuapp
    harness: console
    harness_config:
      type: multi_line
      regex:
        - ".*Example finished successfully!.*"
    integration_platforms:
      - nrf54l15dk/nrf54l15/cpuapp
    sysbuild: true
    extra_args: >
      OVERLAY_CONFIG="overlays/lite.conf;overlays/eddsa.conf"
  sample.eddsa.cracen_normal:
    tags: introduction psa cracen sysbuild ci_samples_crypto
    platform_allow: >
      nrf54l15dk/nrf54l15/cpuapp
    harness: console
    harness_config:
      type: multi_line
      regex:
        - .*Example finished successfully!.*
    integration_platforms:
      - nrf54l15dk/nrf54l15/cpuapp
    sysbuild: true
    extra_args: >
      OVERLAY_CONFIG="overlays/eddsa.conf"
  sample.eddsa_hash.cracen_lite:
    tags: introduction psa cracen sysbuild ci_samples_crypto
    platform_allow: >
      nrf54l15dk/nrf54l15/cpuapp
    harness: console
    harness_config:
      type: multi_line
      regex:
        - ".*Example finished successfully!.*"
    integration_platforms:
      - nrf54l15dk/nrf54l15/cpuapp
    sysbuild: true
    extra_args: >
      OVERLAY_CONFIG="overlays/lite.conf;overlays/eddsa.conf;overlays/hash.conf"
  sample.eddsa_hash.cracen_normal:
    tags: introduction psa oberon sysbuild ci_samples_crypto
    platform_allow: >
      nrf54l15dk/nrf54l15/cpuapp
    harness: console
    harness_config:
      type: multi_line
      regex:
        - .*Example finished successfully!.*
    integration_platforms:
      - nrf54l15dk/nrf54l15/cpuapp
    extra_args: >
      OVERLAY_CONFIG="overlays/eddsa.conf;overlays/hash.conf"
  sample.eddsa_hash_encrypt.cracen_lite:
    tags: introduction psa cracen sysbuild ci_samples_crypto
    platform_allow: >
      nrf54l15dk/nrf54l15/cpuapp
    harness: console
    harness_config:
      type: multi_line
      regex:
        - ".*Example finished successfully!.*"
    integration_platforms:
      - nrf54l15dk/nrf54l15/cpuapp
    sysbuild: true
    extra_args: >
      OVERLAY_CONFIG="overlays/lite.conf;overlays/eddsa.conf;overlays/hash.conf;overlays/encrypt.conf"
  sample.eddsa_hash_encrypt.cracen_normal:
    tags: introduction psa oberon sysbuild ci_samples_crypto
    platform_allow: >
      nrf54l15dk/nrf54l15/cpuapp
    harness: console
    harness_config:
      type: multi_line
      regex:
        - .*Example finished successfully!.*
    integration_platforms:
      - nrf54l15dk/nrf54l15/cpuapp
    sysbuild: true
    extra_args: >
      OVERLAY_CONFIG="overlays/eddsa.conf;overlays/hash.conf;overlays/encrypt.conf;overlays/rng.conf"
  sample.eddsa_hash_encrypt_rng.cracen_lite:
    tags: introduction psa cracen sysbuild ci_samples_crypto
    platform_allow: >
      nrf54l15dk/nrf54l15/cpuapp
    harness: console
    harness_config:
      type: multi_line
      regex:
        - ".*Example finished successfully!.*"
    integration_platforms:
      - nrf54l15dk/nrf54l15/cpuapp
    sysbuild: true
    extra_args: >
      OVERLAY_CONFIG="overlays/lite.conf;overlays/eddsa.conf;overlays/hash.conf;overlays/encrypt.conf;overlays/rng.conf"
  sample.eddsa_hash_encrypt_rng.cracen_normal:
    tags: introduction psa oberon sysbuild ci_samples_crypto
    platform_allow: >
      nrf54l15dk/nrf54l15/cpuapp
    harness: console
    harness_config:
      type: multi_line
      regex:
        - .*Example finished successfully!.*
    integration_platforms:
      - nrf54l15dk/nrf54l15/cpuapp
    sysbuild: true
    extra_args: >
      OVERLAY_CONFIG="overlays/eddsa.conf;overlays/hash.conf;overlays/encrypt.conf;overlays/rng.conf"
  # Sample targets using ECDSA verify_message for signature validation
  sample.ecdsa.cracen_lite:
    tags: introduction psa cracen sysbuild ci_samples_crypto
    platform_allow: >
      nrf54l15dk/nrf54l15/cpuapp
    harness: console
    harness_config:
      type: multi_line
      regex:
        - ".*Example finished successfully!.*"
    integration_platforms:
      - nrf54l15dk/nrf54l15/cpuapp
    sysbuild: true
    extra_args: >
      OVERLAY_CONFIG="overlays/lite.conf;overlays/ecdsa.conf"
  sample.ecdsa.cracen_normal:
    tags: introduction psa cracen sysbuild ci_samples_crypto
    platform_allow: >
      nrf54l15dk/nrf54l15/cpuapp
    harness: console
    harness_config:
      type: multi_line
      regex:
        - .*Example finished successfully!.*
    integration_platforms:
      - nrf54l15dk/nrf54l15/cpuapp
    sysbuild: true
    extra_args: >
      OVERLAY_CONFIG="overlays/ecdsa.conf"
  sample.ecdsa_hash.cracen_lite:
    tags: introduction psa cracen sysbuild ci_samples_crypto
    platform_allow: >
      nrf54l15dk/nrf54l15/cpuapp
    harness: console
    harness_config:
      type: multi_line
      regex:
        - ".*Example finished successfully!.*"
    integration_platforms:
      - nrf54l15dk/nrf54l15/cpuapp
    sysbuild: true
    extra_args: >
      OVERLAY_CONFIG="overlays/lite.conf;overlays/ecdsa.conf;overlays/hash.conf"
  sample.ecdsa_hash.cracen_normal:
    tags: introduction psa oberon sysbuild ci_samples_crypto
    platform_allow: >
      nrf54l15dk/nrf54l15/cpuapp
    harness: console
    harness_config:
      type: multi_line
      regex:
        - .*Example finished successfully!.*
    integration_platforms:
      - nrf54l15dk/nrf54l15/cpuapp
    extra_args: >
      OVERLAY_CONFIG="overlays/ecdsa.conf;overlays/hash.conf"
  sample.ecdsa_hash_encrypt.cracen_lite:
    tags: introduction psa cracen sysbuild ci_samples_crypto
    platform_allow: >
      nrf54l15dk/nrf54l15/cpuapp
    harness: console
    harness_config:
      type: multi_line
      regex:
        - ".*Example finished successfully!.*"
    integration_platforms:
      - nrf54l15dk/nrf54l15/cpuapp
    sysbuild: true
    extra_args: >
      OVERLAY_CONFIG="overlays/lite.conf;overlays/ecdsa.conf;overlays/hash.conf;overlays/encrypt.conf"
  sample.ecdsa_hash_encrypt.cracen_normal:
    tags: introduction psa oberon sysbuild ci_samples_crypto
    platform_allow: >
      nrf54l15dk/nrf54l15/cpuapp
    harness: console
    harness_config:
      type: multi_line
      regex:
        - .*Example finished successfully!.*
    integration_platforms:
      - nrf54l15dk/nrf54l15/cpuapp
    sysbuild: true
    extra_args: >
      OVERLAY_CONFIG="overlays/ecdsa.conf;overlays/hash.conf;overlays/encrypt.conf;overlays/rng.conf"
  sample.ecdsa_hash_encrypt_rng.cracen_lite:
    tags: introduction psa cracen sysbuild ci_samples_crypto
    platform_allow: >
      nrf54l15dk/nrf54l15/cpuapp
    harness: console
    harness_config:
      type: multi_line
      regex:
        - ".*Example finished successfully!.*"
    integration_platforms:
      - nrf54l15dk/nrf54l15/cpuapp
    sysbuild: true
    extra_args: >
      OVERLAY_CONFIG="overlays/lite.conf;overlays/ecdsa.conf;overlays/hash.conf;overlays/encrypt.conf;overlays/rng.conf"
  sample.ecdsa_hash_encrypt_rng.cracen_normal:
    tags: introduction psa oberon sysbuild ci_samples_crypto
    platform_allow: >
      nrf54l15dk/nrf54l15/cpuapp
    harness: console
    harness_config:
      type: multi_line
      regex:
        - .*Example finished successfully!.*
    integration_platforms:
      - nrf54l15dk/nrf54l15/cpuapp
    sysbuild: true
    extra_args: >
      OVERLAY_CONFIG="overlays/ecdsa_verify_hash.conf;overlays/hash.conf;overlays/encrypt.conf;overlays/rng.conf"
  # Sample targets using ECDSA verify_hash for signature validation
  sample.ecdsa_verify_hash.cracen_lite:
    tags: introduction psa cracen sysbuild ci_samples_crypto
    platform_allow: >
      nrf54l15dk/nrf54l15/cpuapp
    harness: console
    harness_config:
      type: multi_line
      regex:
        - ".*Example finished successfully!.*"
    integration_platforms:
      - nrf54l15dk/nrf54l15/cpuapp
    sysbuild: true
    extra_args: >
      OVERLAY_CONFIG="overlays/lite.conf;overlays/ecdsa_verify_hash.conf"
```

## samples/crypto/psa_tls/Kconfig
```kconfig
#
# Copyright (c) 2021 Nordic Semiconductor
#
# SPDX-License-Identifier: LicenseRef-Nordic-5-Clause
#

source "Kconfig.zephyr"

menu "PSA TLS sample"

choice SAMPLE_PSA_TLS_CERTIFICATE_TYPE
	prompt "Certificate type"
	default SAMPLE_PSA_TLS_CERTIFICATE_TYPE_ECDSA
	help
	  Select the certificate type to use in the PSA TLS sample.

config SAMPLE_PSA_TLS_CERTIFICATE_TYPE_RSA
	bool "RSA certificate for the PSA TLS sample"
	help
	  Enable RSA certificates when testing ciphers that supports RSA for authentication.

config SAMPLE_PSA_TLS_CERTIFICATE_TYPE_ECDSA
	bool "ECDSA certificate for the PSA TLS sample"
	help
	  Enable ECDSA certificates when testing ciphers that supports ECDSA for authentication.

endchoice

choice SAMPLE_PSA_TLS_TYPE
	prompt "Server or client selection"
	default SAMPLE_PSA_TLS_TYPE_SERVER

config SAMPLE_PSA_TLS_TYPE_SERVER
	bool "Server functionality for the PSA TLS sample"
	help
	  When acting as a server, the sample waits for a connection from the client on port 4243.
	  After the TCP connection is established, the sample waits for the "ClientHello" message
	  from the client.

config SAMPLE_PSA_TLS_TYPE_CLIENT
	bool "Client functionality for the PSA TLS sample"
	help
	  When acting as a client, the sample tries to connect to the server on port 4243.
	  After the TCP connection is established, the sample automatically initiates the TLS handshake
	  by sending the "ClientHello" message.

endchoice

endmenu
```

## samples/crypto/psa_tls/Kconfig.sysbuild
```kconfig
#
# Copyright (c) 2025 Nordic Semiconductor
#
# SPDX-License-Identifier: LicenseRef-Nordic-5-Clause
#

config PARTITION_MANAGER
	default n if !BOARD_IS_NON_SECURE || SOC_SERIES_NRF53

source "share/sysbuild/Kconfig"
```

## samples/crypto/psa_tls/boards/nrf5340dk_nrf5340_cpuapp_ns.conf
```kconfig
#
# Copyright (c) 2024 Nordic Semiconductor ASA
#
# SPDX-License-Identifier: LicenseRef-Nordic-5-Clause
#
CONFIG_NRF_ENABLE_ICACHE=n
CONFIG_MBEDTLS_PSA_CRYPTO_C=y
```

## samples/crypto/psa_tls/boards/nrf54h20dk_nrf54h20_cpurad.conf
```kconfig
#
# Copyright (c) 2024 Nordic Semiconductor
#
# SPDX-License-Identifier: LicenseRef-Nordic-5-Clause
#

# Disable Oberon PSA crypto drivers
CONFIG_PSA_CRYPTO_DRIVER_OBERON=n

# Enable PSA crypto from SSF client
CONFIG_PSA_SSF_CRYPTO_CLIENT=y
CONFIG_SSF_PSA_CRYPTO_SERVICE_ENABLED=y
```

## samples/crypto/psa_tls/boards/nrf54l15pdk_nrf54l15_cpuapp_ns.conf
```kconfig
#
# Copyright (c) 2024 Nordic Semiconductor ASA
#
# SPDX-License-Identifier: LicenseRef-Nordic-5-Clause
#
CONFIG_TFM_PROFILE_TYPE_NOT_SET=y
CONFIG_NRF_ENABLE_ICACHE=n
CONFIG_MBEDTLS_USE_PSA_CRYPTO=y
CONFIG_MBEDTLS_PSA_CRYPTO_C=y

# The ECDSA CA certificate is stored persistently with Protected Storage,
# which internally uses Internal Trusted Storage. Since ITS encryption is
# enabled by default for nRF54L20, the sample must be configured with a
# larger ITS asset size than the default 500 bytes. This is because
# encrypted ITS assets must be stored in a single chunk.
CONFIG_TFM_ITS_MAX_ASSET_SIZE_OVERRIDE=y
CONFIG_TFM_ITS_MAX_ASSET_SIZE=600
```

## samples/crypto/psa_tls/boards/nrf54ls05dk_nrf54ls05a_cpuapp.conf
```kconfig
#
# Copyright (c) 2026 Nordic Semiconductor ASA
#
# SPDX-License-Identifier: LicenseRef-Nordic-5-Clause
#

# Mbed TLS heap configuration
CONFIG_MBEDTLS_ENABLE_HEAP=y
CONFIG_MBEDTLS_HEAP_SIZE=14484

# Reduce buffers and contexts to fit in the smaller RAM of nRF54LS05
CONFIG_NET_PKT_RX_COUNT=10
CONFIG_NET_PKT_TX_COUNT=10
CONFIG_NET_BUF_RX_COUNT=32
CONFIG_NET_BUF_TX_COUNT=32
```

## samples/crypto/psa_tls/boards/nrf9160dk_nrf9160_ns.conf
```kconfig
#
# Copyright (c) 2024 Nordic Semiconductor ASA
#
# SPDX-License-Identifier: LicenseRef-Nordic-5-Clause
#
CONFIG_NRF_ENABLE_ICACHE=n
CONFIG_MBEDTLS_PSA_CRYPTO_C=y

CONFIG_NRF_MODEM_LIB=n
CONFIG_FPU=y
```

## samples/crypto/psa_tls/boards/nrf9160dk_nrf9160ns.conf
```kconfig
CONFIG_BUILD_WITH_TFM=y
CONFIG_TFM_PARTITION_AUDIT_LOG=n
CONFIG_MBEDTLS_RSA_C=n
CONFIG_MBEDTLS_PKCS1_V15=n
CONFIG_TFM_BL2=n
CONFIG_NRF_ENABLE_ICACHE=n
CONFIG_PM_PARTITION_SIZE_BL2=0x0
CONFIG_MBEDTLS_PSA_CRYPTO_C=y
CONFIG_MBEDTLS_LIBRARY_NRF_SECURITY=y
```
