## samples/crypto/psa_tls/sample.yaml
```yaml
sample:
  description: |
    This sample demonstrates performing TLS handshake as either server or client.
  name: PSA TLS sample
common:
  sysbuild: true
  tags:
    - ci_build
    - sysbuild
    - ci_samples_crypto
  harness: console
  harness_config:
    type: multi_line
    ordered: true
    regex:
      - "Initializing network"
      - "psa_tls_sample: PSA TLS app started"
      - "psa_tls_credentials.* Registering"
      - "psa_tls_sample: Registering Pre-shared key"
      - "psa_.*(tls_client|tls_server).*TLS connection"
  timeout: 15
tests:
  ################################################################################
  ## ECDSA with Cryptocell and Oberon
  ################################################################################
  sample.psa_tls.tls_server.ecdsa.cc3xx_oberon:
    extra_args:
      EXTRA_CONF_FILE="overlays/server.conf;overlays/ecdsa_secp256r1.conf;overlays/tls_1_2_ecdsa.conf;overlays/cc3xx-oberon.conf"
    platform_allow: &cc3xx_oberon_platforms
      - nrf52840dk/nrf52840
      - nrf5340dk/nrf5340/cpuapp
      - nrf5340dk/nrf5340/cpuapp/ns
      - nrf9160dk/nrf9160
      - nrf9160dk/nrf9160/ns
      - nrf9161dk/nrf9161
      - nrf9161dk/nrf9161/ns
      - nrf9151dk/nrf9151
      - nrf9151dk/nrf9151/ns
    integration_platforms: &nrf5340_integration_platforms
      - nrf5340dk/nrf5340/cpuapp
      - nrf5340dk/nrf5340/cpuapp/ns
    tags:
      - cc3xx_oberon
  sample.psa_tls.dtls_server.ecdsa.cc3xx_oberon:
    extra_args:
      EXTRA_CONF_FILE="overlays/server.conf;overlays/ecdsa_secp256r1.conf;overlays/tls_1_2_ecdsa.conf;overlays/cc3xx-oberon.conf;overlays/dtls.conf"
    platform_allow: *cc3xx_oberon_platforms
    integration_platforms: &nrf9160_integration_platforms
      - nrf9160dk/nrf9160
      - nrf9160dk/nrf9160/ns
    tags:
      - dtls
      - cc3xx_oberon
  sample.psa_tls.tls_server_secp384r1.ecdsa.cc3xx_oberon:
    extra_args:
      EXTRA_CONF_FILE="overlays/server.conf;overlays/ecdsa_secp384r1.conf;overlays/tls_1_2_ecdsa.conf;overlays/cc3xx-oberon.conf"
    platform_allow: *cc3xx_oberon_platforms
    integration_platforms: &nrf9161_integration_platforms
      - nrf9161dk/nrf9161
      - nrf9161dk/nrf9161/ns
    tags:
      - cc3xx_oberon
      - secp384r1
  sample.psa_tls.dtls_server_secp384r1.ecdsa.cc3xx_oberon:
    extra_args:
      EXTRA_CONF_FILE="overlays/server.conf;overlays/ecdsa_secp384r1.conf;overlays/tls_1_2_ecdsa.conf;overlays/cc3xx-oberon.conf;overlays/dtls.conf"
    platform_allow: *cc3xx_oberon_platforms
    integration_platforms: &nrf9151_integration_platforms
      - nrf9151dk/nrf9151
      - nrf9151dk/nrf9151/ns
    tags:
      - dtls
      - cc3xx_oberon
      - secp384r1
  sample.psa_tls.tls_client.ecdsa.cc3xx_oberon:
    extra_args:
      EXTRA_CONF_FILE="overlays/client.conf;overlays/ecdsa_secp256r1.conf;overlays/tls_1_2_ecdsa.conf;overlays/cc3xx-oberon.conf"
    platform_allow: *cc3xx_oberon_platforms
    integration_platforms: &nrf52840_integration_platforms
      - nrf52840dk/nrf52840
    tags:
      - cc3xx_oberon
  sample.psa_tls.dtls_client.ecdsa.cc3xx_oberon:
    extra_args:
      EXTRA_CONF_FILE="overlays/client.conf;overlays/ecdsa_secp256r1.conf;overlays/tls_1_2_ecdsa.conf;overlays/cc3xx-oberon.conf;overlays/dtls.conf"
    platform_allow: *cc3xx_oberon_platforms
    integration_platforms: *nrf9161_integration_platforms
    tags:
      - dtls
      - cc3xx_oberon
  sample.psa_tls.tls_client_secp384r1.ecdsa.cc3xx_oberon:
    extra_args:
      EXTRA_CONF_FILE="overlays/client.conf;overlays/ecdsa_secp384r1.conf;overlays/tls_1_2_ecdsa.conf;overlays/cc3xx-oberon.conf"
    platform_allow: *cc3xx_oberon_platforms
    integration_platforms: *nrf9160_integration_platforms
    tags:
      - cc3xx_oberon
      - secp384r1
  sample.psa_tls.dtls_client_secp384r1.ecdsa.cc3xx_oberon:
    extra_args:
      EXTRA_CONF_FILE="overlays/client.conf;overlays/ecdsa_secp384r1.conf;overlays/tls_1_2_ecdsa.conf;overlays/cc3xx-oberon.conf;overlays/dtls.conf"
    platform_allow: *cc3xx_oberon_platforms
    integration_platforms: *nrf5340_integration_platforms
    tags:
      - dtls
      - cc3xx_oberon
      - secp384r1
  sample.psa_tls.tls_1_3_server.ecdsa.cc3xx_oberon:
    extra_args:
      EXTRA_CONF_FILE="overlays/server.conf;overlays/ecdsa_secp256r1.conf;overlays/tls_1_3_ecdsa.conf;overlays/cc3xx-oberon.conf"
    platform_allow: *cc3xx_oberon_platforms
    integration_platforms: *nrf5340_integration_platforms
    tags:
      - tls_1_3
      - cc3xx_oberon
  sample.psa_tls.tls_1_3_client.ecdsa.cc3xx_oberon:
    extra_args:
      EXTRA_CONF_FILE="overlays/client.conf;overlays/ecdsa_secp256r1.conf;overlays/tls_1_3_ecdsa.conf;overlays/cc3xx-oberon.conf"
    platform_allow: *cc3xx_oberon_platforms
    integration_platforms: *nrf9151_integration_platforms
    tags:
      - tls_1_3
      - cc3xx_oberon
  ################################################################################
  ## RSA with Cryptocell and Oberon
  ################################################################################
  sample.psa_tls.tls_server.rsa.cc3xx_oberon:
    extra_args:
      EXTRA_CONF_FILE="overlays/server.conf;overlays/tls_1_2_rsa.conf;overlays/cc3xx-oberon.conf"
    platform_allow: *cc3xx_oberon_platforms
    integration_platforms: *nrf5340_integration_platforms
    tags:
      - cc3xx_oberon
  sample.psa_tls.dtls_server.rsa.cc3xx_oberon:
    extra_args:
      EXTRA_CONF_FILE="overlays/server.conf;overlays/tls_1_2_rsa.conf;overlays/cc3xx-oberon.conf;overlays/dtls.conf"
    platform_allow: *cc3xx_oberon_platforms
    integration_platforms: *nrf9160_integration_platforms
    tags:
      - dtls
      - cc3xx_oberon
  sample.psa_tls.tls_client.rsa.cc3xx_oberon:
    extra_args:
      EXTRA_CONF_FILE="overlays/client.conf;overlays/tls_1_2_rsa.conf;overlays/cc3xx-oberon.conf"
    platform_allow: *cc3xx_oberon_platforms
    integration_platforms: *nrf9161_integration_platforms
    tags:
      - cc3xx_oberon
  sample.psa_tls.dtls_client.rsa.cc3xx_oberon:
    extra_args:
      EXTRA_CONF_FILE="overlays/client.conf;overlays/tls_1_2_rsa.conf;overlays/cc3xx-oberon.conf;overlays/dtls.conf"
    platform_allow: *cc3xx_oberon_platforms
    integration_platforms: *nrf9151_integration_platforms
    tags:
      - dtls
      - cc3xx_oberon
  sample.psa_tls.tls_1_3_server.rsa.cc3xx_oberon:
    extra_args:
      EXTRA_CONF_FILE="overlays/server.conf;overlays/tls_1_3_rsa.conf;overlays/cc3xx-oberon.conf"
    platform_allow: *cc3xx_oberon_platforms
    integration_platforms: *nrf9151_integration_platforms
    tags:
      - tls_1_3
      - cc3xx_oberon
  sample.psa_tls.tls_1_3_client.rsa.cc3xx_oberon:
    extra_args:
      EXTRA_CONF_FILE="overlays/client.conf;overlays/tls_1_3_rsa.conf;overlays/cc3xx-oberon.conf"
    platform_allow: *cc3xx_oberon_platforms
    integration_platforms: *nrf5340_integration_platforms
    tags:
      - tls_1_3
      - cc3xx_oberon
  ################################################################################
  ## ECDSA with Cracen
  ################################################################################
  sample.psa_tls.tls_server.ecdsa.cracen:
    extra_args:
      EXTRA_CONF_FILE="overlays/server.conf;overlays/ecdsa_secp256r1.conf;overlays/tls_1_2_ecdsa.conf;overlays/cracen.conf"
    platform_allow: &cracen_platforms
      - nrf54l15dk/nrf54l15/cpuapp
      - nrf54l15dk/nrf54l15/cpuapp/ns
      - nrf54lm20dk/nrf54lm20a/cpuapp
      - nrf54lm20dk/nrf54lm20a/cpuapp/ns
      - nrf54lm20dk/nrf54lm20b/cpuapp
      - nrf54lm20dk/nrf54lm20b/cpuapp/ns
      - nrf54lv10dk/nrf54lv10a/cpuapp
      - nrf54lv10dk/nrf54lv10a/cpuapp/ns
      - nrf54lc10dk/nrf54lc10a/cpuapp
      - nrf54l15dk/nrf54l10/cpuapp
      - nrf54l15dk/nrf54l10/cpuapp/ns
      - nrf7120dk/nrf7120/cpuapp
      - nrf7120dk/nrf7120/cpuapp/ns
    integration_platforms: &nrf54l15_integration_platforms
      - nrf54l15dk/nrf54l15/cpuapp
      - nrf54l15dk/nrf54l15/cpuapp/ns
    tags:
      - cracen
  sample.psa_tls.dtls_server.ecdsa.cracen:
    extra_args:
      EXTRA_CONF_FILE="overlays/server.conf;overlays/ecdsa_secp256r1.conf;overlays/tls_1_2_ecdsa.conf;overlays/cracen.conf;overlays/dtls.conf"
    platform_allow: *cracen_platforms
    integration_platforms: &nrf54lm20b_integration_platforms
      - nrf54lm20dk/nrf54lm20b/cpuapp
      - nrf54lm20dk/nrf54lm20b/cpuapp/ns
    tags:
      - dtls
      - cracen
  sample.psa_tls.tls_client.ecdsa.cracen:
    extra_args:
      EXTRA_CONF_FILE="overlays/client.conf;overlays/ecdsa_secp256r1.conf;overlays/tls_1_2_ecdsa.conf;overlays/cracen.conf"
    platform_allow: *cracen_platforms
    integration_platforms: &nrf54lv10a_integration_platforms
      - nrf54lv10dk/nrf54lv10a/cpuapp
      - nrf54lv10dk/nrf54lv10a/cpuapp/ns
    tags:
      - cracen
  sample.psa_tls.dtls_client.ecdsa.cracen:
    extra_args:
      EXTRA_CONF_FILE="overlays/client.conf;overlays/ecdsa_secp256r1.conf;overlays/tls_1_2_ecdsa.conf;overlays/cracen.conf;overlays/dtls.conf"
    platform_allow: *cracen_platforms
    integration_platforms: *nrf54l15_integration_platforms
    tags:
      - dtls
      - cracen
  sample.psa_tls.tls_server_secp384r1.ecdsa.cracen:
    extra_args:
      EXTRA_CONF_FILE="overlays/server.conf;overlays/ecdsa_secp384r1.conf;overlays/tls_1_2_ecdsa.conf;overlays/cracen.conf"
    platform_allow: *cracen_platforms
    integration_platforms: *nrf54lm20b_integration_platforms
    tags:
      - cracen
      - secp384r1
  sample.psa_tls.dtls_server_secp384r1.ecdsa.cracen:
    extra_args:
      EXTRA_CONF_FILE="overlays/server.conf;overlays/ecdsa_secp384r1.conf;overlays/tls_1_2_ecdsa.conf;overlays/cracen.conf;overlays/dtls.conf"
    platform_allow: *cracen_platforms
    integration_platforms: *nrf54lv10a_integration_platforms
    tags:
      - dtls
      - cracen
      - secp384r1
  sample.psa_tls.tls_client_secp384r1.ecdsa.cracen:
    extra_args:
      EXTRA_CONF_FILE="overlays/client.conf;overlays/ecdsa_secp384r1.conf;overlays/tls_1_2_ecdsa.conf;overlays/cracen.conf"
    platform_allow: *cracen_platforms
    integration_platforms: *nrf54lm20b_integration_platforms
    tags:
      - cracen
      - secp384r1
  sample.psa_tls.dtls_client_secp384r1.ecdsa.cracen:
    extra_args:
      EXTRA_CONF_FILE="overlays/client.conf;overlays/ecdsa_secp384r1.conf;overlays/tls_1_2_ecdsa.conf;overlays/cracen.conf;overlays/dtls.conf"
    platform_allow: *cracen_platforms
    integration_platforms: *nrf54l15_integration_platforms
    tags:
      - dtls
      - cracen
      - secp384r1
  sample.psa_tls.tls_1_3_server.ecdsa.cracen:
    extra_args:
      EXTRA_CONF_FILE="overlays/server.conf;overlays/ecdsa_secp256r1.conf;overlays/tls_1_3_ecdsa.conf;overlays/cracen.conf"
    platform_allow: *cracen_platforms
    integration_platforms: *nrf54lv10a_integration_platforms
    tags:
      - tls_1_3
      - cracen
  sample.psa_tls.tls_1_3_client.ecdsa.cracen:
    extra_args:
      EXTRA_CONF_FILE="overlays/client.conf;overlays/ecdsa_secp256r1.conf;overlays/tls_1_3_ecdsa.conf;overlays/cracen.conf"
    platform_allow: *cracen_platforms
    integration_platforms: *nrf54lm20b_integration_platforms
    tags:
      - tls_1_3
      - cracen
  ################################################################################
  ## ECDSA with Cracen crypto service
  ################################################################################
  sample.psa_tls.tls_server.ecdsa.cracen.crypto_service:
    extra_args:
      EXTRA_CONF_FILE="overlays/server.conf;overlays/ecdsa_secp256r1.conf;overlays/tls_1_2_ecdsa.conf;overlays/cracen.conf"
    platform_allow: &nrf54h20_cracen_platforms
      - nrf54h20dk/nrf54h20/cpuapp
      - nrf54h20dk/nrf54h20/cpurad
    integration_platforms:
      - nrf54h20dk/nrf54h20/cpuapp
    tags:
      - cracen
  sample.psa_tls.dtls_server.ecdsa.cracen.crypto_service:
    extra_args:
      EXTRA_CONF_FILE="overlays/server.conf;overlays/ecdsa_secp256r1.conf;overlays/tls_1_2_ecdsa.conf;overlays/cracen.conf;overlays/dtls.conf"
    platform_allow: *nrf54h20_cracen_platforms
    integration_platforms:
      - nrf54h20dk/nrf54h20/cpurad
    tags:
      - dtls
      - cracen
  sample.psa_tls.tls_client.ecdsa.cracen.crypto_service:
    extra_args:
      EXTRA_CONF_FILE="overlays/client.conf;overlays/ecdsa_secp256r1.conf;overlays/tls_1_2_ecdsa.conf;overlays/cracen.conf"
    platform_allow: *nrf54h20_cracen_platforms
    integration_platforms:
      - nrf54h20dk/nrf54h20/cpurad
    tags:
      - cracen
  sample.psa_tls.dtls_client.ecdsa.cracen.crypto_service:
    extra_args:
      EXTRA_CONF_FILE="overlays/client.conf;overlays/ecdsa_secp256r1.conf;overlays/tls_1_2_ecdsa.conf;overlays/cracen.conf;overlays/dtls.conf"
    platform_allow: *nrf54h20_cracen_platforms
    integration_platforms:
      - nrf54h20dk/nrf54h20/cpuapp
    tags:
      - dtls
      - cracen
  sample.psa_tls.tls_server_secp384r1.ecdsa.cracen.crypto_service:
    extra_args:
      EXTRA_CONF_FILE="overlays/server.conf;overlays/ecdsa_secp384r1.conf;overlays/tls_1_2_ecdsa.conf;overlays/cracen.conf"
    platform_allow: *nrf54h20_cracen_platforms
    integration_platforms:
      - nrf54h20dk/nrf54h20/cpurad
    tags:
      - cracen
      - secp384r1
  sample.psa_tls.dtls_server_secp384r1.ecdsa.cracen.crypto_service:
    extra_args:
      EXTRA_CONF_FILE="overlays/server.conf;overlays/ecdsa_secp384r1.conf;overlays/tls_1_2_ecdsa.conf;overlays/cracen.conf;overlays/dtls.conf"
    platform_allow: *nrf54h20_cracen_platforms
    integration_platforms:
      - nrf54h20dk/nrf54h20/cpuapp
    tags:
      - dtls
      - cracen
      - secp384r1
  sample.psa_tls.tls_client_secp384r1.ecdsa.cracen.crypto_service:
    extra_args:
      EXTRA_CONF_FILE="overlays/client.conf;overlays/ecdsa_secp384r1.conf;overlays/tls_1_2_ecdsa.conf;overlays/cracen.conf"
    platform_allow: *nrf54h20_cracen_platforms
    integration_platforms:
      - nrf54h20dk/nrf54h20/cpuapp
    tags:
      - cracen
      - secp384r1
  sample.psa_tls.dtls_client_secp384r1.ecdsa.cracen.crypto_service:
    extra_args:
      EXTRA_CONF_FILE="overlays/client.conf;overlays/ecdsa_secp384r1.conf;overlays/tls_1_2_ecdsa.conf;overlays/cracen.conf;overlays/dtls.conf"
    platform_allow: *nrf54h20_cracen_platforms
    integration_platforms:
      - nrf54h20dk/nrf54h20/cpurad
    tags:
      - dtls
      - cracen
      - secp384r1
  sample.psa_tls.tls_1_3_server.ecdsa.cracen.crypto_service:
    extra_args:
      EXTRA_CONF_FILE="overlays/server.conf;overlays/ecdsa_secp256r1.conf;overlays/tls_1_3_ecdsa.conf;overlays/cracen.conf"
    platform_allow: *nrf54h20_cracen_platforms
    integration_platforms:
      - nrf54h20dk/nrf54h20/cpuapp
    tags:
      - tls_1_3
      - cracen
  sample.psa_tls.tls_1_3_client.ecdsa.cracen.crypto_service:
    extra_args:
      EXTRA_CONF_FILE="overlays/client.conf;overlays/ecdsa_secp256r1.conf;overlays/tls_1_3_ecdsa.conf;overlays/cracen.conf"
    platform_allow: *nrf54h20_cracen_platforms
    integration_platforms:
      - nrf54h20dk/nrf54h20/cpurad
    tags:
      - tls_1_3
      - cracen
  ################################################################################
  ## RSA with Cracen
  ################################################################################
  sample.psa_tls.tls_server.rsa.cracen:
    extra_args:
      EXTRA_CONF_FILE="overlays/server.conf;overlays/tls_1_2_rsa.conf;overlays/cracen.conf"
    platform_allow: *cracen_platforms
    integration_platforms: *nrf54lv10a_integration_platforms
    tags:
      - cracen
  sample.psa_tls.dtls_server.rsa.cracen:
    extra_args:
      EXTRA_CONF_FILE="overlays/server.conf;overlays/tls_1_2_rsa.conf;overlays/cracen.conf;overlays/dtls.conf"
    platform_allow: *cracen_platforms
    integration_platforms: *nrf54l15_integration_platforms
    tags:
      - dtls
      - cracen
  sample.psa_tls.tls_client.rsa.cracen:
    extra_args:
      EXTRA_CONF_FILE="overlays/client.conf;overlays/tls_1_2_rsa.conf;overlays/cracen.conf"
    platform_allow: *cracen_platforms
    integration_platforms: *nrf54lm20b_integration_platforms
    tags:
      - cracen
  sample.psa_tls.dtls_client.rsa.cracen:
    extra_args:
      EXTRA_CONF_FILE="overlays/client.conf;overlays/tls_1_2_rsa.conf;overlays/cracen.conf;overlays/dtls.conf"
    platform_allow: *cracen_platforms
    integration_platforms: *nrf54l15_integration_platforms
    tags:
      - dtls
      - cracen
  sample.psa_tls.tls_1_3_server.rsa.cracen:
    extra_args:
      EXTRA_CONF_FILE="overlays/server.conf;overlays/tls_1_3_rsa.conf;overlays/cracen.conf"
    platform_allow: *cracen_platforms
    integration_platforms: *nrf54lm20b_integration_platforms
    tags:
      - tls_1_3
      - cracen
  sample.psa_tls.tls_1_3_client.rsa.cracen:
    extra_args:
      EXTRA_CONF_FILE="overlays/client.conf;overlays/tls_1_3_rsa.conf;overlays/cracen.conf"
    platform_allow: *cracen_platforms
    integration_platforms: *nrf54lv10a_integration_platforms
    tags:
      - tls_1_3
      - cracen
  ################################################################################
  ## ECDSA with Oberon
  ################################################################################
  sample.psa_tls.tls_server.ecdsa.oberon:
    extra_args:
      EXTRA_CONF_FILE="overlays/server.conf;overlays/ecdsa_secp256r1.conf;overlays/tls_1_2_ecdsa.conf;overlays/oberon.conf"
    platform_allow: &nrf54ls05_oberon_platforms
      - nrf54ls05dk/nrf54ls05b/cpuapp
    integration_platforms: *nrf54ls05_oberon_platforms
    tags:
      - oberon
  sample.psa_tls.dtls_server.ecdsa.oberon:
    extra_args:
      EXTRA_CONF_FILE="overlays/server.conf;overlays/ecdsa_secp256r1.conf;overlays/tls_1_2_ecdsa.conf;overlays/oberon.conf;overlays/dtls.conf"
    platform_allow: *nrf54ls05_oberon_platforms
    integration_platforms: *nrf54ls05_oberon_platforms
    tags:
      - dtls
      - oberon
  sample.psa_tls.tls_client.ecdsa.oberon:
    extra_args:
      EXTRA_CONF_FILE="overlays/client.conf;overlays/ecdsa_secp256r1.conf;overlays/tls_1_2_ecdsa.conf;overlays/oberon.conf"
    platform_allow: *nrf54ls05_oberon_platforms
    integration_platforms: *nrf54ls05_oberon_platforms
    tags:
      - oberon
  sample.psa_tls.dtls_client.ecdsa.oberon:
    extra_args:
      EXTRA_CONF_FILE="overlays/client.conf;overlays/ecdsa_secp256r1.conf;overlays/tls_1_2_ecdsa.conf;overlays/oberon.conf;overlays/dtls.conf"
    platform_allow: *nrf54ls05_oberon_platforms
    integration_platforms: *nrf54ls05_oberon_platforms
    tags:
      - dtls
      - oberon
  sample.psa_tls.tls_server_secp384r1.ecdsa.oberon:
    extra_args:
      EXTRA_CONF_FILE="overlays/server.conf;overlays/ecdsa_secp384r1.conf;overlays/tls_1_2_ecdsa.conf;overlays/oberon.conf"
    platform_allow: *nrf54ls05_oberon_platforms
    integration_platforms: *nrf54ls05_oberon_platforms
    tags:
      - oberon
      - secp384r1
  sample.psa_tls.dtls_server_secp384r1.ecdsa.oberon:
    extra_args:
      EXTRA_CONF_FILE="overlays/server.conf;overlays/ecdsa_secp384r1.conf;overlays/tls_1_2_ecdsa.conf;overlays/oberon.conf;overlays/dtls.conf"
    platform_allow: *nrf54ls05_oberon_platforms
    integration_platforms: *nrf54ls05_oberon_platforms
    tags:
      - dtls
      - oberon
      - secp384r1
  sample.psa_tls.tls_client_secp384r1.ecdsa.oberon:
    extra_args:
      EXTRA_CONF_FILE="overlays/client.conf;overlays/ecdsa_secp384r1.conf;overlays/tls_1_2_ecdsa.conf;overlays/oberon.conf"
    platform_allow: *nrf54ls05_oberon_platforms
    integration_platforms: *nrf54ls05_oberon_platforms
    tags:
      - oberon
      - secp384r1
  sample.psa_tls.dtls_client_secp384r1.ecdsa.oberon:
    extra_args:
      EXTRA_CONF_FILE="overlays/client.conf;overlays/ecdsa_secp384r1.conf;overlays/tls_1_2_ecdsa.conf;overlays/oberon.conf;overlays/dtls.conf"
    platform_allow: *nrf54ls05_oberon_platforms
    integration_platforms: *nrf54ls05_oberon_platforms
    tags:
      - dtls
      - oberon
      - secp384r1
  sample.psa_tls.tls_1_3_server.ecdsa.oberon:
    extra_args:
      EXTRA_CONF_FILE="overlays/server.conf;overlays/ecdsa_secp256r1.conf;overlays/tls_1_3_ecdsa.conf;overlays/oberon.conf"
    platform_allow: *nrf54ls05_oberon_platforms
    integration_platforms: *nrf54ls05_oberon_platforms
    tags:
      - tls_1_3
      - oberon
  sample.psa_tls.tls_1_3_client.ecdsa.oberon:
    extra_args:
      EXTRA_CONF_FILE="overlays/client.conf;overlays/ecdsa_secp256r1.conf;overlays/tls_1_3_ecdsa.conf;overlays/oberon.conf"
    platform_allow: *nrf54ls05_oberon_platforms
    integration_platforms: *nrf54ls05_oberon_platforms
    tags:
      - tls_1_3
      - oberon
  ################################################################################
  ## RSA with Oberon
  ################################################################################
  sample.psa_tls.tls_server.rsa.oberon:
    extra_args:
      EXTRA_CONF_FILE="overlays/server.conf;overlays/tls_1_2_rsa.conf;overlays/oberon.conf"
    platform_allow: *nrf54ls05_oberon_platforms
    integration_platforms: *nrf54ls05_oberon_platforms
    tags:
      - oberon
  sample.psa_tls.dtls_server.rsa.oberon:
    extra_args:
      EXTRA_CONF_FILE="overlays/server.conf;overlays/tls_1_2_rsa.conf;overlays/oberon.conf;overlays/dtls.conf"
    platform_allow: *nrf54ls05_oberon_platforms
    integration_platforms: *nrf54ls05_oberon_platforms
    tags:
      - dtls
      - oberon
  sample.psa_tls.tls_client.rsa.oberon:
    extra_args:
      EXTRA_CONF_FILE="overlays/client.conf;overlays/tls_1_2_rsa.conf;overlays/oberon.conf"
    platform_allow: *nrf54ls05_oberon_platforms
    integration_platforms: *nrf54ls05_oberon_platforms
    tags:
      - oberon
  sample.psa_tls.dtls_client.rsa.oberon:
    extra_args:
      EXTRA_CONF_FILE="overlays/client.conf;overlays/tls_1_2_rsa.conf;overlays/oberon.conf;overlays/dtls.conf"
    platform_allow: *nrf54ls05_oberon_platforms
    integration_platforms: *nrf54ls05_oberon_platforms
    tags:
      - dtls
      - oberon
  sample.psa_tls.tls_1_3_server.rsa.oberon:
    extra_args:
      EXTRA_CONF_FILE="overlays/server.conf;overlays/tls_1_3_rsa.conf;overlays/oberon.conf"
    platform_allow: *nrf54ls05_oberon_platforms
    integration_platforms: *nrf54ls05_oberon_platforms
    tags:
      - tls_1_3
      - oberon
  sample.psa_tls.tls_1_3_client.rsa.oberon:
    extra_args:
      EXTRA_CONF_FILE="overlays/client.conf;overlays/tls_1_3_rsa.conf;overlays/oberon.conf"
    platform_allow: *nrf54ls05_oberon_platforms
    integration_platforms: *nrf54ls05_oberon_platforms
    tags:
      - tls_1_3
      - oberon
```
