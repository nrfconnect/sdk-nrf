## CMakeLists.txt
```
#
# Copyright (c) 2025 Nordic Semiconductor ASA
#
# SPDX-License-Identifier: LicenseRef-Nordic-5-Clause
#

cmake_minimum_required(VERSION 3.20.0)

find_package(Zephyr REQUIRED HINTS $ENV{ZEPHYR_BASE})

project(kmu_cracen_usage)

target_sources(app PRIVATE
  src/main.c
  src/key_operations.c
)
```

## Kconfig
```
#
# Copyright (c) 2026 Nordic Semiconductor ASA
#
# SPDX-License-Identifier: LicenseRef-Nordic-5-Clause
#

# Enable required automatic generation and storage of SEED value during the first boot
configdefault HW_UNIQUE_KEY_WRITE_ON_CRYPTO_INIT
	default y

source "Kconfig.zephyr"
```

## Kconfig.sysbuild
```
#
# Copyright (c) 2026 Nordic Semiconductor
#
# SPDX-License-Identifier: LicenseRef-Nordic-5-Clause
#

config PARTITION_MANAGER
	default n if !((SOC_SERIES_NRF91X || SOC_SERIES_NRF53X) && BOARD_IS_NON_SECURE)

source "share/sysbuild/Kconfig"
```

## sample.yaml
```
sample:
  description: |
    This sample provides an example of using key provisioning and the KMU
    (Key Management Unit) with the PSA Crypto API, on devices with the CRACEN hardware peripheral.
    Different types of keys are generated and stored to the KMU.
  name: KMU usage with CRACEN

common:
  sysbuild: true
  tags:
    - introduction
    - kmu
    - sysbuild
    - ci_samples_crypto
  harness: console
  harness_config:
    type: multi_line
    regex:
      - ".*Example finished successfully!.*"

tests:
  sample.kmu_cracen_usage:
    sysbuild: true
    platform_allow:
      - nrf54l15dk/nrf54l15/cpuapp
      - nrf54l15dk/nrf54l15/cpuapp/ns
      - nrf54lm20dk/nrf54lm20a/cpuapp
      - nrf54lm20dk/nrf54lm20b/cpuapp
      - nrf54lv10dk/nrf54lv10a/cpuapp
      - nrf54lv10dk/nrf54lv10a/cpuapp/ns
      - nrf54lc10dk/nrf54lc10a/cpuapp
      - nrf54lc10dk/nrf54lc10a/cpuapp/ns
      - nrf54l15dk/nrf54l10/cpuapp
      - nrf54l15dk/nrf54l10/cpuapp/ns
      - nrf54l15dk/nrf54l05/cpuapp
      - nrf7120dk/nrf7120/cpuapp
      - nrf7120dk/nrf7120/cpuapp/ns
      - nrf7120dk/nrf7120e/cpuapp
      - nrf7120dk/nrf7120e/cpuapp/ns
    integration_platforms:
      - nrf54l15dk/nrf54l15/cpuapp
      - nrf54l15dk/nrf54l15/cpuapp/ns
      - nrf54lm20dk/nrf54lm20a/cpuapp
      - nrf54lm20dk/nrf54lm20b/cpuapp
      - nrf54lv10dk/nrf54lv10a/cpuapp
      - nrf54lv10dk/nrf54lv10a/cpuapp/ns
      - nrf54lc10dk/nrf54lc10a/cpuapp
      - nrf54lc10dk/nrf54lc10a/cpuapp/ns
      - nrf7120dk/nrf7120/cpuapp
      - nrf7120dk/nrf7120/cpuapp/ns
```

## prj.conf
```kconfig
#
# Copyright (c) 2025 Nordic Semiconductor ASA
#
# SPDX-License-Identifier: LicenseRef-Nordic-5-Clause
#
# The Zephyr CMSIS emulation assumes that ticks are ms, currently
CONFIG_SYS_CLOCK_TICKS_PER_SEC=1000

CONFIG_MAIN_STACK_SIZE=4096
CONFIG_HEAP_MEM_POOL_SIZE=4096
CONFIG_REBOOT=y

# Enable logging
CONFIG_CONSOLE=y
CONFIG_LOG=y
CONFIG_LOG_BUFFER_SIZE=4096

CONFIG_PSA_CRYPTO=y

# Enable hardware crypto accelerator
CONFIG_PSA_CRYPTO_DRIVER_OBERON=n
CONFIG_PSA_CRYPTO_DRIVER_CRACEN=y

CONFIG_CRACEN_IKG=y

CONFIG_HW_UNIQUE_KEY=y
# Enable required automatic generation and storage of SEED value during the first boot
# Ineffective here: unsatisfied dependency (!BUILD_WITH_TFM) on the _ns targets, so
# HW_UNIQUE_KEY_WRITE_ON_CRYPTO_INIT stays n there; moved to Kconfig as a default.
# CONFIG_HW_UNIQUE_KEY_WRITE_ON_CRYPTO_INIT=y

# Enable cryptographic features
CONFIG_PSA_WANT_KEY_TYPE_ECC_KEY_PAIR_GENERATE=y
CONFIG_PSA_WANT_KEY_TYPE_ECC_KEY_PAIR_IMPORT=y
CONFIG_PSA_WANT_KEY_TYPE_ECC_KEY_PAIR_EXPORT=y

CONFIG_PSA_WANT_ECC_TWISTED_EDWARDS_255=y
CONFIG_PSA_WANT_ECC_SECP_R1_256=y

CONFIG_PSA_WANT_ALG_SHA_256=y
CONFIG_PSA_WANT_ALG_SHA_512=y
CONFIG_PSA_WANT_ALG_ECDSA=y
CONFIG_PSA_WANT_ALG_PURE_EDDSA=y
CONFIG_PSA_WANT_ALG_CTR=y

# For key generation
CONFIG_PSA_WANT_GENERATE_RANDOM=y

# Required to enable support for Encrypted key usage scheme
CONFIG_PSA_WANT_KEY_TYPE_AES=y
CONFIG_PSA_WANT_AES_KEY_SIZE_256=y
CONFIG_PSA_WANT_ALG_ECB_NO_PADDING=y
CONFIG_PSA_WANT_ALG_CMAC=y
CONFIG_PSA_WANT_ALG_SP800_108_COUNTER_CMAC=y
CONFIG_PSA_WANT_ALG_GCM=y
```

## boards/nrf54lc10dk_nrf54lc10a_cpuapp.conf
```kconfig
#
# Copyright (c) 2026 Nordic Semiconductor ASA
#
# SPDX-License-Identifier: LicenseRef-Nordic-5-Clause

CONFIG_MBEDTLS_ENABLE_HEAP=y
CONFIG_MBEDTLS_HEAP_SIZE=8192
```

## boards/nrf7120pdk_nrf7120_cpuapp.conf
```kconfig
#
# Copyright (c) 2025 Nordic Semiconductor ASA
#
# SPDX-License-Identifier: LicenseRef-Nordic-5-Clause

# Configure crypto driver
CONFIG_MBEDTLS_ENABLE_HEAP=y
CONFIG_MBEDTLS_HEAP_SIZE=8192
```

## src/main.c
```c
/*
 * Copyright (c) 2025 Nordic Semiconductor ASA
 *
 * SPDX-License-Identifier: LicenseRef-Nordic-5-Clause
 */

#include <zephyr/kernel.h>
#include <zephyr/sys/printk.h>
#include <zephyr/logging/log.h>
#include <stdio.h>
#include <psa/crypto.h>

#include <cracen_psa_kmu.h>

#ifdef CONFIG_BUILD_WITH_TFM
#include <tfm_ns_interface.h>
#endif

#include "main.h"
#include "key_operations.h"

#define APP_SUCCESS	    (0)
#define APP_ERROR	    (-1)
#define APP_SUCCESS_MESSAGE "Example finished successfully!"
#define APP_ERROR_MESSAGE   "Example exited with error!"

LOG_MODULE_REGISTER(kmu_cracen_usage, LOG_LEVEL_DBG);

/* ====================================================================== */
/*       Global variables/defines for the KMU Cracen usage example        */

#define SAMPLE_MAX_KEY_COUNT (4)

static sample_key_entry_t m_sample_keys[SAMPLE_MAX_KEY_COUNT] = {
	/* Pre-provisioned keys.
	 * These keys remain in the KMU between MCU resets.
	 */
	{
		/* The key requires 1 KMU slot */
		.key_id = PSA_KEY_ID_FROM_CRACEN_KMU_SLOT(CRACEN_KMU_KEY_USAGE_SCHEME_PROTECTED,
						       PSA_KEY_ID_USER_MIN),
		.supported_operations = {
			.gen_key_cb = NULL,
			.use_key_cb = key_operations_use_aes_key,
		}
	},
	{
		/* The key requires 2 KMU slots */
		.key_id = PSA_KEY_ID_FROM_CRACEN_KMU_SLOT(CRACEN_KMU_KEY_USAGE_SCHEME_RAW,
						       PSA_KEY_ID_USER_MIN + 1),
		.supported_operations = {
			.gen_key_cb = NULL,
			.use_key_cb = key_operations_use_eddsa_key_pair,
		}
	},

	/* Generated keys.
	 * These keys will be erased from the KMU after MCU reset.
	 */
	{
		/* The key requires 1 KMU slot + 2 additional slots
		 *are required since the key is encrypted
		 */
		.key_id = PSA_KEY_ID_FROM_CRACEN_KMU_SLOT(CRACEN_KMU_KEY_USAGE_SCHEME_ENCRYPTED,
						       PSA_KEY_ID_USER_MIN + 3),
		.supported_operations = {
			.gen_key_cb = key_operations_generate_aes_key,
			.use_key_cb = key_operations_use_aes_key,
		}
	},
	{
		/* The key requires 2 KMU slots */
		.key_id = PSA_KEY_ID_FROM_CRACEN_KMU_SLOT(CRACEN_KMU_KEY_USAGE_SCHEME_RAW,
						       PSA_KEY_ID_USER_MIN + 6),
		.supported_operations = {
			.gen_key_cb = key_operations_generate_ecdsa_key_pair,
			.use_key_cb = key_operations_use_ecdsa_key_pair,
		}
	},
};

/* ====================================================================== */

int crypto_init(void)
{
	psa_status_t status;

	/* Initialize PSA Crypto */
	status = psa_crypto_init();
	if (status != PSA_SUCCESS) {
		return APP_ERROR;
	}

	return APP_SUCCESS;
}

int crypto_finish(void)
{
	psa_status_t status;

	LOG_INF("Destroying non-provisioned keys...");

	/* Destroy the key handles for generated keys only */
	for (uint8_t key_entry = 0; key_entry < SAMPLE_MAX_KEY_COUNT; key_entry++) {
		if (m_sample_keys[key_entry].supported_operations.gen_key_cb != NULL) {
			status = psa_destroy_key(m_sample_keys[key_entry].key_id);
			if (status != PSA_SUCCESS) {
				LOG_INF("psa_destroy_key failed! (Error: %d, key_entry: %d)",
					status, key_entry);
				return APP_ERROR;
			}
		}
	}

	return APP_SUCCESS;
}

int use_kmu_keys(void)
{
	psa_status_t status;
	use_key_callback_t use_key_cb;
	use_key_callback_t gen_key_cb;

	LOG_INF("Using keys...");

	for (uint8_t key_entry = 0; key_entry < SAMPLE_MAX_KEY_COUNT; key_entry++) {
		use_key_cb = m_sample_keys[key_entry].supported_operations.use_key_cb;
		gen_key_cb = m_sample_keys[key_entry].supported_operations.gen_key_cb;

		if (use_key_cb != NULL) {
			LOG_INF("Using key [%d]\n", key_entry);
			status = use_key_cb(&m_sample_keys[key_entry].key_id);
			if (status != PSA_SUCCESS) {
				LOG_INF("Failed to use key (entry: %d, error: %d)", key_entry,
					status);

				if (gen_key_cb == NULL) {
					LOG_WRN("Please make sure the key is pre-provisioned!");
				} else {
					return APP_ERROR;
				}
			}
		} else {
			LOG_WRN("Can't check key usage: no callback (entry: %d)", key_entry);
		}
	}

	LOG_INF("Key usage finished");

	return APP_SUCCESS;
}

int prepare_kmu_keys(void)
{
	psa_status_t status;
	generate_key_callback_t gen_key_cb;

	LOG_INF("Preparing non-provisioned keys...");

	for (uint8_t key_entry = 0; key_entry < SAMPLE_MAX_KEY_COUNT; key_entry++) {
		gen_key_cb = m_sample_keys[key_entry].supported_operations.gen_key_cb;

		if (gen_key_cb != NULL) {
			LOG_INF("Generating key [%d]\n", key_entry);
			status = gen_key_cb(&m_sample_keys[key_entry].key_id);
			if (status == PSA_ERROR_ALREADY_EXISTS) {
				LOG_WRN("Failed to generate key [%d]: key already exists! "
					"Erase, pre-provision and flash the board again.",
					key_entry);
			}

			if (status != PSA_SUCCESS) {
				LOG_INF("Failed to generate key (entry: %d, error: %d)", key_entry,
					status);
				return APP_ERROR;
			}
		}
	}

	LOG_INF("All keys prepared");

	return APP_SUCCESS;
}

int main(void)
{
	int status;

	LOG_INF("Starting KMU Cracen usage example...");

	status = crypto_init();
	if (status != APP_SUCCESS) {
		LOG_INF(APP_ERROR_MESSAGE);
		return APP_ERROR;
	}

	status = prepare_kmu_keys();
	if (status != APP_SUCCESS) {
		LOG_INF(APP_ERROR_MESSAGE);
		return APP_ERROR;
	}

	status = use_kmu_keys();
	if (status != APP_SUCCESS) {
		LOG_INF(APP_ERROR_MESSAGE);
		return APP_ERROR;
	}

	status = crypto_finish();
	if (status != APP_SUCCESS) {
		LOG_INF(APP_ERROR_MESSAGE);
		return APP_ERROR;
	}

	LOG_INF(APP_SUCCESS_MESSAGE);

	return APP_SUCCESS;
}
```

## src/key_operations.c
```c
/*
 * Copyright (c) 2025 Nordic Semiconductor ASA
 *
 * SPDX-License-Identifier: LicenseRef-Nordic-5-Clause
 */

#include "key_operations.h"
#include "main.h"

#include <zephyr/device.h>
#include <zephyr/logging/log.h>
#include <zephyr/settings/settings.h>

#include <cracen_psa_kmu.h>

LOG_MODULE_DECLARE(kmu_cracen_usage, LOG_LEVEL_DBG);

/* ====================================================================== */
/*			Global variables/defines for operations on the KMU keys		  */

#define PRINT_HEX(p_label, p_text, len)                                                            \
	({                                                                                         \
		LOG_INF("---- %s (len: %u): ----", p_label, len);                                  \
		LOG_HEXDUMP_INF(p_text, len, "Content:");                                          \
		LOG_INF("---- %s end  ----", p_label);                                             \
	})

/* Below text is used as plaintext for encryption/decryption */
static uint8_t m_plain_text[NRF_CRYPTO_EXAMPLE_KMU_USAGE_KEY_MAX_TEXT_SIZE] = {
	"Example string to demonstrate basic usage of KMU."};

/* ====================================================================== */

/* AES key operations */

int key_operations_generate_aes_key(psa_key_id_t *key_id)
{
	psa_status_t status;
	psa_key_id_t tmp_key_id;

	if (key_id == NULL) {
		LOG_ERR("Provide a valid key ID to generate the key");
		return PSA_ERROR_INVALID_ARGUMENT;
	}
	tmp_key_id = *key_id;

	LOG_INF("Generating random AES key...");

	/* Configure the key attributes */
	psa_key_attributes_t key_attributes = PSA_KEY_ATTRIBUTES_INIT;

	psa_set_key_usage_flags(&key_attributes, PSA_KEY_USAGE_ENCRYPT | PSA_KEY_USAGE_DECRYPT);
	psa_set_key_algorithm(&key_attributes, PSA_ALG_CTR);
	psa_set_key_type(&key_attributes, PSA_KEY_TYPE_AES);
	psa_set_key_bits(&key_attributes, 128);

	/* Persistent key specific settings */
	psa_set_key_lifetime(&key_attributes,
			     PSA_KEY_LIFETIME_FROM_PERSISTENCE_AND_LOCATION(
				     PSA_KEY_PERSISTENCE_DEFAULT, PSA_KEY_LOCATION_CRACEN_KMU));
	psa_set_key_id(&key_attributes, *key_id);

	/* Generate a random AES key with persistent lifetime. The key can be used for
	 * encryption/decryption using the key_id.
	 * The key itself will be stored to the KMU peripheral.
	 */
	status = psa_generate_key(&key_attributes, key_id);

	if (status == PSA_ERROR_ALREADY_EXISTS) {
		/* Revering the key ID to the one provided.
		 * Reason: psa_generate_key() modifies it
		 */
		*key_id = tmp_key_id;
		psa_reset_key_attributes(&key_attributes);
		return status;
	} else if (status != PSA_SUCCESS) {
		LOG_INF("psa_generate_key failed! (Error: %d)", status);
		return status;
	}

	/* Make sure the key metadata is not in memory anymore,
	 * has the same affect as resetting the device
	 */
	status = psa_purge_key(*key_id);
	if (status != PSA_SUCCESS) {
		LOG_INF("psa_purge_key failed! (Error: %d)", status);
		return status;
	}

	/* After the key handle is acquired the attributes are not needed */
	psa_reset_key_attributes(&key_attributes);

	LOG_INF("A key generated successfully!");

	return status;
}

int key_operations_use_aes_key(psa_key_id_t *key_id)
{
	uint32_t olen;
	psa_status_t status;

	if (key_id == NULL) {
		LOG_ERR("Provide a valid key ID to generate the key");
		return PSA_ERROR_INVALID_ARGUMENT;
	}

	uint8_t encrypted_text[PSA_CIPHER_ENCRYPT_OUTPUT_SIZE(
		PSA_KEY_TYPE_AES, PSA_ALG_CTR, NRF_CRYPTO_EXAMPLE_KMU_USAGE_KEY_MAX_TEXT_SIZE)];
	uint8_t decrypted_text[NRF_CRYPTO_EXAMPLE_KMU_USAGE_KEY_MAX_TEXT_SIZE];

	status = psa_cipher_encrypt(*key_id, PSA_ALG_CTR, m_plain_text, sizeof(m_plain_text),
				    encrypted_text, sizeof(encrypted_text), &olen);
	if (status != PSA_SUCCESS) {
		LOG_INF("psa_cipher_encrypt failed! (Error: %d)", status);
		return status;
	}

	LOG_INF("Encryption successful!");
	PRINT_HEX("Plaintext", m_plain_text, sizeof(m_plain_text));
	PRINT_HEX("Encrypted text", encrypted_text, sizeof(encrypted_text));

	status = psa_cipher_decrypt(*key_id, PSA_ALG_CTR, encrypted_text, sizeof(encrypted_text),
				    decrypted_text, sizeof(decrypted_text), &olen);
	if (status != PSA_SUCCESS) {
		LOG_INF("psa_cipher_decrypt failed! (Error: %d)", status);
		return status;
	}

	PRINT_HEX("Decrypted text", decrypted_text, sizeof(decrypted_text));

	/* Check the validity of the decryption */
	if (memcmp(decrypted_text, m_plain_text, NRF_CRYPTO_EXAMPLE_KMU_USAGE_KEY_MAX_TEXT_SIZE) !=
	    0) {
		LOG_INF("Error: Decrypted text doesn't match the plaintext");
		return status;
	}

	LOG_INF("Decryption successful!");

	return status;
}

/* ECC key pair operations */

/* EdDSA */

static int key_operations_import_eddsa_pub_key(const uint8_t *p_key, size_t key_size,
					       psa_key_id_t *key_id)
{
	assert(p_key != NULL);
	assert(key_id != NULL);

	/* Configure the key attributes */
	psa_key_attributes_t key_attributes = PSA_KEY_ATTRIBUTES_INIT;
	psa_status_t status;

	/* Configure the key attributes */
	psa_set_key_usage_flags(&key_attributes, PSA_KEY_USAGE_VERIFY_MESSAGE);
	psa_set_key_lifetime(&key_attributes, PSA_KEY_LIFETIME_VOLATILE);
	psa_set_key_algorithm(&key_attributes, PSA_ALG_PURE_EDDSA);
	psa_set_key_type(&key_attributes,
			 PSA_KEY_TYPE_ECC_PUBLIC_KEY(PSA_ECC_FAMILY_TWISTED_EDWARDS));
	psa_set_key_bits(&key_attributes, 255);

	status = psa_import_key(&key_attributes, p_key, key_size, key_id);
	if (status != PSA_SUCCESS) {
		LOG_INF("psa_import_key failed! (Error: %d)", status);
		return status;
	}

	/* Reset key attributes and free any allocated resources. */
	psa_reset_key_attributes(&key_attributes);

	return status;
}

int key_operations_use_eddsa_key_pair(psa_key_id_t *key_pair_id)
{
	psa_status_t status;
	psa_key_id_t pub_key_id;

	uint8_t pub_key[KEY_OPERATIONS_EDDSA_PUBLIC_KEY_SIZE];
	size_t pub_key_len;
	uint8_t signature[KEY_OPERATIONS_EDDSA_SIGNATURE_SIZE];
	size_t signature_len;

	if (key_pair_id == NULL) {
		LOG_ERR("Provide a valid key ID to generate the key");
		return PSA_ERROR_INVALID_ARGUMENT;
	}

	LOG_INF("Using EdDSA key pair...");

	/* Export the public key */
	status = psa_export_public_key(*key_pair_id, pub_key, sizeof(pub_key), &pub_key_len);
	if (status != PSA_SUCCESS) {
		LOG_INF("psa_export_public_key failed! (Error: %d)", status);
		return status;
	}

	PRINT_HEX("Public-key", pub_key, pub_key_len);

	status = key_operations_import_eddsa_pub_key(pub_key, pub_key_len, &pub_key_id);
	memset(pub_key, 0, sizeof(pub_key));
	if (status != PSA_SUCCESS) {
		LOG_INF("key_operations_import_eddsa_pub_key failed! (Error: %d)", status);
		return status;
	}

	LOG_INF("Signing a message using EDDSA...");

	/* Sign the message */
	status = psa_sign_message(*key_pair_id, PSA_ALG_PURE_EDDSA, m_plain_text,
				  sizeof(m_plain_text), signature, sizeof(signature),
				  &signature_len);
	if (status != PSA_SUCCESS) {
		LOG_INF("psa_sign_message failed! (Error: %d)", status);
		goto exit;
	}

	LOG_INF("Message signed successfully!");
	PRINT_HEX("Plaintext", m_plain_text, sizeof(m_plain_text));
	PRINT_HEX("Signature", signature, sizeof(signature));

	LOG_INF("Verifying EDDSA signature...");

	/* Verify the signature of the message */
	status = psa_verify_message(pub_key_id, PSA_ALG_PURE_EDDSA, m_plain_text,
				    sizeof(m_plain_text), signature, signature_len);
	if (status != PSA_SUCCESS) {
		LOG_INF("psa_verify_message failed! (Error: %d)", status);
		goto exit;
	}

	LOG_INF("EdDSA signature verification was successful!");

exit:
	psa_destroy_key(pub_key_id);
	return status;
}

/* ECDSA */

static int key_operations_import_ecdsa_pub_key(const uint8_t *p_key, size_t key_size,
					       psa_key_id_t *key_id)
{
	assert(p_key != NULL);
	assert(key_id != NULL);

	/* Configure the key attributes */
	psa_key_attributes_t key_attributes = PSA_KEY_ATTRIBUTES_INIT;
	psa_status_t status;

	/* Configure the key attributes */
	psa_set_key_usage_flags(&key_attributes, PSA_KEY_USAGE_VERIFY_HASH);
	psa_set_key_lifetime(&key_attributes, PSA_KEY_LIFETIME_VOLATILE);
	psa_set_key_algorithm(&key_attributes, PSA_ALG_ECDSA(PSA_ALG_SHA_256));
	psa_set_key_type(&key_attributes, PSA_KEY_TYPE_ECC_PUBLIC_KEY(PSA_ECC_FAMILY_SECP_R1));
	psa_set_key_bits(&key_attributes, 256);

	status = psa_import_key(&key_attributes, p_key, key_size, key_id);
	if (status != PSA_SUCCESS) {
		LOG_INF("psa_import_key failed! (Error: %d)", status);
		return status;
	}

	/* Reset key attributes and free any allocated resources. */
	psa_reset_key_attributes(&key_attributes);

	return status;
}

int key_operations_generate_ecdsa_key_pair(psa_key_id_t *key_pair_id)
{
	psa_status_t status;
	psa_key_id_t tmp_key_id;

	if (key_pair_id == NULL) {
		LOG_ERR("Provide a valid key ID to generate the key");
		return PSA_ERROR_INVALID_ARGUMENT;
	}
	tmp_key_id = *key_pair_id;

	LOG_INF("Generating random ECDSA keypair...");

	/* Configure the key attributes */
	psa_key_attributes_t key_attributes = PSA_KEY_ATTRIBUTES_INIT;

	psa_set_key_usage_flags(&key_attributes, PSA_KEY_USAGE_SIGN_HASH);
	psa_set_key_algorithm(&key_attributes, PSA_ALG_ECDSA(PSA_ALG_SHA_256));
	psa_set_key_type(&key_attributes, PSA_KEY_TYPE_ECC_KEY_PAIR(PSA_ECC_FAMILY_SECP_R1));
	psa_set_key_bits(&key_attributes, 256);

	/* Persistent key specific settings */
	psa_set_key_lifetime(&key_attributes,
			     PSA_KEY_LIFETIME_FROM_PERSISTENCE_AND_LOCATION(
				     PSA_KEY_PERSISTENCE_DEFAULT, PSA_KEY_LOCATION_CRACEN_KMU));
	psa_set_key_id(&key_attributes, *key_pair_id);

	/* Generate a random keypair. The keypair is not exposed to the application,
	 * we can use it to sign hashes.
	 */
	status = psa_generate_key(&key_attributes, key_pair_id);

	if (status == PSA_ERROR_ALREADY_EXISTS) {
		/* Using key_pair_id without any modifications. */
		*key_pair_id = tmp_key_id;
		psa_reset_key_attributes(&key_attributes);
		return status;
	} else if (status != PSA_SUCCESS) {
		LOG_INF("psa_generate_key failed! (Error: %d)", status);
		return status;
	}

	/* Make sure the key metadata is not in memory anymore,
	 * has the same affect as resetting the device
	 */
	status = psa_purge_key(*key_pair_id);
	if (status != PSA_SUCCESS) {
		LOG_INF("psa_purge_key failed! (Error: %d)", status);
		return status;
	}

	/* After the key handle is acquired the attributes are not needed */
	psa_reset_key_attributes(&key_attributes);

	LOG_INF("ECDSA key pair generated successfully!");

	return status;
}

int key_operations_use_ecdsa_key_pair(psa_key_id_t *key_pair_id)
{
	psa_status_t status;
	psa_key_id_t pub_key_id;
	uint32_t output_len;

	uint8_t pub_key[KEY_OPERATIONS_ECDSA_PUBLIC_KEY_SIZE];
	size_t pub_key_len;
	uint8_t signature[KEY_OPERATIONS_ECDSA_SIGNATURE_SIZE];
	uint8_t hash[KEY_OPERATIONS_ECDSA_HASH_SIZE];

	if (key_pair_id == NULL) {
		LOG_ERR("Provide a valid key ID to generate the key");
		return PSA_ERROR_INVALID_ARGUMENT;
	}

	LOG_INF("Using ECDSA key pair...");

	/* Export the public key */
	status = psa_export_public_key(*key_pair_id, pub_key, sizeof(pub_key), &pub_key_len);
	if (status != PSA_SUCCESS) {
		LOG_INF("psa_export_public_key failed! (Error: %d)", status);
		return status;
	}

	PRINT_HEX("Public-key", pub_key, pub_key_len);

	status = key_operations_import_ecdsa_pub_key(pub_key, pub_key_len, &pub_key_id);
	memset(pub_key, 0, sizeof(pub_key));
	if (status != PSA_SUCCESS) {
		LOG_INF("key_operations_import_ecdsa_pub_key failed! (Error: %d)", status);
		return status;
	}

	LOG_INF("Signing a message using ECDSA...");

	/* Compute the SHA256 hash*/
	status = psa_hash_compute(PSA_ALG_SHA_256, m_plain_text, sizeof(m_plain_text), hash,
				  sizeof(hash), &output_len);
	if (status != PSA_SUCCESS) {
		LOG_INF("psa_hash_compute failed! (Error: %d)", status);
		goto exit;
	}

	/* Sign the hash */
	status = psa_sign_hash(*key_pair_id, PSA_ALG_ECDSA(PSA_ALG_SHA_256), hash, sizeof(hash),
			       signature, sizeof(signature), &output_len);
	if (status != PSA_SUCCESS) {
		LOG_INF("psa_sign_hash failed! (Error: %d)", status);
		goto exit;
	}

	LOG_INF("Message signed successfully!");
	PRINT_HEX("Plaintext", m_plain_text, sizeof(m_plain_text));
	PRINT_HEX("SHA256 hash", hash, sizeof(hash));
	PRINT_HEX("Signature", signature, sizeof(signature));

	LOG_INF("Verifying ECDSA signature...");

	/* Verify the signature of the hash */
	status = psa_verify_hash(pub_key_id, PSA_ALG_ECDSA(PSA_ALG_SHA_256), hash, sizeof(hash),
				 signature, sizeof(signature));
	if (status != PSA_SUCCESS) {
		LOG_INF("psa_verify_hash failed! (Error: %d)", status);
		goto exit;
	}

	LOG_INF("ECDSA signature verification was successful!");

exit:
	psa_destroy_key(pub_key_id);
	return status;
}
```

## src/key_operations.h
```c
/*
 * Copyright (c) 2025 Nordic Semiconductor ASA
 *
 * SPDX-License-Identifier: LicenseRef-Nordic-5-Clause
 */

#include <psa/crypto.h>

#ifndef __KEY_OPERATIONS_H_
#define __KEY_OPERATIONS_H_

#define KEY_OPERATIONS_EDDSA_PUBLIC_KEY_SIZE    (32)
#define KEY_OPERATIONS_EDDSA_SIGNATURE_SIZE     (64)

#define KEY_OPERATIONS_ECDSA_PUBLIC_KEY_SIZE    (65)
#define KEY_OPERATIONS_ECDSA_SIGNATURE_SIZE     (64)
#define KEY_OPERATIONS_ECDSA_HASH_SIZE          (32)

/* AES key operations */

int key_operations_generate_aes_key(psa_key_id_t *key_id);
int key_operations_use_aes_key(psa_key_id_t *key_id);

/* ECC key pair operations */

int key_operations_use_eddsa_key_pair(psa_key_id_t *key_pair_id);

int key_operations_generate_ecdsa_key_pair(psa_key_id_t *key_pair_id);
int key_operations_use_ecdsa_key_pair(psa_key_id_t *key_pair_id);

#endif
```

## src/main.h
```c
/*
 * Copyright (c) 2025 Nordic Semiconductor ASA
 *
 * SPDX-License-Identifier: LicenseRef-Nordic-5-Clause
 */

#include <psa/crypto.h>

#ifndef __MAIN_H_
#define __MAIN_H_

#define NRF_CRYPTO_EXAMPLE_KMU_USAGE_KEY_MAX_TEXT_SIZE (100)

/**
 * @brief Callback function called to generate specific key.
 *
 * @param key_id A pointer to the key ID.
 *
 * @return psa_status_t
 */
typedef int (*generate_key_callback_t)(psa_key_id_t *key_id);

/**
 * @brief Callback function called to execute key usage functionality.
 *
 * @param key_id A pointer to the key ID.
 *
 * @return psa_status_t
 */
typedef int (*use_key_callback_t)(psa_key_id_t *key_id);

typedef struct {
	const generate_key_callback_t gen_key_cb;
	const use_key_callback_t use_key_cb;
} sample_key_operations_t;

typedef struct {
	psa_key_id_t key_id;
	sample_key_operations_t supported_operations;
} sample_key_entry_t;

#endif
```
