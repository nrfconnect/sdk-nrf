/*
 * Copyright (c) 2021 Nordic Semiconductor ASA
 *
 * SPDX-License-Identifier: LicenseRef-Nordic-5-Clause
 */

/ {
	chosen {
		zephyr,ot-uart = &snippet_cdc_acm_uart;
	};
};

&zephyr_udc0 {
	snippet_cdc_acm_uart: snippet_cdc_acm_uart {
		compatible = "zephyr,cdc-acm-uart";
	};
};
