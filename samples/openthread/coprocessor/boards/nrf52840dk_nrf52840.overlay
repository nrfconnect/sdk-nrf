/* Copyright (c) 2020 Nordic Semiconductor ASA
 *
 * SPDX-License-Identifier: LicenseRef-Nordic-5-Clause
 */

&uart0 {
	current-speed = <1000000>;
	status = "okay";
	hw-flow-control;
};

&uart1 {
	current-speed = <1000000>;
	status = "okay";
};

/ {
	chosen {
		zephyr,ot-uart = &uart0;
	};
};
