/* Copyright (c) 2020 Nordic Semiconductor ASA
 *
 * SPDX-License-Identifier: LicenseRef-Nordic-5-Clause
 */

/* Default Zephyr configuration already provides GPIO support for FEM. */

&uart0 {
	current-speed = <1000000>;
	status = "okay";
	hw-flow-control;
};

&uart1 {
	current-speed = <1000000>;
	status = "okay";
};

/ {
	chosen {
		zephyr,ot-uart = &uart0;
	};
};
