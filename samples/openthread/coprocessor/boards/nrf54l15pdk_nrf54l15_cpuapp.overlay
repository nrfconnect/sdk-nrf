/* Copyright (c) 2024 Nordic Semiconductor ASA
 *
 * SPDX-License-Identifier: LicenseRef-Nordic-5-Clause
 */

&uart20 {
    current-speed = <115200>;
    status = "okay";
    hw-flow-control;
};

 / {
    chosen {
        zephyr,ot-uart = &uart20;
    };
};
