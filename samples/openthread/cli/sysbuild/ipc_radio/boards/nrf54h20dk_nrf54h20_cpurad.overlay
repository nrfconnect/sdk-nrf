/* Copyright (c) 2024 Nordic Semiconductor ASA
 *
 * SPDX-License-Identifier: LicenseRef-Nordic-5-Clause
 */

 &dppic130 {
	owned-channels = <0 1 2 3>;
	sink-channels = <0 1 2>;
	source-channels = <3>;
	nonsecure-channels = <0 1 2 3>;
	status = "okay";
};

&dppic132 {
	owned-channels = <0 1 2 3>;
	owned-channel-groups = <0 1>;
	source-channels = <0 1 2>;
	sink-channels = <3>;
	nonsecure-channels = <0 1 2 3>;
	status = "okay";
};

&cpurad_ipct {
	source-channel-links = <0 13 0>;
	sink-channel-links = <0 13 0
			      1 13 1
			      2 13 2>;
};

&ipct130 {
	status = "okay";
	owned-channels = <0 1 2>;
	source-channel-links = <0 3 0
				1 3 1
				2 3 2>;
	sink-channel-links = <0 3 0>;
};
