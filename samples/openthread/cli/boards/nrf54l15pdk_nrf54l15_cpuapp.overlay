/* Copyright (c) 2024 Nordic Semiconductor ASA
 *
 * SPDX-License-Identifier: LicenseRef-Nordic-5-Clause
 */

&uart30 {
    status = "okay";
    hw-flow-control;
};

 / {
    chosen {
        zephyr,console = &uart30;
        zephyr,shell-uart = &uart30;
    };
};
