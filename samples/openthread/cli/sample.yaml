## samples/openthread/coprocessor/boards/nrf54lm20pdk_nrf54lm20a_cpuapp.conf
```kconfig
#
# Copyright (c) 2025 Nordic Semiconductor ASA
#
# SPDX-License-Identifier: LicenseRef-Nordic-5-Clause
#

CONFIG_SPI_NOR=n

# Workaround required as Zephyr L2 implies usage of NVS backend for settings.
# It should be removed once the proper fix will be applied in Zephyr.
CONFIG_NVS=n
CONFIG_ZMS=y
CONFIG_SETTINGS_ZMS=y

# Disable features based on IKG
CONFIG_TRUSTED_STORAGE_BACKEND_AEAD_KEY_HASH_UID=y
```

## samples/openthread/coprocessor/sample.yaml
```yaml
sample:
  description: Test OpenThread Co-Processor
  name: OpenThread Co-Processor sample

tests:
  sample.openthread.coprocessor:
    sysbuild: true
    build_only: true
    tags:
      - ci_build
      - sysbuild
      - ci_samples_openthread
    platform_allow:
      - nrf52833dk/nrf52833
      - nrf52840dk/nrf52840
      - nrf52840dongle/nrf52840
      - nrf21540dk/nrf52840
      - nrf54l15dk/nrf54l15/cpuapp
      - nrf54l15dk/nrf54l10/cpuapp
      - nrf54l15dk/nrf54l05/cpuapp
      - nrf54l15dk/nrf54l15/cpuapp/ns
      - nrf54lm20dk/nrf54lm20a/cpuapp
    integration_platforms:
      - nrf52833dk/nrf52833
      - nrf52840dk/nrf52840
      - nrf21540dk/nrf52840
      - nrf52840dongle/nrf52840
      - nrf54l15dk/nrf54l15/cpuapp
      - nrf54l15dk/nrf54l10/cpuapp
      - nrf54l15dk/nrf54l05/cpuapp
      - nrf54l15dk/nrf54l15/cpuapp/ns
      - nrf54lm20dk/nrf54lm20a/cpuapp
  sample.openthread.coprocessor.vendor_hook:
    sysbuild: true
    build_only: true
    tags:
      - ci_build
      - sysbuild
      - ci_samples_openthread
    platform_allow:
      - nrf52833dk/nrf52833
      - nrf52840dk/nrf52840
      - nrf52840dongle/nrf52840
      - nrf21540dk/nrf52840
      - nrf54l15dk/nrf54l15/cpuapp
      - nrf54l15dk/nrf54l10/cpuapp
      - nrf54l15dk/nrf54l05/cpuapp
      - nrf54l15dk/nrf54l15/cpuapp/ns
    extra_args: >
      coprocessor_SNIPPET="ci;logging;vendor_hook"
    integration_platforms:
      - nrf52833dk/nrf52833
      - nrf52840dk/nrf52840
      - nrf21540dk/nrf52840
      - nrf52840dongle/nrf52840
      - nrf54l15dk/nrf54l15/cpuapp
      - nrf54l15dk/nrf54l10/cpuapp
      - nrf54l15dk/nrf54l05/cpuapp
      - nrf54l15dk/nrf54l15/cpuapp/ns
  sample.openthread.coprocessor.usb:
    sysbuild: true
    build_only: true
    tags:
      - ci_build
      - sysbuild
      - ci_samples_openthread
    platform_allow:
      - nrf52833dk/nrf52833
      - nrf52840dk/nrf52840
      - nrf21540dk/nrf52840
    extra_args: >
      coprocessor_SNIPPET="ci;usb"
    integration_platforms:
      - nrf52840dk/nrf52840
      - nrf52833dk/nrf52833
      - nrf21540dk/nrf52840
  sample.openthread.coprocessor.hci:
    sysbuild: true
    build_only: true
    tags:
      - ci_build
      - sysbuild
      - ci_samples_openthread
    extra_args: >
      coprocessor_SNIPPET="ci;hci"
    platform_allow:
      - nrf52840dk/nrf52840
      - nrf21540dk/nrf52840
    integration_platforms:
      - nrf52840dk/nrf52840
```

## samples/openthread/ncp/Kconfig
```kconfig
#
# Copyright (c) 2020 Nordic Semiconductor ASA
#
# SPDX-License-Identifier: LicenseRef-Nordic-5-Clause
#

menu "Zephyr Kernel"
source "Kconfig.zephyr"
endmenu

module = OT_NCP
module-str = ot_ncp
source "${ZEPHYR_BASE}/subsys/logging/Kconfig.template.log_config"
```

## samples/openthread/ncp/sample.yaml
```yaml
sample:
  name: OpenThread NCP sample
  description: Test OpenThread NCP
tests:
  samples.openthread.ncp:
    build_only: true
    build_on_all: true
    platform_allow: nrf52840dk_nrf52840 nrf52833dk_nrf52833
    tags: ci_build
```

## samples/openthread/ot_cli/sample.yaml
```yaml
sample:
  description: Test OpenThread Command Line Interface.
  name: OpenThread CLI sample
tests:
  sample.net.openthread.ot_cli:
    tags: openthread cli
    platform_whitelist: nrf52840_pca10056 nrf52833_pca10100
```

## samples/peripheral/802154_phy_test/Kconfig
```kconfig
#
# Copyright (c) 2021 Nordic Semiconductor
#
# SPDX-License-Identifier: LicenseRef-Nordic-5-Clause
#

source "Kconfig.zephyr"

menu "PHY Test Tool configuration"

choice
	prompt "Device Mode"
	default PTT_BOTH
	help
	  Select the device mode

config PTT_DUT_MODE
	bool "Configure device as a DUT"
	help
	  DUT (Device Under Test) - serial communication is not initialized

config PTT_CMD_MODE
	bool "Configure device as a CMD"
	help
	  CMD - serial communication is available with 115200 8N1 settings

config PTT_BOTH
	bool "Supports both CMD and DUT modes"
	help
	  Device can be switched between modes using "custom changemode 0/1" command.

endchoice

config PTT_POWER
	int "Transmit Power (dBm)"
	default 0
	range -20 8

config PTT_CHANNEL_MASK
	hex "Channel page and channel number mask"
	default 0x00000800

config PTT_SW_VERSION
	int "Software Version"
	default 1
	range 0 255

config PTT_HW_VERSION
	int "Hardware Version"
	default 1
	range 0 255

config PTT_ANTENNA_DIVERSITY
	depends on !SOC_SERIES_NRF53X
	depends on NRFX_GPIOTE
	bool "Enable Antenna Diversity [EXPERIMENTAL]"
	select EXPERIMENTAL

if PTT_ANTENNA_DIVERSITY

choice
	prompt "Antenna Mode"
	default PTT_ANT_MODE_AUTO
	help
	  Select the antenna diversity mode

config PTT_ANT_MODE_AUTO
	bool "Automatic"

config PTT_ANT_MODE_MANUAL
	bool "Manual"

endchoice

config PTT_ANTENNA_NUMBER
	int "Antenna Number"
	range 0 1
	default 0

config PTT_ANT_PIN
	int "Antenna Selection Pin"
	default 20
	help
	  Choose which GPIO Pin is responsible for antenna selection

config PTT_ANT_TOGGLE_TIME
	int "Antenna Toggle Time"
	default 40
	help
	  Time in microseconds between antenna switches in Auto Mode

endif #PTT_ANTENNA_DIVERSITY

config PTT_CLK_OUT
	bool "Enable external clock signal generator"
	default y
	depends on NRFX_GPIOTE
	help
	  Output clock signal to an external pin

config PTT_POWER_MGMT
	bool "Enable power management commands"
	default y
	depends on NRFX_POWER
	help
	  Enable power management commands.

config PTT_CACHE_MGMT
	bool "Enable cache management commands"
	default y
	help
	  Enable cache management commands.

config PTT_RF_INIT_PRIORITY
	int "PTT RF init priority"
	default 50
	help
	  PTT RF module init priority

endmenu
```

## samples/peripheral/802154_phy_test/Kconfig.sysbuild
```kconfig
#
# Copyright (c) 2024 Nordic Semiconductor
#
# SPDX-License-Identifier: LicenseRef-Nordic-5-Clause
#

choice APPCORE
	default APPCORE_REMOTE_SHELL if SOC_NRF5340_CPUNET || SOC_NRF54H20_CPURAD || SOC_NRF54H20_ENGB_CPURAD

endchoice

source "${ZEPHYR_BASE}/share/sysbuild/Kconfig"
```

## samples/peripheral/802154_phy_test/boards/nrf21540dk_nrf52840.conf
```kconfig
#
# Copyright (c) 2023 Nordic Semiconductor
#
# SPDX-License-Identifier: LicenseRef-Nordic-5-Clause
#

CONFIG_SHELL_PROMPT_UART=">"
```

## samples/peripheral/802154_phy_test/boards/nrf52840dk_nrf52840.conf
```kconfig
#
# Copyright (c) 2023 Nordic Semiconductor
#
# SPDX-License-Identifier: LicenseRef-Nordic-5-Clause
#

CONFIG_SHELL_PROMPT_UART=">"

# nrfx drivers configuration:
CONFIG_NRFX_POWER=y  # enable DC/DC support
CONFIG_NRFX_RNG=y  # enable RNG
CONFIG_NRFX_TIMER2=y  # enable TIMER2

# Allow sharing the RTC between IEEE 802.15.4 and Zephyr
CONFIG_NRF_RTC_TIMER_USER_CHAN_COUNT=3
```
