/* Copyright (c) 2020 Nordic Semiconductor ASA
 *
 * SPDX-License-Identifier: LicenseRef-BSD-5-Clause-Nordic
 */

&uart0 {
	current-speed = <1000000>;
	status = "okay";
	hw-flow-control;
};

&uart1 {
	current-speed = <1000000>;
	status = "okay";
};
