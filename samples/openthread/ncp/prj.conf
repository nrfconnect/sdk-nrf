## CMakeLists.txt
```
#
# Copyright (c) 2020 Nordic Semiconductor ASA
#
# SPDX-License-Identifier: LicenseRef-Nordic-5-Clause
#

cmake_minimum_required(VERSION 3.13.1)

set(OT_NCP_VENDOR_HOOK_SOURCE_DIR ${CMAKE_CURRENT_SOURCE_DIR})

list(INSERT OVERLAY_CONFIG 0 ../common/overlay-ot-defaults.conf)

find_package(Zephyr REQUIRED HINTS $ENV{ZEPHYR_BASE})

project(openthread_ncp)

# NORDIC SDK APP START
target_sources(app PRIVATE src/main.c src/nrf_802154_radio_wrapper.c)
# NORDIC SDK APP END
```

## Kconfig
```
#
# Copyright (c) 2020 Nordic Semiconductor ASA
#
# SPDX-License-Identifier: LicenseRef-Nordic-5-Clause
#

menu "Zephyr Kernel"
source "Kconfig.zephyr"
endmenu

module = OT_NCP
module-str = ot_ncp
source "${ZEPHYR_BASE}/subsys/logging/Kconfig.template.log_config"
```

## sample.yaml
```
sample:
  name: OpenThread NCP sample
  description: Test OpenThread NCP
tests:
  samples.openthread.ncp:
    build_only: true
    build_on_all: true
    platform_allow: nrf52840dk_nrf52840 nrf52833dk_nrf52833
    tags: ci_build
```

## prj.conf
```kconfig
#
# Copyright (c) 2020 Nordic Semiconductor
#
# SPDX-License-Identifier: LicenseRef-Nordic-5-Clause
#

# Set OpenThread NCP architecture
CONFIG_OPENTHREAD_COPROCESSOR=y
CONFIG_OPENTHREAD_COPROCESSOR_NCP=y

# Logging
CONFIG_OT_NCP_LOG_LEVEL_ERR=y
CONFIG_LOG_MAX_LEVEL=1
CONFIG_OPENTHREAD_LOG_LEVEL_CRIT=y
CONFIG_NET_CONFIG_LOG_LEVEL_OFF=y
CONFIG_LOG_MINIMAL=n
CONFIG_LOG_BACKEND_SPINEL=y
CONFIG_LOG_BACKEND_RTT=n
CONFIG_LOG_BACKEND_UART=n
CONFIG_BOOT_BANNER=n

# Increase logging thread stack size due to Spinel backend needs
CONFIG_LOG_PROCESS_THREAD_STACK_SIZE=2048

# Enable OpenThread features set
CONFIG_OPENTHREAD_NORDIC_LIBRARY_MASTER=y
```

## overlay-logging.conf
```kconfig
#
# Copyright (c) 2020 Nordic Semiconductor
#
# SPDX-License-Identifier: LicenseRef-Nordic-5-Clause

# Option for configuring log level in sample module
CONFIG_OT_NCP_LOG_LEVEL_INF=y

# Option for configuring log level in whole Zephyr
CONFIG_LOG_MAX_LEVEL=3

# Option for configuring log level in OpenThread
CONFIG_OPENTHREAD_LOG_LEVEL_INFO=y
```

## overlay-vendor_hook.conf
```kconfig
#
# Copyright (c) 2020 Nordic Semiconductor
#
# SPDX-License-Identifier: LicenseRef-BSD-5-Clause-Nordic
#

CONFIG_OPENTHREAD_COPROCESSOR_VENDOR_HOOK_SOURCE="/src/user_vendor_hook.cpp"
```

## boards/nrf21540dk_nrf52840.overlay
```dts
/* Copyright (c) 2020 Nordic Semiconductor ASA
 *
 * SPDX-License-Identifier: LicenseRef-Nordic-5-Clause
 */

/* Default Zephyr configuration already provides GPIO support for FEM. */

&uart0 {
	current-speed = <1000000>;
	status = "okay";
	hw-flow-control;
};

&uart1 {
	current-speed = <1000000>;
	status = "okay";
};
```

## boards/nrf52833dk_nrf52833.overlay
```dts
/* Copyright (c) 2020 Nordic Semiconductor ASA
 *
 * SPDX-License-Identifier: LicenseRef-Nordic-5-Clause
 */

&uart0 {
	current-speed = <1000000>;
	status = "okay";
	hw-flow-control;
};

&uart1 {
	current-speed = <1000000>;
	status = "okay";
};
```

## boards/nrf52840dk_nrf52840.overlay
```dts
/* Copyright (c) 2020 Nordic Semiconductor ASA
 *
 * SPDX-License-Identifier: LicenseRef-Nordic-5-Clause
 */

&uart0 {
	current-speed = <1000000>;
	status = "okay";
	hw-flow-control;
};

&uart1 {
	current-speed = <1000000>;
	status = "okay";
};

/ {
	/*
	* In some default configurations within the nRF Connect SDK,
	* e.g. on nRF52840, the chosen zephyr,entropy node is &cryptocell.
	* This devicetree overlay ensures that default is overridden wherever it
	* is set, as this application uses the RNG node for entropy exclusively.
	*/
	chosen {
		zephyr,entropy = &rng;
	};
};
```

## src/main.c
```c
/*
 * Copyright (c) 2020 Nordic Semiconductor ASA
 *
 * SPDX-License-Identifier: LicenseRef-Nordic-5-Clause
 */
#include <zephyr.h>
#include <logging/log.h>

LOG_MODULE_REGISTER(ncp_sample, CONFIG_OT_NCP_LOG_LEVEL);

#define WELCOME_TEXT \
	"\n\r"\
	"\n\r"\
	"=================================================\n\r"\
	"OpenThread NCP application is now running on NCS.\n\r"\
	"=================================================\n\r"


void main(void)
{
	LOG_INF(WELCOME_TEXT);
}
```

## src/nrf_802154_radio_wrapper.c
```c
/*
 * Copyright (c) 2020 Nordic Semiconductor ASA
 *
 * SPDX-License-Identifier: LicenseRef-Nordic-5-Clause
 */
#include "nrf_802154_radio_wrapper.h"
#include <nrf_802154.h>
#include <device.h>
#include <net/ieee802154_radio.h>

static const struct device *radio_dev;
static struct ieee802154_radio_api *radio_api;

bool nrf_802154_radio_wrapper_auto_ack_get(void)
{
	return nrf_802154_auto_ack_get();
}

void nrf_802154_radio_wrapper_auto_ack_set(bool enabled)
{
	nrf_802154_auto_ack_set(enabled);
}

uint16_t nrf_802154_radio_wrapper_hw_capabilities_get(void)
{
	radio_dev = device_get_binding(CONFIG_NET_CONFIG_IEEE802154_DEV_NAME);
	__ASSERT_NO_MSG(radio_dev != NULL);

	radio_api = (struct ieee802154_radio_api *)radio_dev->api;
	__ASSERT_NO_MSG(radio_api != NULL);

	return radio_api->get_capabilities(radio_dev);
}
```

## src/nrf_802154_radio_wrapper.h
```c
/*
 * Copyright (c) 2020 Nordic Semiconductor ASA
 *
 * SPDX-License-Identifier: LicenseRef-Nordic-5-Clause
 */
#ifndef __NRF_802154_RADIO_WRAPPER_H__
#define __NRF_802154_RADIO_WRAPPER_H__

#include <stdint.h>
#include <stdbool.h>

#ifdef __cplusplus
extern "C" {
#endif

/**
 * Gets current automatic acknowledgments mode state.
 *
 * @return                true when auto ACK is set, false otherwise
 */
bool nrf_802154_radio_wrapper_auto_ack_get(void);

/**
 * Enables or disables the automatic acknowledgments mode (auto ACK).
 *
 * @param[in]  enabled        Value setting (true) or clearing (false)
 *                              auto ACK radio mode.
 */
void nrf_802154_radio_wrapper_auto_ack_set(bool enabled);

/**
 * Gets the device hardware capabilities
 *
 * @return                0 on failure; nonzero hw capabilities value
 *                          on success (@ref ieee802154_hw_caps).
 */
uint16_t nrf_802154_radio_wrapper_hw_capabilities_get(void);

#ifdef __cplusplus
}
#endif

#endif
```

## src/user_vendor_hook.cpp
```c
/*
 * Copyright (c) 2020 Nordic Semiconductor ASA
 *
 * SPDX-License-Identifier: LicenseRef-Nordic-5-Clause
 */
/**
 * @file
 *   This file shows how to implement the NCP vendor hook.
 */
#if OPENTHREAD_ENABLE_NCP_VENDOR_HOOK
#include "nrf_802154_radio_wrapper.h"
#include <logging/log.h>
#include <ncp_base.hpp>
#include <ncp_uart.hpp>
#include <common/new.hpp>

#define VENDOR_SPINEL_PROP_VENDOR_NAME SPINEL_PROP_VENDOR__BEGIN
#define VENDOR_SPINEL_PROP_AUTO_ACK_ENABLED SPINEL_PROP_VENDOR__BEGIN + 1
#define VENDOR_SPINEL_PROP_HW_CAPABILITIES SPINEL_PROP_VENDOR__BEGIN + 2

LOG_MODULE_REGISTER(ncp_sample_vendor_hook, CONFIG_OT_NCP_LOG_LEVEL);

namespace ot {
namespace Ncp {

otError NcpBase::VendorCommandHandler(uint8_t aHeader, unsigned int aCommand)
{
    otError error = OT_ERROR_NONE;

    LOG_DBG("VendorCommandHandler");

    switch (aCommand)
    {
        // TODO: Implement your command handlers here.

    default:
        error = PrepareLastStatusResponse(aHeader, SPINEL_STATUS_INVALID_COMMAND);
    }

    return error;
}

void NcpBase::VendorHandleFrameRemovedFromNcpBuffer(Spinel::Buffer::FrameTag aFrameTag)
{
    // This method is a callback which mirrors `NcpBase::HandleFrameRemovedFromNcpBuffer()`.
    // It is called when a spinel frame is sent and removed from NCP buffer.
    //
    // (a) This can be used to track and verify that a vendor spinel frame response is
    //     delivered to the host (tracking the frame using its tag).
    //
    // (b) It indicates that NCP buffer space is now available (since a spinel frame is
    //     removed). This can be used to implement reliability mechanisms to re-send
    //     a failed spinel command response (or an async spinel frame) transmission
    //     (failed earlier due to NCP buffer being full).

    OT_UNUSED_VARIABLE(aFrameTag);
}

otError NcpBase::VendorGetPropertyHandler(spinel_prop_key_t aPropKey)
{
    otError error = OT_ERROR_NONE;

    switch (aPropKey)
    {
    case VENDOR_SPINEL_PROP_VENDOR_NAME:
        LOG_DBG("Got NAME get property request");
        error = mEncoder.WriteUtf8("Nordic Seminconductor");
        break;
    case VENDOR_SPINEL_PROP_AUTO_ACK_ENABLED:
        LOG_DBG("Got VENDOR_SPINEL_PROP_AUTO_ACK_ENABLED get property request");
        error = mEncoder.WriteUint8(nrf_802154_radio_wrapper_auto_ack_get());
        break;
    case VENDOR_SPINEL_PROP_HW_CAPABILITIES:
        LOG_DBG("Got VENDOR_SPINEL_PROP_HW_CAPABILITIES get property request");
        error = mEncoder.WriteUint16(nrf_802154_radio_wrapper_hw_capabilities_get());
        break;

        // TODO: Implement your get properties handlers here.
    default:
        error = OT_ERROR_NOT_FOUND;
        break;
    }

    return error;
}

otError NcpBase::VendorSetPropertyHandler(spinel_prop_key_t aPropKey)
{
    otError error = OT_ERROR_NONE;

    switch (aPropKey)
    {
    case VENDOR_SPINEL_PROP_AUTO_ACK_ENABLED: {
            LOG_DBG("Got VENDOR_SPINEL_PROP_AUTO_ACK_ENABLED set property request");

            uint8_t mode = 0;
            SuccessOrExit(error = mDecoder.ReadUint8(mode));
            nrf_802154_radio_wrapper_auto_ack_set(mode);
        }
        break;

        // TODO: Implement your set properties handlers here.
    default:
        error = OT_ERROR_NOT_FOUND;
        break;
    }

exit:
    return error;
}

} // namespace Ncp
} // namespace ot

//------------------------------------------------------------------
// When OPENTHREAD_ENABLE_NCP_VENDOR_HOOK is enabled, vendor code is
// expected to provide the `otNcpInit()` function. The reason behind
// this is to enable vendor code to define its own sub-class of
// `NcpBase` or `NcpUart`/`NcpSpi`.
//
// Example below show how to add a vendor sub-class over `NcpUart`.

class NcpVendorUart : public ot::Ncp::NcpUart
{
public:
    NcpVendorUart(ot::Instance *aInstance)
        : ot::Ncp::NcpUart(aInstance)
    {
    }

    // Add public/private methods or member variables
};

static OT_DEFINE_ALIGNED_VAR(sNcpVendorRaw, sizeof(NcpVendorUart), uint64_t);

extern "C" void otNcpInit(otInstance *aInstance)
{
    NcpVendorUart *ncpVendor = NULL;
    ot::Instance *instance  = static_cast<ot::Instance *>(aInstance);

    ncpVendor = new (&sNcpVendorRaw) NcpVendorUart(instance);
}
#endif
```
