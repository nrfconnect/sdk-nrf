## samples/tfm/protected_storage/sample.yaml
```yaml
sample:
  description: Protected Storage API sample
  name: PSA Protected Storage
common:
  tags: psa
  platform_allow: nrf5340dk_nrf5340_cpuappns nrf9160dk_nrf9160ns
  harness: console
  harness_config:
    type: multi_line
    regex:
      - "TF-M Protected Storage sample started."
      - "Writing data to UID1: .*"
      - "Info on data stored in UID1:"
      - "- Size: [0-9]"
      - "- Capacity: 0x[0-9a-f]"
      - "Got expected error (PSA_ERROR_NO_PERMITTED) when writing to protected UID"

tests:
  sample.tfm.protected_storage:
    tags: tfm ci_build
```

## samples/tfm/provisioning_image/Kconfig.sysbuild
```kconfig
#
# Copyright (c) 2024 Nordic Semiconductor
#
# SPDX-License-Identifier: LicenseRef-Nordic-5-Clause
#

menu "Network core configuration"
	depends on SUPPORT_NETCORE

choice NETCORE
	prompt "Netcore image"
	default NETCORE_PROVISIONING_IMAGE_NET_CORE if NETCORE_REMOTE_BOARD_TARGET_CPUCLUSTER != ""

config NETCORE_PROVISIONING_IMAGE_NET_CORE
	bool "Provisioning"
	help
	  Include tfm provisioning network core image.

endchoice

if !NETCORE_NONE

config NETCORE_IMAGE_NAME
	default "provisioning_image_net_core" if NETCORE_PROVISIONING_IMAGE_NET_CORE

config NETCORE_IMAGE_PATH
	default "${ZEPHYR_NRF_MODULE_DIR}/samples/tfm/provisioning_image_net_core" if NETCORE_PROVISIONING_IMAGE_NET_CORE

endif # !NETCORE_NONE

endmenu

source "${ZEPHYR_BASE}/share/sysbuild/Kconfig"
```

## samples/tfm/provisioning_image/boards/nrf5340dk_nrf5340_cpuapp.conf
```kconfig
#
# Copyright (c) 2023 Nordic Semiconductor ASA
#
# SPDX-License-Identifier: LicenseRef-Nordic-5-Clause
#


# Enable the network core
CONFIG_SOC_NRF53_CPUNET_ENABLE=y
```

## samples/tfm/provisioning_image/boards/nrf9151dk_nrf9151.conf
```kconfig
#
# Copyright (c) 2026 Nordic Semiconductor ASA
#
# SPDX-License-Identifier: LicenseRef-Nordic-5-Clause
#

CONFIG_IDENTITY_KEY=y
CONFIG_IDENTITY_KEY_RANDOM=y

CONFIG_PSA_CRYPTO_DRIVER_CC3XX=y
CONFIG_PSA_CRYPTO_DRIVER_OBERON=n

CONFIG_MPU_ALLOW_FLASH_WRITE=y
CONFIG_NRFX_NVMC=y
```

## samples/tfm/provisioning_image/sample.yaml
```yaml
sample:
  description: Initiates the provisioning of a TF-M image.
  name: Provisioning Image
common:
  tags:
    - keys
    - ci_samples_tfm
  platform_allow:
    - nrf5340dk/nrf5340/cpuapp
    - nrf9151dk/nrf9151
    - nrf9160dk/nrf9160
    - nrf9161dk/nrf9161
    - nrf54l15dk/nrf54l15/cpuapp
    - nrf54lv10dk/nrf54lv10a/cpuapp
    - nrf54lm20dk/nrf54lm20a/cpuapp
    - nrf54lm20dk/nrf54lm20b/cpuapp
  harness: console
tests:
  sample.tfm.provisioning_image:
    sysbuild: true
    tags:
      - keys
      - ci_build
      - sysbuild
      - ci_samples_tfm
    platform_allow:
      - nrf5340dk/nrf5340/cpuapp
      - nrf9151dk/nrf9151
      - nrf9160dk/nrf9160
      - nrf9161dk/nrf9161
    integration_platforms:
      - nrf5340dk/nrf5340/cpuapp
      - nrf9151dk/nrf9151
      - nrf9160dk/nrf9160
      - nrf9161dk/nrf9161
    harness_config:
      type: multi_line
      regex:
        - "Writing the identity key to KMU"
        - "Success!"
  sample.tfm.provisioning_image.nrf54l:
    sysbuild: true
    tags:
      - keys
      - ci_build
      - sysbuild
      - ci_samples_tfm
    platform_allow:
      - nrf54l15dk/nrf54l15/cpuapp
      - nrf54lv10dk/nrf54lv10a/cpuapp
      - nrf54lm20dk/nrf54lm20a/cpuapp
      - nrf54lm20dk/nrf54lm20b/cpuapp
    integration_platforms:
      - nrf54l15dk/nrf54l15/cpuapp
      - nrf54lv10dk/nrf54lv10a/cpuapp
      - nrf54lm20dk/nrf54lm20a/cpuapp
      - nrf54lm20dk/nrf54lm20b/cpuapp
    harness_config:
      type: one_line
      regex:
        - "Success!"
```

## samples/tfm/provisioning_image_net_core/sample.yaml
```yaml
sample:
  description: Provisioning image which disables the debug access of the network core.
  name: Provisioning image for the network core
tests:
  sample.tfm.provisioning_image_net_core.build:
    sysbuild: true
    build_only: true
    integration_platforms:
      - nrf5340dk/nrf5340/cpuapp
    platform_allow: nrf5340dk/nrf5340/cpuapp
    tags: ci_build sysbuild
```

## samples/tfm/tfm_cert/sample.yaml
```yaml
sample:
  description: TF-M certifiable sample
  name: TF-M Cert
common:
    tags: tfm
    platform_allow: nrf5340dk_nrf5340_cpuapp_ns nrf9160dk_nrf9160_ns
    integration_platforms:
      - nrf5340dk_nrf5340_cpuapp_ns
      - nrf9160dk_nrf9160_ns
tests:
  sample.tfm.cert:
    tags: tfm ci_build
    build_only: true
```

## samples/tfm/tfm_hello_world/sample.yaml
```yaml
sample:
  description: Hello World sample, the simplest Zephyr application, with TF-M enabled
  name: TF-M Hello World sample
common:
  tags:
    - tfm
    - ci_samples_tfm
  platform_allow:
    - nrf5340dk/nrf5340/cpuapp/ns
    - nrf9151dk/nrf9151/ns
    - nrf9160dk/nrf9160/ns
    - nrf9161dk/nrf9161/ns
  integration_platforms:
    - nrf5340dk/nrf5340/cpuapp/ns
    - nrf9151dk/nrf9151/ns
    - nrf9160dk/nrf9160/ns
    - nrf9161dk/nrf9161/ns
  harness: console
  harness_config:
    type: multi_line
    regex:
      - ".*Example finished successfully!.*"
tests:
  sample.tfm.helloworld:
    sysbuild: true
    tags:
      - ci_build
      - sysbuild
      - ci_samples_tfm
    platform_allow:
      - nrf54l15dk/nrf54l15/cpuapp/ns
      - nrf54lv10dk/nrf54lv10a/cpuapp/ns
      - nrf54lm20dk/nrf54lm20a/cpuapp/ns
      - nrf54lm20dk/nrf54lm20b/cpuapp/ns
      - nrf7120dk/nrf7120/cpuapp/ns
    integration_platforms:
      - nrf54l15dk/nrf54l15/cpuapp/ns
      - nrf54lv10dk/nrf54lv10a/cpuapp/ns
      - nrf54lm20dk/nrf54lm20a/cpuapp/ns
      - nrf54lm20dk/nrf54lm20b/cpuapp/ns
      - nrf7120dk/nrf7120/cpuapp/ns
  sample.tfm.hello_world.bootloaders:
    sysbuild: true
    tags:
      - ci_build
      - sysbuild
      - ci_samples_tfm
    extra_args: FILE_SUFFIX=bootloaders
  sample.tfm.hello_world.bootloaders_debug:
    sysbuild: true
    build_only: true
    tags:
      - ci_build
      - sysbuild
      - ci_samples_tfm
    extra_args:
      - FILE_SUFFIX=bootloaders
      - CONFIG_DEBUG_OPTIMIZATIONS=y
  sample.tfm.hello_world.full:
    sysbuild: true
    tags:
      - ci_build
      - sysbuild
      - ci_samples_tfm
    extra_args:
      - CONFIG_TFM_PROFILE_TYPE_NOT_SET=y
      - CONFIG_NRF_SECURITY=y
  sample.tfm.hello_world.lvl2:
    sysbuild: true
    tags:
      - ci_build
      - sysbuild
      - ci_samples_tfm
    extra_args:
      - CONFIG_TFM_IPC=y
      - CONFIG_TFM_ISOLATION_LEVEL=2
      - CONFIG_TFM_PROFILE_TYPE_NOT_SET=y
```

## samples/tfm/tfm_psa_template/boards/nrf54l15dk_nrf54l15_cpuapp_ns.conf
```kconfig
CONFIG_SPI_NOR=n

# Since provisioning is not supported for the nRF54L15 yet,
# we will use dummy provisioning for now.
CONFIG_TFM_NRF_PROVISIONING=n
CONFIG_TFM_DUMMY_PROVISIONING=y
```

## samples/tfm/tfm_psa_template/boards/nrf54lm20dk_nrf54lm20a_cpuapp_ns.conf
```kconfig
#
# Copyright (c) 2026 Nordic Semiconductor ASA
#
# SPDX-License-Identifier: LicenseRef-Nordic-5-Clause
#

# The get_fw_info() demo reads the NSIB fw_info of the s0/s1 MCUboot pair, which
# has no non-secure storage backend on nRF54L, so it is compiled out here.
CONFIG_SECURE_BOOT=n
```

## samples/tfm/tfm_psa_template/boards/nrf9160dk_nrf9160_ns.conf
```kconfig
#
# Copyright (c) 2022 Nordic Semiconductor ASA
#
# SPDX-License-Identifier: LicenseRef-Nordic-5-Clause
#

CONFIG_FPU=y
CONFIG_IDENTITY_KEY_TFM=y
```

## samples/tfm/tfm_psa_template/sysbuild/mcuboot/boards/nrf54l15dk_nrf54l15_cpuapp.conf
```kconfig
#
# Copyright (c) 2025 Nordic Semiconductor ASA
#
# SPDX-License-Identifier: LicenseRef-Nordic-5-Clause
#

# MCUboot on nRF54L is signed by NSIB (b0) into the s0/s1 slot pair, so the s1
# image carries an extra ~0x630-byte trailer on top of the MCUboot binary. The
# size must also satisfy size mod 0x1000 == 0x800 to keep s0 and s1 equally
# sized after partition manager applies the 0x1000 end alignment to mcuboot;
# any other value introduces an EMPTY pad before s0_image and trips the
# BUILD_ASSERT(S0_SIZE == S1_SIZE) check in bl_validation. 0xe800 is the
# smallest such value that fits MCUboot+trailer with FIH profile medium.
CONFIG_PM_PARTITION_SIZE_MCUBOOT=0xe800
CONFIG_BOOT_MAX_IMG_SECTORS=256

# nRF54L uses hardware ACL for memory protection; FPROTECT is not needed.
CONFIG_FPROTECT=n
```

## samples/tfm/tfm_psa_template/sysbuild/mcuboot/boards/nrf54lm20dk_nrf54lm20b_cpuapp.conf
```kconfig
#
# Copyright (c) 2026 Nordic Semiconductor ASA
#
# SPDX-License-Identifier: LicenseRef-Nordic-5-Clause
#

# FPROTECT is set in NSIB instead
CONFIG_FPROTECT=n
```

## samples/tfm/tfm_psa_template/sysbuild/mcuboot/boards/nrf9160dk_nrf9160.conf
```kconfig
#
# Copyright (c) 2026 Nordic Semiconductor ASA
#
# SPDX-License-Identifier: LicenseRef-Nordic-5-Clause
#

CONFIG_NRF_RTC_TIMER_USER_CHAN_COUNT=0
```

## samples/tfm/tfm_psa_template_net_core/sample.yaml
```yaml
sample:
  description: Minimal image for network core
  name: TFM PSA Template Network Core
tests:
  sample.tfm.psa_template_net_core:
    sysbuild: true
    build_only: true
    integration_platforms:
      - nrf5340dk/nrf5340/cpunet
    platform_allow: nrf5340dk/nrf5340/cpunet
    tags: ci_build sysbuild
```

## samples/tfm/tfm_psa_test/sample.yaml
```yaml
common:
    tags: tfm
    platform_allow: nrf5340dk_nrf5340_cpuappns nrf9160dk_nrf9160ns
    harness: console
    harness_config:
      type: multi_line
      regex:
        - "\\*\\*\\*\\*\\* PSA Architecture Test Suite - Version 1.1 \\*\\*\\*\\*\\*"
        - "TOTAL FAILED    : 0"
sample:
  name: "TFM PSA Test"

tests:
  sample.tfm.psa_protected_storage_test:
    extra_args: "CONFIG_TFM_PSA_TEST_PROTECTED_STORAGE=y"
    timeout: 100
  sample.tfm.psa_internal_trusted_storage_test:
    extra_args: "CONFIG_TFM_PSA_TEST_INTERNAL_TRUSTED_STORAGE=y"
  sample.tfm.psa_crypto_test:
    extra_args: "CONFIG_TFM_PSA_TEST_CRYPTO=y CONFIG_MAIN_STACK_SIZE=4096"
    timeout: 240
  sample.tfm.psa_initial_attestation_test:
    extra_args: "CONFIG_TFM_PSA_TEST_INITIAL_ATTESTATION=y CONFIG_MAIN_STACK_SIZE=4096"
```

## samples/tfm/tfm_secure_peripheral/Kconfig.sysbuild
```kconfig
#
# Copyright (c) 2026 Nordic Semiconductor
#
# SPDX-License-Identifier: LicenseRef-Nordic-5-Clause
#

config PARTITION_MANAGER
	default n if !SOC_SERIES_NRF53 && !BOARD_THINGY91X && !BOARD_THINGY91

source "share/sysbuild/Kconfig"
```

## samples/tfm/tfm_secure_peripheral/boards/nrf5340dk_nrf5340_cpuapp.conf
```kconfig
#
# Copyright (c) 2022 Nordic Semiconductor ASA
#
# SPDX-License-Identifier: LicenseRef-Nordic-5-Clause
#

CONFIG_NRF_GPIO0_PIN_MASK_SECURE=0x00800000 # P0: 23
CONFIG_NRF_GPIO1_PIN_MASK_SECURE=0x0000a000 # P1: 13, 15
```

## samples/tfm/tfm_secure_peripheral/boards/nrf5340dk_nrf5340_cpuapp_ns.conf
```kconfig
#
# Copyright (c) 2022 Nordic Semiconductor ASA
#
# SPDX-License-Identifier: LicenseRef-Nordic-5-Clause
#

# P0: 23 (button0)
CONFIG_NRF_GPIO0_PIN_MASK_SECURE=0x00800000

CONFIG_NRF_TIMER1_SECURE=y
CONFIG_NRF_SPIM3_SECURE=y
CONFIG_NRF_GPIOTE0_SECURE=y
```

## samples/tfm/tfm_secure_peripheral/boards/nrf54l15dk_nrf54l15_cpuapp_ns_no_ps.conf
```kconfig
#
# Copyright (c) 2026 Nordic Semiconductor ASA
#
# SPDX-License-Identifier: LicenseRef-Nordic-5-Clause
#

# Disable Protected Storage and ITS - not needed for this sample
CONFIG_TFM_PARTITION_PROTECTED_STORAGE=n
CONFIG_TFM_PARTITION_INTERNAL_TRUSTED_STORAGE=n

# Disable PSA crypto storage - keys are volatile only (no persistence)
CONFIG_MBEDTLS_PSA_CRYPTO_STORAGE_C=n

# Disable key derivation module
CONFIG_TFM_CRYPTO_KEY_DERIVATION_MODULE_ENABLED=n
```

## samples/tfm/tfm_secure_peripheral/boards/nrf54lm20dk_nrf54lm20a_cpuapp_ns.conf
```kconfig
#
# Copyright (c) 2025 Nordic Semiconductor ASA
#
# SPDX-License-Identifier: LicenseRef-Nordic-5-Clause
#

# P1: 26 (button0)
CONFIG_NRF_GPIO1_PIN_MASK_SECURE=0x04000000

CONFIG_NRF_TIMER10_SECURE=y
CONFIG_NRF_SPIM21_SECURE=y
CONFIG_NRF_GPIOTE20_SECURE=y
CONFIG_NRF_GPIOTE20_SECURE_CHANNELS_MASK=0x2
```

## samples/tfm/tfm_secure_peripheral/boards/nrf54lm20dk_nrf54lm20b_cpuapp_ns.conf
```kconfig
#
# Copyright (c) 2026 Nordic Semiconductor ASA
#
# SPDX-License-Identifier: LicenseRef-Nordic-5-Clause
#

# P1: 11 (SPIM21_MOSI), 12 (SPIM21_SCK), 26 (button0)
CONFIG_NRF_GPIO1_PIN_MASK_SECURE=0x04001800

CONFIG_NRF_TIMER10_SECURE=y
CONFIG_NRF_SPIM21_SECURE=y
CONFIG_NRF_GPIOTE20_SECURE=y
CONFIG_NRF_GPIOTE20_SECURE_CHANNELS_MASK=0x2
```

## samples/tfm/tfm_secure_peripheral/boards/nrf54lv10dk_nrf54lv10a_cpuapp_ns.conf
```kconfig
#
# Copyright (c) 2025 Nordic Semiconductor ASA
#
# SPDX-License-Identifier: LicenseRef-Nordic-5-Clause
#

# P1: 5 (SPIM_MOSI), 6 (SPIM_SCK) 15 (button0)
CONFIG_NRF_GPIO1_PIN_MASK_SECURE=0x00008060

CONFIG_NRF_TIMER10_SECURE=y
CONFIG_NRF_SPIM21_SECURE=y
CONFIG_NRF_GPIOTE20_SECURE=y
CONFIG_NRF_GPIOTE20_SECURE_CHANNELS_MASK=0x2
```

## samples/tfm/tfm_secure_peripheral/boards/nrf9151dk_nrf9151_ns.conf
```kconfig
#
# Copyright (c) 2024 Nordic Semiconductor ASA
#
# SPDX-License-Identifier: LicenseRef-Nordic-5-Clause
#

CONFIG_FPU=y
# P0: 8 (button0), 11 (SPIM_MOSI), 13 (SPIM_SCK)
CONFIG_NRF_GPIO0_PIN_MASK_SECURE=0x00002900
```

## samples/tfm/tfm_secure_peripheral/boards/nrf9160dk_nrf9160.conf
```kconfig
#
# Copyright (c) 2022 Nordic Semiconductor ASA
#
# SPDX-License-Identifier: LicenseRef-Nordic-5-Clause
#

CONFIG_NRF_GPIO0_PIN_MASK_SECURE=0x00002840 # P0: 6, 11, 13
```
