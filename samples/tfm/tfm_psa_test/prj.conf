## CMakeLists.txt
```
#
# Copyright (c) 2021 Nordic Semiconductor ASA
#
# SPDX-License-Identifier: LicenseRef-Nordic-5-Clause
#

cmake_minimum_required(VERSION 3.13.1)

find_package(Zephyr REQUIRED HINTS $ENV{ZEPHYR_BASE})

project(tfm_psa_storage_test)

target_sources(app PRIVATE src/main.c)
```

## sample.yaml
```
common:
    tags: tfm
    platform_allow: nrf5340dk_nrf5340_cpuappns nrf9160dk_nrf9160ns
    harness: console
    harness_config:
      type: multi_line
      regex:
        - "\\*\\*\\*\\*\\* PSA Architecture Test Suite - Version 1.1 \\*\\*\\*\\*\\*"
        - "TOTAL FAILED    : 0"
sample:
  name: "TFM PSA Test"

tests:
  sample.tfm.psa_protected_storage_test:
    extra_args: "CONFIG_TFM_PSA_TEST_PROTECTED_STORAGE=y"
    timeout: 100
  sample.tfm.psa_internal_trusted_storage_test:
    extra_args: "CONFIG_TFM_PSA_TEST_INTERNAL_TRUSTED_STORAGE=y"
  sample.tfm.psa_crypto_test:
    extra_args: "CONFIG_TFM_PSA_TEST_CRYPTO=y CONFIG_MAIN_STACK_SIZE=4096"
    timeout: 240
  sample.tfm.psa_initial_attestation_test:
    extra_args: "CONFIG_TFM_PSA_TEST_INITIAL_ATTESTATION=y CONFIG_MAIN_STACK_SIZE=4096"
```

## prj.conf
```kconfig
#
# Copyright (c) 2021 Nordic Semiconductor ASA
#
# SPDX-License-Identifier: LicenseRef-Nordic-5-Clause
#

CONFIG_BUILD_WITH_TFM=y
```

## src/main.c
```c
/*
 * Copyright (c) 2021 Nordic Semiconductor ASA.
 *
 * SPDX-License-Identifier: LicenseRef-Nordic-5-Clause
 */

#include <zephyr.h>

/**
 * \brief This symbol is the entry point provided by the PSA API compliance
 *        test libraries
 */
extern void val_entry(void);

extern void TIMER1_Handler(void);

__attribute__((noreturn))
void main(void)
{
	IRQ_CONNECT(TIMER1_IRQn, NRFX_TIMER_DEFAULT_CONFIG_IRQ_PRIORITY,
		TIMER1_Handler, NULL, 0);

#if !defined(CONFIG_TFM_PSA_TEST_CRYPTO) \
	&& !defined(CONFIG_TFM_PSA_TEST_PROTECTED_STORAGE) \
	&& !defined(CONFIG_TFM_PSA_TEST_INTERNAL_TRUSTED_STORAGE) \
	&& !defined(CONFIG_TFM_PSA_TEST_STORAGE) \
	&& !defined(CONFIG_TFM_PSA_TEST_INITIAL_ATTESTATION)
	printk("No PSA test suite set. Use Kconfig to enable a test suite.\n");
#else
	val_entry();
#endif

	for (;;) {
	}
}
```
