/*
 * Copyright (c) 2026 Nordic Semiconductor ASA
 *
 * SPDX-License-Identifier: LicenseRef-Nordic-5-Clause
 *
 * B0 (NSIB) flash layout for the nRF91 build of tfm_psa_template. Shares the
 * partition table with the application and MCUboot images via the included
 * board overlay.
 */

#include "../../../boards/nrf9160dk_nrf9160_ns.overlay"

&sram0_s {
	reg = <0x0 0x40000>;
};

/ {
	chosen {
		zephyr,code-partition = &b0_partition;
	};
};
