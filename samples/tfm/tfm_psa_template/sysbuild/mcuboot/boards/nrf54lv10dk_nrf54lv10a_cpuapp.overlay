/*
 * Copyright (c) 2026 Nordic Semiconductor ASA
 *
 * SPDX-License-Identifier: LicenseRef-Nordic-5-Clause
 *
 * MCUboot flash layout for the nRF54LV10A build of tfm_psa_template. Shares the
 * partition table with the application and B0 images.
 */

/* Replace the default cpuapp (secure) partitions with the shared table. */
/delete-node/ &boot_partition;
/delete-node/ &slot0_partition;
/delete-node/ &slot1_partition;
/delete-node/ &storage_partition;

#include "../../../dts/nrf54lv10dk_nrf54lv10a_cpuapp_partitions.dtsi"

/ {
	chosen {
		zephyr,code-partition = &s0_partition;
	};
};
