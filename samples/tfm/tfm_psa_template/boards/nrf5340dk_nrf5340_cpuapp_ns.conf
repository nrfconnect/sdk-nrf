## samples/tfm/tfm_psa_template/boards/nrf5340dk_nrf5340_cpuapp_ns.conf
```kconfig
#
# Copyright (c) 2024 Nordic Semiconductor ASA
#
# SPDX-License-Identifier: LicenseRef-Nordic-5-Clause
#

CONFIG_FPU=y
CONFIG_SOC_NRF53_CPUNET_ENABLE=y
CONFIG_IDENTITY_KEY_TFM=y
```

## samples/tfm/tfm_psa_template/sample.yaml
```yaml
sample:
  description: TF-M PSA Template
  name: TF-M PSA Template
common:
  tags:
    - tfm
    - ci_samples_tfm
  platform_allow:
    - nrf5340dk/nrf5340/cpuapp/ns
    - nrf9151dk/nrf9151/ns
    - nrf9160dk/nrf9160/ns
    - nrf9161dk/nrf9161/ns
    - nrf54l15dk/nrf54l15/cpuapp/ns
    - nrf54lv10dk/nrf54lv10a/cpuapp/ns
    - nrf54lm20dk/nrf54lm20a/cpuapp/ns
    - nrf54lm20dk/nrf54lm20b/cpuapp/ns
  integration_platforms:
    - nrf5340dk/nrf5340/cpuapp/ns
    - nrf9151dk/nrf9151/ns
    - nrf9160dk/nrf9160/ns
    - nrf9161dk/nrf9161/ns
    - nrf54l15dk/nrf54l15/cpuapp/ns
    - nrf54lv10dk/nrf54lv10a/cpuapp/ns
    - nrf54lm20dk/nrf54lm20a/cpuapp/ns
    - nrf54lm20dk/nrf54lm20b/cpuapp/ns
  # The device has to be provisioned by a separate image programmed before the
  # application, so the sample runs from a pytest harness.
  harness: pytest
  harness_config:
    pytest_root:
      - "pytest/test_tfm_psa_template.py"
tests:
  sample.tfm.psa_template:
    sysbuild: true
    tags:
      - ci_build
      - sysbuild
      - ci_samples_tfm
      - pytest
```

## samples/tfm/tfm_psa_template/sysbuild/mcuboot/boards/nrf5340dk_nrf5340_cpuapp.conf
```kconfig
#
# Copyright (c) 2024 Nordic Semiconductor ASA
#
# SPDX-License-Identifier: LicenseRef-Nordic-5-Clause
#

CONFIG_PCD_READ_NETCORE_APP_VERSION=y
CONFIG_NRF_RTC_TIMER_USER_CHAN_COUNT=0
```

## samples/tfm/tfm_secure_peripheral/boards/nrf54lc10dk_nrf54lc10a_cpuapp_ns.conf
```kconfig
#
# Copyright (c) 2026 Nordic Semiconductor ASA
#
# SPDX-License-Identifier: LicenseRef-Nordic-5-Clause
#

# P1: 21 (button0)
CONFIG_NRF_GPIO1_PIN_MASK_SECURE=0x00200000

CONFIG_NRF_TIMER10_SECURE=y
CONFIG_NRF_SPIM21_SECURE=y
CONFIG_NRF_GPIOTE20_SECURE=y
CONFIG_NRF_GPIOTE20_SECURE_CHANNELS_MASK=0x2
```

## samples/vpr/vio_clocked_output/Kconfig
```kconfig
# Copyright (c) 2026 Nordic Semiconductor ASA
# SPDX-License-Identifier: LicenseRef-Nordic-5-Clause

menu "VPR VIO clocked output sample"

config APP_VIO_PIN
	int "VIO bit index used as UART TX"
	range 0 15
	help
	  The VPR VIO pin number used for the emulated UART signal.
	  This must match the physical pin routed to the VPR core.

config APP_TX_GPIO_PORT
	int "Physical GPIO port for the emulated UART TX line"
	help
	  Physical GPIO port of the TX pin. It must correspond to the VIO index and board routing.
	  Required for nRF54L, only for testing purposes on nRF92.

config APP_TX_GPIO_PIN
	int "Physical GPIO pin for the emulated UART TX line"
	help
	  Physical GPIO pin number on :kconfig:option:`CONFIG_APP_TX_GPIO_PORT`.
	  It must correspond to the VIO index.
	  Required for nRF54L, only for testing purposes on nRF92.

config APP_UART_BAUD_RATE
	int "Baud rate of the emulated UART"
	default 115200
	help
	  Baud rate of the bit-banged UART transmitter.
	  It must correspond to the VIO index.
	  The bit period is derived from the VPR core clock, so very low baud rates may exceed the
	  16-bit range of VTIM counter 0.

endmenu

source "Kconfig.zephyr"
```

## samples/vpr/vio_clocked_output/sample.yaml
```yaml
sample:
  name: VPR VIO clocked output
  description: Drive a VIO pin from a VPR coprocessor emulating UART
tests:
  sample.vpr.vio_clocked_output.build:
    build_only: true
    sysbuild: true
    integration_platforms:
      - nrf9251dk/nrf9251/cpuflpr
    platform_allow:
      - nrf9251dk/nrf9251/cpuflpr
      - nrf9251dk/nrf9251/cpuppr
      - nrf54l15dk/nrf54l15/cpuflpr
    tags:
      - ci_build
```

## samples/vpr/vio_shift_output/sample.yaml
```yaml
sample:
  name: VPR VIO shift output
  description: Drive a VIO pin from a VPR coprocessor emulating UART using output shifting.
tests:
  sample.vpr.vio_shift_output.build:
    build_only: true
    sysbuild: true
    integration_platforms:
      - nrf9251dk/nrf9251/cpuflpr
    platform_allow:
      - nrf9251dk/nrf9251/cpuflpr
      - nrf9251dk/nrf9251/cpuppr
      - nrf54l15dk/nrf54l15/cpuflpr
    tags:
      - ci_build
```

## samples/vpr/vio_toggle/Kconfig
```kconfig
# Copyright (c) 2026 Nordic Semiconductor ASA
# SPDX-License-Identifier: LicenseRef-Nordic-5-Clause

menu "VPR VIO sample"

config APP_VIO_PIN
	int "VIO bit index to drive"
	range 0 15
	default 0
	help
	  The VPR VIO pin number that the sample toggles. This must match the physical pin routed to
	  this VPR core in the vpr_launcher devicetree overlay.

config APP_PULSE_HIGH_CYCLES
	int "Pulse HIGH width in core cycles"
	default 4
	help
	  Total number of clock cycles the pin is held high.
	  This can be as low as 1 cycle as that is how long a pin write takes.

config APP_PULSE_LOW_CYCLES
	int "Pulse LOW width in core cycles"
	default 12
	help
	  Total number of clock cycles the pin is held low.
	  This must be at least the 4 cycles needed for the loop and pin write.

endmenu

source "Kconfig.zephyr"
```

## samples/vtf_monitoring/Kconfig
```kconfig
#
# Copyright (c) 2026 Nordic Semiconductor ASA
#
# SPDX-License-Identifier: LicenseRef-Nordic-5-Clause
#

config SAMPLE_VTF_CUSTOM_BATTERY_VOLTAGE_MONITOR
	bool "Enables customer battery voltage monitor"

menu "Zephyr"
source "Kconfig.zephyr"
endmenu
```

## samples/wifi/Kconfig.sysbuild.nrf70
```kconfig
#
# Copyright (c) 2026 Nordic Semiconductor ASA
#
# SPDX-License-Identifier: LicenseRef-Nordic-5-Clause
#

config WIFI_NRF70
	default y if !SOC_SERIES_NRF71
```

## samples/wifi/coex_shell/Kconfig
```kconfig
#
# Copyright (c) 2026 Nordic Semiconductor ASA
#
# SPDX-License-Identifier: LicenseRef-Nordic-5-Clause
#

# Bluetooth LE controller settings. These symbols only exist in the image that contains
# the controller, which is the application image on single-core SoCs such as the nRF7120.
# They must come before Kconfig.zephyr so they take precedence over the driver defaults,
# and are set here instead of in prj.conf so that they are silently ignored when the
# controller does not support the feature.
if HAS_BT_CTLR

config BT_CTLR_DATA_LENGTH_MAX
	default 251

config BT_CTLR_PHY_2M
	default y

config BT_CTLR_PHY_CODED
	default y

endif # HAS_BT_CTLR

source "Kconfig.zephyr"

menu "Wi-Fi and Short-Range coexistence shell sample"

config COEX_SHELL_BT_INTERVAL_MIN
	int "Bluetooth LE minimum connection interval"
	range 6 3200
	default 80
	help
	  Minimum connection interval requested for the throughput test, in units of
	  1.25 ms. For example, 6 is 7.5 ms and 80 is 100 ms. The value must not be
	  larger than COEX_SHELL_BT_INTERVAL_MAX.

config COEX_SHELL_BT_INTERVAL_MAX
	int "Bluetooth LE maximum connection interval"
	range 6 3200
	default 80
	help
	  Maximum connection interval requested for the throughput test, in units of
	  1.25 ms. The connection is only updated when the current interval differs
	  from this value.

config COEX_SHELL_BT_CONN_LATENCY
	int "Bluetooth LE connection latency"
	range 0 499
	default 0
	help
	  Peripheral latency, in number of connection events that the peripheral may
	  skip. It is used for both the initial connection and the throughput test.

config COEX_SHELL_BT_SUPERVISION_TIMEOUT
	int "Bluetooth LE supervision timeout"
	range 10 3200
	default 3200
	help
	  Supervision timeout requested for the throughput test, in units of 10 ms.
	  It must be longer than twice the maximum connection interval multiplied
	  by (1 + COEX_SHELL_BT_CONN_LATENCY). This is checked at build time.

config SR_COEX_BRINGUP_IN_MAIN
	bool "Bring up the coexistence manager from main"
	depends on NRF71_SR_COEX_DRIVER
	default y
	help
	  After the network interface is up, main() waits for the Wi-Fi FMAC
	  transport and then for the coexistence driver to finish sending the
	  coexistence configuration to the Coexistence Manager on the RPU and
	  enabling it. The driver starts this sequence itself when Wi-Fi comes up.

config SR_COEX_SR_NOTIFY_IN_MAIN
	bool "Report the Short-Range radio as ready from main"
	depends on SR_COEX_BRINGUP_IN_MAIN
	default y
	help
	  Send an NRF71_SR_COEX_SR_POWERED_UP_READY notification from main() using
	  nrf71_sr_coex_sr_power_notify() after the CM becomes active. This opens
	  the coexistence gate without waiting for Bluetooth. The sample sends the
	  same notification when Bluetooth is enabled by the first bt_cfg_tput
	  command, so sending it twice is harmless. Disable this option to keep
	  coexistence off until Bluetooth is enabled.

endmenu
```

## samples/wifi/monitor/boards/nrf7120dk_nrf7120_cpuapp.conf
```kconfig
#
# Copyright (c) 2026 Nordic Semiconductor
#
# SPDX-License-Identifier: LicenseRef-Nordic-5-Clause
#

CONFIG_WIFI_NRF71=y
CONFIG_NRF71_WIFI_MONITOR_SUPPORT=y
CONFIG_NRF71_WIFI_LOW_POWER_SUPPORT=n
CONFIG_NRF71_WIFI_CTRL_HEAP_SIZE=20000
CONFIG_NRF71_WIFI_DATA_HEAP_SIZE=168192
```

## samples/wifi/nrf_cloud/Kconfig.sysbuild
```kconfig
#
# Copyright (c) 2024 Nordic Semiconductor
#
# SPDX-License-Identifier: LicenseRef-Nordic-5-Clause
#

config WIFI_NRF70
	default y if BOARD_NRF7002DK_NRF5340_CPUAPP_NS || \
		BOARD_NRF54LM20DK_NRF54LM20A_CPUAPP_NS || \
		BOARD_NRF54LM20DK_NRF54LM20B_CPUAPP_NS

# MCUBoot is not fully supported on nRF7120/ns yet
choice BOOTLOADER
	default BOOTLOADER_MCUBOOT if !BOARD_NRF7120DK_NRF7120_CPUAPP_NS
endchoice

source "share/sysbuild/Kconfig"
```
