/*
 * Copyright (c) 2026 Nordic Semiconductor ASA
 *
 * SPDX-License-Identifier: LicenseRef-Nordic-5-Clause
 */

/* Replace the default cpuapp_ns partitions with the shared B0 + MCUboot + TF-M
 * table.
 */
/delete-node/ &slot0_s_partition;
/delete-node/ &slot0_ns_partition;
/delete-node/ &tfm_its_partition;
/delete-node/ &tfm_otp_partition;
/delete-node/ &tfm_ps_partition;
/delete-node/ &storage_partition;

#include "../dts/nrf54lm20dk_nrf54lm20_cpuapp_partitions.dtsi"

/* The inherited nordic-tz descriptors reference the partitions deleted above, so
 * recreate them against the shared table. TF-M and the SoC soc_secure helpers
 * derive the TrustZone-M flash layout from these nodes, so they must mirror the
 * partitions rather than be dropped.
 */
/ {
	/delete-node/ nordic-tz-secure;
	/delete-node/ nordic-tz-nonsecure;

	nordic-tz-secure {
		compatible = "nordic,tz-secure";
		code-partitions = <&slot0_s_partition>;
		data-partitions = <&tfm_ps_partition>,
				  <&tfm_its_partition>,
				  <&tfm_otp_partition>;
	};

	nordic-tz-nonsecure {
		compatible = "nordic,tz-nonsecure";
		code-partitions = <&slot0_ns_partition>;
		data-partitions = <&storage_partition>;
	};
};
