## CMakeLists.txt
```
#
# Copyright (c) 2023 Nordic Semiconductor ASA
#
# SPDX-License-Identifier: LicenseRef-Nordic-5-Clause
#
cmake_minimum_required(VERSION 3.20.0)

find_package(Zephyr REQUIRED HINTS $ENV{ZEPHYR_BASE})

project(provisioning_image_netcore)

# NORDIC SDK APP START
target_sources(app PRIVATE src/main.c)
# NORDIC SDK APP END
```

## Kconfig.sysbuild
```
#
# Copyright (c) 2026 Nordic Semiconductor
#
# SPDX-License-Identifier: LicenseRef-Nordic-5-Clause
#

config PARTITION_MANAGER
	default n if SOC_SERIES_NRF53

source "share/sysbuild/Kconfig"
```

## sample.yaml
```
sample:
  description: Provisioning image which disables the debug access of the network core.
  name: Provisioning image for the network core
tests:
  sample.tfm.provisioning_image_net_core.build:
    sysbuild: true
    build_only: true
    integration_platforms:
      - nrf5340dk/nrf5340/cpuapp
    platform_allow: nrf5340dk/nrf5340/cpuapp
    tags: ci_build sysbuild ci_samples_tfm
```

## prj.conf
```kconfig
#
# Copyright (c) 2022 Nordic Semiconductor ASA
#
# SPDX-License-Identifier: LicenseRef-Nordic-5-Clause
#

CONFIG_PRINTK=y
CONFIG_NRFX_NVMC=y
```

## src/main.c
```c
/*
 * Copyright (c) 2023 Nordic Semiconductor ASA.
 *
 * SPDX-License-Identifier: LicenseRef-Nordic-5-Clause
 */

#include <zephyr/sys/printk.h>
#include <stdio.h>
#include <nrfx_nvmc.h>

int main(void)
{
	bool is_writable = nrfx_nvmc_word_writable_check((uint32_t)&NRF_UICR->APPROTECT,
		UICR_APPROTECT_PALL_Protected);

	if (!is_writable) {
		printk("Cannot write to the UICR->APPROTECT register, exiting...!\n");
		return 0;
	}

	nrfx_nvmc_word_write((uint32_t)&NRF_UICR->APPROTECT, UICR_APPROTECT_PALL_Protected);
	printk("The UICR->APPROTECT register is now configured to deny debugging access for the "
		   "network core!\n");
	printk("Success!\n");

	return 0;
}
```
