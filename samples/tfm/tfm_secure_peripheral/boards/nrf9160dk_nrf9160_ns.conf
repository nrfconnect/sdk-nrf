## samples/tfm/tfm_secure_peripheral/boards/nrf9160dk_nrf9160_ns.conf
```kconfig
#
# Copyright (c) 2022 Nordic Semiconductor ASA
#
# SPDX-License-Identifier: LicenseRef-Nordic-5-Clause
#

CONFIG_FPU=y
# P0: 6 (button0), 11 (SPIM_MOSI), 13 (SPIM_SCK)
CONFIG_NRF_GPIO0_PIN_MASK_SECURE=0x00002840

CONFIG_NRF_TIMER1_SECURE=y
CONFIG_NRF_SPIM3_SECURE=y
CONFIG_NRF_GPIOTE0_SECURE=y
```

## samples/tfm/tfm_secure_peripheral/boards/nrf9161dk_nrf9161_ns.conf
```kconfig
#
# Copyright (c) 2024 Nordic Semiconductor ASA
#
# SPDX-License-Identifier: LicenseRef-Nordic-5-Clause
#
CONFIG_FPU=y
# P0: 8 (button0)
CONFIG_NRF_GPIO0_PIN_MASK_SECURE=0x00000100

CONFIG_NRF_TIMER1_SECURE=y
CONFIG_NRF_SPIM3_SECURE=y
CONFIG_NRF_GPIOTE0_SECURE=y
```

## samples/tfm/tfm_secure_peripheral/sample.yaml
```yaml
sample:
  name: TF-M Secure Peripheral Sample
  description: |
    TF-M sample demonstrating use of secure peripherals in a secure partition
common:
  tags: tfm
  platform_allow:
    - nrf5340dk/nrf5340/cpuapp/ns
    - nrf9151dk/nrf9151/ns
    - nrf9160dk/nrf9160/ns
    - nrf9161dk/nrf9161/ns
  integration_platforms:
    - nrf5340dk/nrf5340/cpuapp/ns
    - nrf9151dk/nrf9151/ns
    - nrf9160dk/nrf9160/ns
    - nrf9161dk/nrf9161/ns
  harness: console
  harness_config:
    type: multi_line
    regex:
      - "SPP: sending message: Success"
      - "SPP: processing signals: Success"
tests:
  sample.tfm.secure_peripheral:
    sysbuild: true
    tags: tfm ci_build sysbuild
```

## samples/tfm_psa_test/sample.yaml
```yaml
sample:
common:
    tags: tfm
    platform_allow: nrf5340pdk_nrf5340_cpuappns nrf9160dk_nrf9160ns
    harness: console
    harness_config:
      type: multi_line
      regex:
        - "\\*\\*\\*\\*\\* PSA Architecture Test Suite - Version 1.0 \\*\\*\\*\\*\\*"
        - "TOTAL FAILED    : 0"
sample:
  name: "TFM PSA Test"

tests:
  sample.tfm.psa_storage_test:
    tags: tfm
    extra_args: "CONFIG_TFM_PSA_TEST_STORAGE=y"
    timeout: 100
  # sample.tfm.psa_crypto_test:
  #   tags: tfm
  #   extra_args: "CONFIG_TFM_PSA_TEST_CRYPTO=y"
  #   timeout: 240
  #sample.tfm.psa_initial_attestation_test:
  #  tags: tfm
  #  extra_args: "CONFIG_TFM_PSA_TEST_INITIAL_ATTESTATION=y"
```

## samples/tfm_regression_test/sample.yaml
```yaml
sample:
common:
    tags: tfm regression
    platform_allow: nrf5340pdk_nrf5340_cpuappns nrf9160dk_nrf9160ns
    harness: console
    harness_config:
      type: multi_line
      regex:
        - "\\*\\*\\* Non-secure test suites summary \\*\\*\\*"
        - ".*TFM_PS_TEST_1XXX.*PASSED"
        - ".*TFM_ITS_TEST_1XXX.*PASSED"
        - ".*TFM_CRYPTO_TEST_6XXX.*PASSED"
        - ".*TFM_PLATFORM_TEST_2XXX.*PASSED"
        - ".*TFM_ATTEST_TEST_2XXX.*PASSED"
        - ".*TFM_QCBOR_TEST_7XXX.*PASSED"
        - ".*TFM_T_COSE_TEST_8XXX.*PASSED"
        - ".*TFM_IPC_TEST_1XXX.*PASSED"
sample:
  name: "TFM PSA Test"

tests:
  sample.tfm.regression_test:
    timeout: 200
  sample.tfm.regression_test.ipc:
    timeout: 200
    tags: ipc
    extra_args: CONFIG_TFM_IPC=y
  sample.tfm.regression_test.ipc.level2:
    timeout: 200
    tags: level_2
    extra_args: CONFIG_TFM_IPC=y CONFIG_TFM_ISOLATION_LEVEL=2
```

## samples/untitled_sample_demo/Kconfig
```kconfig
#
# Copyright (c) 2025 Nordic Semiconductor
#
# SPDX-License-Identifier: LicenseRef-Nordic-5-Clause
#

# A menu is used to encapsulate application configuration togethers
menu "Application configuration"

osource "$(APPLICATION_SOURCE_DIR)/VERSION"

config APP_SHOW_VERSION
	bool "Show application version at boot time"
	default y
	depends on LOG && "$(VERSION_MAJOR)" != ""
	help
	  Will show the application version (from the VERSION file) upon booting the application.

config APP_SHOW_BUILD_DATE
	bool "Show build date at boot time"
	depends on LOG
	help
	  Will show the time and date that the application was built upon booting the application.

# Logging for the sample is included at the bottom of the application configuration
module = APP
module-str = Application
source "subsys/logging/Kconfig.template.log_config"

endmenu

# After the application configuration section is the Zephyr configuration, which must be included
source "Kconfig.zephyr"
```

## samples/untitled_sample_demo/Kconfig.sysbuild
```kconfig
#
# Copyright (c) 2025 Nordic Semiconductor ASA
#
# SPDX-License-Identifier: LicenseRef-Nordic-5-Clause
#

# For this sample, we build without using partition manager
config PARTITION_MANAGER
	default n

# After the application sysbuild configuration section is the Zephyr sysbuild configuration, which
# must be included
source "share/sysbuild/Kconfig"
```

## samples/untitled_sample_demo/sample.yaml
```yaml
sample:
  description: Untitled sample demo
  name: Untitled sample demo
common:
  sysbuild: true
  build_only: true
  harness: bluetooth
  tags: bluetooth
  platform_allow:
    - nrf54l15dk/nrf54l15/cpuapp
    - nrf54lv10dk@0.7.0/nrf54lv10a/cpuapp
    - nrf54lm20dk/nrf54lm20a/cpuapp
  integration_platforms:
    - nrf54l15dk/nrf54l15/cpuapp
    - nrf54lv10dk@0.7.0/nrf54lv10a/cpuapp
    - nrf54lm20dk/nrf54lm20a/cpuapp
tests:
  todo.untitled_sample_demo: {}
  todo.untitled_sample_demo.security:
    extra_args: EXTRA_CONF_FILE="authentication.conf"
```

## samples/usb/usb_uart_bridge/sample.yaml
```yaml
sample:
  description: USB-UART bridge sample
  name: USB-UART bridge
tests:
  samples.usb.usb_uart_bridge:
    build_only: true
    build_on_all: true
    platform_whitelist: thingy91_nrf52840
    tags: ci_build
```

## samples/wifi/ble_coex/Kconfig
```kconfig
#
# Copyright (c) 2022 Nordic Semiconductor
#
# SPDX-License-Identifier: LicenseRef-Nordic-5-Clause
#

source "Kconfig.zephyr"

menu "Nordic Coex sample"

choice TEST_TYPE
	prompt "Test type"
	default TEST_TYPE_WLAN_BLE

config TEST_TYPE_WLAN_ONLY
	bool "WLAN only"
	help
	  Enable WLAN only

config TEST_TYPE_BLE_ONLY
	bool "BLE only"
	help
	  Enable BLE only

config TEST_TYPE_WLAN_BLE
	bool "WLAN and BLE"
	help
	  Enable WLAN and BLE

endchoice

config TEST_TYPE_WLAN
	bool "WLAN"
	default y if TEST_TYPE_WLAN_ONLY || TEST_TYPE_WLAN_BLE
	select WIFI
	help
	  Enable WLAN

config TEST_TYPE_BLE
	bool "BLE"
	default y if TEST_TYPE_BLE_ONLY || TEST_TYPE_WLAN_BLE
	help
	  Enable BLE

config NET_CONFIG_PEER_IPV4_ADDR
	string "Peer IPv4 address"
	default "192.168.1.253"

config NET_CONFIG_PEER_IPV4_PORT
	int "Peer IPv4 port"
	default 5001

config WIFI_THREAD_STACK_SIZE
	int "Wi-Fi thread stack size"
	default 4096

config WIFI_THREAD_PRIORITY
	int "Wi-Fi thread priority"
	default 5

config WIFI_ZPERF_SERVER
	bool "Zperf role: server or client"
	default n

config WIFI_ZPERF_PROT_UDP
	bool "UDP or TCP"
	default y

config WIFI_ZPERF_PKT_SIZE
	int "packet size"
	default 1024

config WIFI_ZPERF_RATE
	int "rate in kbps"
	default 10000

config INTERVAL_MIN
	int "BLE min connection interval. Each unit 1.25milliseconds"
	default 80

config INTERVAL_MAX
	int "BLE max connection interval. Each unit 1.25milliseconds"
	default 80

config COEX_ENABLE
	bool "Control if coexistence HW is enable"
	default y

config COEX_WLAN_2PT4G
	bool "Indicates if WLAN operating band is 2.4GHz or 5GHz"
	default y

config WIFI_TEST_DURATION
	int "test duration in milliseconds"
	default 20000

config BLE_TEST_DURATION
	int "test duration in milliseconds"
	default 20000

config COEX_BT_CENTRAL
	bool "BT device role"
	default y

config COEX_SEP_ANTENNAS
	bool "Control if the antennas are shared/separate for BT and WLAN"
	default y

config SR_PROTOCOL_BLE
	bool "Indicates if the Short Range protocol is Bluetooth LE or not"
	default y

endmenu
```

## samples/wifi/ble_coex/Kconfig.sysbuild
```kconfig
#
# Copyright (c) 2024 Nordic Semiconductor
#
# SPDX-License-Identifier: LicenseRef-Nordic-5-Clause
#

source "share/sysbuild/Kconfig"

config NRF_DEFAULT_IPC_RADIO
	depends on SOC_SERIES_NRF53X || SOC_SERIES_NRF54HX
	default y
```

## samples/wifi/ble_coex/sample.yaml
```yaml
sample:
  description: Wi-Fi Bluetooth Low Energy coex sample
  name: Wi-Fi Bluetooth LE coex
tests:
  sample.nrf7002.ble_coex_sep_ant:
    sysbuild: true
    build_only: true
    integration_platforms:
      - nrf7002dk/nrf5340/cpuapp
    extra_args: CONFIG_MPSL_CX=y ipc_radio_CONFIG_MPSL_CX=y
                CONFIG_COEX_SEP_ANTENNAS=y
    platform_allow: nrf7002dk/nrf5340/cpuapp
    tags: ci_build sysbuild ci_samples_wifi
  sample.nrf7002.ble_coex_sha_ant:
    sysbuild: true
    build_only: true
    integration_platforms:
      - nrf7002dk/nrf5340/cpuapp
    extra_args: CONFIG_MPSL_CX=y ipc_radio_CONFIG_MPSL_CX=y
                CONFIG_COEX_SEP_ANTENNAS=n
    platform_allow: nrf7002dk/nrf5340/cpuapp
    tags: ci_build sysbuild ci_samples_wifi
  sample.nrf7001.ble_coex:
    sysbuild: true
    build_only: true
    integration_platforms:
      - nrf7002dk/nrf5340/cpuapp/nrf7001
    extra_args: CONFIG_MPSL_CX=y ipc_radio_CONFIG_MPSL_CX=y
                CONFIG_COEX_SEP_ANTENNAS=y
    platform_allow: nrf7002dk/nrf5340/cpuapp/nrf7001
    tags: ci_build sysbuild ci_samples_wifi
  # Daughter boards (EK's/EB's) do not have a shared antenna
  sample.nrf7002ek.ble_coex:
    sysbuild: true
    build_only: true
    integration_platforms:
      - nrf5340dk/nrf5340/cpuapp
    extra_args: SHIELD=nrf7002ek
                CONFIG_MPSL_CX=y ipc_radio_CONFIG_MPSL_CX=y
                CONFIG_COEX_SEP_ANTENNAS=y
    platform_allow: nrf5340dk/nrf5340/cpuapp
    tags: ci_build sysbuild ci_samples_wifi
  sample.nrf7001ek.ble_coex:
    sysbuild: true
    build_only: true
    integration_platforms:
      - nrf5340dk/nrf5340/cpuapp
    extra_args: SHIELD=nrf7002ek_nrf7001
                CONFIG_MPSL_CX=y ipc_radio_CONFIG_MPSL_CX=y
                CONFIG_COEX_SEP_ANTENNAS=y
    platform_allow: nrf5340dk/nrf5340/cpuapp
    tags: ci_build sysbuild ci_samples_wifi
  sample.nrf7002_eb.thingy53.ble_coex:
    sysbuild: true
    build_only: true
    extra_args: ble_coex_SHIELD=nrf7002eb
                CONFIG_MPSL_CX=y ipc_radio_CONFIG_MPSL_CX=y
                CONFIG_COEX_SEP_ANTENNAS=y
    integration_platforms:
      - thingy53/nrf5340/cpuapp
    platform_allow: thingy53/nrf5340/cpuapp
    tags: ci_build sysbuild ci_samples_wifi
```

## samples/wifi/common/Kconfig.usbd
```kconfig
#
# Copyright (c) 2026 Nordic Semiconductor
#
# SPDX-License-Identifier: LicenseRef-Nordic-5-Clause
#

menu "Wi-Fi sample USB Next configuration"

config SAMPLE_WIFI_USBD
	bool "Enable USB device next configuration"
	depends on USB_DEVICE_STACK_NEXT
	help
	  This configuration option enables the USB device next configuration.

if SAMPLE_WIFI_USBD

config SAMPLE_WIFI_USBD_PID
	hex "USB device Product ID (PID)"

config SAMPLE_WIFI_USBD_VID
	hex "USB device Vendor ID (VID)"
	default 0x1915

config SAMPLE_WIFI_USBD_MANUFACTURER
	string "USB manufacturer string"
	default "Nordic Semiconductor ASA"

config SAMPLE_WIFI_USBD_PRODUCT
	string "USB product string"
	default "Wi-Fi promiscuous sample (ECM)"

config SAMPLE_WIFI_USBD_SELF_POWERED
	bool "Self-powered"
	default y

config SAMPLE_WIFI_USBD_REMOTE_WAKEUP
	bool "Remote wakeup"

config SAMPLE_WIFI_USBD_MAX_POWER
	int "bMaxPower (2 mA units)"
	default 125
	range 0 250
endif

endmenu
```

## samples/wifi/monitor/Kconfig
```kconfig
#
# Copyright (c) 2024 Nordic Semiconductor
#
# SPDX-License-Identifier: LicenseRef-Nordic-5-Clause
#

source "samples/subsys/usb/common/Kconfig.sample_usbd"
source "Kconfig.zephyr"

menu "Nordic Wi-Fi Monitor mode sample"

config MONITOR_MODE_REG_DOMAIN_ALPHA2
	string "Configure the regulatory domain for Monitor mode sample"
	default "00"
	help
	  Specify the regulatory domain for the Monitor mode sample.
	  The regulatory domain is a two-letter country code (alpha2).

config MONITOR_MODE_CHANNEL
	int "Configure the channel for Monitor mode sample"
	default 1
	help
	  Specify the channel for receiving Wi-Fi packets in Monitor mode.
	  The valid channel range depends on the regulatory domain.

choice
	prompt "Wi-Fi frame filter mode"
	default MONITOR_MODE_WIFI_PACKET_FILTER_ALL

config MONITOR_MODE_WIFI_PACKET_FILTER_ALL
	bool "Filter all frames"
	help
	  Enable filtering of all Wi-Fi frames.

config MONITOR_MODE_WIFI_PACKET_FILTER_CUSTOM
	bool "Filter specific type of frames"
	help
	  Enable filtering of specific type of frames.

endchoice

if MONITOR_MODE_WIFI_PACKET_FILTER_CUSTOM

config MONITOR_MODE_WIFI_PACKET_FILTER_MGMT
	bool "Filter management frames"
	help
	  Accept only IEEE 802.11 management frames.

config MONITOR_MODE_WIFI_PACKET_FILTER_CTRL
	bool "Filter control frames"
	help
	  Accept only IEEE 802.11 control frames.

config MONITOR_MODE_WIFI_PACKET_FILTER_DATA
	bool "Filter data frames"
	help
	  Accept only IEEE 802.11 data frames.
endif

config MONITOR_MODE_WIFI_PACKET_FILTER_CAPTURE_LEN
	int "Wi-Fi packet capture length"
	range 14 1552
	default 64
	help
	  This option sets the number of bytes to capture from each Wi-Fi packet.
	  Allowed values range from a minimum of 14 bytes (standard ethernet header length)
	  to a maximum of 1552 bytes.

config RX_THREAD_STACK_SIZE
	int "Thread Stack Size"
	default 4096
	help
	  This option sets the stack size for the threads used in the sample.

config STATS_PRINT_TIMEOUT
	int "Periodic statistics print timeout"
	default 5
	help
	  This option sets the timeout for periodic statistics print in seconds.

endmenu
```

## samples/wifi/monitor/sample.yaml
```yaml
sample:
  description: Wi-Fi Monitor sample application
  name: Wi-Fi Monitor sample
tests:
  sample.nrf7002.monitor:
    sysbuild: true
    build_only: true
    integration_platforms:
      - nrf7002dk/nrf5340/cpuapp
    platform_allow: nrf7002dk/nrf5340/cpuapp
    tags:
      - ci_build
      - sysbuild
      - ci_samples_wifi
  sample.nrf7002_eks.monitor:
    sysbuild: true
    build_only: true
    extra_args: SHIELD=nrf7002ek
    integration_platforms:
      - nrf5340dk/nrf5340/cpuapp
    platform_allow: nrf5340dk/nrf5340/cpuapp
    tags:
      - ci_build
      - sysbuild
      - ci_samples_wifi
  sample.nrf7001.monitor:
    sysbuild: true
    build_only: true
    integration_platforms:
      - nrf7002dk/nrf5340/cpuapp/nrf7001
    platform_allow: nrf7002dk/nrf5340/cpuapp/nrf7001
    tags:
      - ci_build
      - sysbuild
      - ci_samples_wifi
  sample.nrf7002eb_interposer_p1.nrf7002eb.monitor:
    sysbuild: true
    build_only: true
    extra_args:
      - monitor_SHIELD="nrf7002eb_interposer_p1;nrf7002eb"
      - monitor_SNIPPET=nrf70-wifi
    integration_platforms:
      - nrf54h20dk/nrf54h20/cpuapp
    platform_allow:
      - nrf54h20dk/nrf54h20/cpuapp
    tags:
      - ci_build
      - sysbuild
      - ci_samples_wifi
  sample.54lm20dk.nrf7002eb2.monitor:
    sysbuild: true
    build_only: true
    extra_args:
      - monitor_SHIELD="nrf7002eb2"
    integration_platforms:
      - nrf54lm20dk/nrf54lm20a/cpuapp
    platform_allow:
      - nrf54lm20dk/nrf54lm20a/cpuapp
    tags:
      - ci_build
      - sysbuild
      - ci_samples_wifi
```
