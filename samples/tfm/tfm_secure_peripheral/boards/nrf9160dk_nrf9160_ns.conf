## samples/wifi/mqtt_wifi/Kconfig
```kconfig
#
# Copyright (c) 2022 Nordic Semiconductor ASA
#
# SPDX-License-Identifier: LicenseRef-Nordic-5-Clause
#

menu "Wi-Fi MQTT simple sample"
config MQTT_PUB_TOPIC
	string "MQTT publish topic"
	default "my/publish/topic"

config MQTT_SUB_TOPIC
	string "MQTT subscribe topic"
	default "my/subscribe/topic"

config MQTT_CLIENT_ID
	string "MQTT Client ID"
	help
	  Use a custom Client ID string. If not set, the client ID will be
	  generated based on IMEI number (for nRF9160 based targets) or
	  randomly (for other platforms).
	default ""

config MQTT_BROKER_HOSTNAME
	string "MQTT broker hostname"
	default "test.mosquitto.org"

config MQTT_BROKER_PORT
	int "MQTT broker port"
	default 1883

config MQTT_MESSAGE_BUFFER_SIZE
	int "MQTT message buffer size"
	default 128

config MQTT_PAYLOAD_BUFFER_SIZE
	int "MQTT payload buffer size"
	default 128

config BUTTON_EVENT_PUBLISH_MSG
	string "The message to publish on a button event"
	default "Hello from nRF700x MQTT Simple Sample"

config BUTTON_EVENT_BTN_NUM
	int "The button number"
	default 1

config MQTT_RECONNECT_DELAY_S
	int "Seconds to delay before attempting to reconnect to the broker"
	default 60

config MQTT_TLS_SEC_TAG
	int "TLS credentials security tag"
	default 24

config MQTT_TLS_PEER_VERIFY
	int "Set peer verification level"
	default 2
	help
		Set to 0 for VERIFY_NONE, 1 for VERIFY_OPTIONAL, and 2 for
		VERIFY_REQUIRED.

endmenu

menu "Zephyr Kernel"
source "Kconfig.zephyr"
endmenu

module = WIFI_MQTT_SIMPLE
module-str = Wi-Fi MQTT Simple
source "${ZEPHYR_BASE}/subsys/logging/Kconfig.template.log_config"
```

## samples/wifi/mqtt_wifi/sample.yaml
```yaml
sample:
  name: mqtt wifi sample
tests:
  sample.wifi.mqtt_wifi:
    build_only: true
    integration_platforms:
      - nrf7002dk_nrf5340_cpuapp
    platform_allow: nrf7002dk_nrf5340_cpuapp
    tags: ci_build
```

## samples/wifi/nrf_cloud/Kconfig
```kconfig
#
# Copyright (c) 2022 Nordic Semiconductor ASA
#
# SPDX-License-Identifier: LicenseRef-Nordic-5-Clause
#

menu "Wi-Fi nRF Cloud sample settings"

config APP_VERSION
	string "Wi-Fi nRF Cloud sample version"
	default "1.0.0"

config CLOUD_CONNECTION_RETRY_TIMEOUT_SECONDS
	int "Cloud connection retry timeout (seconds)"
	default 30
	help
	  If connecting to nRF Cloud takes longer than this timeout, it will be
	  reattempted.

config CLOUD_READY_TIMEOUT_SECONDS
	int "Cloud readiness timeout (seconds)"
	default 600
	help
	  If the connection to nRF Cloud does not become ready within this
	  timeout, the sample will reset its connection and try again.

config DATE_TIME_ESTABLISHMENT_TIMEOUT_SECONDS
	int "Date and time establishment timeout (seconds)"
	default 300
	help
	  The sample will wait this many seconds for the device to determine the
	  current date and time before giving up and moving on.

config APPLICATION_THREAD_STACK_SIZE
	int "Application Thread Stack Size (bytes)"
	default 2048
	help
	  Sets the stack size (in bytes) for the application thread of the
	  sample.

config CONNECTION_THREAD_STACK_SIZE
	int "Connection Thread Stack Size (bytes)"
	default 2048
	help
	  Sets the stack size (in bytes) for the connection thread of the
	  sample.

config MESSAGE_THREAD_STACK_SIZE
	int "Message Queue Thread Stack Size (bytes)"
	default 2048
	help
	  Sets the stack size (in bytes) for the message queue processing
	  thread of the sample.

config LED_THREAD_STACK_SIZE
	int "LED Thread Stack Size (bytes)"
	default 1024
	help
	  Sets the stack size (in bytes) for the LED thread.

config MAX_OUTGOING_MESSAGES
	int "Outgoing message maximum"
	default 25
	help
	  Sets the maximum number of device messages which may be enqueued
	  before further messages are dropped.
	  Increasing this value may require an increase to CONFIG_HEAP_MEM_POOL_SIZE.

config MAX_CONSECUTIVE_SEND_FAILURES
	int "Max outgoing consecutive send failures"
	default 5
	help
	  Sets the maximum number of device messages which may fail to send
	  before a connection reset and cooldown is triggered.

config CONSECUTIVE_SEND_FAILURE_COOLDOWN_SECONDS
	int "Cooldown after max consecutive send failures exceeded"
	default 10
	help
	  If a connection reset is triggered by too many failed device
	  messages, the sample will wait this long (in seconds) before trying
	  again.

config SENSOR_SAMPLE_INTERVAL_SECONDS
	int "Sensor sampling interval (seconds)"
	default 60
	help
	  Sets the time to wait between each sensor sample.

menuconfig LOCATION_TRACKING
	bool "Location tracking service"
	default y
	help
	  Uses Wi-Fi information to determine and report device location.

if LOCATION_TRACKING

config LOCATION_TRACKING_SAMPLE_INTERVAL_SECONDS
	int "Location sampling interval (seconds)"
	default 60
	help
	  Sets the location sampling interval in seconds.

endif

config TEMP_TRACKING
	bool "Track temperature"
	default y
	help
	  Sets whether to take temperature measurements.

config TEMP_ALERT_LIMIT
	int "Temperature limit to print alert"
	default 30
	help
	  Sets the temperature in degrees C over which a temperature alert will
	  be printed through serial terminal.

choice
	prompt "LED indication"
	default LED_INDICATION_GPIO if $(dt_compat_enabled,gpio-leds)
	default LED_INDICATION_DISABLED

config LED_INDICATION_GPIO
	bool "Enable LED indication using the gpio-leds driver"
	select LED
	select LED_GPIO

config LED_INDICATION_DISABLED
	bool "Disable LED indication"

endchoice

choice
	prompt "LED indication LED type"
	depends on !LED_INDICATION_DISABLED
	default LED_INDICATOR_4LED if !LED_INDICATION_DISABLED
	default LED_INDICATOR_NONE

config LED_INDICATOR_4LED
	bool "Four binary LEDs"
	depends on !LED_INDICATION_DISABLED

config LED_INDICATOR_NONE
	bool "No indicator LEDs"
	depends on LED_INDICATION_DISABLED

endchoice

config LED_VERBOSE_INDICATION
	bool "Enables extra LED status indications"
	depends on !LED_INDICATION_DISABLED
	default y

config LED_CONTINUOUS_INDICATION
	bool "Show an idle pattern instead of turning LEDs off"
	depends on !LED_INDICATION_DISABLED
	default y

config TEST_COUNTER
	bool "Sets whether the test counter is enabled"
	help
	  When enabled, the test counter configuration setting in the shadow is ignored.

config TEST_COUNTER_MULTIPLIER
	int "The number of test counter messages sent on each update"
	default 1
	range 1 1000
	help
	  This is a way to increase the number of device messages sent by the sample.
	  It is useful for load testing.

if NRF_CLOUD_COAP

menuconfig COAP_FOTA
	bool "FOTA service when using CoAP to connect to nRF Cloud"
	select FOTA_DOWNLOAD
	select FOTA_DOWNLOAD_PROGRESS_EVT
	select IMG_ERASE_PROGRESSIVELY
	select DFU_TARGET
	select DOWNLOADER
	select REBOOT
	select CJSON_LIB
	select SETTINGS
	default y

if COAP_FOTA

config COAP_FOTA_JOB_CHECK_RATE_MINUTES
	int "FOTA job check interval (minutes)"
	default 60
	help
	  Sets the time to wait between each request to get any pending FOTA job.

config COAP_FOTA_THREAD_STACK_SIZE
	int "CoAP FOTA Thread Stack Size (bytes)"
	default 2048
	help
	  Sets the stack size (in bytes) for the CoAP FOTA thread of the
	  sample.

endif

menuconfig COAP_SHADOW
	bool "Updating shadow service"
	default y
	help
	  Updates the shadow with device information. Checks for a shadow
	  delta periodically and processes it if received.

if COAP_SHADOW

config COAP_SHADOW_CHECK_RATE_SECONDS
	int "Shadow job check interval (seconds)"
	default 300
	help
	  Sets the time to wait between each request to get any change to the
	  device shadow.

config COAP_SHADOW_THREAD_STACK_SIZE
	int "CoAP Shadow Thread Stack Size (bytes)"
	default 3072
	help
	  Sets the stack size (in bytes) for the CoAP shadow thread of the
	  sample.

endif

config COAP_SEND_CONFIRMABLE
	bool "Send device messages as confirmable"
	help
	  Ensures all CoAP transfers, even for often less important messages such
	  as sensor data, are sent as confirmable messages.

endif

endmenu

if NRF_CLOUD_MQTT
module-str = MQTT nRF Cloud
endif
if NRF_CLOUD_COAP
module-str = CoAP nRF Cloud
endif
module = WIFI_NRF_CLOUD
source "$(ZEPHYR_BASE)/subsys/logging/Kconfig.template.log_config"

menu "Zephyr Kernel"
source "Kconfig.zephyr"
endmenu
```

## samples/wifi/nrf_cloud/boards/nrf7120dk_nrf7120_cpuapp_ns.conf
```kconfig
#
# Copyright (c) 2026 Nordic Semiconductor ASA
#
# SPDX-License-Identifier: LicenseRef-Nordic-5-Clause
#

# MM_IOVEC is not compatible with TFM_ITS_ENCRYPTED
CONFIG_TFM_PSA_FRAMEWORK_HAS_MM_IOVEC=n
# Necessary for TLS with MM-less IOVEC.
# 36864 = 2 * MBEDTLS_SSL_MAX_CONTENT_LEN (16384) + overhead
CONFIG_TFM_CRYPTO_IOVEC_BUFFER_SIZE=36864

# pk_wrap.c uses PSA_ALG_ECDSA_ANY for X.509 certificate chain verification.
CONFIG_PSA_WANT_ALG_ECDSA_ANY=y

# FOTA requires MCUBoot; this sample uses BOOTLOADER_NONE on nrf7120dk.
# Disabling NRF_CLOUD_FOTA also avoids pulling in FW_INFO, which has no
# SOC_SERIES_NRF71 defaults and causes both a CMake and a linker error.
CONFIG_NRF_CLOUD_FOTA=n

# No Flash driver in NS yet, use PSA for settings for now.
CONFIG_SETTINGS_TFM_PSA=y
```

## samples/wifi/nrf_cloud/boards/nrf9161dk_nrf9161_ns.conf
```kconfig
#
# Copyright (c) 2023 Nordic Semiconductor ASA
#
# SPDX-License-Identifier: LicenseRef-Nordic-5-Clause
#

# This file is merged with prj.conf in the application folder, and options
# set here will take precedence if they are present in both files.

CONFIG_GPIO=y
CONFIG_LED_GPIO=y

# Enable external flash
CONFIG_SPI=y
CONFIG_SPI_NOR=y
CONFIG_SPI_NOR_SFDP_DEVICETREE=y
CONFIG_PM_OVERRIDE_EXTERNAL_DRIVER_CHECK=y
```

## samples/wifi/offloaded_raw_tx/sample.yaml
```yaml
sample:
  description: Wi-Fi Offloaded Raw Tx Packet sample application
  name: Wi-Fi Offloaded Raw Tx Packet sample
tests:
  sample.nrf7002.offloaded_raw_tx:
    sysbuild: true
    build_only: true
    integration_platforms:
      - nrf7002dk/nrf5340/cpuapp
    platform_allow: nrf7002dk/nrf5340/cpuapp
    tags:
      - ci_build
      - sysbuild
      - ci_samples_wifi
  sample.nrf7002_eks.offloaded_raw_tx:
    sysbuild: true
    build_only: true
    extra_args: SHIELD=nrf7002ek
    integration_platforms:
      - nrf5340dk/nrf5340/cpuapp
    platform_allow: nrf5340dk/nrf5340/cpuapp
    tags:
      - ci_build
      - sysbuild
      - ci_samples_wifi
  sample.nrf7002eb_interposer_p1.nrf7002eb.offloaded_raw_tx:
    sysbuild: true
    build_only: true
    extra_args:
      - offloaded_raw_tx_SHIELD="nrf7002eb_interposer_p1;nrf7002eb"
      - offloaded_raw_tx_SNIPPET=nrf70-wifi
    integration_platforms:
      - nrf54h20dk/nrf54h20/cpuapp
      - nrf54l15dk/nrf54l15/cpuapp
    platform_allow:
      - nrf54h20dk/nrf54h20/cpuapp
      - nrf54l15dk/nrf54l15/cpuapp
    tags:
      - ci_build
      - sysbuild
      - ci_samples_wifi
  sample.nrf7002eb2.offloaded_raw_tx:
    sysbuild: true
    build_only: true
    extra_args:
      - offloaded_raw_tx_SHIELD="nrf7002eb2"
      - offloaded_raw_tx_SNIPPET=nrf70-wifi
    integration_platforms:
      - nrf54l15dk/nrf54l15/cpuapp
    platform_allow:
      - nrf54l15dk/nrf54l15/cpuapp
    tags:
      - ci_build
      - sysbuild
      - ci_samples_wifi
  sample.54lm20dk.nrf7002eb2.offloaded_raw_tx:
    sysbuild: true
    build_only: true
    extra_args:
      - offloaded_raw_tx_SHIELD="nrf7002eb2"
    integration_platforms:
      - nrf54lm20dk/nrf54lm20a/cpuapp
    platform_allow:
      - nrf54lm20dk/nrf54lm20a/cpuapp
    tags:
      - ci_build
      - sysbuild
      - ci_samples_wifi
```

## samples/wifi/p2p/sample.yaml
```yaml
sample:
  description: Wi-Fi P2P sample application
  name: Wi-Fi P2P
tests:
  sample.nrf7002.p2p:
    sysbuild: true
    build_only: true
    integration_platforms:
      - nrf7002dk/nrf5340/cpuapp
    platform_allow: nrf7002dk/nrf5340/cpuapp
    tags:
      - ci_build
      - sysbuild
      - ci_samples_wifi
  sample.nrf7002_eks.p2p:
    sysbuild: true
    build_only: true
    extra_args:
      - SHIELD="nrf7002ek"
    integration_platforms:
      - nrf5340dk/nrf5340/cpuapp
    platform_allow:
      - nrf5340dk/nrf5340/cpuapp
    tags:
      - ci_build
      - sysbuild
      - ci_samples_wifi
  sample.54lm20dk.nrf7002eb2.p2p:
    sysbuild: true
    build_only: true
    extra_args:
      - SHIELD="nrf7002eb2"
    integration_platforms:
      - nrf54lm20dk/nrf54lm20a/cpuapp
    platform_allow:
      - nrf54lm20dk/nrf54lm20a/cpuapp
    tags:
      - ci_build
      - sysbuild
      - ci_samples_wifi
```

## samples/wifi/promiscuous/Kconfig
```kconfig
#
# Copyright (c) 2024 Nordic Semiconductor
#
# SPDX-License-Identifier: LicenseRef-Nordic-5-Clause
#

source "Kconfig.zephyr"

menu "Nordic Raw Tx Packet sample"

config PROMISCUOUS_SAMPLE_CONNECTION_TIMEOUT_S
	int "Wi-Fi connection timeout in seconds"
	default 30

config PROMISCUOUS_SAMPLE_DHCP_TIMEOUT_S
	int "DHCP timeout in seconds"
	default 20

config PROMISCUOUS_SAMPLE_RX_THREAD_STACK_SIZE
	int "Thread stack size"
	default 4096
	help
	  This option sets the stack size for the threads used in the sample.

config PROMISCUOUS_SAMPLE_STATS_PRINT_TIMEOUT
	int "Periodic statistics print timeout"
	default 5
	help
	  This option sets the timeout for periodic statistics print in seconds.

config PROMISCUOUS_SAMPLE_RECV_BUFFER_SIZE
	int "Size of the receive buffer"
	default 1024
	help
	  This option sets the size of the receive buffer in bytes.

endmenu
```

## samples/wifi/promiscuous/sample.yaml
```yaml
sample:
  description: Wi-Fi Promiscuous sample application
  name: Wi-Fi Promiscuous sample
tests:
  sample.nrf7002.promiscuous:
    sysbuild: true
    build_only: true
    integration_platforms:
      - nrf7002dk/nrf5340/cpuapp
    platform_allow: nrf7002dk/nrf5340/cpuapp
    tags:
      - ci_build
      - sysbuild
      - ci_samples_wifi
  sample.nrf7002_eks.promiscuous:
    sysbuild: true
    build_only: true
    extra_args: SHIELD=nrf7002ek
    integration_platforms:
      - nrf5340dk/nrf5340/cpuapp
    platform_allow: nrf5340dk/nrf5340/cpuapp
    tags:
      - ci_build
      - sysbuild
      - ci_samples_wifi
  sample.nrf7001.promiscuous:
    sysbuild: true
    build_only: true
    integration_platforms:
      - nrf7002dk/nrf5340/cpuapp/nrf7001
    platform_allow: nrf7002dk/nrf5340/cpuapp/nrf7001
    tags:
      - ci_build
      - sysbuild
      - ci_samples_wifi
    skip: true
  sample.nrf7002eb_interposer_p1.nrf7002eb.promiscuous:
    sysbuild: true
    build_only: true
    extra_args:
      - promiscuous_SHIELD="nrf7002eb_interposer_p1;nrf7002eb"
      - promiscuous_SNIPPET=nrf70-wifi
    integration_platforms:
      - nrf54h20dk/nrf54h20/cpuapp
    platform_allow:
      - nrf54h20dk/nrf54h20/cpuapp
    tags:
      - ci_build
      - sysbuild
      - ci_samples_wifi
  sample.54lm20dk.nrf7002eb2.promiscuous:
    sysbuild: true
    build_only: true
    extra_args:
      - promiscuous_SHIELD="nrf7002eb2"
    integration_platforms:
      - nrf54lm20dk/nrf54lm20a/cpuapp
    platform_allow:
      - nrf54lm20dk/nrf54lm20a/cpuapp
    tags:
      - ci_build
      - sysbuild
      - ci_samples_wifi
```
