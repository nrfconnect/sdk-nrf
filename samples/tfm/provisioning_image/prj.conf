## CMakeLists.txt
```
#
# Copyright (c) 2022 Nordic Semiconductor ASA
#
# SPDX-License-Identifier: LicenseRef-Nordic-5-Clause
#
cmake_minimum_required(VERSION 3.20.0)

find_package(Zephyr REQUIRED HINTS $ENV{ZEPHYR_BASE})

project(provisioning_image)

# NORDIC SDK APP START
target_sources(app PRIVATE src/main.c)
# NORDIC SDK APP END

target_include_directories(app PRIVATE src)
```

## Kconfig
```
#
# Copyright (c) 2022 Nordic Semiconductor ASA
#
# SPDX-License-Identifier: LicenseRef-Nordic-5-Clause
#

source "Kconfig.zephyr"

config INCLUDE_NET_CORE_IMAGE
	bool "Include net image as sub image"
	depends on SOC_NRF5340_CPUAPP
	default y if (BOARD_NRF5340DK_NRF5340_CPUAPP)
	select PARTITION_MANAGER_ENABLED
	select BOARD_ENABLE_CPUNET
```

## Kconfig.sysbuild
```
#
# Copyright (c) 2024 Nordic Semiconductor
#
# SPDX-License-Identifier: LicenseRef-Nordic-5-Clause
#

menu "Network core configuration"
	depends on SUPPORT_NETCORE

choice NETCORE
	prompt "Netcore image"
	default NETCORE_PROVISIONING_IMAGE_NET_CORE if NETCORE_REMOTE_BOARD_TARGET_CPUCLUSTER != ""

config NETCORE_PROVISIONING_IMAGE_NET_CORE
	bool "Provisioning"
	help
	  Include tfm provisioning network core image.

endchoice

if !NETCORE_NONE

config NETCORE_IMAGE_NAME
	default "provisioning_image_net_core" if NETCORE_PROVISIONING_IMAGE_NET_CORE

config NETCORE_IMAGE_PATH
	default "${ZEPHYR_NRF_MODULE_DIR}/samples/tfm/provisioning_image_net_core" if NETCORE_PROVISIONING_IMAGE_NET_CORE

endif # !NETCORE_NONE

endmenu

source "${ZEPHYR_BASE}/share/sysbuild/Kconfig"
```

## sample.yaml
```
sample:
  description: Initiates the provisioning of a TF-M image.
  name: Provisioning Image
common:
  sysbuild: true
  tags:
    - keys
    - ci_build
    - sysbuild
    - ci_samples_tfm
  harness: console
tests:
  sample.tfm.provisioning_image:
    platform_allow:
      - nrf5340dk/nrf5340/cpuapp
      - nrf9151dk/nrf9151
      - nrf9160dk/nrf9160
      - nrf9161dk/nrf9161
    integration_platforms:
      - nrf5340dk/nrf5340/cpuapp
      - nrf9151dk/nrf9151
      - nrf9160dk/nrf9160
      - nrf9161dk/nrf9161
    harness_config:
      type: multi_line
      regex:
        - "Writing the identity key to KMU"
        - "Success!"
  sample.tfm.provisioning_image.nrf54l:
    platform_allow:
      - nrf54l15dk/nrf54l15/cpuapp
      - nrf54lv10dk/nrf54lv10a/cpuapp
      - nrf54lm20dk/nrf54lm20a/cpuapp
      - nrf54lm20dk/nrf54lm20b/cpuapp
    integration_platforms:
      - nrf54l15dk/nrf54l15/cpuapp
      - nrf54lv10dk/nrf54lv10a/cpuapp
      - nrf54lm20dk/nrf54lm20a/cpuapp
      - nrf54lm20dk/nrf54lm20b/cpuapp
    harness_config:
      type: one_line
      regex:
        - "Success!"
```

## prj.conf
```kconfig
#
# Copyright (c) 2022 Nordic Semiconductor ASA
#
# SPDX-License-Identifier: LicenseRef-Nordic-5-Clause
#

CONFIG_MAIN_STACK_SIZE=8192

CONFIG_CONSOLE=y
CONFIG_LOG=y

# The HW_UNIQUE_KEY library is needed for the MKEK
CONFIG_HW_UNIQUE_KEY=y
CONFIG_HW_UNIQUE_KEY_RANDOM=y

CONFIG_PSA_CRYPTO=y
CONFIG_MBEDTLS_ENABLE_HEAP=y
CONFIG_MBEDTLS_HEAP_SIZE=8192

CONFIG_RESET_ON_FATAL_ERROR=n
CONFIG_SECURE_BOOT_STORAGE=y
```

## boards/nrf5340dk_nrf5340_cpuapp.conf
```kconfig
#
# Copyright (c) 2023 Nordic Semiconductor ASA
#
# SPDX-License-Identifier: LicenseRef-Nordic-5-Clause
#


# Enable the network core
CONFIG_SOC_NRF53_CPUNET_ENABLE=y

CONFIG_IDENTITY_KEY=y
CONFIG_IDENTITY_KEY_RANDOM=y

CONFIG_PSA_CRYPTO_DRIVER_CC3XX=y
CONFIG_PSA_CRYPTO_DRIVER_OBERON=n

CONFIG_MPU_ALLOW_FLASH_WRITE=y
CONFIG_NRFX_NVMC=y
```

## boards/nrf9151dk_nrf9151.conf
```kconfig
#
# Copyright (c) 2026 Nordic Semiconductor ASA
#
# SPDX-License-Identifier: LicenseRef-Nordic-5-Clause
#

CONFIG_IDENTITY_KEY=y
CONFIG_IDENTITY_KEY_RANDOM=y

CONFIG_PSA_CRYPTO_DRIVER_CC3XX=y
CONFIG_PSA_CRYPTO_DRIVER_OBERON=n

CONFIG_MPU_ALLOW_FLASH_WRITE=y
CONFIG_NRFX_NVMC=y
```

## src/main.c
```c
/*
 * Copyright (c) 2022 Nordic Semiconductor ASA.
 *
 * SPDX-License-Identifier: LicenseRef-Nordic-5-Clause
 */

#include <zephyr/kernel.h>
#include <zephyr/logging/log.h>
#include <string.h>
#include <hw_unique_key.h>
#include <bl_storage.h>

#include <config_implementation_id.h>

#if defined(CONFIG_HAS_HW_NRF_CRACEN)
#include <nrfx_rramc.h>
#else
#include <identity_key.h>
#include <nrfx_nvmc.h>
#endif

LOG_MODULE_REGISTER(provisioning_image, LOG_LEVEL_DBG);

#define IMPLEMENTATION_ID_NUM_WORDS (sizeof(implementation_id_in_flash) / sizeof(uint32_t))

int provision_implementation_id(void)
{
#if defined(CONFIG_HAS_HW_NRF_CRACEN)
	/* BL_STORAGE is at the start of UICR OTP, so each field's OTP index is
	 * its word offset from BL_STORAGE. The RRAMC OTP API takes a word index
	 * rather than an address, so divide the field's byte offset by the word
	 * size to convert it.
	 */
	const uint32_t base_index = ((uint32_t)&BL_STORAGE->implementation_id -
				     (uint32_t)BL_STORAGE) / sizeof(uint32_t);

	for (uint32_t i = 0; i < IMPLEMENTATION_ID_NUM_WORDS; i++) {
		uint32_t word;

		memcpy(&word, &implementation_id_in_flash[i * sizeof(word)],
		       sizeof(word));
		if (!nrfx_rramc_otp_word_write(base_index + i, word)) {
			LOG_ERR("nrfx_rramc_otp_word_write failed at OTP index %u",
				base_index + i);
			return -1;
		}
	}
#else
	const uint32_t address = (uint32_t)&BL_STORAGE->implementation_id;

	/* implementation_id_in_flash is a uint8_t[] and may not be 4-byte
	 * aligned, so build each word explicitly instead of casting the buffer
	 * to a uint32_t pointer.
	 */
	for (uint32_t i = 0; i < IMPLEMENTATION_ID_NUM_WORDS; i++) {
		uint32_t word;

		memcpy(&word, &implementation_id_in_flash[i * sizeof(word)],
		       sizeof(word));
		nrfx_nvmc_word_write(address + i * sizeof(word), word);
	}
#endif
	return 0;
}

int main(void)
{
	enum bl_storage_lcs lcs;
	int err;

	err = read_life_cycle_state(&lcs);
	if (err != 0) {
		LOG_INF("Failure: Cannot read PSA lifecycle state. Exiting!");
		return 0;
	}

	if (lcs != BL_STORAGE_LCS_ASSEMBLY) {
		LOG_INF("Failure: Lifecycle state is not ASSEMBLY as expected. Exiting!");
		return 0;
	}

	LOG_INF("Successfully verified PSA lifecycle state ASSEMBLY!");

	err = update_life_cycle_state(BL_STORAGE_LCS_PROVISIONING);
	if (err != 0) {
		LOG_INF("Failure: Cannot set PSA lifecycle state PROVISIONING. Exiting!");
		return 0;
	}

	err = read_life_cycle_state(&lcs);
	if (err != 0) {
		LOG_INF("Failure: Cannot read PSA lifecycle state. Exiting!");
		return 0;
	}

	if (lcs != BL_STORAGE_LCS_PROVISIONING) {
		LOG_INF("Lifecycle state was %d", lcs);
		LOG_INF("Failure: Lifecycle state is not PROVISION as expected. Exiting!");
		return 0;
	}

	LOG_INF("Successfully switched to PSA lifecycle state PROVISIONING!");

	LOG_INF("Generating random HUK keys (including MKEK)");
	err = hw_unique_key_write_random();
	if (err != HW_UNIQUE_KEY_SUCCESS) {
		LOG_INF("Failure: Writing random HUK keys failed. Exiting!");
		return 0;
	}

#if !defined(CONFIG_HAS_HW_NRF_CRACEN)
	if (identity_key_is_written()) {
		LOG_INF("Failure: Identity key slot already written. Exiting!");
		return 0;
	}

	LOG_INF("Writing the identity key to KMU");

#ifdef CONFIG_IDENTITY_KEY_DUMMY
	err = identity_key_write_dummy();
#else
	err = identity_key_write_random();
#endif

	if (err != IDENTITY_KEY_SUCCESS) {
		LOG_INF("Failure: Identity key write failed! Exiting!");
		return 0;
	}

	if (!identity_key_is_written()) {
		LOG_INF("Failure: Identity key is not written! Exiting!");
		return 0;
	}
#endif /* !CONFIG_HAS_HW_NRF_CRACEN */

	err = provision_implementation_id();
	if (err != 0) {
		LOG_INF("Failure: Writing implementation ID failed. Exiting!");
		return 0;
	}

	LOG_INF("Success!");

	return 0;
}
```

## src/config_implementation_id.h
```c
/*
 * Copyright (c) 2022 Nordic Semiconductor ASA.
 *
 * SPDX-License-Identifier: LicenseRef-Nordic-5-Clause
 */

#pragma once

/* For a different implementation id, application's are expected to
 * create their own config_implementation_id.h header file and ensure
 * it is placed earlier than this header on the include path.
 */

uint8_t implementation_id_in_flash[32] = {
	0xAA, 0xAA, 0xAA, 0xAA, 0xAA, 0xAA, 0xAA, 0xAA,
	0xBB, 0xBB, 0xBB, 0xBB, 0xBB, 0xBB, 0xBB, 0xBB,
	0xCC, 0xCC, 0xCC, 0xCC, 0xCC, 0xCC, 0xCC, 0xCC,
	0xDD, 0xDD, 0xDD, 0xDD, 0xDD, 0xDD, 0xDD, 0xDD
};
```
