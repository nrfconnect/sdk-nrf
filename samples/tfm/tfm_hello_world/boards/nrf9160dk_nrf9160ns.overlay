/*
 * Copyright (c) 2020 Nordic Semiconductor ASA
 *
 * SPDX-License-Identifier: LicenseRef-BSD-5-Clause-Nordic
 */

/* Disable uart1 in nonsecure since it is used by the TFM secure app. */
&uart1 {
	status = "disabled";
};
