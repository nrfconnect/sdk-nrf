## CMakeLists.txt
```
#
# Copyright (c) 2021 Nordic Semiconductor ASA
#
# SPDX-License-Identifier: LicenseRef-Nordic-5-Clause
#

cmake_minimum_required(VERSION 3.13.1)

find_package(Zephyr HINTS $ENV{ZEPHYR_BASE})

project(chip-light-switch)

set(COMMON_ROOT ${CMAKE_CURRENT_LIST_DIR}/../common)

# NORDIC SDK APP START
target_include_directories(app PRIVATE src ${COMMON_ROOT}/src ${ZEPHYR_CONNECTEDHOMEIP_MODULE_DIR}/src/app)

target_compile_options(app PRIVATE -Wno-deprecated-declarations)

target_sources(app PRIVATE
               src/app_task.cpp
               src/light_switch.cpp
               src/main.cpp
               ${COMMON_ROOT}/src/led_widget.cpp
               ${COMMON_ROOT}/src/thread_util.cpp)
# NORDIC SDK APP END
```

## sample.yaml
```
sample:
  name: CHIP Light Switch
  description: CHIP Light Switch example
tests:
  connectedhomeip.light_switch:
    build_only: true
    build_on_all: true
    platform_allow: nrf52840dk_nrf52840 nrf5340dk_nrf5340_cpuapp
    integration_platforms:
      - nrf52840dk_nrf52840
      - nrf5340dk_nrf5340_cpuapp
    tags: ci_build
```

## prj.conf
```kconfig
#
# Copyright (c) 2021 Nordic Semiconductor ASA
#
# SPDX-License-Identifier: LicenseRef-Nordic-5-Clause
#

# Enable CHIP
CONFIG_CHIP=y
CONFIG_STD_CPP14=y

# General networking settings
CONFIG_NETWORKING=y
CONFIG_NET_IPV6_NBR_CACHE=n
CONFIG_NET_IPV6_MLD=n

# Enable OpenThread MTD
CONFIG_NET_L2_OPENTHREAD=y

CONFIG_OPENTHREAD_FTD=y
CONFIG_OPENTHREAD_SLAAC=y
CONFIG_OPENTHREAD_MTD_NETDIAG=y
CONFIG_OPENTHREAD_MANUAL_START=y
CONFIG_OPENTHREAD_THREAD_STACK_SIZE=6144

CONFIG_OPENTHREAD_PANID=4660
CONFIG_OPENTHREAD_CHANNEL=15
CONFIG_OPENTHREAD_NETWORK_NAME="OpenThread"
CONFIG_OPENTHREAD_XPANID="11:11:11:11:22:22:22:22"

# Use nrf_security
CONFIG_NORDIC_SECURITY_BACKEND=y
CONFIG_OPENTHREAD_MBEDTLS=n

CONFIG_CC3XX_BACKEND=y
CONFIG_OBERON_BACKEND=y

CONFIG_MBEDTLS_ENABLE_HEAP=y
CONFIG_MBEDTLS_HEAP_SIZE=15360
CONFIG_MBEDTLS_TLS_LIBRARY=y
CONFIG_NRF_SECURITY_ADVANCED=y

CONFIG_MBEDTLS_AES_C=y
CONFIG_MBEDTLS_RSA_C=y
CONFIG_MBEDTLS_ECP_C=y
CONFIG_MBEDTLS_ECP_DP_SECP256R1_ENABLED=y
CONFIG_MBEDTLS_CTR_DRBG_C=y
CONFIG_MBEDTLS_CIPHER_MODE_CTR=y
CONFIG_MBEDTLS_ECJPAKE_C=y
CONFIG_MBEDTLS_SHA256_C=y

# Use SHA256 implementation from Oberon
CONFIG_CHOICE_OBERON_MBEDTLS_SHA256_C=y

# Disable unneeded crypto operations
CONFIG_MBEDTLS_SHA512_C=n
CONFIG_MBEDTLS_CIPHER_MODE_XTS=n
CONFIG_MBEDTLS_CHACHA20_C=n
CONFIG_MBEDTLS_POLY1305_C=n
CONFIG_MBEDTLS_CHACHAPOLY_C=n
CONFIG_MBEDTLS_GCM_C=n
CONFIG_MBEDTLS_RSA_C=n
CONFIG_OBERON_MBEDTLS_AES_C=n

# Add support for LEDs and buttons on Nordic development kits
CONFIG_DK_LIBRARY=y

# Other settings
CONFIG_LOG=y
CONFIG_LOG_MODE_MINIMAL=y
CONFIG_MAIN_STACK_SIZE=8192
CONFIG_INIT_STACKS=y
CONFIG_THREAD_NAME=y
CONFIG_MPU_STACK_GUARD=y
CONFIG_SHELL=y
```

## src/light_switch.cpp
```c
/*
 * Copyright (c) 2021 Nordic Semiconductor ASA
 *
 * SPDX-License-Identifier: LicenseRef-Nordic-5-Clause
 */

#include "light_switch.h"

#include "app_task.h"

#include <platform/CHIPDeviceLayer.h>
#include <app/chip-zcl-zpro-codec.h>
#include <support/ErrorStr.h>

#include <logging/log.h>
#include <net/net_ip.h>

LOG_MODULE_DECLARE(app);

namespace
{
static constexpr chip::EndpointId kLightBulbEndpointId = 1;
static constexpr uint16_t kDiscoveryPort = 12345;
static constexpr const char kDiscoveryMagicString[] = "chip-light-bulb";
} /* namespace */

void LightSwitch::DiscoveryHandler::HandleMessageReceived(const chip::PacketHeader &header,
							  const chip::Transport::PeerAddress &source,
							  chip::System::PacketBufferHandle msgBuf)
{
	if (!mEnabled.load(std::memory_order_relaxed)) {
		return;
	}

	if (msgBuf->DataLength() != sizeof(kDiscoveryMagicString) ||
	    memcmp(msgBuf->Start(), kDiscoveryMagicString, sizeof(kDiscoveryMagicString)) != 0) {
		LOG_ERR("Discovery service received invalid message");
		return;
	}

	GetAppTask().PostEvent(AppEvent(AppEvent::LightFound, source.GetIPAddress()));
}

CHIP_ERROR LightSwitch::Init()
{
	CHIP_ERROR err = mCommissioner.Init(chip::kTestControllerNodeId, {});

	if (err != CHIP_NO_ERROR) {
		LOG_ERR("DeviceCommissioner::Init() failed: %s", chip::ErrorStr(err));
		return err;
	}

	err = mCommissioner.ServiceEvents();

	if (err != CHIP_NO_ERROR) {
		LOG_ERR("DeviceCommissioner::ServiceEvents() failed: %s", chip::ErrorStr(err));
		return err;
	}

	auto params = chip::Transport::UdpListenParameters(&chip::DeviceLayer::InetLayer).SetListenPort(kDiscoveryPort);
	err = mDiscoveryServiceEndpoint.Init(params);

	if (err != CHIP_NO_ERROR) {
		LOG_ERR("Transport::UDP::Init() failed: %s", chip::ErrorStr(err));
		return err;
	}

	mDiscoveryHandler.SetEnabled(true);
	mDiscoveryServiceEndpoint.SetDelegate(&mDiscoveryHandler);
	return CHIP_NO_ERROR;
}

void LightSwitch::StartDiscovery()
{
	LOG_INF("Starting light bulb discovery");
	mDiscoveryHandler.SetEnabled(true);
}

void LightSwitch::StopDiscovery()
{
	LOG_INF("Stopping light bulb discovery");
	mDiscoveryHandler.SetEnabled(false);
}

CHIP_ERROR LightSwitch::Pair(const chip::Inet::IPAddress &lightBulbAddress)
{
	{
		char addrStr[NET_IPV6_ADDR_LEN];
		LOG_INF("Pairing with light bulb %s", lightBulbAddress.ToString(addrStr, NET_IPV6_ADDR_LEN));
	}

	CHIP_ERROR err = CHIP_NO_ERROR;

	{
		chip::Controller::SerializedDevice serializedDevice;
		err = mCommissioner.PairTestDeviceWithoutSecurity(
			chip::kTestDeviceNodeId, chip::Transport::PeerAddress::UDP(lightBulbAddress, CHIP_PORT),
			serializedDevice);
	}

	if (err != CHIP_NO_ERROR)
		LOG_ERR("Pairing failed: %s", chip::ErrorStr(err));

	return err;
}

CHIP_ERROR LightSwitch::ToggleLight()
{
	LOG_INF("Toggling the light");

	chip::Controller::Device *device;
	CHIP_ERROR err = mCommissioner.GetDevice(chip::kTestDeviceNodeId, &device);

	if (err != CHIP_NO_ERROR) {
		LOG_ERR("No light bulb device is paired");
		return err;
	}

	auto buffer = encodeOnOffClusterToggleCommand(0, kLightBulbEndpointId);
	if (buffer.IsNull()) {
		return CHIP_ERROR_NO_MEMORY;
	}

	return device->SendMessage(chip::Protocols::TempZCL::Id, 0, std::move(buffer));
}

CHIP_ERROR LightSwitch::SetLightLevel(uint8_t level)
{
	LOG_INF("Setting brightness level to %u", level);

	chip::Controller::Device *device;
	CHIP_ERROR err = mCommissioner.GetDevice(chip::kTestDeviceNodeId, &device);

	if (err != CHIP_NO_ERROR) {
		LOG_ERR("No light bulb device is paired");
		return err;
	}

	auto buffer = encodeLevelControlClusterMoveToLevelCommand(0, kLightBulbEndpointId, level, 0, 0, 0);
	if (buffer.IsNull()) {
		return CHIP_ERROR_NO_MEMORY;
	}

	return device->SendMessage(chip::Protocols::TempZCL::Id, 0, std::move(buffer));
}
```
