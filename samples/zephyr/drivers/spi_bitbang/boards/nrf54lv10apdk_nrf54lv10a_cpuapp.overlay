/*
 * Copyright (c) 2025 Nordic Semiconductor ASA
 *
 * SPDX-License-Identifier: LicenseRef-Nordic-5-Clause
 */

/ {
	spibb0: spibb0 {
		compatible = "zephyr,spi-bitbang";
		status="okay";
		#address-cells = <1>;
		#size-cells = <0>;
		clk-gpios = <&gpio1 0 GPIO_ACTIVE_HIGH>;
		mosi-gpios = <&gpio1 10 GPIO_ACTIVE_HIGH>;
		miso-gpios = <&gpio1 11 GPIO_ACTIVE_HIGH>;
		cs-gpios = <&gpio1 2 GPIO_ACTIVE_LOW>;
	};
};
