/*
 * Copyright (c) 2025 Nordic Semiconductor ASA
 *
 * SPDX-License-Identifier: LicenseRef-Nordic-5-Clause
 */

/*
 * Test requires loopback between P1.05 and P1.21
 * No other driver on SPI_CLK and SPI_CS.
 */

/ {
	spibb0: spibb0 {
		compatible = "zephyr,spi-bitbang";
		status = "okay";
		#address-cells = <1>;
		#size-cells = <0>;
		clk-gpios = <&gpio1 4 GPIO_ACTIVE_HIGH>;
		mosi-gpios = <&gpio1 5 GPIO_ACTIVE_HIGH>;
		miso-gpios = <&gpio1 21 GPIO_ACTIVE_HIGH>;
		cs-gpios = <&gpio1 6 GPIO_ACTIVE_LOW>;
	};
};
