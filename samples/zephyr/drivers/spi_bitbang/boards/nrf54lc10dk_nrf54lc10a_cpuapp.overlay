/*
 * Copyright (c) 2026 Nordic Semiconductor ASA
 *
 * SPDX-License-Identifier: LicenseRef-Nordic-5-Clause
 */

/*
 * Test requires loopback between P1.10 and P1.11
 */

/ {
	spibb0: spibb0 {
		compatible = "zephyr,spi-bitbang";
		#address-cells = <1>;
		#size-cells = <0>;
		clk-gpios = <&gpio1 0 GPIO_ACTIVE_HIGH>;
		sdo-gpios = <&gpio1 10 GPIO_ACTIVE_HIGH>;
		sdi-gpios = <&gpio1 11 GPIO_ACTIVE_HIGH>;
		cs-gpios = <&gpio1 2 GPIO_ACTIVE_LOW>;
		status = "okay";
	};
};
