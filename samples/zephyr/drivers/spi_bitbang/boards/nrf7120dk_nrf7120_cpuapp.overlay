/*
 * Test requires loopback between P1.07 and P1.12
 * No other driver on SPI_CLK and SPI_CS.
 */

/ {
	spibb0: spibb0 {
		compatible = "zephyr,spi-bitbang";
		status = "okay";
		#address-cells = <1>;
		#size-cells = <0>;
		clk-gpios = <&gpio1 13 GPIO_ACTIVE_HIGH>;
		mosi-gpios = <&gpio1 7 GPIO_ACTIVE_HIGH>;
		miso-gpios = <&gpio1 12 GPIO_ACTIVE_HIGH>;
		cs-gpios = <&gpio1 14 GPIO_ACTIVE_LOW>;
	};
};
