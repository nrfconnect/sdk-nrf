/*
 * Copyright (c) 2026 Nordic Semiconductor ASA
 *
 * SPDX-License-Identifier: LicenseRef-Nordic-5-Clause
 */

&spi120 {
	status = "okay";
	pinctrl-0 = <&spi120_default>;
	pinctrl-1 = <&spi120_sleep>;
	pinctrl-names = "default", "sleep";
	cs-gpios = <&gpio5 5 GPIO_ACTIVE_LOW>;

	gd25le255e: gd25le255e@0 {
		compatible = "jedec,spi-nor";
		status = "okay";
		reg = <0>;
		spi-max-frequency = <8000000>;
		size = <DT_SIZE_M(256)>;
		has-dpd;
		t-enter-dpd = <3000>;
		t-exit-dpd = <20000>;
		jedec-id = [c8 60 19];
		sfdp-bfp = [e5 20 f3 ff ff ff ff 0f 44 eb 08 6b 08 3b 42 bb
			    fe ff ff ff ff ff 00 ff ff ff 42 eb 0c 20 0f 52
			    10 d8 00 ff d4 31 a5 fe 84 df 14 4f ec 62 16 33
			    7a 75 7a 75 04 b3 d5 5c 19 06 14 00 08 50 00 01];
		reset-gpios = <&gpio5 0 GPIO_ACTIVE_LOW>;
		wp-gpios = <&gpio5 3 GPIO_ACTIVE_LOW>;
	};
};

&gd25le255e {
	status = "okay";
};

&gpio5 {
	status = "okay";
};

&uart120 {
	status = "disabled";
};
