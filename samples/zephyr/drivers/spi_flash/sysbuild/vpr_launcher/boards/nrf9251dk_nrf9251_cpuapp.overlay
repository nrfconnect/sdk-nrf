/*
 * Copyright (c) 2026 Nordic Semiconductor ASA
 *
 * SPDX-License-Identifier: LicenseRef-Nordic-5-Clause
 */

&spi120 {
	status = "reserved";
	interrupt-parent = <&cpuflpr_clic>;
};

/delete-node/ &gd25le255e;
