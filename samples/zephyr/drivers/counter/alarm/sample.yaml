## samples/zephyr/drivers/counter/alarm/sample.yaml
```yaml
sample:
  name: Counter RTC Driver Sample
common:
  tags:
    - drivers
    - counter
    - ci_samples_zephyr_drivers_counter
  harness: console
  harness_config:
    type: multi_line
    ordered: true
    regex:
      - "Counter alarm sample"
      - "Set alarm in 2 sec"
      - "!!! Alarm !!!"
      - "Now: [2|3]"
  depends_on: counter
  timeout: 30

tests:
  nrf.extended.sample.drivers.counter.alarm:
    platform_allow:
      - nrf54h20dk/nrf54h20/cpuapp
      - nrf54l15dk/nrf54l15/cpuapp
      - nrf54ls05dk/nrf54ls05b/cpuapp
      - nrf54ls05dk@0.0.0/nrf54ls05b/cpuapp
      - nrf54lv10dk/nrf54lv10a/cpuapp
      - nrf54lv10dk/nrf54lv10a/cpuapp/ns
      - nrf54lv10dk/nrf54lv10a/cpuflpr
      - nrf54lv10dk@0.2.0/nrf54lv10a/cpuapp
    integration_platforms:
      - nrf54h20dk/nrf54h20/cpuapp
      - nrf54l15dk/nrf54l15/cpuapp
      - nrf54ls05dk/nrf54ls05b/cpuapp
      - nrf54lv10dk/nrf54lv10a/cpuapp
```

## samples/zephyr/drivers/i2c/rtio_loopback/boards/nrf7120dk_nrf7120_cpuapp.conf
```kconfig
#
# Copyright (c) 2025 Nordic Semiconductor ASA
#
# SPDX-License-Identifier: LicenseRef-Nordic-5-Clause
#

CONFIG_I2C_NRFX_TWIS_BUF_SIZE=256
```

## samples/zephyr/drivers/i2c/rtio_loopback/sample.yaml
```yaml
sample:
  name: I2C RTIO loopback sample

common:
  tags:
    - rtio
    - i2c_target
    - ci_samples_zephyr_drivers_i2c
  harness: console
  harness_config:
    fixture: i2c_bus_short
    type: one_line
    regex:
      - "sample complete"
tests:
  nrf.extended.sample.drivers.i2c.rtio_loopback:
    platform_allow:
      - nrf54ls05dk/nrf54ls05b/cpuapp
      - nrf54ls05dk@0.0.0/nrf54ls05b/cpuapp
      - nrf54lv10dk/nrf54lv10a/cpuapp
      - nrf54lv10dk@0.2.0/nrf54lv10a/cpuapp
      - nrf7120pdk/nrf7120/cpuapp
    integration_platforms:
      - nrf54ls05dk/nrf54ls05b/cpuapp
```

## samples/zephyr/drivers/jesd216/sample.yaml
```yaml
sample:
  name: JESD216 Sample
common:
  tags:
    - spi
    - flash
    - ci_samples_zephyr_drivers_jesd216
  harness: console
  harness_config:
    fixture: external_flash
    type: multi_line
    ordered: true
    regex:
      - "sfdp-bfp ="
      - "jedec-id ="
tests:
  sample.drivers.spi.jesd216.sqspi:
    filter: CONFIG_MSPI_NRF_SQSPI and dt_compat_enabled("jedec,mspi-nor")
    platform_allow:
      - nrf54l15dk/nrf54l15/cpuapp
      - nrf54lm20dk/nrf54lm20b/cpuapp
    integration_platforms:
      - nrf54l15dk/nrf54l15/cpuapp
    extra_args:
      - FILE_SUFFIX=sqspi
  sample.drivers.spi.jesd216.sqspi_16M:
    filter: CONFIG_MSPI_NRF_SQSPI and dt_compat_enabled("jedec,mspi-nor")
    platform_allow:
      - nrf54l15dk/nrf54l15/cpuapp
      - nrf54lm20dk/nrf54lm20b/cpuapp
    integration_platforms:
      - nrf54l15dk/nrf54l15/cpuapp
    extra_args:
      - FILE_SUFFIX=sqspi
      - EXTRA_DTC_OVERLAY_FILE="boards/sqspi_16MHz.overlay"
  sample.drivers.spi.jesd216.sqspi_32M:
    filter: CONFIG_MSPI_NRF_SQSPI and dt_compat_enabled("jedec,mspi-nor")
    platform_allow:
      - nrf54l15dk/nrf54l15/cpuapp
      - nrf54lm20dk/nrf54lm20b/cpuapp
    integration_platforms:
      - nrf54l15dk/nrf54l15/cpuapp
    extra_args:
      - FILE_SUFFIX=sqspi
      - EXTRA_DTC_OVERLAY_FILE="boards/sqspi_32MHz.overlay"
```

## samples/zephyr/drivers/mbox/Kconfig.sysbuild
```kconfig
#
# Copyright (c) 2025 Nordic Semiconductor ASA
#
# SPDX-License-Identifier: LicenseRef-Nordic-5-Clause
#

source "share/sysbuild/Kconfig"

config REMOTE_BOARD
	string "Remote board"
	default "nrf54lv10dk/nrf54lv10a/cpuflpr" if $(BOARD) = "nrf54lv10dk"
```

## samples/zephyr/drivers/mbox/sample.yaml
```yaml
sample:
  name: MBOX IPC sample
common:
  sysbuild: true
  tags:
    - mbox
    - ci_samples_zephyr_drivers_mbox
  timeout: 30
tests:
  nrf.extended.sample.drivers.mbox.nrf54l:
    platform_allow:
      - nrf54lv10dk/nrf54lv10a/cpuapp
    integration_platforms:
      - nrf54lv10dk/nrf54lv10a/cpuapp
    extra_args: mbox_SNIPPET=nordic-flpr
    sysbuild: true
    harness: console
    harness_config:
      type: multi_line
      ordered: false
      regex:
        - "Ping \\(on channel 21\\)"
        - "Pong \\(on channel 20\\)"

  nrf.extended.sample.drivers.mbox.nrf54l_no_multithreading:
    platform_allow:
      - nrf54lv10dk/nrf54lv10a/cpuapp
    integration_platforms:
      - nrf54lv10dk/nrf54lv10a/cpuapp
    extra_args:
      - mbox_SNIPPET=nordic-flpr
      - mbox_CONFIG_MULTITHREADING=n
      - remote_CONFIG_MULTITHREADING=n
    sysbuild: true
    harness: console
    harness_config:
      type: multi_line
      ordered: false
      regex:
        - "Ping \\(on channel 21\\)"
        - "Pong \\(on channel 20\\)"

  nrf.extended.sample.drivers.mbox.nrf54l_remote_no_multithreading:
    platform_allow:
      - nrf54lv10dk/nrf54lv10a/cpuapp
    integration_platforms:
      - nrf54lv10dk/nrf54lv10a/cpuapp
    extra_args:
      - mbox_SNIPPET=nordic-flpr
      - remote_CONFIG_MULTITHREADING=n
    sysbuild: true
    harness: console
    harness_config:
      type: multi_line
      ordered: false
      regex:
        - "Ping \\(on channel 21\\)"
        - "Pong \\(on channel 20\\)"

  nrf.extended.sample.drivers.mbox.nrf9251_app_ppr:
    platform_allow:
      - nrf9251dk/nrf9251/cpuapp
    integration_platforms:
      - nrf9251dk/nrf9251/cpuapp
    extra_args:
      - SB_CONF_FILE=sysbuild/nrf9251dk_nrf9251_cpuppr.conf
    sysbuild: true
    harness: console
    harness_config:
      type: multi_line
      ordered: false
      regex:
        - "Ping \\(on channel 15\\)"
        - "Pong \\(on channel 18\\)"

  nrf.extended.sample.drivers.mbox.nrf9251_app_flpr:
    platform_allow:
      - nrf9251dk/nrf9251/cpuapp
    integration_platforms:
      - nrf9251dk/nrf9251/cpuapp
    extra_args:
      - mbox_DTC_OVERLAY_FILE="boards/nrf9251dk_nrf9251_cpuapp_cpuflpr.overlay"
      - SB_CONF_FILE=sysbuild/nrf9251dk_nrf9251_cpuflpr.conf
    sysbuild: true
    harness: console
    harness_config:
      type: multi_line
      ordered: false
      regex:
        - "Ping \\(on channel 16\\)"
        - "Pong \\(on channel 14\\)"
```

## samples/zephyr/drivers/spi_bitbang/sample.yaml
```yaml
sample:
  name: SPI Bitbang Driver Sample
tests:
  nrf.extended.sample.drivers.spi.bitbang:
    tags:
      - drivers
      - spi
      - gpio
      - ci_samples_zephyr_drivers_spi_bitbang
    platform_allow:
      - nrf54ls05dk/nrf54ls05b/cpuapp
      - nrf54ls05dk@0.0.0/nrf54ls05b/cpuapp
      - nrf54lv10dk/nrf54lv10a/cpuapp
      - nrf54lv10dk@0.2.0/nrf54lv10a/cpuapp
    integration_platforms:
      - nrf54ls05dk/nrf54ls05b/cpuapp
    harness: console
    harness_config:
      fixture: gpio_loopback
      type: multi_line
      ordered: true
      regex:
        - "basic_write_9bit_words; ret: 0"
        - "wrote 0101 00ff 00a5 0000 0102"
        - "9bit_loopback_partial; ret: 0"
        - "tx [(]i[)]  : 0101 0102"
        - "tx [(]ii[)] : 0003 0004 0105"
        - "rx [(]ii[)] : 0003 0004 0105"
        - "8bit_loopback_partial; ret: 0"
        - "tx [(]i[)]  : 01 02 03 04 05"
        - "rx [(]i[)]  : 01 02 03 04 05"
    timeout: 30
```

## samples/zephyr/drivers/spi_flash/sample.yaml
```yaml
sample:
  name: SPI Flash Sample
common:
  tags:
    - spi
    - flash
    - ci_samples_zephyr_drivers_spi_flash
  harness: console
  harness_config:
    type: multi_line
    ordered: true
    regex:
      - "Test 1: Flash erase"
      - "Flash erase succeeded!"
      - "Test 2: Flash write"
      - "Attempting to write 4 bytes"
      - "Data read matches data written. Good!!"
tests:
  sample.drivers.spi.flash.sqspi:
    filter: CONFIG_MSPI_NRF_SQSPI and dt_compat_enabled("jedec,mspi-nor")
    platform_allow:
      - nrf54l15dk/nrf54l15/cpuapp
    integration_platforms:
      - nrf54l15dk/nrf54l15/cpuapp
    extra_args:
      - DTC_OVERLAY_FILE="boards/nrf54l15dk_nrf54l15_cpuapp_sqspi.overlay"
```

## samples/zephyr/drivers/watchdog/sample.yaml
```yaml
sample:
  name: Watchdog Driver Sample
common:
  tags:
    - drivers
    - watchdog
    - ci_sampples_zephyr_drivers_watchdog
  harness: console
  harness_config:
    type: multi_line
    ordered: true
    regex:
      - "Watchdog sample application"
      - "Feeding watchdog..."
      - "Waiting for reset..."
      - "Watchdog sample application"
  timeout: 30

tests:
  nrf.extended.sample.drivers.watchdog:
    platform_allow:
      - nrf54ls05dk/nrf54ls05b/cpuapp
      - nrf54ls05dk@0.0.0/nrf54ls05b/cpuapp
      - nrf54lv10dk/nrf54lv10a/cpuapp
      - nrf54lv10dk/nrf54lv10a/cpuflpr
      - nrf54lv10dk@0.2.0/nrf54lv10a/cpuapp
      - nrf54lv10dk@0.2.0/nrf54lv10a/cpuflpr
    integration_platforms:
      - nrf54ls05dk/nrf54ls05b/cpuapp
```

## samples/zephyr/hello_world_mini_boot/sysbuild/mcuboot/boards/nrf54l15dk_nrf54l05_cpuapp.conf
```kconfig
#
# Copyright (c) 2025 Nordic Semiconductor ASA
#
# SPDX-License-Identifier: LicenseRef-Nordic-5-Clause
#

# NOTE: These save about 2 KiB
CONFIG_SYS_CLOCK_EXISTS=n
CONFIG_NRF_GRTC_TIMER=n

CONFIG_PSA_CRYPTO_DRIVER_CRACEN=n
CONFIG_PSA_CRYPTO_DRIVER_OBERON=y

# NOTE: Does not influence binary size; it is not mentioned in docs - what is its purpose?
CONFIG_NRF_OBERON=y
```

## samples/zephyr/net/dns_resolve/sample.yaml
```yaml
sample:
  description: DNS resolver, mDNS and LLMNR responder
  name: DNS resolver and responder sample application
tests:
  nrf.extended.sample.net.dns_resolve.wifi.nrf71dk:
    tags:
      - ci_build
      - sysbuild
      - ci_samples_net
    extra_args:
      - SNIPPET=wifi-ipv4
    platform_allow:
      - nrf7120dk/nrf7120/cpuapp
```

## samples/zephyr/net/ipv4_autoconf/sample.yaml
```yaml
sample:
  description: Test IPv4 autoconf functionality
  name: IPv4 autoconf sample app
tests:
  nrf.extended.sample.net.ipv4_autoconf.wifi.nrf71dk:
    tags:
      - ci_build
      - sysbuild
      - ci_samples_net
    extra_args:
      - SNIPPET=wifi-ipv4
    platform_allow:
      - nrf7120dk/nrf7120/cpuapp
```

## samples/zephyr/net/mdns_responder/Kconfig
```kconfig
#
# Copyright (c) 2026 Nordic Semiconductor ASA
#
# SPDX-License-Identifier: Apache-2.0
#

# Source the original Zephyr sample Kconfig directly to avoid duplication.
source "${ZEPHYR_BASE}/samples/net/mdns_responder/Kconfig"
```

## samples/zephyr/net/mdns_responder/Kconfig.sysbuild
```kconfig
#
# Copyright (c) 2026 Nordic Semiconductor ASA
#
# SPDX-License-Identifier: LicenseRef-Nordic-5-Clause
#

# Source the original Zephyr sample Kconfig.sysbuild directly to avoid duplication.
source "${ZEPHYR_BASE}/samples/net/mdns_responder/Kconfig.sysbuild"
```

## samples/zephyr/net/mdns_responder/sample.yaml
```yaml
sample:
  name: mDNS responder
tests:
  nrf.extended.sample.net.mdns_responder.wifi.nrf71dk:
    tags:
      - ci_build
      - sysbuild
      - ci_samples_net
    extra_args:
      - SNIPPET=wifi-ipv4
    platform_allow:
      - nrf7120dk/nrf7120/cpuapp
```

## samples/zephyr/net/mqtt_publisher/sample.yaml
```yaml
sample:
  description: MQTT publisher sample application
  name: MQTT publisher
tests:
  nrf.extended.sample.net.mqtt_publisher.wifi.nrf71dk:
    tags:
      - ci_build
      - sysbuild
      - ci_samples_net
    extra_args:
      - SNIPPET=wifi-ipv4
    platform_allow:
      - nrf7120dk/nrf7120/cpuapp
    integration_platforms:
      - nrf7120dk/nrf7120/cpuapp
```

## samples/zephyr/net/sockets/echo_async/sample.yaml
```yaml
sample:
  description: BSD Sockets API TCP echo server sample using non-blocking sockets
  name: socket_echo_async
tests:
  nrf.extended.sample.net.sockets.echo_async.wifi.nrf71dk:
    tags:
      - ci_build
      - sysbuild
      - ci_samples_net
    extra_args:
      - SNIPPET=wifi-ipv4
    platform_allow:
      - nrf7120dk/nrf7120/cpuapp
    integration_platforms:
      - nrf7120dk/nrf7120/cpuapp
```

## samples/zephyr/net/sockets/echo_client/sample.yaml
```yaml
sample:
  description: Test network sockets using a client/server sample
  name: Socket Echo Client
tests:
  nrf.extended.sample.net.sockets.echo_client.wifi.nrf71dk:
    tags:
      - ci_build
      - sysbuild
      - ci_samples_net
    extra_args:
      - SNIPPET=wifi-ipv4
    platform_allow:
      - nrf7120dk/nrf7120/cpuapp
```

## samples/zephyr/net/sockets/http_get/sample.yaml
```yaml
sample:
  description: BSD Sockets API HTTP GET example
  name: socket_http_get
tests:
  nrf.extended.sample.net.sockets.http_get.wifi.nrf71dk:
    tags:
      - ci_build
      - sysbuild
      - ci_samples_net
    extra_args:
      - SNIPPET=wifi-ipv4
    platform_allow:
      - nrf7120dk/nrf7120/cpuapp
```

## samples/zephyr/net/sockets/sntp_client/sample.yaml
```yaml
sample:
  description: SNTP client sample
  name: sntp_client
tests:
  nrf.extended.sample.net.sockets.sntp_client.wifi.nrf71dk:
    tags:
      - ci_build
      - sysbuild
      - ci_samples_net
    extra_args:
      - SNIPPET=wifi-ipv4
    platform_allow:
      - nrf7120dk/nrf7120/cpuapp
```

## samples/zephyr/net/syslog_net/sample.yaml
```yaml
sample:
  description: syslog network backend
  name: syslog_net
tests:
  nrf.extended.sample.net.syslog.wifi.nrf71dk:
    tags:
      - ci_build
      - sysbuild
      - ci_samples_net
    extra_args:
      - SNIPPET=wifi-ipv4
    platform_allow:
      - nrf7120dk/nrf7120/cpuapp
```
