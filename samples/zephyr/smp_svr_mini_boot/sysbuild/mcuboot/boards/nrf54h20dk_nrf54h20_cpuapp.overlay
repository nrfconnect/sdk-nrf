/*
 * Copyright (c) 2025 Nordic Semiconductor ASA
 *
 * SPDX-License-Identifier: LicenseRef-Nordic-5-Clause
 */

#include "../../nrf54h20dk_nrf54h20_memory_map_merged_slot.dtsi"

/ {
	chosen {
		zephyr,code-partition = &boot_partition;
	};
};
