/*
 * Copyright (c) 2025 Nordic Semiconductor ASA
 *
 * SPDX-License-Identifier: LicenseRef-Nordic-5-Clause
 */

/* On nRF54H20 the Direct XIP mode is supported in the merged slot configuration
 * Merge application and radio slots by extending the application parition.
 */
&cpuapp_slot0_partition {
	reg = <0x40000 DT_SIZE_K(656)>;
};

&cpuapp_slot1_partition {
	reg = <0x100000 DT_SIZE_K(656)>;
};
