## samples/zephyr/subsys/usb/hid-mouse/sample.yaml
```yaml
sample:
  name: USB HID mouse sample
common:
  tags:
    - ci_samples_zephyr_subsys_usb
    - usb

tests:
  nrf.extended.sample.usb_device_next.hid-mouse:
    timeout: 15
    harness: console
    harness_config:
      fixture: usb_connected
      type: multi_line
      regex:
        - "HS bNumConfigurations 1"
        - "FS bNumConfigurations 1"
        - "Actual device speed 2"
        - "Status OUT finished"
    integration_platforms:
      - nrf54h20dk/nrf54h20/cpuapp
    platform_allow:
      - nrf54h20dk/nrf54h20/cpuapp
      - nrf54lm20dk/nrf54lm20a/cpuapp
      - nrf54lm20dk/nrf54lm20b/cpuapp

  nrf.extended.sample.usb_device_next.hid-mouse-bc12:
    integration_platforms:
      - nrf54lm20dk/nrf54lm20b/cpuapp
    platform_allow:
      - nrf54lm20dk/nrf54lm20a/cpuapp
      - nrf54lm20dk/nrf54lm20b/cpuapp
    extra_configs:
      - CONFIG_USB_BC12=y
    harness: console
    harness_config:
      fixture: usb_connected
      type: multi_line
      regex:
        - "HS bNumConfigurations 1"
        - "FS bNumConfigurations 1"
        - "New BC state CDP \\(5000000 uV \\d+ uA\\)"
        - "Actual device speed 2"
        - "Status OUT finished"
```

## samples/zephyr/subsys/usb/mass/sample.yaml
```yaml
sample:
  name: Mass Storage
common:
  min_ram: 128
  platform_allow:
    - nrf54h20dk/nrf54h20/cpuapp
    - nrf54lm20dk/nrf54lm20a/cpuapp
  integration_platforms:
    - nrf54h20dk/nrf54h20/cpuapp
  extra_args:
    - EXTRA_DTC_OVERLAY_FILE="ramdisk.overlay"
  tags:
    - msd
    - usb
    - ci_samples_zephyr_subsys_usb

tests:
  nrf.extended.sample.usbd.mass_ram_none:
    harness: console
    harness_config:
      type: multi_line
      ordered: true
      regex:
        - "No file system selected"
        - "The device is put in USB mass storage mode."
        - "usbd_msc: Enable"
        - "usbd_msc: Bulk-Only Mass Storage Reset"
    extra_configs:
      - CONFIG_LOG_DEFAULT_LEVEL=3
  nrf.extended.sample.usbd.mass_ram_fat:
    harness: console
    harness_config:
      type: multi_line
      ordered: true
      regex:
        - "End of files"
        - "The device is put in USB mass storage mode."
        - "usbd_msc: Enable"
        - "usbd_msc: Bulk-Only Mass Storage Reset"
    extra_configs:
      - CONFIG_LOG_DEFAULT_LEVEL=3
      - CONFIG_APP_MSC_STORAGE_RAM=y
```

## samples/zephyr/sysbuild/hello_world/sample.yaml
```yaml
sample:
  name: Hello World for multiple board targets using Sysbuild
  description: |
    Hello World application that builds for multiple targets. Both images print
    the board target they were run on.

common:
  sysbuild: true
  harness: pytest
  harness_config:
    pytest_dut_scope: session
  timeout: 20
  tags:
    - ci_samples_zephyr_sysbuild_hello_world

tests:
  nrf.extended.sample.sysbuild.hello_world:
    platform_allow:
      - nrf54lv10dk/nrf54lv10a/cpuapp
      - nrf7120pdk/nrf7120/cpuapp
    integration_platforms:
      - nrf54lv10dk/nrf54lv10a/cpuapp
    extra_args:
      - hello_world_SNIPPET=nordic-flpr
```

## samples/zephyr/tfm_integration/psa_protected_storage/sample.yaml
```yaml
sample:
  description: Protected Storage API sample
  name: PSA Protected Storage
common:
  tags:
    - psa
    - trusted-firmware-m
    - mcuboot
    - ci_samples_zephyr_tfm_integration

  platform_allow:
    - nrf54l15dk/nrf54l15/cpuapp/ns
    - nrf54lm20dk/nrf54lm20b/cpuapp/ns
    - nrf54lm20dk/nrf54lm20a/cpuapp/ns
    - nrf54lv10dk/nrf54lv10a/cpuapp/ns
  harness: console
  harness_config:
    type: multi_line
    regex:
      - "Protected Storage sample started"
      - "PSA Protected Storage API Version [0-9]*.[0-9]*"
      - "Writing data to UID1: .*"
      - "Info on data stored in UID1:"
      - "- Size: [0-9]*"
      - "- Capacity: 0x[0-9a-f]*"
      - "- Flags: 0x[0-9-a-f]*"
      - "Got expected error \\(PSA_ERROR_NOT_PERMITTED\\) when writing to protected\
      \ UID"
      - "Removing UID1"

tests:
  nrf.extended.sample.tfm.protected_storage: {}
```

## samples/zephyr/tfm_integration/tfm_ipc/sample.yaml
```yaml
sample:
  description: This app provides an example of using TF-M on the secure side, with
    Zephyr on the NS side, using IPC.
  name: TF-M IPC example
common:
  tags:
    - introduction
    - trusted-firmware-m
    - ci_samples_zephyr_tfm_integration

tests:
  nrf.extended.sample.tfm_ipc:
    tags:
      - mcuboot
    platform_allow:
      - nrf54l15dk/nrf54l15/cpuapp/ns
      - nrf54lc10dk/nrf54lc10a/cpuapp/ns
      - nrf54lm20dk/nrf54lm20b/cpuapp/ns
      - nrf54lm20dk/nrf54lm20a/cpuapp/ns
      - nrf54lv10dk/nrf54lv10a/cpuapp/ns
    harness: console
    harness_config:
      type: multi_line
      regex:
        - "TF-M IPC on .*"
        - "The version of the PSA Framework API is"
        - "The PSA Crypto service minor version is"
        - "Generating 256 bytes of random data"
  nrf.extended.sample.tfm_ipc.no_bl2:
    platform_allow:
      - nrf54l15dk/nrf54l15/cpuapp/ns
      - nrf54l15dk/nrf54l10/cpuapp/ns
      - nrf54lc10dk/nrf54lc10a/cpuapp/ns
      - nrf54lm20dk/nrf54lm20a/cpuapp/ns
      - nrf54lm20dk/nrf54lm20b/cpuapp/ns
      - nrf54lv10dk/nrf54lv10a/cpuapp/ns
    extra_configs:
      - CONFIG_TFM_BL2=n
    harness: console
    harness_config:
      type: multi_line
      regex:
        - "TF-M IPC on .*"
        - "The version of the PSA Framework API is"
        - "The PSA Crypto service minor version is"
        - "Generating 256 bytes of random data"
```

## samples/zigbee/benchmark_shell/sample.yaml
```yaml
sample:
  name: Zigbee application with Zigbee shell
  description: Zigbee application thast includes all Zigbee shell commands
tests:
  zigbee.shell:
    build_only: true
    platform_allow: nrf52840dk_nrf52840 nrf52833dk_nrf52833 nrf5340dk_nrf5340_cpuapp nrf21540dk_nrf52840
    tags: ci_build shell
    integration_platforms:
      - nrf52840dk_nrf52840
      - nrf52833dk_nrf52833
      - nrf5340dk_nrf5340_cpuapp
      - nrf21540dk_nrf52840
```

## samples/zigbee/light_bulb/boards/nrf5340dk_nrf5340_cpuapp.conf
```kconfig
#
# Copyright (c) 2020 Nordic Semiconductor ASA
#
# SPDX-License-Identifier: LicenseRef-Nordic-5-Clause
#

CONFIG_MAIN_STACK_SIZE=2048

# Use software cryptography on nRF5340
CONFIG_ZIGBEE_USE_SOFTWARE_AES=y
CONFIG_CRYPTO=n
CONFIG_CRYPTO_NRF_ECB=n

# Networking
CONFIG_MPSL=n
```

## samples/zigbee/light_bulb/sample.yaml
```yaml
sample:
  description: Zigbee Light control - light bulb sample
  name: Zigbee Light control
tests:
  sample.zigbee.light_bulb:
    sysbuild: true
    build_only: true
    integration_platforms:
      - nrf52840dk/nrf52840
      - nrf52833dk/nrf52833
      - nrf5340dk/nrf5340/cpuapp
      - nrf21540dk/nrf52840
    platform_allow: nrf52840dk/nrf52840 nrf52833dk/nrf52833 nrf5340dk/nrf5340/cpuapp
      nrf21540dk/nrf52840
    tags: ci_build smoke sysbuild
  sample.zigbee.light_bulb.with_shell:
    sysbuild: true
    build_only: true
    extra_args: >
      CONFIG_ZIGBEE_SHELL=y CONFIG_ZIGBEE_SHELL_DEBUG_CMD=y CONFIG_ZIGBEE_LOGGER_EP=n
      CONFIG_ZIGBEE_SHELL_ENDPOINT=10 CONFIG_LOG_MODE_DEFERRED=y
    integration_platforms:
      - nrf52840dk/nrf52840
      - nrf52833dk/nrf52833
      - nrf5340dk/nrf5340/cpuapp
      - nrf21540dk/nrf52840
    platform_allow: nrf52840dk/nrf52840 nrf52833dk/nrf52833 nrf5340dk/nrf5340/cpuapp
      nrf21540dk/nrf52840
    tags: ci_build shell sysbuild
```

## samples/zigbee/light_switch/Kconfig
```kconfig
#
# Copyright (c) 2020 Nordic Semiconductor ASA
#
# SPDX-License-Identifier: LicenseRef-Nordic-5-Clause
#

menu "Zephyr Kernel"
source "Kconfig.zephyr"
endmenu

module = NUS_CMD
module-str = NUS command
source "${ZEPHYR_BASE}/subsys/logging/Kconfig.template.log_config"


config LIGHT_SWITCH_CONFIGURE_TX_POWER
	bool "Configure TX power"
	default y
	help
		Enable this option to configure TX power for the sample.

config LIGHT_SWITCH_TX_POWER
	int "TX power"
	depends on LIGHT_SWITCH_CONFIGURE_TX_POWER
	default 0
	help
		TX power level in dBm.
```

## samples/zigbee/light_switch/Kconfig.sysbuild
```kconfig
#
# Copyright (c) 2023 Nordic Semiconductor
#
# SPDX-License-Identifier: LicenseRef-Nordic-5-Clause
#

#### Radio core selection
config NRF_DEFAULT_IPC_RADIO
	default y

if BOOTLOADER_MCUBOOT

#### DFU multi-image support
config DFU_MULTI_IMAGE_PACKAGE_BUILD
	default y

config DFU_MULTI_IMAGE_PACKAGE_APP
	default y

#### DFU dual core configuration
if SOC_SERIES_NRF53X

config PM_EXTERNAL_FLASH_MCUBOOT_SECONDARY
	default y

config MCUBOOT_UPDATEABLE_IMAGES
	default 2

choice MCUBOOT_MODE
	default MCUBOOT_MODE_OVERWRITE_ONLY
endchoice

config SECURE_BOOT_NETCORE
	default y

config NETCORE_APP_UPDATE
	default y

config DFU_MULTI_IMAGE_PACKAGE_NET
	default y

endif # SOC_SERIES_NRF53X

endif # BOOTLOADER_MCUBOOT

source "${ZEPHYR_BASE}/share/sysbuild/Kconfig"
```

## samples/zigbee/light_switch/boards/nrf5340dk_nrf5340_cpuapp.conf
```kconfig
#
# Copyright (c) 2022 Nordic Semiconductor ASA
#
# SPDX-License-Identifier: LicenseRef-Nordic-5-Clause
#

CONFIG_MAIN_STACK_SIZE=2048

# Use software cryptography on nRF5340
CONFIG_ZIGBEE_USE_SOFTWARE_AES=y
```

## samples/zigbee/light_switch/boards/nrf5340dk_nrf5340_cpuapp_fota.conf
```kconfig
#
# Copyright (c) 2022 Nordic Semiconductor ASA
#
# SPDX-License-Identifier: LicenseRef-Nordic-5-Clause
#

CONFIG_MAIN_STACK_SIZE=2048

# Use software cryptography on nRF5340
CONFIG_ZIGBEE_USE_SOFTWARE_AES=y

#######################
# Zigbee FOTA overlay #
#######################

# Allow for storing two images in MCUboot partitions
CONFIG_UPDATEABLE_IMAGE_NUMBER=2

# Store new images inside external flash
CONFIG_PM_EXTERNAL_FLASH_MCUBOOT_SECONDARY=y

# Configure QSPI for external flash
CONFIG_NORDIC_QSPI_NOR=y
CONFIG_NORDIC_QSPI_NOR_FLASH_LAYOUT_PAGE_SIZE=4096
CONFIG_NORDIC_QSPI_NOR_STACK_WRITE_BUFFER_SIZE=16

CONFIG_DFU_MULTI_IMAGE=y
CONFIG_NRF53_ENFORCE_IMAGE_VERSION_EQUALITY=y
```

## samples/zigbee/light_switch/boards/nrf54l15pdk_nrf54l15_cpuapp.conf
```kconfig
# Disable NRF_SECURITY temporarily for testing - due to some build error
CONFIG_NRF_SECURITY=n
# Disable PM temporarily for testing
CONFIG_PM=n

# Let's not use PSA_CRYPTO_RNG but PRNG instead for initial testing
CONFIG_ENTROPY_PSA_CRYPTO_RNG=n
CONFIG_FAKE_ENTROPY_NRF_PRNG=y

# Let's use software cryptography for initial testing
CONFIG_ZIGBEE_USE_SOFTWARE_AES=y
```

## samples/zigbee/light_switch/child_image/mcuboot/boards/nrf5340dk_nrf5340_cpuapp_fota.conf
```kconfig
#
# Copyright (c) 2022 Nordic Semiconductor ASA
#
# SPDX-License-Identifier: LicenseRef-Nordic-5-Clause
#

# Increase main stack size
CONFIG_MAIN_STACK_SIZE=10240

# Configure logger
CONFIG_LOG=y
CONFIG_LOG_MODE_MINIMAL=y # former CONFIG_MODE_MINIMAL
CONFIG_LOG_DEFAULT_LEVEL=0
### Decrease footprint by ~4 KB in comparison to CBPRINTF_COMPLETE=y
CONFIG_CBPRINTF_NANO=y

# Configure MCUboot features
CONFIG_NRF53_MULTI_IMAGE_UPDATE=y
CONFIG_BOOT_UPGRADE_ONLY=y
CONFIG_BOOT_MAX_IMG_SECTORS=256
CONFIG_MCUBOOT_DOWNGRADE_PREVENTION=y

# Allow for storing two images in MCUboot partitions
CONFIG_UPDATEABLE_IMAGE_NUMBER=2

# Store new images inside external flash
CONFIG_PM_EXTERNAL_FLASH_MCUBOOT_SECONDARY=y

# Enable flash simulator
CONFIG_PCD_APP=y
CONFIG_FLASH_SIMULATOR=y
CONFIG_FLASH_SIMULATOR_DOUBLE_WRITES=y
CONFIG_FLASH_SIMULATOR_STATS=n

# Configure QSPI for external flash
CONFIG_FLASH=y
CONFIG_FPROTECT=y
CONFIG_NORDIC_QSPI_NOR=y
CONFIG_NORDIC_QSPI_NOR_FLASH_LAYOUT_PAGE_SIZE=4096
CONFIG_NORDIC_QSPI_NOR_STACK_WRITE_BUFFER_SIZE=16

# Use minimal C library instead of the Picolib
CONFIG_MINIMAL_LIBC=y
```

## samples/zigbee/light_switch/sample.yaml
```yaml
sample:
  description: Zigbee dimmable light switch based on ZBOSS stack
  name: Zigbee Light switch
tests:
  sample.zigbee.light_switch:
    sysbuild: true
    build_only: true
    integration_platforms:
      - nrf52840dk/nrf52840
      - nrf52833dk/nrf52833
      - nrf5340dk/nrf5340/cpuapp
      - nrf21540dk/nrf52840
    platform_allow: nrf52840dk/nrf52840 nrf52833dk/nrf52833 nrf5340dk/nrf5340/cpuapp
      nrf21540dk/nrf52840
    tags: ci_build smoke sysbuild
  sample.zigbee.light_switch.current_measurement:
    sysbuild: true
    build_only: true
    extra_args: CONFIG_SERIAL=n
    integration_platforms:
      - nrf52840dk/nrf52840
      - nrf52833dk/nrf52833
      - nrf5340dk/nrf5340/cpuapp
    platform_allow: nrf52840dk/nrf52840 nrf52833dk/nrf52833 nrf5340dk/nrf5340/cpuapp
    tags: ci_build current_measurement sysbuild
  sample.zigbee.light_switch.fota:
    sysbuild: true
    build_only: true
    extra_args: >
      FILE_SUFFIX=fota
    integration_platforms:
      - nrf52840dk/nrf52840
      - nrf21540dk/nrf52840
    platform_allow: nrf52840dk/nrf52840 nrf21540dk/nrf52840
    tags: ci_build smoke sysbuild
  sample.zigbee.light_switch.fota.nrf5340dk:
    sysbuild: true
    build_only: true
    extra_args: >
      FILE_SUFFIX=fota
    integration_platforms:
      - nrf5340dk/nrf5340/cpuapp
    platform_allow: nrf5340dk/nrf5340/cpuapp
    tags: ci_build smoke sysbuild
  sample.zigbee.light_switch.fota_and_multiprotocol:
    sysbuild: true
    build_only: true
    extra_args: >
      FILE_SUFFIX=fota OVERLAY_CONFIG=overlay-multiprotocol_ble.conf
    integration_platforms:
      - nrf52840dk/nrf52840
    platform_allow: nrf52840dk/nrf52840
    tags: ci_build sysbuild
  sample.zigbee.light_switch.fota_and_multiprotocol.nrf5340dk:
    sysbuild: true
    build_only: true
    extra_args: >
      FILE_SUFFIX=fota OVERLAY_CONFIG=overlay-multiprotocol_ble.conf
    integration_platforms:
      - nrf5340dk/nrf5340/cpuapp
    platform_allow: nrf5340dk/nrf5340/cpuapp
    tags: ci_build sysbuild
  sample.zigbee.light_switch.multiprotocol:
    sysbuild: true
    build_only: true
    extra_args: OVERLAY_CONFIG=overlay-multiprotocol_ble.conf
    integration_platforms:
      - nrf52840dk/nrf52840
      - nrf52833dk/nrf52833
      - nrf5340dk/nrf5340/cpuapp
    platform_allow: nrf52840dk/nrf52840 nrf52833dk/nrf52833 nrf5340dk/nrf5340/cpuapp
    tags: ci_build sysbuild
  sample.zigbee.light_switch.with_shell:
    sysbuild: true
    build_only: true
    extra_args: >
      CONFIG_ZIGBEE_SHELL=y CONFIG_ZIGBEE_SHELL_DEBUG_CMD=y CONFIG_ZIGBEE_LOGGER_EP=n
      CONFIG_ZIGBEE_SHELL_ENDPOINT=1 CONFIG_LOG_MODE_DEFERRED=y
    integration_platforms:
      - nrf52840dk/nrf52840
      - nrf52833dk/nrf52833
      - nrf5340dk/nrf5340/cpuapp
      - nrf21540dk/nrf52840
    platform_allow: nrf52840dk/nrf52840 nrf52833dk/nrf52833 nrf5340dk/nrf5340/cpuapp
      nrf21540dk/nrf52840
    tags: ci_build shell sysbuild
```

## samples/zigbee/light_switch/sysbuild/multiprotocol_rpmsg/boards/nrf5340dk_nrf5340_cpunet_fota.conf
```kconfig
#
# Copyright (c) 2022 Nordic Semiconductor ASA
#
# SPDX-License-Identifier: LicenseRef-Nordic-5-Clause
#

## Disable serial and UART interface.
CONFIG_SERIAL=n
CONFIG_UART_CONSOLE=n

CONFIG_LOG=n

CONFIG_HEAP_MEM_POOL_SIZE=8192

CONFIG_MAIN_STACK_SIZE=2048
CONFIG_SYSTEM_WORKQUEUE_STACK_SIZE=2048
CONFIG_BT=y
CONFIG_BT_HCI_RAW=y
CONFIG_BT_CTLR_ASSERT_HANDLER=y
CONFIG_BT_HCI_RAW_RESERVE=1
CONFIG_BT_CENTRAL=n

# Workaround: Unable to allocate command buffer when using K_NO_WAIT since
# Host number of completed commands does not follow normal flow control.
CONFIG_BT_BUF_CMD_TX_COUNT=10

CONFIG_ASSERT=y
CONFIG_DEBUG_INFO=y
CONFIG_EXCEPTION_STACK_TRACE=y

CONFIG_NRF_802154_SER_RADIO=y
CONFIG_NRF_RTC_TIMER_USER_CHAN_COUNT=3
CONFIG_IPC_SERVICE_BACKEND_RPMSG=y
```

## samples/zigbee/ncp/Kconfig
```kconfig
#
# Copyright (c) 2021 Nordic Semiconductor ASA
#
# SPDX-License-Identifier: LicenseRef-Nordic-5-Clause
#

if USB
config USB_DEVICE_PID
	default USB_PID_CDC_ACM_SAMPLE
endif

source "Kconfig.zephyr"
```

## samples/zigbee/ncp/boards/nrf21540dk_nrf52840.conf
```kconfig
#
# Copyright (c) 2021 Nordic Semiconductor ASA
#
# SPDX-License-Identifier: LicenseRef-Nordic-5-Clause
#

# Enable nRF ECB driver
CONFIG_CRYPTO=y
CONFIG_CRYPTO_NRF_ECB=y
CONFIG_CRYPTO_INIT_PRIORITY=80
```
