## samples/zigbee/ncp/boards/nrf52833dk_nrf52833.conf
```kconfig
#
# Copyright (c) 2021 Nordic Semiconductor ASA
#
# SPDX-License-Identifier: LicenseRef-Nordic-5-Clause
#

# Enable nRF ECB driver
CONFIG_CRYPTO=y
CONFIG_CRYPTO_NRF_ECB=y
CONFIG_CRYPTO_INIT_PRIORITY=80

# Cryptocell is not supported through CSPRNG driver API: NCSDK-4813
CONFIG_ENTROPY_CC3XX=n
```

## samples/zigbee/ncp/boards/nrf52833dk_nrf52833_usb.conf
```kconfig
#
# Copyright (c) 2021 Nordic Semiconductor ASA
#
# SPDX-License-Identifier: LicenseRef-Nordic-5-Clause
#

# Enable MCUBoot
CONFIG_BOOTLOADER_MCUBOOT=y

# Enable nRF ECB driver
CONFIG_CRYPTO=y
CONFIG_CRYPTO_NRF_ECB=y
CONFIG_CRYPTO_INIT_PRIORITY=80
```

## samples/zigbee/ncp/boards/nrf52840dongle_nrf52840.conf
```kconfig
#
# Copyright (c) 2021 Nordic Semiconductor ASA
#
# SPDX-License-Identifier: LicenseRef-Nordic-5-Clause
#

# Enable nRF ECB driver
CONFIG_CRYPTO=y
CONFIG_CRYPTO_NRF_ECB=y
CONFIG_CRYPTO_INIT_PRIORITY=80

# Inform application that CDC ACM requires the line control signals to be configured.
CONFIG_ZIGBEE_UART_SUPPORTS_FLOW_CONTROL=y

# Configure NCP sample to print ZBOSS stack logs in binary format using uart1 device
# CONFIG_ZBOSS_TRACE_BINARY_LOGGING=y

#### Use this configuration to print ZBOSS stack logs in binary format using USB cdc_acm_uart1 device
# CONFIG_ZBOSS_TRACE_BINARY_LOGGING=y
# CONFIG_ZBOSS_TRACE_USB_CDC_LOGGING=y

# Two USB CDC ACM instances configured for this sample: cdc_acm_uart0 and cdc_acm_uart1
# CONFIG_USB_COMPOSITE_DEVICE=y
####

CONFIG_USB_DEVICE_STACK=y
CONFIG_USB_DEVICE_REMOTE_WAKEUP=n
CONFIG_USB_DEVICE_PRODUCT="Zigbee NCP"
CONFIG_USB_CDC_ACM=y
CONFIG_UART_LINE_CTRL=y
CONFIG_USB_DEVICE_PID=0x0001
```

## samples/zigbee/ncp/boards/nrf5340dk_nrf5340_cpuapp.conf
```kconfig
#
# Copyright (c) 2021 Nordic Semiconductor ASA
#
# SPDX-License-Identifier: LicenseRef-Nordic-5-Clause
#

CONFIG_MAIN_STACK_SIZE=2048

# Use software cryptography on nRF5340
CONFIG_ZIGBEE_USE_SOFTWARE_AES=y

CONFIG_NRF53_UPGRADE_NETWORK_CORE=n
```

## samples/zigbee/ncp/boards/nrf5340dk_nrf5340_cpuapp_usb.conf
```kconfig
#
# Copyright (c) 2021 Nordic Semiconductor ASA
#
# SPDX-License-Identifier: LicenseRef-Nordic-5-Clause
#

# Enable MCUBoot
CONFIG_BOOTLOADER_MCUBOOT=y

CONFIG_MAIN_STACK_SIZE=2048

# Use software cryptography on nRF5340
CONFIG_TINYCRYPT=y
CONFIG_CTR_DRBG_CSPRNG_GENERATOR=y
CONFIG_ZIGBEE_USE_SOFTWARE_AES=y

# Networking
CONFIG_MPSL=n

CONFIG_NRF53_UPGRADE_NETWORK_CORE=n
```

## samples/zigbee/ncp/sample.yaml
```yaml
sample:
  description: Zigbee network co-processor
  name: Zigbee NCP
tests:
  sample.zigbee.ncp:
    sysbuild: true
    build_only: true
    platform_allow: >
      nrf52840dk/nrf52840 nrf52833dk/nrf52833 nrf21540dk/nrf52840 nrf5340dk/nrf5340/cpuapp
    integration_platforms:
      - nrf52840dk/nrf52840
      - nrf52833dk/nrf52833
      - nrf21540dk/nrf52840
      - nrf5340dk/nrf5340/cpuapp
    tags: sysbuild ci_samples_zigbee
  sample.zigbee.ncp.usb:
    sysbuild: true
    build_only: true
    platform_allow: nrf52840dk/nrf52840 nrf52833dk/nrf52833 nrf21540dk/nrf52840
      nrf5340dk/nrf5340/cpuapp
    tags: ci_build ncp sysbuild ci_samples_zigbee
    extra_args: FILE_SUFFIX=usb
    integration_platforms:
      - nrf52840dk/nrf52840
      - nrf52833dk/nrf52833
      - nrf21540dk/nrf52840
      - nrf5340dk/nrf5340/cpuapp
  sample.zigbee.ncp.dongle:
    sysbuild: true
    build_only: true
    platform_allow: nrf52840dongle/nrf52840
    tags: ci_build ncp sysbuild ci_samples_zigbee
    extra_args: FILE_SUFFIX=dongle
    integration_platforms:
      - nrf52840dongle/nrf52840
  sample.zigbee.ncp.with_nrf21540ek:
    sysbuild: true
    build_only: true
    extra_args: SHIELD=nrf21540ek
    integration_platforms:
      - nrf52840dk/nrf52840
    platform_allow: nrf52840dk/nrf52840
    tags: ci_build sysbuild ci_samples_zigbee
```
