/*
 * Copyright (c) 2025 Nordic Semiconductor ASA
 *
 * SPDX-License-Identifier: Apache-2.0
 */

#include "../../nrf54h20dk_nrf54h20_memory_map_larger_mcuboot.dtsi"

/ {
	chosen {
		zephyr,code-partition = &boot_partition;
	};
};
