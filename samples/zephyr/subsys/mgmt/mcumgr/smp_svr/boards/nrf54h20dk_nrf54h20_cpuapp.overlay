/*
 * Copyright (c) 2025 Nordic Semiconductor ASA
 *
 * SPDX-License-Identifier: LicenseRef-Nordic-5-Clause
 */

/ {
	chosen {
		zephyr,uart-mcumgr = &uart136;
		zephyr,console = &uart135;
		zephyr,shell-uart = &uart135;
	};
};

&uart135 {
	memory-regions = <&cpuapp_dma_region>;
	status = "okay";
};
