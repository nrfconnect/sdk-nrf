/*
 * Copyright (c) 2025 Nordic Semiconductor ASA
 *
 * SPDX-License-Identifier: LicenseRef-Nordic-5-Clause
 */

/ {
	chosen {
		zephyr,uart-mcumgr = &uart20;
		zephyr,console = &uart30;
		zephyr,shell-uart = &uart30;
	};
};

&uart30 {
	status = "okay";
};
