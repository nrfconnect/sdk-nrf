## samples/zephyr/subsys/mgmt/mcumgr/smp_svr/sample.yaml
```yaml
sample:
  description: Simple Management Protocol sample
  name: smp svr
common:
  sysbuild: true
  harness: console
  harness_config:
    type: multi_line
    ordered: false
    regex:
      - "Starting .*bootloader"
      - "Jumping to the .*image slot"
      - "smp_sample: build time"
  timeout: 15
  tags:
    - ci_samples_zephyr_subsys_mgmt_mcumgr_smp_svr

tests:
  sample.mcumgr.smp_svr.basic:
    platform_allow:
      - nrf52840dk/nrf52840
      - nrf5340dk/nrf5340/cpuapp
      - nrf9160dk/nrf9160
      - nrf54l15dk/nrf54l15/cpuapp
      - nrf54l15dk/nrf54l10/cpuapp
      - nrf54l15dk/nrf54l05/cpuapp
      - nrf54h20dk/nrf54h20/cpuapp
      - nrf54lm20dk/nrf54lm20a/cpuapp
      - nrf54lv10dk/nrf54lv10a/cpuapp
    extra_args:
      - mcuboot_CONFIG_MCUBOOT_DOWNGRADE_PREVENTION=y

  sample.mcumgr.smp_svr.encryption.rsa:
    platform_allow:
      - nrf52840dk/nrf52840
      - nrf5340dk/nrf5340/cpuapp
      - nrf54l15dk/nrf54l15/cpuapp
      - nrf54lm20dk/nrf54lm20a/cpuapp
      - nrf54lv10dk/nrf54lv10a/cpuapp
    tags:
      - encryption
    extra_args:
      - SB_CONFIG_BOOT_ENCRYPTION=y
      - SB_CONFIG_BOOT_SIGNATURE_TYPE_RSA=y
      - mcuboot_CONFIG_MCUBOOT_DOWNGRADE_PREVENTION=y
      - FILE_SUFFIX=larger_mcuboot

  sample.mcumgr.smp_svr.encryption.ecdsa_p256:
    platform_allow:
      - nrf5340dk/nrf5340/cpuapp
      - nrf54l15dk/nrf54l15/cpuapp
      - nrf54h20dk/nrf54h20/cpuapp
      - nrf54lm20dk/nrf54lm20a/cpuapp
      - nrf54lv10dk/nrf54lv10a/cpuapp
    tags:
      - encryption
    extra_args:
      - SB_CONFIG_BOOT_ENCRYPTION=y
      - SB_CONFIG_BOOT_SIGNATURE_TYPE_ECDSA_P256=y
      - FILE_SUFFIX=larger_mcuboot

  sample.mcumgr.smp_svr.encryption.ed25519:
    platform_allow:
      - nrf52840dk/nrf52840
      - nrf5340dk/nrf5340/cpuapp
      - nrf54l15dk/nrf54l15/cpuapp
      - nrf54lm20dk/nrf54lm20a/cpuapp
      - nrf54lv10dk/nrf54lv10a/cpuapp
    tags:
      - encryption
    extra_args:
      - FILE_SUFFIX=larger_mcuboot
      - SB_CONFIG_BOOT_ENCRYPTION=y
      - SB_CONFIG_BOOT_SIGNATURE_TYPE_ED25519=y

  sample.mcumgr.smp_svr.signature.none:
    platform_allow:
      - nrf52840dk/nrf52840
      - nrf5340dk/nrf5340/cpuapp
      - nrf54l15dk/nrf54l15/cpuapp
      - nrf54h20dk/nrf54h20/cpuapp
      - nrf54lm20dk/nrf54lm20a/cpuapp
      - nrf54lv10dk/nrf54lv10a/cpuapp
    tags:
      - signature
    extra_args:
      - SB_CONFIG_BOOT_SIGNATURE_TYPE_NONE=y

  sample.mcumgr.smp_svr.signature.ed25519:
    platform_allow:
      - nrf54l15dk/nrf54l15/cpuapp
      - nrf54lm20dk/nrf54lm20a/cpuapp
      - nrf54lv10dk/nrf54lv10a/cpuapp
      - nrf54h20dk/nrf54h20/cpuapp
    tags:
      - signature
    extra_args:
      - SB_CONFIG_BOOT_SIGNATURE_TYPE_ED25519=y

  sample.mcumgr.smp_svr.signature.ecdsa_p256:
    platform_allow:
      - nrf54h20dk/nrf54h20/cpuapp
    tags:
      - signature
    extra_args:
      - SB_CONFIG_BOOT_SIGNATURE_TYPE_ECDSA_P256=y

  sample.mcumgr.smp_svr.signature.pure:
    platform_allow:
      - nrf54l15dk/nrf54l15/cpuapp
      - nrf54h20dk/nrf54h20/cpuapp
    tags:
      - signature
    extra_args:
      - SB_CONFIG_BOOT_SIGNATURE_TYPE_ED25519=y
      - SB_CONFIG_BOOT_SIGNATURE_TYPE_PURE=y

  sample.mcumgr.smp_svr.kmu.basic:
    platform_allow:
      - nrf54l15dk/nrf54l15/cpuapp
      - nrf54l15dk/nrf54l10/cpuapp
      - nrf54l15dk/nrf54l05/cpuapp
      - nrf54lm20dk/nrf54lm20a/cpuapp
      - nrf54lv10dk/nrf54lv10a/cpuapp
    tags: kmu
    extra_args:
      - SB_CONFIG_MCUBOOT_SIGNATURE_USING_KMU=y
      - SB_CONFIG_BOOT_SIGNATURE_TYPE_ED25519=y

  sample.mcumgr.smp_svr.nsib.kmu.basic:
    platform_allow:
      - nrf54l15dk/nrf54l15/cpuapp
      - nrf54lm20dk/nrf54lm20a/cpuapp
      - nrf54lv10dk/nrf54lv10a/cpuapp
    tags:
      - kmu
      - nsib
    extra_args:
      - SB_CONFIG_SECURE_BOOT_APPCORE=y
      - SB_CONFIG_MCUBOOT_SIGNATURE_USING_KMU=y
      - SB_CONFIG_BOOT_SIGNATURE_TYPE_ED25519=y

  sample.mcumgr.smp_svr.kmu.revocation:
    platform_allow:
      - nrf54l15dk/nrf54l15/cpuapp
      - nrf54lm20dk/nrf54lm20a/cpuapp
      - nrf54lv10dk/nrf54lv10a/cpuapp
    tags: kmu
    extra_args:
      - SB_CONFIG_MCUBOOT_SIGNATURE_USING_KMU=y
      - SB_CONFIG_BOOT_SIGNATURE_TYPE_ED25519=y
      - mcuboot_CONFIG_BOOT_SIGNATURE_KMU_SLOTS=3
      - mcuboot_CONFIG_BOOT_KEYS_REVOCATION=y

  sample.mcumgr.smp_svr.nrf_compress.basic:
    tags:
      - nrf_compress
    platform_allow:
      - nrf52840dk/nrf52840
      - nrf5340dk/nrf5340/cpuapp
      - nrf54l15dk/nrf54l15/cpuapp
      - nrf54h20dk/nrf54h20/cpuapp
      - nrf54lm20dk/nrf54lm20a/cpuapp
      - nrf54lv10dk/nrf54lv10a/cpuapp
    extra_args:
      - SB_CONFIG_MCUBOOT_MODE_OVERWRITE_ONLY=y
      - SB_CONFIG_MCUBOOT_COMPRESSED_IMAGE_SUPPORT=y
      - FILE_SUFFIX=larger_mcuboot

  sample.mcumgr.smp_svr.nrf_compress.encryption_rsa:
    platform_allow:
      - nrf52840dk/nrf52840
      - nrf5340dk/nrf5340/cpuapp
    tags:
      - encryption
      - nrf_compress
    extra_args:
      - SB_CONFIG_MCUBOOT_MODE_OVERWRITE_ONLY=y
      - SB_CONFIG_MCUBOOT_COMPRESSED_IMAGE_SUPPORT=y
      - SB_CONFIG_BOOT_ENCRYPTION=y
      - SB_CONFIG_BOOT_SIGNATURE_TYPE_RSA=y
      - FILE_SUFFIX=larger_mcuboot

  sample.mcumgr.smp_svr.nrf_compress.encryption_ecdsa_p256:
    platform_allow:
      - nrf5340dk/nrf5340/cpuapp
      - nrf54l15dk/nrf54l15/cpuapp
      - nrf54h20dk/nrf54h20/cpuapp
      - nrf54lm20dk/nrf54lm20a/cpuapp
      - nrf54lv10dk/nrf54lv10a/cpuapp
    tags:
      - encryption
      - nrf_compress
    extra_args:
      - SB_CONFIG_MCUBOOT_MODE_OVERWRITE_ONLY=y
      - SB_CONFIG_MCUBOOT_COMPRESSED_IMAGE_SUPPORT=y
      - SB_CONFIG_BOOT_ENCRYPTION=y
      - SB_CONFIG_BOOT_SIGNATURE_TYPE_ECDSA_P256=y
      - FILE_SUFFIX=larger_mcuboot

  sample.mcumgr.smp_svr.nrf_compress.encryption_ed25519:
    platform_allow:
      - nrf52840dk/nrf52840
      - nrf5340dk/nrf5340/cpuapp
      - nrf54l15dk/nrf54l15/cpuapp
      - nrf54lm20dk/nrf54lm20a/cpuapp
      - nrf54lv10dk/nrf54lv10a/cpuapp
    tags:
      - encryption
      - nrf_compress
    extra_args:
      - SB_CONFIG_MCUBOOT_MODE_OVERWRITE_ONLY=y
      - SB_CONFIG_MCUBOOT_COMPRESSED_IMAGE_SUPPORT=y
      - SB_CONFIG_BOOT_ENCRYPTION=y
      - SB_CONFIG_BOOT_SIGNATURE_TYPE_ED25519=y
      - FILE_SUFFIX=larger_mcuboot

  sample.mcumgr.smp_svr.bt.nrf5340dk.ext_flash:
    sysbuild: true
    extra_args:
      - FILE_SUFFIX=nrf5340_bt
    platform_allow:
      - nrf5340dk/nrf5340/cpuapp
    integration_platforms:
      - nrf5340dk/nrf5340/cpuapp
    harness_config: &bt_harness_config
      type: multi_line
      ordered: false
      regex:
        - "Starting .*bootloader"
        - "Jumping to the .*image slot"
        - "smp_sample: build time"
        - "smp_bt_sample: Advertising successfully started"

  sample.mcumgr.smp_svr.bt.nrf54l15:
    tags: bluetooth
    extra_args: EXTRA_CONF_FILE="overlay-bt.conf"
    platform_allow:
      - nrf54l15dk/nrf54l15/cpuapp
      - nrf54l15dk/nrf54l10/cpuapp
    integration_platforms:
      - nrf54l15dk/nrf54l15/cpuapp
      - nrf54l15dk/nrf54l10/cpuapp
    harness_config: *bt_harness_config

  sample.mcumgr.smp_svr.bt.nrf54l15dk.ext_flash:
    extra_args:
      - OVERLAY_CONFIG="overlay-bt.conf"
      - FILE_SUFFIX=ext_flash
      - DTC_OVERLAY_FILE="boards/nrf54l15dk_ext_flash.overlay"
      - SB_CONFIG_PM_OVERRIDE_EXTERNAL_DRIVER_CHECK=y
      - SB_CONFIG_PM_EXTERNAL_FLASH_MCUBOOT_SECONDARY=y
    platform_allow:
      - nrf54l15dk/nrf54l15/cpuapp
      - nrf54l15dk/nrf54l10/cpuapp
      - nrf54l15dk/nrf54l05/cpuapp
    integration_platforms:
      - nrf54l15dk/nrf54l15/cpuapp
      - nrf54l15dk/nrf54l10/cpuapp
      - nrf54l15dk/nrf54l05/cpuapp
    harness_config: *bt_harness_config

  sample.mcumgr.smp_svr.bt.nrf54h20dk:
    sysbuild: true
    extra_args:
      - EXTRA_CONF_FILE="overlay-bt.conf"
      - SB_CONFIG_NETCORE_IPC_RADIO=y
      - SB_CONFIG_NETCORE_IPC_RADIO_BT_HCI_IPC=y
      - mcuboot_CONFIG_NRF_SECURITY=y
      - mcuboot_CONFIG_MULTITHREADING=y
    platform_allow:
      - nrf54h20dk/nrf54h20/cpuapp
    integration_platforms:
      - nrf54h20dk/nrf54h20/cpuapp
    harness_config: *bt_harness_config

  sample.mcumgr.smp_svr.bt.nrf54h20dk.direct_xip_withrevert:
    sysbuild: true
    extra_args:
      - FILE_SUFFIX="merged_slot"
      - EXTRA_CONF_FILE="overlay-bt.conf"
      - SB_CONFIG_NETCORE_IPC_RADIO=y
      - SB_CONFIG_NETCORE_IPC_RADIO_BT_HCI_IPC=y
      - SB_CONFIG_MCUBOOT_MODE_DIRECT_XIP_WITH_REVERT=y
      - mcuboot_CONFIG_NRF_SECURITY=y
      - mcuboot_CONFIG_MULTITHREADING=y
    platform_allow:
      - nrf54h20dk/nrf54h20/cpuapp
    integration_platforms:
      - nrf54h20dk/nrf54h20/cpuapp
    harness_config: *bt_harness_config

  sample.mcumgr.smp_svr.serial.nrf54h20dk.ecdsa:
    sysbuild: true
    extra_args:
      - EXTRA_CONF_FILE="overlay-serial.conf"
      - SB_CONFIG_BOOT_SIGNATURE_TYPE_ECDSA_P256=y
      - mcuboot_CONFIG_NRF_SECURITY=y
      - mcuboot_CONFIG_MULTITHREADING=y
    platform_allow:
      - nrf54h20dk/nrf54h20/cpuapp
    integration_platforms:
      - nrf54h20dk/nrf54h20/cpuapp

  sample.mcumgr.smp_svr.bt.nrf54h20dk.direct_xip_withrequests:
    sysbuild: true
    extra_args:
      - FILE_SUFFIX="requests"
      - EXTRA_CONF_FILE="overlay-bt.conf"
      - SB_CONFIG_NETCORE_IPC_RADIO=y
      - SB_CONFIG_NETCORE_IPC_RADIO_BT_HCI_IPC=y
      - SB_CONFIG_MCUBOOT_MODE_DIRECT_XIP_WITH_REVERT=y
      - mcuboot_CONFIG_NRF_SECURITY=y
      - mcuboot_CONFIG_MULTITHREADING=y
    platform_allow:
      - nrf54h20dk/nrf54h20/cpuapp
    integration_platforms:
      - nrf54h20dk/nrf54h20/cpuapp
    harness_config: *bt_harness_config
```

## samples/zephyr/subsys/mgmt/mcumgr/smp_svr/sysbuild/mcuboot/boards/nrf54h20dk_nrf54h20_cpuapp.conf
```kconfig
CONFIG_PM=n

CONFIG_MAIN_STACK_SIZE=10240

CONFIG_BOOT_SWAP_SAVE_ENCTLV=n
CONFIG_BOOT_ENCRYPT_IMAGE=n

CONFIG_BOOT_UPGRADE_ONLY=n
CONFIG_BOOT_BOOTSTRAP=n

### mbedTLS has its own heap
# CONFIG_HEAP_MEM_POOL_SIZE is not set

CONFIG_FLASH=y

### Various Zephyr boards enable features that we don't want.
# CONFIG_BT is not set
# CONFIG_I2C is not set

CONFIG_LOG=y
CONFIG_LOG_MODE_MINIMAL=y
### Ensure Zephyr logging changes don't use more resources
CONFIG_LOG_DEFAULT_LEVEL=0
### Use info log level by default
CONFIG_MCUBOOT_LOG_LEVEL_INF=y
### Decrease footprint by ~4 KB in comparison to CBPRINTF_COMPLETE=y
CONFIG_CBPRINTF_NANO=y
### Use picolibc to reduce flash usage
CONFIG_PICOLIBC=y
### Disable malloc arena because we don't need it
CONFIG_COMMON_LIBC_MALLOC_ARENA_SIZE=0

# NCS boot banner
CONFIG_NCS_APPLICATION_BOOT_BANNER_STRING="MCUboot"

# Configuration which is needed for supporting resume the application execution
# after suspend to RAM (S2RAM) requested by the application.
# MCUboot does not support S2RAM itself, but serves as an immediate actor while waking up
# from suspension.
CONFIG_SOC_EARLY_RESET_HOOK=y

# Ensure that the SPI NOR driver is disabled by default
CONFIG_SPI_NOR=n

# TODO: below are not yet supported and need fixing
CONFIG_FPROTECT=n

CONFIG_BOOT_WATCHDOG_FEED=n

# Power domains forced on by default on boot, no need
# to manage them in bootloader.
CONFIG_POWER_DOMAIN=n

CONFIG_MCUBOOT_UUID_VID=y
CONFIG_NCS_MCUBOOT_UUID_VID_VALUE="nordicsemi.com"

CONFIG_MCUBOOT_UUID_CID=y
CONFIG_NCS_MCUBOOT_UUID_CID_IMAGE_0_VALUE="nRF54H20_sample_app"
CONFIG_NCS_MCUBOOT_UUID_CID_IMAGE_1_VALUE="nRF54H20_sample_rad"

# MULTITHREADING should be enabled
CONFIG_MULTITHREADING=y
```

## samples/zephyr/subsys/mgmt/mcumgr/smp_svr/sysbuild/mcuboot/boards/nrf54l15dk_nrf54l15_cpuapp_ed25519.conf
```kconfig
# increasead for encryption ed25519
CONFIG_PM_PARTITION_SIZE_MCUBOOT=0x13000
# MCUboot requires a large stack size, otherwise an MPU fault will occur
CONFIG_MAIN_STACK_SIZE=16384

# Enable flash operations
CONFIG_FLASH=y

CONFIG_BOOT_MAX_IMG_SECTORS=256

CONFIG_MULTITHREADING=y

CONFIG_LOG=y
CONFIG_LOG_MODE_MINIMAL=y
CONFIG_LOG_DEFAULT_LEVEL=0
CONFIG_MCUBOOT_LOG_LEVEL_INF=y
# Decrease footprint by ~4 KB in comparison to CBPRINTF_COMPLETE=y
CONFIG_CBPRINTF_NANO=y
# Use minimal C library instead of the Picolib
CONFIG_MINIMAL_LIBC=y

CONFIG_FW_INFO_FIRMWARE_VERSION=2

# NCS boot banner
CONFIG_NCS_APPLICATION_BOOT_BANNER_STRING="MCUboot"
```

## samples/zephyr/subsys/mgmt/mcumgr/smp_svr/sysbuild/mcuboot/boards/nrf54l15dk_nrf54l15_cpuapp_fprotect.conf
```kconfig
CONFIG_FPROTECT=y

CONFIG_MULTITHREADING=n
CONFIG_SPI_NOR=n
CONFIG_BOOT_WATCHDOG_FEED=n
CONFIG_NRF_RRAM_WRITE_BUFFER_SIZE=32
# MCUboot requires a large stack size, otherwise an MPU fault will occur
CONFIG_MAIN_STACK_SIZE=16384

# Enable flash operations
CONFIG_FLASH=y

CONFIG_BOOT_MAX_IMG_SECTORS=256

CONFIG_MULTITHREADING=y

CONFIG_LOG=y
CONFIG_LOG_MODE_MINIMAL=y
CONFIG_LOG_DEFAULT_LEVEL=0
CONFIG_MCUBOOT_LOG_LEVEL_INF=y
# Decrease footprint by ~4 KB in comparison to CBPRINTF_COMPLETE=y
CONFIG_CBPRINTF_NANO=y
# Use minimal C library instead of the Picolib
CONFIG_MINIMAL_LIBC=y

CONFIG_FW_INFO_FIRMWARE_VERSION=2

# NCS boot banner
CONFIG_NCS_APPLICATION_BOOT_BANNER_STRING="MCUboot"
```

## samples/zephyr/subsys/mgmt/mcumgr/smp_svr/sysbuild/mcuboot/boards/nrf54ls05dk_nrf54ls05b_cpuapp.conf
```kconfig
CONFIG_FLASH=y
CONFIG_MAIN_STACK_SIZE=10240
CONFIG_FPROTECT=n

# NOTE: To enable mcuboot logs...
# NOTE: ... these lines should be commented...
# CONFIG_SERIAL=n
# CONFIG_CONSOLE=n
# CONFIG_UART_CONSOLE=n
# NOTE: ... and these lines shoud not be commented
CONFIG_LOG=y
CONFIG_LOG_MODE_MINIMAL=y
CONFIG_LOG_DEFAULT_LEVEL=0
CONFIG_MCUBOOT_LOG_LEVEL_DBG=y

CONFIG_PSA_CORE_LITE=y
CONFIG_PSA_CORE_LITE_NSIB_ED25519_OPTIMIZATIONS=y
CONFIG_PSA_USE_CRACEN_KEY_DERIVATION_DRIVER=n
CONFIG_PSA_USE_CRACEN_PAKE_DRIVER=n
CONFIG_PSA_CRYPTO_DRIVER_CRACEN=n
CONFIG_PSA_CRYPTO_DRIVER_OBERON=n

CONFIG_NRF_OBERON=y
CONFIG_BOOT_ECDSA_NRF_OBERON=y
```

## samples/zephyr/subsys/settings/testcase.yaml
```yaml
sample:
  name: Settings Sample

tests:
  nrf.extended.sample.subsys.settings.zms:
    platform_allow:
      - nrf54l15dk/nrf54l05/cpuapp
      - nrf54l15dk/nrf54l10/cpuapp
      - nrf54l15dk/nrf54l15/cpuapp
      - nrf54lm20dk/nrf54lm20a/cpuapp
      - nrf54ls05dk/nrf54ls05b/cpuapp
      - nrf54ls05dk@0.0.0/nrf54ls05b/cpuapp
      - nrf54ls05dk@0.2.0/nrf54ls05b/cpuapp
      - nrf54lv10dk/nrf54lv10a/cpuapp
    integration_platforms:
      - nrf54ls05dk/nrf54ls05b/cpuapp
    tags:
      - settings
      - ci_samples_zephyr_subsys_settings
    timeout: 10
    harness: console
    harness_config:
      type: multi_line
      ordered: true
      regex:
        - "subtree <alpha> handler registered: OK"
        - "# iteration 0"
        - "[.]*<alpha/length> value exist in the storage"
        - "[.]*Can\\'t to load the <alpha/length> value as expected"
        - "<gamma> = 0 \\(default\\)"
        - "# iteration 1"
        - "<alpha/length/2> = 59"
        - "# iteration 2"
        - "<alpha/length/1> = 42"
        - "# iteration 3"
        - "<alpha/beta/voltage> = -3100"
        - "# iteration 4"
        - "<alpha/beta/source> = abcd"
        - "# iteration 5"
        - "<alpha/angle/1> = 5"
        - "<alpha/beta/source> is not compatible with the application"
        - "direct.length = 100"
        - "direct.length_1 = 46"
        - "direct.length_2 = 54"
        - "<gamma> = 5"
        - "The settings destination off the key <alpha/beta/source> has got value:\
        \ \"RT\""
        - "String value \"rtos\" was retrieved from the settings destination off the\
        \ key <alpha/beta/source>"
```
