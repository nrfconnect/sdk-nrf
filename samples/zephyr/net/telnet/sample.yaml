## samples/zephyr/net/telnet/sample.yaml
```yaml
sample:
  name: Telnet Server
tests:
  nrf.extended.sample.net.telnet.wifi.nrf71dk:
    tags:
      - ci_build
      - sysbuild
      - ci_samples_net
    extra_args:
      - SNIPPET=wifi-ipv4
    platform_allow:
      - nrf7120dk/nrf7120/cpuapp
    integration_platforms:
      - nrf7120dk/nrf7120/cpuapp
```

## samples/zephyr/sensor/accel_polling/sample.yaml
```yaml
sample:
  name: Accelerometer polling sample
common:
  depends_on: spi
  tags:
    - drivers
    - spi
    - sensors
    - ci_samples_zephyr_sensor_accel_polling
  harness: console

tests:
  nrf.extended.sample.sensor.accel_polling.nrf54h:
    filter: not CONFIG_COVERAGE
    harness_config:
      fixture: pca63566
      type: one_line
      regex:
        - "^\\s*[0-9A-Za-z_,+-.]*@[0-9A-Fa-f]* \\[m/s\\^2\\]:    \\(\\s*-?[0-9\\.]*,\\\
        s*-?[0-9\\.]*,\\s*-?[0-9\\.]*\\)$"
    extra_args:
      - SHIELD=pca63566
    extra_configs:
      - CONFIG_LOG=y
      - CONFIG_SENSOR_LOG_LEVEL_DBG=y
    platform_allow: nrf54h20dk/nrf54h20/cpuapp

  nrf.extended.sample.sensor.accel_polling.nrf54h_cpuppr:
    filter: not CONFIG_COVERAGE
    sysbuild: true
    harness_config:
      fixture: pca63566
      type: one_line
      regex:
        - "^\\s*[0-9A-Za-z_,+-.]*@[0-9A-Fa-f]* \\[m/s\\^2\\]:    \\(\\s*-?[0-9\\.]*,\\\
        s*-?[0-9\\.]*,\\s*-?[0-9\\.]*\\)$"
    extra_args:
      - accel_polling_SHIELD=pca63566
      - vpr_launcher_SHIELD=pca63566_fwd
    platform_allow: nrf54h20dk/nrf54h20/cpuppr

  nrf.extended.sample.sensor.accel_polling.nrf54h_coverage:
    filter: CONFIG_COVERAGE
    harness_config:
      fixture: pca63566
      type: one_line
      regex:
        - "^\\s*[0-9A-Za-z_,+-.]*@[0-9A-Fa-f]* \\[m/s\\^2\\]:    \\(\\s*-?[0-9\\.]*,\\\
        s*-?[0-9\\.]*,\\s*-?[0-9\\.]*\\)$"
    extra_args:
      - SHIELD=pca63566
      - SNIPPET=coverage_support
    platform_allow: nrf54h20dk/nrf54h20/cpuapp

  nrf.extended.sample.sensor.accel_polling.nrf54l:
    filter: not CONFIG_COVERAGE
    harness_config:
      fixture: pca63565
      type: one_line
      regex:
        - "^\\s*[0-9A-Za-z_,+-.]*@[0-9A-Fa-f]* \\[m/s\\^2\\]:    \\(\\s*-?[0-9\\.]*,\\\
        s*-?[0-9\\.]*,\\s*-?[0-9\\.]*\\)$"
    extra_args:
      - SHIELD=pca63565
    extra_configs:
      - CONFIG_LOG=y
      - CONFIG_SENSOR_LOG_LEVEL_DBG=y
    platform_allow:
      - nrf54l15dk/nrf54l15/cpuapp
      - nrf54lm20dk/nrf54lm20a/cpuapp

  nrf.extended.sample.sensor.accel_polling.nrf54l_coverage:
    filter: CONFIG_COVERAGE
    harness_config:
      fixture: pca63565
      type: one_line
      regex:
        - "^\\s*[0-9A-Za-z_,+-.]*@[0-9A-Fa-f]* \\[m/s\\^2\\]:    \\(\\s*-?[0-9\\.]*,\\\
        s*-?[0-9\\.]*,\\s*-?[0-9\\.]*\\)$"
    extra_args:
      - SHIELD=pca63565
      - SNIPPET=coverage_support
    platform_allow:
      - nrf54l15dk/nrf54l15/cpuapp
      - nrf54lm20dk/nrf54lm20a/cpuapp

  nrf.extended.sample.sensor.accel_polling.nrf54l_cpuflpr:
    filter: not CONFIG_COVERAGE
    sysbuild: true
    harness_config:
      fixture: pca63565
      type: one_line
      regex:
        - "^\\s*[0-9A-Za-z_,+-.]*@[0-9A-Fa-f]* \\[m/s\\^2\\]:    \\(\\s*-?[0-9\\.]*,\\\
        s*-?[0-9\\.]*,\\s*-?[0-9\\.]*\\)$"
    extra_args:
      - SHIELD=pca63565
      - vpr_launcher_DTC_OVERLAY_FILE="${ZEPHYR_NRF_MODULE_DIR}/boards/shields/pca63565/boards/nrf54l_vpr_launcher.overlay"
    extra_configs:
      - CONFIG_LOG=y
      - CONFIG_SENSOR_LOG_LEVEL_DBG=y
    platform_allow:
      - nrf54l15dk/nrf54l15/cpuflpr
      - nrf54lm20dk/nrf54lm20a/cpuflpr
```

## samples/zephyr/sensor/bme680/sample.yaml
```yaml
sample:
  name: BME680 Sensor sample
common:
  depends_on: i2c
  tags:
    - drivers
    - i2c
    - sensors
    - ci_samples_zephyr_sensor_bme680
  harness: console

tests:
  nrf.extended.sample.sensor.bme680.nrf54h:
    filter: not CONFIG_COVERAGE
    harness_config:
      fixture: pca63566
      type: one_line
      regex:
        - "^\\s*T:\\s*-?[0-9\\.]*; P:\\s*-?[0-9\\.]*; H: \\s*-?[0-9\\.]*; G:\\s*-?[0-9\\\
        .]*$"
    extra_args:
      - SHIELD=pca63566
    platform_allow: nrf54h20dk/nrf54h20/cpuapp

  nrf.extended.sample.sensor.bme680.nrf54h_cpuppr:
    filter: not CONFIG_COVERAGE
    sysbuild: true
    harness_config:
      fixture: pca63566
      type: one_line
      regex:
        - "^\\s*T:\\s*-?[0-9\\.]*; P:\\s*-?[0-9\\.]*; H: \\s*-?[0-9\\.]*; G:\\s*-?[0-9\\\
        .]*$"
    extra_args:
      - bme680_SHIELD=pca63566
      - vpr_launcher_SHIELD=pca63566_fwd
    platform_allow: nrf54h20dk/nrf54h20/cpuppr

  nrf.extended.sample.sensor.bme680.nrf54h_coverage:
    filter: CONFIG_COVERAGE
    harness_config:
      fixture: pca63566
      type: one_line
      regex:
        - "^\\s*T:\\s*-?[0-9\\.]*; P:\\s*-?[0-9\\.]*; H: \\s*-?[0-9\\.]*; G:\\s*-?[0-9\\\
        .]*$"
    extra_args:
      - SHIELD=pca63566
      - SNIPPET=coverage_support
    platform_allow: nrf54h20dk/nrf54h20/cpuapp

  nrf.extended.sample.sensor.bme680.nrf54l:
    filter: not CONFIG_COVERAGE
    harness_config:
      fixture: pca63565
      type: one_line
      regex:
        - "^\\s*T:\\s*-?[0-9\\.]*; P:\\s*-?[0-9\\.]*; H: \\s*-?[0-9\\.]*; G:\\s*-?[0-9\\\
        .]*$"
    extra_args:
      - SHIELD=pca63565
    platform_allow:
      - nrf54l15dk/nrf54l15/cpuapp
      - nrf54lm20dk/nrf54lm20a/cpuapp

  nrf.extended.sample.sensor.bme680.nrf54l_coverage:
    filter: CONFIG_COVERAGE
    harness_config:
      fixture: pca63565
      type: one_line
      regex:
        - "^\\s*T:\\s*-?[0-9\\.]*; P:\\s*-?[0-9\\.]*; H: \\s*-?[0-9\\.]*; G:\\s*-?[0-9\\\
        .]*$"
    extra_args:
      - SHIELD=pca63565
      - SNIPPET=coverage_support
    platform_allow:
      - nrf54l15dk/nrf54l15/cpuapp
      - nrf54lm20dk/nrf54lm20a/cpuapp

  nrf.extended.sample.sensor.bme680.nrf54l_cpuflpr:
    filter: not CONFIG_COVERAGE
    sysbuild: true
    harness_config:
      fixture: pca63565
      type: one_line
      regex:
        - "^\\s*T:\\s*-?[0-9\\.]*; P:\\s*-?[0-9\\.]*; H: \\s*-?[0-9\\.]*; G:\\s*-?[0-9\\\
        .]*$"
    extra_args:
      - SHIELD=pca63565
      - vpr_launcher_DTC_OVERLAY_FILE="${ZEPHYR_NRF_MODULE_DIR}/boards/shields/pca63565/boards/nrf54l_vpr_launcher.overlay"
    platform_allow:
      - nrf54l15dk/nrf54l15/cpuapp
      - nrf54lm20dk/nrf54lm20a/cpuapp
```

## samples/zephyr/sensor/qdec/sample.yaml
```yaml
sample:
  description: Usage quadrature decoder sensor
  name: qdec_sensor
common:
  tags:
    - sensors
    - ci_samples_zephyr_sensor_qdec
  timeout: 5
  harness: console

tests:
  nrf.extended.sample.sensor.nrf_qdec_sensor:
    platform_allow:
      - nrf54ls05dk/nrf54ls05b/cpuapp
      - nrf54ls05dk@0.0.0/nrf54ls05b/cpuapp
    integration_platforms:
      - nrf54ls05dk/nrf54ls05b/cpuapp
    harness_config:
      fixture: gpio_loopback
      type: multi_line
      ordered: true
      regex:
        - "Quadrature decoder sensor test"
        - "Position = -[45678]\\d degrees"
```

## samples/zephyr/smp_svr_mini_boot/Kconfig.sysbuild
```kconfig
#
# Copyright (c) 2025 Nordic Semiconductor
#
# SPDX-License-Identifier: LicenseRef-Nordic-5-Clause
#

config MCUBOOT_SIGNATURE_USING_KMU
	default y if SOC_SERIES_NRF54L && !SOC_NRF54LS05B

config MCUBOOT_GENERATE_DEFAULT_KMU_KEYFILE
	default y if SOC_SERIES_NRF54L && !SOC_NRF54LS05B

choice BOOT_SIGNATURE_TYPE
	default BOOT_SIGNATURE_TYPE_ECDSA_P256 if SOC_NRF54LS05B
	default BOOT_SIGNATURE_TYPE_ED25519 if !SOC_NRF54LS05B
endchoice

config BOOT_SIGNATURE_TYPE_PURE
	default y if !SOC_NRF54LS05B

choice MCUBOOT_MODE
	default MCUBOOT_MODE_DIRECT_XIP if SOC_NRF54LS05B
endchoice

config NRF_DEFAULT_IPC_RADIO
	default y if SOC_SERIES_NRF54H

config NETCORE_IPC_RADIO_BT_HCI_IPC
	default y if SOC_SERIES_NRF54H

config MCUBOOT_IMAGES_ROM_END_OFFSET_AUTO
	default "ipc_radio;ipc_radio_secondary_app" if MCUBOOT_SIGN_MERGED_BINARY

source "share/sysbuild/Kconfig"
```

## samples/zephyr/smp_svr_mini_boot/sample.yaml
```yaml
sample:
  description: Mcuboot minimal configuration sample
  name: smp_svr_mini_boot
common:
  sysbuild: true
  tags:
    - ci_samples_zephyr_smp_svr_mini_boot
  harness: console
  harness_config:
    type: one_line
    regex:
      - "smp_sample: build time:"
tests:
  sample.smp_svr_mini_boot:
    extra_args:
      - SB_CONFIG_MCUBOOT_MODE_DIRECT_XIP=y
    platform_allow:
      - nrf54l15dk/nrf54l15/cpuapp
      - nrf54h20dk/nrf54h20/cpuapp
    integration_platforms:
      - nrf54l15dk/nrf54l15/cpuapp
      - nrf54h20dk/nrf54h20/cpuapp
  sample.smp_svr_mini_boot.swap_move:
    extra_args:
      - SB_CONFIG_MCUBOOT_MODE_SWAP_USING_MOVE=y
    platform_allow:
      - nrf54l15dk/nrf54l15/cpuapp
      - nrf54h20dk/nrf54h20/cpuapp
    integration_platforms:
      - nrf54l15dk/nrf54l15/cpuapp
      - nrf54h20dk/nrf54h20/cpuapp
```

## samples/zephyr/smp_svr_mini_boot/sysbuild/mcuboot/boards/nrf54l15dk_nrf54l15_cpuapp.conf
```kconfig
#
# Copyright (c) 2025 Nordic Semiconductor ASA
#
# SPDX-License-Identifier: LicenseRef-Nordic-5-Clause
#
CONFIG_SYS_CLOCK_EXISTS=n
CONFIG_NRF_GRTC_TIMER=n
CONFIG_PSA_CORE_LITE=y
CONFIG_PSA_CORE_LITE_NSIB_ED25519_OPTIMIZATIONS=y
CONFIG_CRACEN_IKG=n

# Disable run-time CRACEN provisioning of TRNG data.
# KMU slots 248, 249 shall be pre-provisioned while programming with secret TRNG values instead.
CONFIG_CRACEN_PROVISION_PROT_RAM_INV_SLOTS_ON_INIT=n
```

## samples/zephyr/subsys/ipc/ipc_service/icmsg/Kconfig.sysbuild
```kconfig
# Copyright 2025 Nordic Semiconductor ASA
#
# SPDX-License-Identifier: LicenseRef-Nordic-5-Clause

source "share/sysbuild/Kconfig"

config REMOTE_BOARD
	string
	default "$(BOARD)/nrf54lv10a/cpuflpr" if SOC_NRF54LV10A_CPUAPP
	default "$(BOARD)/nrf54lm20a/cpuflpr" if SOC_NRF54LM20A_CPUAPP
```

## samples/zephyr/subsys/ipc/ipc_service/icmsg/sample.yaml
```yaml
sample:
  name: IPC Service example integration (icmsg backend)
common:
  timeout: 30
  tags:
    - ipc
    - ci_samples_zephyr_subsys_ipc_ipc_service_icmsg
  sysbuild: true
  platform_allow:
    - nrf54lm20dk/nrf54lm20a/cpuapp
    - nrf54lv10dk/nrf54lv10a/cpuapp
    - nrf54lv10dk@0.2.0/nrf54lv10a/cpuapp
  integration_platforms:
    - nrf54lv10dk/nrf54lv10a/cpuapp

tests:
  nrf.extended.sample.ipc.icmsg.nrf54l:
    extra_args:
      - icmsg_SNIPPET=nordic-flpr
    harness: console
    harness_config:
      type: multi_line
      ordered: false
      regex:
        - "host: IPC-service HOST demo started"
        - "host: Ep bounded"
        - "host: Perform sends for"
        - "host: Sent"
        - "host: Received"
        - "host: IPC-service HOST demo ended"

  nrf.extended.sample.ipc.icmsg.nrf54l_no_multithreading:
    extra_args:
      - icmsg_SNIPPET=nordic-flpr
      - icmsg_CONFIG_MULTITHREADING=n
      - icmsg_CONFIG_LOG_MODE_MINIMAL=y
      - remote_CONFIG_MULTITHREADING=n
      - remote_CONFIG_LOG_MODE_MINIMAL=y
    harness: console
    harness_config:
      type: multi_line
      ordered: false
      regex:
        - "I: IPC-service HOST demo started"
        - "I: Ep bounded"
        - "I: Perform sends for"
        - "I: Sent"
        - "I: Received"
        - "I: IPC-service HOST demo ended"

  nrf.extended.sample.ipc.icmsg.nrf54l_remote_no_multithreading:
    extra_args:
      - icmsg_SNIPPET=nordic-flpr
      - remote_CONFIG_MULTITHREADING=n
      - remote_CONFIG_LOG_MODE_MINIMAL=y
    harness: console
    harness_config:
      type: multi_line
      ordered: false
      regex:
        - "host: IPC-service HOST demo started"
        - "host: Ep bounded"
        - "host: Perform sends for"
        - "host: Sent"
        - "host: Received"
        - "host: IPC-service HOST demo ended"

  nrf.extended.sample.ipc.icbmsg.nrf54l:
    extra_args:
      - icmsg_SNIPPET=nordic-flpr
      - icmsg_CONFIG_IPC_SERVICE_BACKEND_ICBMSG_NUM_EP=1
      - icmsg_FILE_SUFFIX=icbmsg
      - remote_CONFIG_IPC_SERVICE_BACKEND_ICBMSG_NUM_EP=1
      - remote_FILE_SUFFIX=icbmsg
    harness: console
    harness_config:
      type: multi_line
      ordered: false
      regex:
        - "host: IPC-service HOST demo started"
        - "host: Ep bounded"
        - "host: Perform sends for"
        - "host: Sent"
        - "host: Received"
        - "host: IPC-service HOST demo ended"

  nrf.extended.sample.ipc.icbmsg.nrf54l_no_multithreading:
    extra_args:
      - icmsg_SNIPPET=nordic-flpr
      - icmsg_CONFIG_IPC_SERVICE_BACKEND_ICBMSG_NUM_EP=1
      - icmsg_FILE_SUFFIX=icbmsg
      - icmsg_CONFIG_MULTITHREADING=n
      - icmsg_CONFIG_LOG_MODE_MINIMAL=y
      - remote_CONFIG_IPC_SERVICE_BACKEND_ICBMSG_NUM_EP=1
      - remote_FILE_SUFFIX=icbmsg
      - remote_CONFIG_MULTITHREADING=n
      - remote_CONFIG_LOG_MODE_MINIMAL=y
    harness: console
    harness_config:
      type: multi_line
      ordered: false
      regex:
        - "I: IPC-service HOST demo started"
        - "I: Ep bounded"
        - "I: Perform sends for"
        - "I: Sent"
        - "I: Received"
        - "I: IPC-service HOST demo ended"

  nrf.extended.sample.ipc.icbmsg.nrf54l_remote_no_multithreading:
    extra_args:
      - icmsg_SNIPPET=nordic-flpr
      - icmsg_CONFIG_IPC_SERVICE_BACKEND_ICBMSG_NUM_EP=1
      - icmsg_FILE_SUFFIX=icbmsg
      - remote_CONFIG_IPC_SERVICE_BACKEND_ICBMSG_NUM_EP=1
      - remote_FILE_SUFFIX=icbmsg
      - remote_CONFIG_MULTITHREADING=n
      - remote_CONFIG_LOG_MODE_MINIMAL=y
    harness: console
    harness_config:
      type: multi_line
      ordered: false
      regex:
        - "host: IPC-service HOST demo started"
        - "host: Ep bounded"
        - "host: Perform sends for"
        - "host: Sent"
        - "host: Received"
        - "host: IPC-service HOST demo ended"
```

## samples/zephyr/subsys/ipc/ipc_service/multi_endpoint/Kconfig.sysbuild
```kconfig
# Copyright 2026 Nordic Semiconductor ASA
#
# SPDX-License-Identifier: LicenseRef-Nordic-5-Clause

config REMOTE_BOARD
	string "Remote board"
	default "$(BOARD)/nrf9251/cpuppr" if SOC_NRF9251_CPUAPP

source "share/sysbuild/Kconfig"
```

## samples/zephyr/subsys/mgmt/mcumgr/smp_svr/Kconfig.sysbuild
```kconfig
#
# Copyright (c) 2025 Nordic Semiconductor
#
# SPDX-License-Identifier: LicenseRef-Nordic-5-Clause
#

if SOC_SERIES_NRF54L

config MCUBOOT_GENERATE_DEFAULT_KMU_KEYFILE
	default y if BOOTLOADER_MCUBOOT && MCUBOOT_SIGNATURE_USING_KMU

config SECURE_BOOT_GENERATE_DEFAULT_KMU_KEYFILE
	default y if SECURE_BOOT_APPCORE

endif

source "$(ZEPHYR_BASE)/share/sysbuild/Kconfig"
```

## samples/zephyr/subsys/mgmt/mcumgr/smp_svr/boards/nrf54lm20dk_nrf54lm20a_cpuapp.conf
```kconfig
# Configure SoC and application-specific UUIDs
CONFIG_MCUBOOT_IMGTOOL_UUID_VID=y
CONFIG_MCUBOOT_IMGTOOL_UUID_VID_NAME="nordicsemi.com"
CONFIG_MCUBOOT_IMGTOOL_UUID_CID=y
CONFIG_MCUBOOT_IMGTOOL_UUID_CID_NAME="nRF54LM20a_sample_app"
CONFIG_MCUBOOT_IMGTOOL_UUID_CID_SECONDARY_NAME="nRF54LM20a_sample_app_secondary"
```
