## samples/zephyr/subsys/usb/cdc_acm/sample.yaml
```yaml
sample:
  name: CDC ACM USB
common:
  tags:
    - usb
    - ci_samples_zephyr_subsys_usb
  platform_allow:
    - nrf54h20dk/nrf54h20/cpuapp
    - nrf54lm20dk/nrf54lm20a/cpuapp
  integration_platforms:
    - nrf54h20dk/nrf54h20/cpuapp
  harness: console
  harness_config:
    type: multi_line
    regex:
      - "Wait for DTR"
      - "cdc_acm_echo: USBD message: New device configuration"
      - "cdc_acm_echo: USBD message: CDC ACM line coding"
      - "cdc_acm_echo: Baudrate"
tests:
  nrf.extended.sample.usb_device_next.cdc-acm: {}
  nrf.extended.sample.usb_device_next.cdc-acm-workqueue:
    extra_args:
      - DCONFIG_USBD_CDC_ACM_WORKQUEUE=y
```

## samples/zephyr/subsys/usb/hid-keyboard/sample.yaml
```yaml
sample:
  name: USB HID keyboard sample
common:
  filter: dt_alias_exists("sw0") and dt_alias_exists("led0")
  depends_on:
    - gpio
  tags:
    - usb
    - ci_samples_zephyr_subsys_usb
  timeout: 15
  harness: console
  harness_config:
    type: multi_line
    ordered: false
    regex:
      - "HS bNumConfigurations 1"
      - "FS bNumConfigurations 1"
      - "HID keyboard sample is initialized"
      - "USBD message: VBUS ready"
      - "Actual device speed 2"
      - "s-in-status finished"
  integration_platforms:
    - nrf54h20dk/nrf54h20/cpuapp
  platform_allow:
    - nrf54h20dk/nrf54h20/cpuapp
    - nrf54lm20dk/nrf54lm20a/cpuapp
tests:
  nrf.extended.sample.usbd.hid-keyboard: {}
  nrf.extended.sample.usbd.hid-keyboard.out-report:
    extra_args:
      - EXTRA_DTC_OVERLAY_FILE="out_report.overlay"
  nrf.extended.sample.usbd.hid-keyboard.large-report:
    extra_args:
      - EXTRA_DTC_OVERLAY_FILE="large_in_report.overlay"
  nrf.extended.sample.usbd.hid-keyboard.large-out-report:
    extra_args:
      - EXTRA_DTC_OVERLAY_FILE="large_out_report.overlay"
```
