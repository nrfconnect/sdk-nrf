## samples/zigbee/network_coordinator/sample.yaml
```yaml
sample:
  description: Zigbee Light control - coordinator sample
  name: Zigbee Network coordinator
tests:
  sample.zigbee.network_coordinator:
    build_only: true
    integration_platforms:
      - nrf52840dk_nrf52840
      - nrf52833dk_nrf52833
      - nrf5340dk_nrf5340_cpuapp
      - nrf21540dk_nrf52840
    platform_allow: nrf52840dk_nrf52840 nrf52833dk_nrf52833 nrf5340dk_nrf5340_cpuapp
      nrf21540dk_nrf52840
    tags: ci_build smoke
```

## samples/zigbee/shell/sample.yaml
```yaml
sample:
  description: Zigbee application that includes all Zigbee shell commands
  name: Zigbee application with Zigbee shell
tests:
  sample.zigbee.shell:
    build_only: true
    sysbuild: true
    integration_platforms:
      - nrf52840dk/nrf52840
      - nrf52833dk/nrf52833
      - nrf5340dk/nrf5340/cpuapp
      - nrf21540dk/nrf52840
    platform_allow: nrf52840dk/nrf52840 nrf52833dk/nrf52833 nrf5340dk/nrf5340/cpuapp
      nrf21540dk/nrf52840
    tags: ci_build shell sysbuild
  sample.zigbee.shell.usb:
    sysbuild: true
    build_only: true
    extra_args:
      FILE_SUFFIX=usb
    integration_platforms:
      - nrf52840dk/nrf52840
      - nrf21540dk/nrf52840
      - nrf52833dk/nrf52833
      - nrf52840dongle/nrf52840
      - nrf5340dk/nrf5340/cpuapp
    platform_allow: nrf52840dk/nrf52840 nrf21540dk/nrf52840 nrf52833dk/nrf52833
      nrf52840dongle/nrf52840 nrf5340dk/nrf5340/cpuapp
    tags: ci_build shell sysbuild
```

## samples/zigbee/template/sample.yaml
```yaml
sample:
  description: Zigbee application template
  name: Zigbee application template
tests:
  sample.zigbee.template:
    sysbuild: true
    build_only: true
    integration_platforms:
      - nrf52840dk/nrf52840
      - nrf52833dk/nrf52833
      - nrf5340dk/nrf5340/cpuapp
      - nrf21540dk/nrf52840
    platform_allow: nrf52840dk/nrf52840 nrf52833dk/nrf52833 nrf5340dk/nrf5340/cpuapp
      nrf21540dk/nrf52840
    tags: ci_build smoke sysbuild
```

## scripts/twister/alt/zephyr/samples/basic/blinky/sample.yaml
```yaml
sample:
  name: Blinky Sample
common:
  tags:
    - LED
    - gpio
  depends_on: gpio
tests:
  sample.basic.blinky:
    filter: dt_enabled_alias_with_parent_compat("led0", "gpio-leds")
    harness: led
    integration_platforms:
      - frdm_k64f

  sample.basic.blinky.egpio_icmsg:
    sysbuild: true
    platform_allow:
      - nrf54l15dk/nrf54l15/cpuapp
    integration_platforms:
      - nrf54l15dk/nrf54l15/cpuapp
    extra_args: SB_CONFIG_SDP=y
                SB_CONFIG_EGPIO_FLPR_APPLICATION=y
                SB_CONFIG_EGPIO_BACKEND_ICMSG=y
                SB_CONFIG_PARTITION_MANAGER=n
                EXTRA_DTC_OVERLAY_FILE="./boards/nrf54l15dk_nrf54l15_cpuapp_egpio.overlay"
    harness: console
    harness_config:
      type: multi_line
      ordered: true
      regex:
        - "LED state: ON"
        - "LED state: OFF"

  sample.basic.blinky.egpio_mbox:
    sysbuild: true
    platform_allow:
      - nrf54l15dk/nrf54l15/cpuapp
    integration_platforms:
      - nrf54l15dk/nrf54l15/cpuapp
    extra_args: SB_CONFIG_SDP=y
                SB_CONFIG_EGPIO_FLPR_APPLICATION=y
                SB_CONFIG_EGPIO_BACKEND_MBOX=y
                SB_CONFIG_PARTITION_MANAGER=n
                EXTRA_DTC_OVERLAY_FILE="./boards/nrf54l15dk_nrf54l15_cpuapp_egpio.overlay"
    harness: console
    harness_config:
      type: multi_line
      ordered: true
      regex:
        - "LED state: ON"
        - "LED state: OFF"

  sample.basic.blinky.egpio_icbmsg:
    sysbuild: true
    platform_allow:
      - nrf54l15dk/nrf54l15/cpuapp
    integration_platforms:
      - nrf54l15dk/nrf54l15/cpuapp
    extra_args: SB_CONFIG_SDP=y
                SB_CONFIG_EGPIO_FLPR_APPLICATION=y
                SB_CONFIG_EGPIO_BACKEND_ICBMSG=y
                SB_CONFIG_PARTITION_MANAGER=n
                EXTRA_DTC_OVERLAY_FILE="./boards/nrf54l15dk_nrf54l15_cpuapp_egpio.overlay"
    harness: console
    harness_config:
      type: multi_line
      ordered: true
      regex:
        - "LED state: ON"
        - "LED state: OFF"
```

## scripts/twister/alt/zephyr/samples/sensor/accel_polling/sample.yaml
```yaml
sample:
  name: Accelerometer polling sample
common:
  depends_on: spi
  tags: drivers spi sensors
  harness: console

tests:
  sample.sensor.accel_polling.nrf54h:
    filter: not CONFIG_COVERAGE
    harness_config:
      fixture: pca63566
      type: one_line
      regex:
        - "^\\s*[0-9A-Za-z_,+-.]*@[0-9A-Fa-f]* \\[m\/s\\^2\\]:    \
           \\(\\s*-?[0-9\\.]*,\\s*-?[0-9\\.]*,\\s*-?[0-9\\.]*\\)$"
    extra_args:
      - SHIELD=pca63566
    platform_allow: nrf54h20dk/nrf54h20/cpuapp

  sample.sensor.accel_polling.nrf54h_cpuppr:
    filter: not CONFIG_COVERAGE
    sysbuild: true
    harness_config:
      fixture: pca63566
      type: one_line
      regex:
        - "^\\s*[0-9A-Za-z_,+-.]*@[0-9A-Fa-f]* \\[m\/s\\^2\\]:    \
           \\(\\s*-?[0-9\\.]*,\\s*-?[0-9\\.]*,\\s*-?[0-9\\.]*\\)$"
    extra_args:
      - accel_polling_SHIELD=pca63566
      - vpr_launcher_SHIELD=pca63566_fwd
    platform_allow: nrf54h20dk/nrf54h20/cpuppr

  sample.sensor.accel_polling.nrf54h_coverage:
    filter: CONFIG_COVERAGE
    harness_config:
      fixture: pca63566
      type: one_line
      regex:
        - "^\\s*[0-9A-Za-z_,+-.]*@[0-9A-Fa-f]* \\[m\/s\\^2\\]:    \
           \\(\\s*-?[0-9\\.]*,\\s*-?[0-9\\.]*,\\s*-?[0-9\\.]*\\)$"
    extra_args:
      - SHIELD=pca63566;coverage_support
    platform_allow: nrf54h20dk/nrf54h20/cpuapp

  sample.sensor.accel_polling.nrf54l:
    filter: not CONFIG_COVERAGE
    harness_config:
      fixture: pca63565
      type: one_line
      regex:
        - "^\\s*[0-9A-Za-z_,+-.]*@[0-9A-Fa-f]* \\[m\/s\\^2\\]:    \
           \\(\\s*-?[0-9\\.]*,\\s*-?[0-9\\.]*,\\s*-?[0-9\\.]*\\)$"
    extra_args:
      - SHIELD=pca63565
    platform_allow: nrf54l15dk/nrf54l15/cpuapp

  sample.sensor.accel_polling.nrf54l_coverage:
    filter: CONFIG_COVERAGE
    harness_config:
      fixture: pca63565
      type: one_line
      regex:
        - "^\\s*[0-9A-Za-z_,+-.]*@[0-9A-Fa-f]* \\[m\/s\\^2\\]:    \
           \\(\\s*-?[0-9\\.]*,\\s*-?[0-9\\.]*,\\s*-?[0-9\\.]*\\)$"
    extra_args:
      - SHIELD=pca63565;coverage_support
    platform_allow: nrf54l15dk/nrf54l15/cpuapp

  sample.sensor.accel_polling.nrf54l15_cpuflpr:
    filter: not CONFIG_COVERAGE
    sysbuild: true
    harness_config:
      fixture: pca63565
      type: one_line
      regex:
        - "^\\s*[0-9A-Za-z_,+-.]*@[0-9A-Fa-f]* \\[m\/s\\^2\\]:    \
           \\(\\s*-?[0-9\\.]*,\\s*-?[0-9\\.]*,\\s*-?[0-9\\.]*\\)$"
    extra_args:
      - SHIELD=pca63565
      - vpr_launcher_DTC_OVERLAY_FILE="../../../../nrf/boards/shields/pca63565/boards/nrf54l15dk_nrf54l15_vpr_launcher.overlay"
    platform_allow: nrf54l15dk/nrf54l15/cpuflpr
```

## scripts/twister/alt/zephyr/samples/sensor/bme680/sample.yaml
```yaml
sample:
  name: BME680 Sensor sample
common:
  depends_on: i2c
  tags: drivers i2c sensors
  harness: console

tests:
  sample.sensor.bme680.nrf54h:
    filter: not CONFIG_COVERAGE
    harness_config:
      fixture: pca63566
      type: one_line
      regex:
        - "^\\s*T:\\s*-?[0-9\\.]*; P:\\s*-?[0-9\\.]*; H: \\s*-?[0-9\\.]*; G:\\s*-?[0-9\\.]*$"
    extra_args:
      - SHIELD=pca63566
    platform_allow: nrf54h20dk/nrf54h20/cpuapp

  sample.sensor.bme680.nrf54h_cpuppr:
    filter: not CONFIG_COVERAGE
    sysbuild: true
    harness_config:
      fixture: pca63566
      type: one_line
      regex:
        - "^\\s*T:\\s*-?[0-9\\.]*; P:\\s*-?[0-9\\.]*; H: \\s*-?[0-9\\.]*; G:\\s*-?[0-9\\.]*$"
    extra_args:
      - bme680_SHIELD=pca63566
      - vpr_launcher_SHIELD=pca63566_fwd
    platform_allow: nrf54h20dk/nrf54h20/cpuppr

  sample.sensor.bme680.nrf54h_coverage:
    filter: CONFIG_COVERAGE
    harness_config:
      fixture: pca63566
      type: one_line
      regex:
        - "^\\s*T:\\s*-?[0-9\\.]*; P:\\s*-?[0-9\\.]*; H: \\s*-?[0-9\\.]*; G:\\s*-?[0-9\\.]*$"
    extra_args:
      - SHIELD=pca63566;coverage_support
    platform_allow: nrf54h20dk/nrf54h20/cpuapp

  sample.sensor.bme680.nrf54l:
    filter: not CONFIG_COVERAGE
    harness_config:
      fixture: pca63565
      type: one_line
      regex:
        - "^\\s*T:\\s*-?[0-9\\.]*; P:\\s*-?[0-9\\.]*; H: \\s*-?[0-9\\.]*; G:\\s*-?[0-9\\.]*$"
    extra_args:
      - SHIELD=pca63565
    platform_allow: nrf54l15dk/nrf54l15/cpuapp

  sample.sensor.bme680.nrf54l_coverage:
    filter: CONFIG_COVERAGE
    harness_config:
      fixture: pca63565
      type: one_line
      regex:
        - "^\\s*T:\\s*-?[0-9\\.]*; P:\\s*-?[0-9\\.]*; H: \\s*-?[0-9\\.]*; G:\\s*-?[0-9\\.]*$"
    extra_args:
      - SHIELD=pca63565;coverage_support
    platform_allow: nrf54l15dk/nrf54l15/cpuapp

  sample.sensor.bme680.nrf54l_cpuflpr:
    filter: not CONFIG_COVERAGE
    sysbuild: true
    harness_config:
      fixture: pca63565
      type: one_line
      regex:
        - "^\\s*T:\\s*-?[0-9\\.]*; P:\\s*-?[0-9\\.]*; H: \\s*-?[0-9\\.]*; G:\\s*-?[0-9\\.]*$"
    extra_args:
      - SHIELD=pca63565
      - vpr_launcher_DTC_OVERLAY_FILE="../../../../nrf/boards/shields/pca63565/boards/nrf54l15dk_nrf54l15_vpr_launcher.overlay"
    platform_allow: nrf54l15dk/nrf54l15/cpuflpr
```

## scripts/twister/alt/zephyr/tests/drivers/i2c/i2c_bme688/testcase.yaml
```yaml
common:
  tags: drivers i2c
  depends_on: i2c
  harness: ztest
tests:
  drivers.i2c.bme688_nrf54l:
    filter: not CONFIG_COVERAGE
    harness_config:
      fixture: pca63565
    extra_args:
      - SHIELD=pca63565
      - SB_CONFIG_VPR_LAUNCHER=y
      - vpr_launcher_DTC_OVERLAY_FILE="../../../../nrf/boards/shields/pca63565/boards/nrf54l15dk_nrf54l15_vpr_launcher.overlay"
    platform_allow:
      - nrf54l15dk/nrf54l15/cpuapp
      - nrf54l15dk/nrf54l15/cpuflpr

  drivers.i2c.bme688_nrf54l_fast_speed:
    filter: not CONFIG_COVERAGE
    harness_config:
      fixture: pca63565
    extra_args:
      - SHIELD=pca63565
      - SB_CONFIG_VPR_LAUNCHER=y
      - vpr_launcher_DTC_OVERLAY_FILE="../../../../nrf/boards/shields/pca63565/boards/nrf54l15dk_nrf54l15_vpr_launcher.overlay"
      - CONFIG_TEST_I2C_SPEED=2
    platform_allow:
      - nrf54l15dk/nrf54l15/cpuapp
      - nrf54l15dk/nrf54l15/cpuflpr

  drivers.i2c.bme688_nrf54l_coverage:
    filter: CONFIG_COVERAGE
    harness_config:
      fixture: pca63565
    extra_args:
      - SHIELD=pca63565;coverage_support
    platform_allow:
      - nrf54l15dk/nrf54l15/cpuapp

  drivers.i2c.bme688_nrf54l_coverage_fast_speed:
    filter: CONFIG_COVERAGE
    harness_config:
      fixture: pca63565
    extra_args:
      - SHIELD=pca63565;coverage_support
      - CONFIG_TEST_I2C_SPEED=2
    platform_allow:
      - nrf54l15dk/nrf54l15/cpuapp

  drivers.i2c.bme688_nrf54h:
    filter: not CONFIG_COVERAGE
    harness_config:
      fixture: pca63566
    extra_args:
      - i2c_bme688_SHIELD=pca63566
      - SB_CONFIG_VPR_LAUNCHER=y
      - vpr_launcher_SHIELD=pca63566_fwd
    platform_allow:
      - nrf54h20dk/nrf54h20/cpuapp
      - nrf54h20dk/nrf54h20/cpuppr

  drivers.i2c.bme688_nrf54h_fast_speed:
    filter: not CONFIG_COVERAGE
    harness_config:
      fixture: pca63566
    extra_args:
      - i2c_bme688_SHIELD=pca63566
      - SB_CONFIG_VPR_LAUNCHER=y
      - vpr_launcher_SHIELD=pca63566_fwd
      - CONFIG_TEST_I2C_SPEED=2
    platform_allow:
      - nrf54h20dk/nrf54h20/cpuapp
      - nrf54h20dk/nrf54h20/cpuppr

  drivers.i2c.bme688_nrf54h_fast_plus_speed:
    filter: not CONFIG_COVERAGE
    harness_config:
      fixture: pca63566
    extra_args:
      - i2c_bme688_SHIELD=pca63566
      - SB_CONFIG_VPR_LAUNCHER=y
      - vpr_launcher_SHIELD=pca63566_fwd
      - CONFIG_TEST_I2C_SPEED=3
    platform_allow:
      - nrf54h20dk/nrf54h20/cpuapp
      - nrf54h20dk/nrf54h20/cpuppr

  drivers.i2c.bme688_nrf54h_coverage:
    filter: CONFIG_COVERAGE
    harness_config:
      fixture: pca63566
    extra_args:
      - SHIELD=pca63566;coverage_support
    platform_allow:
      - nrf54h20dk/nrf54h20/cpuapp

  drivers.i2c.bme688_nrf54h_coverage_fast_speed:
    filter: CONFIG_COVERAGE
    harness_config:
      fixture: pca63566
    extra_args:
      - SHIELD=pca63566;coverage_support
      - CONFIG_TEST_I2C_SPEED=2
    platform_allow:
      - nrf54h20dk/nrf54h20/cpuapp

  drivers.i2c.bme688_nrf54h_coverage_fast_plus_speed:
    filter: CONFIG_COVERAGE
    harness_config:
      fixture: pca63566
    extra_args:
      - SHIELD=pca63566;coverage_support
      - CONFIG_TEST_I2C_SPEED=3
    platform_allow:
      - nrf54h20dk/nrf54h20/cpuapp
```

## scripts/twister/alt/zephyr/tests/drivers/mspi/api/testcase.yaml
```yaml
tests:
  drivers.mspi.api:
    tags:
      - drivers
      - mspi
      - api
    filter: dt_compat_enabled("zephyr,mspi-emul-controller") or
            dt_compat_enabled("ambiq,mspi-controller")
    harness: ztest
    platform_allow:
      - native_sim
      - apollo3p_evb
    integration_platforms:
      - native_sim

  drivers.mspi.api.emspi:
    tags:
      - drivers
      - mspi
      - api
    harness: ztest
    platform_allow:
      - nrf54l15dk/nrf54l15/cpuapp
    integration_platforms:
      - nrf54l15dk/nrf54l15/cpuapp
    extra_args:
      - SB_CONFIG_VPR_LAUNCHER=n
      - SB_CONFIG_PARTITION_MANAGER=n
      - SB_CONFIG_SDP=y
      - SB_CONFIG_SDP_MSPI=y
```

## scripts/west_commands/create_board/templates/nrf52/Kconfig.board.jinja2
```kconfig
config BOARD_{{ board | upper }}
	select SOC_{{ soc | upper }}_{{ variant | upper}}
```

## scripts/west_commands/create_board/templates/nrf53/Kconfig.board.jinja2
```kconfig
config BOARD_{{ board | upper }}
	select SOC_NRF5340_CPUAPP_QKAA if BOARD_{{ board | upper }}_NRF5340_CPUAPP || \
		BOARD_{{ board | upper }}_NRF5340_CPUAPP_NS
	select SOC_NRF5340_CPUNET_QKAA if BOARD_{{ board | upper }}_NRF5340_CPUNET
```

## scripts/west_commands/create_board/templates/nrf54h/Kconfig.board.jinja2
```kconfig
config BOARD_{{ board | upper }}
	select SOC_NRF54H20_CPUAPP if BOARD_{{ board | upper }}_NRF54H20_CPUAPP
	select SOC_NRF54H20_CPURAD if BOARD_{{ board | upper }}_NRF54H20_CPURAD
	select SOC_NRF54H20_CPUPPR if BOARD_{{ board | upper }}_NRF54H20_CPUPPR || \
					BOARD_{{ board | upper }}_NRF54H20_CPUPPR_XIP
	select SOC_NRF54H20_CPUFLPR if BOARD_{{ board | upper }}_NRF54H20_CPUFLPR || \
					BOARD_{{ board | upper }}_NRF54H20_CPUFLPR_XIP
```

## scripts/west_commands/create_board/templates/nrf54h/Kconfig.defconfig.jinja2
```kconfig
if BOARD_{{ board | upper }}_NRF54H20_CPUAPP

config BT_HCI_IPC
	default y if BT

endif # BOARD_{{ board | upper }}_NRF54H20_CPUAPP

if BOARD_{{ board | upper }}_NRF54H20_CPURAD

config BT_CTLR
	default y if BT

endif # BOARD_{{ board | upper }}_NRF54H20_CPURAD
```

## scripts/west_commands/create_board/templates/nrf54l/Kconfig.board.jinja2
```kconfig
config BOARD_{{ board | upper }}
	select SOC_{{ soc | upper }}_CPUAPP if BOARD_{{ board | upper }}_{{ soc | upper }}_CPUAPP
	select SOC_{{ soc | upper }}_CPUFLPR if \
		BOARD_{{ board | upper }}_{{ soc | upper }}_CPUFLPR || \
		BOARD_{{ board | upper }}_{{ soc | upper }}_CPUFLPR_XIP
```

## scripts/west_commands/create_board/templates/nrf54l/Kconfig.defconfig.jinja2
```kconfig
config HW_STACK_PROTECTION
	default ARCH_HAS_STACK_PROTECTION

if BOARD_{{ board | upper }}_{{ soc | upper }}_CPUAPP

config ROM_START_OFFSET
	default 0 if PARTITION_MANAGER_ENABLED
	default 0x800 if BOOTLOADER_MCUBOOT

endif # BOARD_{{ board | upper }}_{{ soc | upper }}_CPUAPP
```

## scripts/west_commands/create_board/templates/nrf54lc/Kconfig.defconfig.jinja2
```kconfig
config NRF_RRAM_WRITE_BUFFER_SIZE
	default 16
	range 0 16

config HAS_BT_CTLR
	default BT

config HW_STACK_PROTECTION
	default ARCH_HAS_STACK_PROTECTION
```

## scripts/west_commands/create_board/templates/nrf54lm/Kconfig.defconfig.jinja2
```kconfig
if CONFIG_SOC_{{ soc | upper }}_CPUAPP

config HW_STACK_PROTECTION
	default ARCH_HAS_STACK_PROTECTION

endif # CONFIG_SOC_{{ soc | upper }}_CPUAPP
```
