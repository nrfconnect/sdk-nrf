/* Copyright (c) 2021 Nordic Semiconductor ASA
 *
 * SPDX-License-Identifier: LicenseRef-Nordic-5-Clause
 */

/ {
  radio_coex: radio_coex_three_wire {
    status = "okay";
    compatible = "generic-radio-coex-three-wire";
    req-gpios =     <&gpio0 14 (GPIO_PULL_DOWN | GPIO_ACTIVE_HIGH)>;
    pri-dir-gpios = <&gpio0 16 (GPIO_PULL_UP   | GPIO_ACTIVE_HIGH)>;
    grant-gpios =   <&gpio0 12 (GPIO_PULL_DOWN | GPIO_ACTIVE_HIGH)>;
  };
};

&radio {
  coex = <&radio_coex>;
};
