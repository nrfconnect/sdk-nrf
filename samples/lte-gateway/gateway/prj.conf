## CMakeLists.txt
```
#
# Copyright (c) 2018 Nordic Semiconductor
#
# SPDX-License-Identifier: LicenseRef-BSD-5-Clause-Nordic
#

cmake_minimum_required(VERSION 3.8.2)

include($ENV{ZEPHYR_BASE}/cmake/app/boilerplate.cmake NO_POLICY_SCOPE)
project(NONE)

target_sources(app PRIVATE src/main.c)
zephyr_include_directories(src)

include_directories(src/orientation_detector)
target_sources(app PRIVATE src/orientation_detector/orientation_detector.c)
target_sources(app PRIVATE src/aggregator.c)
target_sources(app PRIVATE src/ble.c)
```

## prj.conf
```kconfig
# General config
CONFIG_NEWLIB_LIBC=y
CONFIG_TEST_RANDOM_GENERATOR=y
CONFIG_ASSERT=y
CONFIG_REBOOT=y

# Trusted execution
CONFIG_TRUSTED_EXECUTION_NONSECURE=y

# Network
CONFIG_NETWORKING=y
CONFIG_NET_SOCKETS=y
CONFIG_NET_SOCKETS_OFFLOAD=y

# MQTT
CONFIG_MQTT_SOCKET_LIB=y
CONFIG_MQTT_LIB_TLS=y
CONFIG_MQTT_MAX_PACKET_LENGTH=2048

# LTE link control
CONFIG_LTE_LINK_CONTROL=y

# BSD library
CONFIG_BSD_LIBRARY=y

# Disable Modem traces, since we need UART1 for HCI
CONFIG_BSD_LIBRARY_TRACE_ENABLED=n

# nRF Cloud
CONFIG_NRF_CLOUD=y

# Sensors
CONFIG_GPS_USE_SIM=y
CONFIG_ACCEL_USE_SIM=y

# Library for buttons and LEDs
CONFIG_DK_LIBRARY=y
CONFIG_DK_LIBRARY_INVERT_LEDS=n

# Console
CONFIG_CONSOLE_SUBSYS=y
CONFIG_CONSOLE_HANDLER=y
CONFIG_CONSOLE_GETCHAR=y

CONFIG_CONSOLE=y
CONFIG_STDOUT_CONSOLE=y
CONFIG_UART_CONSOLE=y

# Main thread
CONFIG_MAIN_THREAD_PRIORITY=7

# Enable Bluetooth stack and libraries
CONFIG_BT=y
CONFIG_BT_H4=y
CONFIG_BT_CENTRAL=y
CONFIG_BT_GATT_CLIENT=y
CONFIG_BT_GATT_DM=y
CONFIG_NRF_BT_SCAN=y
CONFIG_NRF_BT_SCAN_FILTER_ENABLE=y
CONFIG_NRF_BT_SCAN_UUID_CNT=1

CONFIG_UART_1_NRF_UARTE=y
CONFIG_UART_1_NRF_FLOW_CONTROL=y
CONFIG_UART_INTERRUPT_DRIVEN=y

CONFIG_LOG=y
CONFIG_BT_GATT_DM_LOG_LEVEL_INF=y

# Heap and stacks
CONFIG_HEAP_MEM_POOL_SIZE=16384
CONFIG_MAIN_STACK_SIZE=8192
CONFIG_GPS_SIM_THREAD_STACK_SIZE=1024
```

## nrf9160_pca10090.overlay
```dts
/ {
	chosen {
		zephyr,bt-uart=&uart1;
	};
};

&uart1 {
	current-speed = <1000000>;
	status = "ok";
};
```

## src/main.c
```c
/*
 * Copyright (c) 2018 Nordic Semiconductor ASA
 *
 * SPDX-License-Identifier: LicenseRef-BSD-5-Clause-Nordic
 */

#include <zephyr.h>
#include <stdio.h>
#include <string.h>
#include <gps.h>
#include <sensor.h>
#include <console.h>
#include <nrf_cloud.h>
#include <dk_buttons_and_leds.h>
#include <lte_lc.h>
#include <misc/reboot.h>
#include <bsd.h>
#include <uart.h>
#include <device.h>

#include "ble.h"
#include "nrf_socket.h"
#include "orientation_detector.h"
#include "aggregator.h"

/* Interval in seconds between each time sensor data is sent. */
#define APP_SENSOR_DATA_SEND_INTERVAL	1
/* Interval in milliseconds between each time status LEDs are updated. */
#define APP_LEDS_UPDATE_INTERVAL	500

#define AT_CMD_BUFFER_SIZE		100
#define BUTTON_1			BIT(0)
#define BUTTON_2			BIT(1)
#define SWITCH_1			BIT(2)
#define SWITCH_2			BIT(3)

#define LED_ON(x)			(x)
#define LED_BLINK(x)			((x) << 8)
#define LED_GET_ON(x)			((x) & 0xFF)
#define LED_GET_BLINK(x)		(((x) >> 8) & 0xFF)

#if !defined(CONFIG_LTE_LINK_CONTROL)
#error "Missing CONFIG_LTE_LINK_CONTROL"
#endif /* !defined(CONFIG_LTE_LINK_CONTROL) */

#if defined(CONFIG_LTE_AUTO_INIT_AND_CONNECT) && \
	defined(CONFIG_NRF_CLOUD_PROVISION_CERTIFICATES)
#error "PROVISION_CERTIFICATES \
	requires CONFIG_LTE_AUTO_INIT_AND_CONNECT to be disabled!"
#endif /* defined(CONFIG_LTE_AUTO_INIT_AND_CONNECT)
	* defined(CONFIG_NRF_CLOUD_PROVISION_CERTIFICATES)
	*/

enum {
	LEDS_INITIALIZING     = LED_ON(0),
	LEDS_CONNECTING       = LED_BLINK(DK_LED3_MSK),
	LEDS_PATTERN_WAIT     = LED_BLINK(DK_LED3_MSK | DK_LED4_MSK),
	LEDS_PATTERN_ENTRY    = LED_ON(DK_LED3_MSK) | LED_BLINK(DK_LED4_MSK),
	LEDS_PATTERN_DONE     = LED_BLINK(DK_LED4_MSK),
	LEDS_PAIRED           = LED_ON(DK_LED4_MSK),
	LEDS_ERROR            = LED_ON(DK_ALL_LEDS_MSK)
} display_state;

 /* Variables to keep track of nRF cloud user association. */
static u8_t ua_pattern[10];
static int buttons_to_capture;
static int buttons_captured;
static bool pattern_recording;
static struct k_sem user_assoc_sem;

/* Sensor data */
static struct gps_data nmea_data;
static struct nrf_cloud_sensor_data flip_cloud_data;
static struct nrf_cloud_sensor_data gps_cloud_data;
static struct nrf_cloud_sensor_data gps_cloud_data_out;
static u8_t gps_data_buffer[GPS_NMEA_SENTENCE_MAX_LENGTH];

/* Flag used for flip detection */
static bool flip_mode_enabled = true;
static bool alarm_pending;

/* Structure for delayed work */
static struct k_delayed_work leds_update_work;
static struct k_delayed_work connect_work;

/* Forward declaration of functions */
static void cloud_connect(struct k_work *work);
static void app_flip_poll(void);
static void app_sensors_init(void);
static void work_init(void);
void sensor_data_send(struct nrf_cloud_sensor_data *data);

/**@brief nRF Cloud error handler. */
void app_nrf_cloud_error_handler(void)
{
	int err;

	/* TODO: ensure that the delayed work is indeed cancelled.
	 * The current situation is that work might be ongoing and "self-submit"
	 * because it's executed from a higher priority thread
	 */
	k_delayed_work_cancel(&leds_update_work);
	k_delayed_work_cancel(&connect_work);

	/* Turn off and shutdown modem */
	err = lte_lc_power_off();
	__ASSERT(err == 0, "lte_lc_power_off failed %d", err);
	bsd_shutdown();

#if !defined(CMAKE_C_FLAGS_DEBUG)
	sys_reboot(SYS_REBOOT_COLD);
#else
	/* Blinking all LEDs ON/OFF in pairs (1 and 4, 2 and 3)
	 * if there is an recoverable error.
	 */
	while (true) {
		dk_set_leds_state(DK_LED1_MSK | DK_LED4_MSK,
			DK_LED2_MSK | DK_LED3_MSK);
		k_sleep(250);
		dk_set_leds_state(DK_LED2_MSK | DK_LED3_MSK,
			DK_LED1_MSK | DK_LED4_MSK);
		k_sleep(250);
	}
#endif /* defined (APP_DEBUG_BUILD) */
}

/**@brief Recoverable BSD library error. */
void bsd_recoverable_error_handler(uint32_t error)
{
	ARG_UNUSED(error);

	/* Blinking all LEDs ON/OFF in pairs (1 and 3, 2 and 4)
	 * if there is an recoverable error.
	 */
	while (true) {
		dk_set_leds_state(DK_LED1_MSK | DK_LED3_MSK,
			DK_LED2_MSK | DK_LED4_MSK);
		k_sleep(250);
		dk_set_leds_state(DK_LED2_MSK | DK_LED4_MSK,
			DK_LED1_MSK | DK_LED3_MSK);
		k_sleep(250);
	}
}

/**@brief Irrecoverable BSD library error. */
void bsd_irrecoverable_error_handler(uint32_t error)
{
	ARG_UNUSED(error);

	/* Blinking all LEDs ON/OFF if there is an irrecoverable error. */
	while (true) {
		dk_set_leds_state(DK_ALL_LEDS_MSK, 0x00);
		k_sleep(250);
		dk_set_leds_state(0x00, DK_ALL_LEDS_MSK);
		k_sleep(250);
	}
}

/**@brief Callback for GPS trigger events */
static void gps_trigger_handler(struct device *dev, struct gps_trigger *trigger)
{
	u32_t button_state, has_changed;

	ARG_UNUSED(trigger);
	dk_read_buttons(&button_state, &has_changed);

	if (!(button_state & SWITCH_2)) {
		gps_sample_fetch(dev);
		gps_channel_get(dev, GPS_CHAN_NMEA, &nmea_data);
		gps_cloud_data.data.ptr = nmea_data.str;
		gps_cloud_data.data.len = nmea_data.len;
		gps_cloud_data.tag += 1;

		if (gps_cloud_data.tag == 0) {
			gps_cloud_data.tag = 0x1;
		}

		struct sensor_data in_data;

		in_data.type = GPS_POSITION;
		in_data.length = gps_cloud_data.data.len;
		memcpy(&in_data.data[4], gps_cloud_data.data.ptr,
			gps_cloud_data.data.len);
		*((u32_t *)&in_data.data[0]) = gps_cloud_data.tag;

		printk("gps length: %d", gps_cloud_data.data.len);

		if (aggregator_put(in_data) != 0) {
			aggregator_get(NULL);
			if (aggregator_put(in_data) != 0) {
				printk("put error.\n");
			}
		}
	}
}

/**@brief Callback for sensor trigger events */
static void sensor_trigger_handler(struct device *dev,
			struct sensor_trigger *trigger)
{
	ARG_UNUSED(dev);
	ARG_UNUSED(trigger);

	/* No action implemented. */
}

/**@brief Function for polling flip orientation if mode has been enabled. */
static void app_flip_poll(void)
{
	static enum orientation_state last_orientation_state =
		ORIENTATION_NOT_KNOWN;
	static struct orientation_detector_sensor_data sensor_data;

	if (!flip_mode_enabled) {
		return;
	}

	if (orientation_detector_poll(&sensor_data) == 0) {
		if (sensor_data.orientation == last_orientation_state) {
			return;
		}

		switch (sensor_data.orientation) {
		case ORIENTATION_NORMAL:
			flip_cloud_data.data.ptr = "NORMAL";
			flip_cloud_data.data.len = sizeof("NORMAL") - 1;
			break;
		case ORIENTATION_UPSIDE_DOWN:
			flip_cloud_data.data.ptr = "UPSIDE_DOWN";
			flip_cloud_data.data.len = sizeof("UPSIDE_DOWN") - 1;
			break;
		default:
			return;
		}

		sensor_data_send(&flip_cloud_data);

		last_orientation_state = sensor_data.orientation;
	}
}

/**@brief Update LEDs state. */
static void app_leds_update(struct k_work *work)
{
	static bool led_on;
	static u8_t current_led_on_mask;
	u8_t led_on_mask = current_led_on_mask;

	ARG_UNUSED(work);

	/* Reset LED3 and LED4. */
	led_on_mask &= ~(DK_LED3_MSK | DK_LED4_MSK);

	/* Set LED3 and LED4 to match current state. */
	led_on_mask |= LED_GET_ON(display_state);

	led_on = !led_on;
	if (led_on) {
		led_on_mask |= LED_GET_BLINK(display_state);
	} else {
		led_on_mask &= ~LED_GET_BLINK(display_state);
	}

	if (led_on_mask != current_led_on_mask) {
		dk_set_leds(led_on_mask);
		current_led_on_mask = led_on_mask;
	}

	k_delayed_work_submit(&leds_update_work, APP_LEDS_UPDATE_INTERVAL);
}

/**@brief Send sensor data to nRF Cloud. **/
void sensor_data_send(struct nrf_cloud_sensor_data *data)
{
	int err;

	if (pattern_recording) {
		return;
	}

	if (data->type == NRF_CLOUD_SENSOR_FLIP) {
		err = nrf_cloud_sensor_data_stream(data);
	} else {
		err = nrf_cloud_sensor_data_send(data);
	}

	if (err) {
		app_nrf_cloud_error_handler();
	}
}

/**@brief Callback for user association event received from nRF Cloud. */
static void on_user_association_req(const struct nrf_cloud_evt *p_evt)
{
	if (!pattern_recording) {
		k_sem_init(&user_assoc_sem, 0, 1);
		display_state = LEDS_PATTERN_WAIT;
		pattern_recording = true;
		buttons_captured = 0;
		buttons_to_capture = p_evt->param.ua_req.sequence.len;

		printk("Please enter the user association pattern ");

		if (IS_ENABLED(CONFIG_CLOUD_UA_BUTTONS)) {
			printk("using the buttons and switches\n");
		} else if (IS_ENABLED(CONFIG_CLOUD_UA_CONSOLE)) {
			printk("using the console\n");
		}
	}
}

/**@brief Callback for nRF Cloud events. */
static void cloud_event_handler(const struct nrf_cloud_evt *p_evt)
{
	int err;

	switch (p_evt->type) {
	case NRF_CLOUD_EVT_TRANSPORT_CONNECTED:
		printk("NRF_CLOUD_EVT_TRANSPORT_CONNECTED\n");
		break;
	case NRF_CLOUD_EVT_USER_ASSOCIATION_REQUEST:
		printk("NRF_CLOUD_EVT_USER_ASSOCIATION_REQUEST\n");
		on_user_association_req(p_evt);
		break;
	case NRF_CLOUD_EVT_USER_ASSOCIATED:
		printk("NRF_CLOUD_EVT_USER_ASSOCIATED\n");
		break;
	case NRF_CLOUD_EVT_READY:
		printk("NRF_CLOUD_EVT_READY\n");
		display_state = LEDS_PAIRED;
		struct nrf_cloud_sa_param param = {
			.sensor_type = NRF_CLOUD_SENSOR_FLIP,
		};

		err = nrf_cloud_sensor_attach(&param);

		if (err) {
			app_nrf_cloud_error_handler();
		}

		param.sensor_type = NRF_CLOUD_SENSOR_GPS;
		err = nrf_cloud_sensor_attach(&param);

		if (err) {
			app_nrf_cloud_error_handler();
		}

		app_sensors_init();
		break;
	case NRF_CLOUD_EVT_SENSOR_ATTACHED:
		printk("NRF_CLOUD_EVT_SENSOR_ATTACHED\n");
		break;
	case NRF_CLOUD_EVT_SENSOR_DATA_ACK:
		printk("NRF_CLOUD_EVT_SENSOR_DATA_ACK\n");
		break;
	case NRF_CLOUD_EVT_TRANSPORT_DISCONNECTED:
		printk("NRF_CLOUD_EVT_TRANSPORT_DISCONNECTED\n");
		display_state = LEDS_INITIALIZING;
		/* Try to reconnect after 3 seconds hold of time */
		/* TODO: Investigate if this need to be 3 seconds */
		k_delayed_work_submit(&connect_work, K_SECONDS(3));
		break;
	case NRF_CLOUD_EVT_ERROR:
		printk("NRF_CLOUD_EVT_ERROR\n");
		display_state = LEDS_ERROR;
		app_nrf_cloud_error_handler();
		break;
	default:
		printk("Received unknown %d\n", p_evt->type);
		break;
	}
}

/**@brief Initialize nRF CLoud library. */
static void cloud_init(void)
{
	const struct nrf_cloud_init_param param = {
		.event_handler = cloud_event_handler
	};

	int err = nrf_cloud_init(&param);

	__ASSERT(err == 0, "nRF Cloud library could not be initialized\n");
}

/**@brief Connect to nRF Cloud, */
static void cloud_connect(struct k_work *work)
{
	int err;

	ARG_UNUSED(work);

	const enum nrf_cloud_ua supported_uas[] = {
		NRF_CLOUD_UA_BUTTON
	};

	const enum nrf_cloud_sensor supported_sensors[] = {
		NRF_CLOUD_SENSOR_GPS,
		NRF_CLOUD_SENSOR_FLIP
	};

	const struct nrf_cloud_ua_list ua_list = {
		.size = ARRAY_SIZE(supported_uas),
		.ptr = supported_uas
	};

	const struct nrf_cloud_sensor_list sensor_list = {
		.size = ARRAY_SIZE(supported_sensors),
		.ptr = supported_sensors
	};

	const struct nrf_cloud_connect_param param = {
		.ua = &ua_list,
		.sensor = &sensor_list,
	};

	display_state = LEDS_CONNECTING;
	err = nrf_cloud_connect(&param);

	if (err) {
		printk("nrf_cloud_connect failed %d\n", err);
		app_nrf_cloud_error_handler();
	}
}

/**@brief Send user association information to nRF Cloud. */
static void cloud_user_associate(void)
{
	int err;
	const struct nrf_cloud_ua_param ua = {
		.type = NRF_CLOUD_UA_BUTTON,
		.sequence = {
			.len = buttons_to_capture,
			.ptr = ua_pattern
		}
	};

	err = nrf_cloud_user_associate(&ua);

	if (err) {
		app_nrf_cloud_error_handler();
	}
}

/**@brief Function to keep track of user association input when using
 * buttons and switches to register the association pattern.
 */
static void pairing_button_register(u32_t button_state, u32_t has_changed)
{
	if (buttons_captured < buttons_to_capture) {
		if (display_state == LEDS_PATTERN_WAIT)	{
			display_state = LEDS_PATTERN_ENTRY;
		}

		if (button_state & has_changed & BUTTON_1) {
			ua_pattern[buttons_captured++] =
				NRF_CLOUD_UA_BUTTON_INPUT_3;
			printk("Button 1\n");
		} else if (button_state & has_changed & BUTTON_2) {
			ua_pattern[buttons_captured++] =
				NRF_CLOUD_UA_BUTTON_INPUT_4;
			printk("Button 2\n");
		} else if (has_changed & SWITCH_1) {
			ua_pattern[buttons_captured++] =
				NRF_CLOUD_UA_BUTTON_INPUT_1;
			printk("Switch 1\n");
		} else if (has_changed & SWITCH_2) {
			ua_pattern[buttons_captured++] =
				NRF_CLOUD_UA_BUTTON_INPUT_2;
			printk("Switch 2\n");
		}
	}

	if (buttons_captured == buttons_to_capture) {
		display_state = LEDS_PATTERN_DONE;
		k_sem_give(&user_assoc_sem);
	}
}

/**@brief Callback for button events from the DK buttons and LEDs library. */
static void button_handler(u32_t buttons, u32_t has_changed)
{
	if (pattern_recording && IS_ENABLED(CONFIG_CLOUD_UA_BUTTONS)) {
		pairing_button_register(buttons, has_changed);
		return;
	}

	if (has_changed & SWITCH_1) {
		app_flip_poll();
	}
}

/**@brief Processing of user inputs to the application. */
static void app_process(void)
{
	if (!pattern_recording) {
		return;
	}

	if (k_sem_take(&user_assoc_sem, K_NO_WAIT) == 0) {
		cloud_user_associate();
		pattern_recording = false;
		return;
	}

	if (!IS_ENABLED(CONFIG_CLOUD_UA_CONSOLE)) {
		return;
	}

	u8_t c[2];

	c[0] = console_getchar();
	c[1] = console_getchar();

	if (c[0] == 'b' && c[1] == '1') {
		printk("Button 1\n");
		ua_pattern[buttons_captured++] = NRF_CLOUD_UA_BUTTON_INPUT_3;
	} else if (c[0] == 'b' && c[1] == '2') {
		printk("Button 2\n");
		ua_pattern[buttons_captured++] = NRF_CLOUD_UA_BUTTON_INPUT_4;
	} else if (c[0] == 's' && c[1] == '1') {
		printk("Switch 1\n");
		ua_pattern[buttons_captured++] = NRF_CLOUD_UA_BUTTON_INPUT_1;
	} else if (c[0] == 's' && c[1] == '2') {
		printk("Switch 2\n");
		ua_pattern[buttons_captured++] = NRF_CLOUD_UA_BUTTON_INPUT_2;
	}

	if (buttons_captured == buttons_to_capture) {
		k_sem_give(&user_assoc_sem);
	}
}

/**@brief Initializes and submits delayed work. */
static void work_init(void)
{
	k_delayed_work_init(&leds_update_work, app_leds_update);
	k_delayed_work_init(&connect_work, cloud_connect);
	k_delayed_work_submit(&leds_update_work, APP_LEDS_UPDATE_INTERVAL);
}

/**@brief Configures modem to provide LTE link. Blocks until link is
 * successfully established.
 */
static void modem_configure(void)
{
	if (IS_ENABLED(CONFIG_LTE_AUTO_INIT_AND_CONNECT)) {
		/* Do nothing, modem is already turned on
		 * and connected.
		 */
	} else {
		int err;

		printk("LTE LC config ...\n");
		err = lte_lc_init_and_connect();
		__ASSERT(err == 0, "LTE link could not be established");
	}
}

/**@brief Initializes GPS device and configures trigger if set.
 * Gets initial sample from GPS device.
 */
static void gps_init(void)
{
	int err;
	struct device *gps_dev = device_get_binding(CONFIG_GPS_DEV_NAME);
	struct gps_trigger gps_trig = {
		.type = GPS_TRIG_DATA_READY,
	};

	if (gps_dev == NULL) {
		printk("Could not get %s device\n", CONFIG_GPS_DEV_NAME);
		return;
	}
	printk("GPS device found\n");

	if (IS_ENABLED(CONFIG_GPS_TRIGGER)) {
		err = gps_trigger_set(gps_dev, &gps_trig,
				gps_trigger_handler);

		if (err) {
			printk("Could not set trigger, error code: %d\n", err);
			return;
		}
	}

	err = gps_sample_fetch(gps_dev);
	__ASSERT(err == 0, "GPS sample could not be fetched.");

	err = gps_channel_get(gps_dev, GPS_CHAN_NMEA, &nmea_data);
	__ASSERT(err == 0, "GPS sample could not be retrieved.");
}

/**@brief Initializes flip detection using orientation detector module
 * and configured accelerometer device.
 */
static void flip_detection_init(void)
{
	struct device *accel_dev =
		device_get_binding(CONFIG_ACCEL_DEV_NAME);

	if (accel_dev == NULL) {
		printk("Could not get %s device\n", CONFIG_ACCEL_DEV_NAME);
		return;
	}

	struct sensor_trigger sensor_trig = {
		.type = SENSOR_TRIG_DATA_READY,
	};

	if (IS_ENABLED(CONFIG_ACCEL_TRIGGER)) {
		int err = 0;

		err = sensor_trigger_set(accel_dev, &sensor_trig,
				sensor_trigger_handler);

		if (err) {
			printk("Could not set trigger, error code: %d\n", err);
			return;
		}
	}

	orientation_detector_init(accel_dev);
}

/**@brief Initializes the sensors that are used by the application. */
static void app_sensors_init(void)
{
	gps_init();
	flip_detection_init();

	gps_cloud_data.type = NRF_CLOUD_SENSOR_GPS;
	gps_cloud_data.tag = 0x1;
	gps_cloud_data.data.ptr = nmea_data.str;
	gps_cloud_data.data.len = nmea_data.len;

	flip_cloud_data.type = NRF_CLOUD_SENSOR_FLIP;
}

/**@brief Initializes buttons and LEDs, using the DK buttons and LEDs
 * library.
 */
static void buttons_leds_init(void)
{
	dk_buttons_and_leds_init(button_handler);
	dk_set_leds_state(0x00, DK_ALL_LEDS_MSK);
}

static void alarm(void)
{
	alarm_pending = true;
}

static void send_aggregated_data(void)
{
	struct sensor_data aggregator_data;

	if (!alarm_pending) {
		return;
	}

	alarm_pending = false;

	printk("flip_alarm triggered.\n");
	while (1) {
		if (aggregator_get(&aggregator_data) == -1) {
			printk("No data in aggregator.\n");
			break;
		}
		switch (aggregator_data.type) {
		case THINGY_ORIENTATION:
			switch (aggregator_data.data[0]) {
			case 0:
				flip_cloud_data.data.ptr = "LEFT";
				flip_cloud_data.data.len = sizeof("LEFT") - 1;
				break;
			case 1:
				flip_cloud_data.data.ptr = "NORMAL";
				flip_cloud_data.data.len = sizeof("NORMAL") - 1;
				break;
			case 2:
				flip_cloud_data.data.ptr = "RIGHT";
				flip_cloud_data.data.len = sizeof("RIGHT") - 1;
				break;
			case 3:
				flip_cloud_data.data.ptr = "UPSIDE_DOWN";
				flip_cloud_data.data.len =
					sizeof("UPSIDE_DOWN") - 1;
				break;
			default:
				printk("Orientation unknown %d\n",
				       aggregator_data.data[0]);
				break;
			}
			sensor_data_send(&flip_cloud_data);
		break;

		case GPS_POSITION:
			printk("Sending GPS data.\n");
			gps_cloud_data_out.type = NRF_CLOUD_SENSOR_GPS;
			gps_cloud_data_out.data.ptr = gps_data_buffer;
			memcpy((void *)gps_cloud_data_out.data.ptr,
				&aggregator_data.data[4],
				aggregator_data.length);
			gps_cloud_data_out.data.len = aggregator_data.length;
			gps_cloud_data_out.tag =
				*((u32_t *)&aggregator_data.data[0]);
			sensor_data_send(&gps_cloud_data_out);
		break;

		default:
			printk("Unsupported data type from aggregator: %d.\n",
			       aggregator_data.type);
			continue;
		}
	}
}

void main(void)
{
	console_init();

	printk("Application started\n");

	buttons_leds_init();
	ble_init(alarm);

	work_init();
	cloud_init();
	modem_configure();
	cloud_connect(NULL);

	while (true) {
		nrf_cloud_process();
		app_process();
		send_aggregated_data();
	}
}
```

## src/aggregator.c
```c
/*
 * Copyright (c) 2018 Nordic Semiconductor ASA
 *
 * SPDX-License-Identifier: LicenseRef-BSD-5-Clause-Nordic
 */
#include "aggregator.h"
#include <kernel.h>
#include <zephyr.h>
#include <stdio.h>
#include <zephyr/types.h>
#include <string.h>
#include <board.h>

K_FIFO_DEFINE(aggregator_fifo);

static u32_t entry_count;

struct fifo_entry {
	void *fifo_reserved;
	u8_t  length;
	u32_t data[ENTRY_MAX_SIZE];
};

int aggregator_put(struct sensor_data in_data)
{
	struct fifo_entry *fifo_data;

	if (entry_count >= FIFO_MAX_ELEMENT_COUNT) {
		aggregator_get(NULL);
	}

	fifo_data = k_malloc(sizeof(struct fifo_entry));
	if (fifo_data == NULL) {
		return -1;
	}
	memcpy(fifo_data->data, &in_data, sizeof(struct sensor_data));
	k_fifo_put(&aggregator_fifo, fifo_data);
	entry_count++;
	printk("Queue size %d\n", entry_count);
	return 0;
}

int aggregator_get(struct sensor_data *out_data)
{
	void *fifo_data;

	if (out_data == NULL) {
		/* If the get function is called with NULL the oldest element
		 * in the FIFO is removed. Useful for making space in the FIFO.
		 */
		fifo_data = k_fifo_get(&aggregator_fifo, K_NO_WAIT);
		entry_count--;
		k_free(fifo_data);
		return 0;
	}

	fifo_data = k_fifo_get(&aggregator_fifo, K_NO_WAIT);
	if (fifo_data == NULL) {
		return -1;
	}

	memcpy(out_data, ((struct fifo_entry *)fifo_data)->data,
	       sizeof(struct sensor_data));
	k_free(fifo_data);
	entry_count--;

	return 0;
}

void aggregator_purge(void)
{
	void *fifo_data = NULL;

	while (1) {
		fifo_data = k_fifo_get(&aggregator_fifo, K_NO_WAIT);
		if (fifo_data == NULL) {
			break;
		}
		k_free(fifo_data);
	};
	k_fifo_init(&aggregator_fifo);
}

int aggregator_element_count_get(void)
{
	return entry_count;
}

void aggregator_process(void)
{
}
```

## src/aggregator.h
```c
/*
 * Copyright (c) 2018 Nordic Semiconductor ASA
 *
 * SPDX-License-Identifier: LicenseRef-BSD-5-Clause-Nordic
 */
/*
 * Simple aggregator module which can have sensordata added and retrieved in a
 * FIFO fashion. The queue allows TLD formated data to be aggregated from
 * sensors in a FIFO fashion. When some event in the future causes data
 * transfer to start, the most recent X datapoints (determined by ENTRY_MAX_SIZE
 * and HEAP_MEM_POOL_SIZE) can be transferred.
 *
 * Note: The module is single instance to allow simple global access to the
 * data.
 */
#include <zephyr/types.h>
#include <gps.h>

/* In this sample the GPS data is 66 byte + a tag, so 70 byte is used. */
#define ENTRY_MAX_SIZE (GPS_NMEA_SENTENCE_MAX_LENGTH + 4)
#define FIFO_MAX_ELEMENT_COUNT 12

enum sensor_data_type { THINGY_ORIENTATION, GPS_POSITION };

struct sensor_data {
	u8_t		      length;
	enum sensor_data_type type;
	u32_t		      data[ENTRY_MAX_SIZE];
};

int aggregator_init(void);

int aggregator_put(struct sensor_data data);

int aggregator_get(struct sensor_data *data);

void aggregator_purge(void);

int aggregator_element_count_get(void);

void aggregator_process(void);
```

## src/ble.c
```c
/*
 * Copyright (c) 2018 Nordic Semiconductor ASA
 *
 * SPDX-License-Identifier: LicenseRef-BSD-5-Clause-Nordic
 */

#include <zephyr.h>

#include <bluetooth/gatt.h>
#include <bluetooth/uuid.h>
#include <bluetooth/common/gatt_dm.h>
#include <bluetooth/common/scan.h>

#include <dk_buttons_and_leds.h>
#include <misc/byteorder.h>

#include <nrf_cloud.h>
#include "aggregator.h"

/* Thinghy advertisement UUID */
#define BT_UUID_THINGY                                                         \
	BT_UUID_DECLARE_128(0x42, 0x00, 0x74, 0xA9, 0xFF, 0x52, 0x10, 0x9B,    \
			    0x33, 0x49, 0x35, 0x9B, 0x00, 0x01, 0x68, 0xEF)

/* Thingy service UUID */
#define BT_UUID_TMS                                                            \
	BT_UUID_DECLARE_128(0x42, 0x00, 0x74, 0xA9, 0xFF, 0x52, 0x10, 0x9B,    \
			    0x33, 0x49, 0x35, 0x9B, 0x00, 0x04, 0x68, 0xEF)

/* Thingy characteristic UUID */
#define BT_UUID_TOC                                                            \
	BT_UUID_DECLARE_128(0x42, 0x00, 0x74, 0xA9, 0xFF, 0x52, 0x10, 0x9B,    \
			    0x33, 0x49, 0x35, 0x9B, 0x03, 0x04, 0x68, 0xEF)

typedef void (*alarm_cb)();
alarm_cb alarm;

static u8_t on_received(struct bt_conn *conn,
			struct bt_gatt_subscribe_params *params,
			const void *data, u16_t length)
{
	if (length > 0) {
		printk("Orientation: %x\n", ((u8_t *)data)[0]);
		struct sensor_data in_data;

		in_data.type = THINGY_ORIENTATION;
		in_data.length = 1;
		in_data.data[0] = ((u8_t *)data)[0];

		if (aggregator_put(in_data) != 0) {
			aggregator_get(NULL);
			if (aggregator_put(in_data) != 0) {
				printk("put error.\n");
			}
		}
		/* If the thingy is upside down, trigger an alarm. */
		if (((u8_t *)data)[0] == 3) {
			alarm();
		}

	} else {
		printk("Orientation notification with 0 length\n");
	}
	return BT_GATT_ITER_CONTINUE;
}

static void discovery_completed(struct bt_conn *conn,
				   const struct bt_gatt_attr *attrs,
				   size_t attrs_len)
{
	int err;
	static struct bt_gatt_subscribe_params param = {
		.notify = on_received,
		.value = BT_GATT_CCC_NOTIFY,
	};

	printk("GATT discovery completed\n");

	for (size_t i = 0; i < attrs_len - 1; i++) {
		if (!bt_uuid_cmp(attrs[i].uuid, BT_UUID_TOC)) {
			param.value_handle = attrs[i].handle;
			if (!bt_uuid_cmp(attrs[i + 1].uuid, BT_UUID_GATT_CCC)) {
				param.ccc_handle = attrs[i + 1].handle;
				break;
			}
		}
	}

	if (param.value_handle == 0 && param.ccc_handle == 0) {
		printk("Could not find char handles.\n");
		goto release;
	}

	err = bt_gatt_subscribe(conn, &param);
	if (err) {
		printk("Subscribe failed (err %d)", err);
	}

release:
	err = bt_gatt_dm_data_release();
	if (err) {
		printk("Could not release discovery data, err: %d\n", err);
	}
}

static void discovery_service_not_found(struct bt_conn *conn)
{
	printk("Thing orientation service not found!\n");
}

static void discovery_error_found(struct bt_conn *conn, int err)
{
	printk("The discovery procedure failed, err %d\n", err);
}

static struct bt_gatt_dm_cb discovery_cb = {
	.completed = discovery_completed,
	.service_not_found = discovery_service_not_found,
	.error_found = discovery_error_found,
};

static void connected(struct bt_conn *conn, u8_t conn_err)
{
	int err;
	char addr[BT_ADDR_LE_STR_LEN];

	bt_addr_le_to_str(bt_conn_get_dst(conn), addr, sizeof(addr));

	if (conn_err) {
		printk("Failed to connect to %s (%u)\n", addr, conn_err);
		return;
	}

	printk("Connected: %s\n", addr);

	err = bt_gatt_dm_start(conn, BT_UUID_TMS, &discovery_cb);
	if (err) {
		printk("Could not start service discovery, err %d\n", err);
	}
}

static struct bt_conn_cb conn_callbacks = {
	.connected = connected,
};

void scan_filter_match(struct bt_scan_device_info *device_info,
		       struct bt_scan_filter_match *filter_match,
		       bool connectable)
{
	char addr[BT_ADDR_LE_STR_LEN];

	bt_addr_le_to_str(device_info->addr, addr, sizeof(addr));

	printk("Device found: %s\n", addr);
}

void scan_connecting_error(struct bt_scan_device_info *device_info)
{
	printk("Connection to peer failed!\n");
}

static struct bt_scan_cb scan_cb = {
	.filter_match = scan_filter_match,
	.connecting_error = scan_connecting_error,
};

static void scan_start(void)
{
	int err;

	struct bt_le_scan_param scan_param = {
		.type = BT_HCI_LE_SCAN_ACTIVE,
		.filter_dup = BT_HCI_LE_SCAN_FILTER_DUP_ENABLE,
		.interval = 0x0010,
		.window = 0x0010,
	};

	struct bt_scan_init_param scan_init = {
		.connect_if_match = 1,
		.scan_param = &scan_param,
		.conn_param = BT_LE_CONN_PARAM_DEFAULT,
	};

	bt_scan_init(&scan_init);
	bt_scan_cb_register(&scan_cb);

	err = bt_scan_filter_add(BT_SCAN_FILTER_TYPE_UUID, BT_UUID_THINGY);
	if (err) {
		printk("Scanning filters cannot be set\n");
		return;
	}

	err = bt_scan_filter_enable(BT_SCAN_UUID_FILTER, false);
	if (err) {
		printk("Filters cannot be turned on\n");
	}

	err = bt_scan_start(BT_SCAN_TYPE_SCAN_ACTIVE);
	if (err) {
		printk("Scanning failed to start, err %d\n", err);
	}

	printk("Scanning...\n");
}

void ble_init(void (*alarm_func))
{
	int err;

	alarm = alarm_func;

	err = bt_enable(NULL);
	if (err) {
		printk("Bluetooth init failed (err %d)\n", err);
		return;
	}

	printk("Bluetooth initialized\n");

	bt_conn_cb_register(&conn_callbacks);
	scan_start();
}
```

## src/ble.h
```c
/*
 * Copyright (c) 2018 Nordic Semiconductor ASA
 *
 * SPDX-License-Identifier: LicenseRef-BSD-5-Clause-Nordic
 */

void ble_init(void (*alarm)());
```
