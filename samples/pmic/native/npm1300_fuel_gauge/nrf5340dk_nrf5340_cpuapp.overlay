/*
 * Copyright (c) 2023 Nordic Semiconductor ASA
 *
 * SPDX-License-Identifier: LicenseRef-Nordic-5-Clause
 */

&i2c1_default {
	group1 {
		bias-pull-up;
	};
};

&npm1300_ek_pmic {
	host-int-gpios = <&gpio1 12 0>;
	pmic-int-pin = <3>;
};
