/*
 * Copyright (c) 2023 Nordic Semiconductor ASA
 *
 * SPDX-License-Identifier: LicenseRef-Nordic-5-Clause
 */

#include <dt-bindings/regulator/npm1300.h>

&i2c0_default {
	group1 {
		bias-pull-up;
	};
};

&npm1300_ek_ldo1 {
	regulator-initial-mode = <NPM1300_LDSW_MODE_LDSW>;
};

&npm1300_ek_pmic {
	host-int-gpios = <&gpio0 22 0>;
	pmic-int-pin = <3>;
};
