/*
 * Copyright (c) 2023 Nordic Semiconductor ASA
 *
 * SPDX-License-Identifier: LicenseRef-Nordic-5-Clause
 */

#include <dt-bindings/regulator/npm13xx.h>

&i2c1_default {
	group1 {
		bias-pull-up;
	};
};

&npm1300_ek_ldo1 {
	regulator-initial-mode = <NPM13XX_LDSW_MODE_LDSW>;
};

&npm1300_ek_pmic {
	host-int-gpios = <&gpio1 12 0>;
	pmic-int-pin = <3>;
};
