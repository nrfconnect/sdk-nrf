/*
 * Copyright (c) 2025 Nordic Semiconductor ASA
 *
 * SPDX-License-Identifier: LicenseRef-Nordic-5-Clause
 */

#include <dt-bindings/regulator/npm2100.h>

&i2c1_default {
	group1 {
		bias-pull-up;
	};
};

&arduino_i2c {
	#include "npm2100_pmic.dtsi"
};

&npm2100_pmic {
	host-int-gpios = <&gpio1 12 GPIO_ACTIVE_HIGH>;
};
