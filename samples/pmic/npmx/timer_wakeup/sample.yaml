## samples/pmic/npmx/timer_wakeup/sample.yaml
```yaml
sample:
  description: Sample for nPM1300 PMIC TIMER used as wake up timer
  name: nPM1300 PMIC TIMER wake up

common:
  integration_platforms:
    - nrf5340dk_nrf5340_cpuapp
    - nrf52840dk_nrf52840
  platform_allow: nrf5340dk_nrf5340_cpuapp nrf52840dk_nrf52840
  tags: pmic

tests:
  sample.pmic.timer_wakeup_simple_eng_b:
    extra_args: CONFIG_NPMX_DEVICE_NPM1300_ENG_B=y
    timeout: 30
    harness: console
    harness_config:
      fixture: nPM1300_setup_eng_b
      type: multi_line
      ordered: true
      regex:
        - "PMIC device ok"

  sample.pmic.timer_wakeup_advanced_eng_b:
    extra_args: CONFIG_NPMX_DEVICE_NPM1300_ENG_B=y
    harness: console
    harness_config:
      fixture: nPM1300_setup_and_manual_action_eng_b
      type: multi_line
      ordered: true
      regex:
        - "PMIC device ok"
        - "Enter hibernate mode"
        - "LED turned on, elapsed time: 80[0-9]{2} ms"
```

## samples/pmic/npmx/vbusin/sample.yaml
```yaml
sample:
  description: Sample for nPM1300 PMIC VBUSIN
  name: nPM1300 PMIC VBUSIN

common:
  integration_platforms:
    - nrf5340dk_nrf5340_cpuapp
    - nrf52840dk_nrf52840
  platform_allow: nrf5340dk_nrf5340_cpuapp nrf52840dk_nrf52840
  tags: pmic
  timeout: 30

tests:
  sample.pmic.vbusin_eng_b:
    extra_args: CONFIG_NPMX_DEVICE_NPM1300_ENG_B=y
    harness: console
    harness_config:
      fixture: nPM1300_setup_eng_b
      type: multi_line
      ordered: true
      regex:
        - "PMIC device ok"
        - "VBUSIN initialized"
```

## samples/pmic/npmx/watchdog/Kconfig
```kconfig
#
# Copyright (c) 2022 Nordic Semiconductor ASA
#
# SPDX-License-Identifier: LicenseRef-Nordic-5-Clause
#

mainmenu "PMIC example: Watchdog"

choice
	bool "Watchdog mode selection"

config TESTCASE_WATCHDOG_MODE_WARNING
	bool "Set watchdog to warning mode"

config TESTCASE_WATCHDOG_MODE_RESET
	bool "Set watchdog to reset mode"

endchoice

source "Kconfig.zephyr"
```

## samples/pmic/npmx/watchdog/sample.yaml
```yaml
sample:
  description: Sample for nPM1300 PMIC TIMER WATCHDOG
  name: nPM1300 PMIC TIMER WATCHDOG

common:
  integration_platforms:
    - nrf5340dk_nrf5340_cpuapp
    - nrf52840dk_nrf52840
  platform_allow: nrf5340dk_nrf5340_cpuapp nrf52840dk_nrf52840
  tags: pmic

tests:
  sample.pmic.timer_watchdog_simple_eng_b:
    extra_args: CONFIG_NPMX_DEVICE_NPM1300_ENG_B=y
    timeout: 30
    harness: console
    harness_config:
      fixture: nPM1300_setup_eng_b
      type: multi_line
      ordered: true
      regex:
        - "PMIC device ok"
        - "Watchdog is being kicked, press any key to stop it."

  sample.pmic.timer_watchdog_advanced_eng_b:
    extra_args: CONFIG_NPMX_DEVICE_NPM1300_ENG_B=y
    harness: console
    harness_config:
      fixture: nPM1300_setup_and_manual_action_eng_b
      type: multi_line
      ordered: true
      regex:
        - "PMIC device ok"
        - "Watchdog is being kicked, press any key to stop it."
        - "Kicking stopped!"
        - "Wait for watchdog warning interrupt."
        - "Watchdog warning callback"
        - "Warning after ([0-9]{3}) ms"
        - "SHIPHOLD"
        - "Watchdog Timeout Warn"
        - "Reset after ([0-9]{2}) ms"
```

## samples/profiler/sample.yaml
```yaml
sample:
  description: Sample showing Profiler usage
  name: Profiler sample
tests:
  samples.profiler:
    build_only: true
    platform_exclude: native_posix qemu_x86 qemu_cortex_m3
    integration_platforms:
      - nrf52dk_nrf52832
      - nrf52840dk_nrf52840
      - nrf9160dk_nrf9160_ns
    tags: ci_build
```

## samples/pulse_width_measurement/sample.yaml
```yaml
sample:
  description: Pulse width measurement sample application
  name: Pulse width measurement
common:
  tags: ci_samples_nrf_pulse_meas
  integration_platforms:
    - nrf54l15dk/nrf54l15/cpuapp
  platform_allow:
    - nrf54l15dk/nrf54l15/cpuapp
  harness: console
  harness_config:
    type: one_line
    regex:
      - "Test finished (.*)"
tests:
  sample.pulse_width_measurement:
    tags: ci_samples_nrf_pulse_meas
```

## samples/rt_framework/Kconfig
```kconfig
#
# Copyright (c) 2026 Nordic Semiconductor
#
# SPDX-License-Identifier: LicenseRef-Nordic-5-Clause
#

mainmenu "App-domain RT framework"

config RT_FW_MIN_PERIOD_US
	int "Minimum accepted RT toggle period (us)"
	default 10
	help
	  Lower bound for rt_fw_set_period_us(). Periods below this are rejected
	  rather than clamped. Guards against configuring an extremely high RT
	  tick rate that would saturate the CPU (and, on SoCs where MPSL shares
	  the application core, interfere with radio timing).

config RT_FW_MAX_PERIOD_US
	int "Maximum accepted RT toggle period (us)"
	default 1000000
	help
	  Upper bound for rt_fw_set_period_us(). The RT period is also the
	  control-plane polling interval, so this bounds the worst-case latency
	  of a subsequent stop/reconfigure command to one period.

config RT_FW_EGU_IRQ_PRIO
	int "EGU (data-plane) interrupt priority"
	depends on RT_FW_DATA_PLANE
	default 5
	help
	  Zephyr (non-ZLI) interrupt priority for the EGU interrupt that drains
	  the RT -> Zephyr event ring. Must stay below the ZLI level and is
	  SoC/board dependent. Override it per target if needed.

config RT_FW_DATA_PLANE
	bool "Enable RT -> Zephyr data plane (EGU + event ring)"
	default n
	help
	  When enabled, the RT component pushes events into a single-producer /
	  single-consumer ring in shared RAM and triggers EGU. The EGU interrupt
	  runs at a normal (non-ZLI) Zephyr priority and schedules a work item
	  that drains the ring. Demonstrates the RT -> Zephyr notification path
	  without using Zephyr primitives in the timing-critical path.

config RT_FW_SHARED_DMA_VISIBLE
	bool "Keep the RT event buffer cache-coherent for a DMA/other-master observer"
	depends on RT_FW_DATA_PLANE
	default n
	help
	  Opt-in for the case where the unidirectional RT->Zephyr event payload is
	  also observed by another bus master (a DMA engine or another core),
	  rather than only by the Zephyr threads on the application core.

	  When enabled, the event entries are aligned and padded to whole data
	  cache line(s) and rt_shared.h performs explicit cache maintenance:
	  sys_cache_data_flush_range() after the producer writes an entry and
	  sys_cache_data_invd_range() before the consumer reads it. This is the
	  same cache-maintenance pattern Zephyr's DMM uses for DMA buffers and
	  keeps the buffer coherent without placing it in non-cacheable memory.

	  This option only handles cache coherency. Exposing the buffer to a real
	  external master additionally requires mapping/placing it into that
	  master's address view, e.g. via a devicetree "zephyr,memory-region" with
	  ATTR_MPU_RAM_NOCACHE (board-specific). See the sample README.

	  Leave this disabled for the default app-core ISR <-> thread model: the
	  shared data cache is self-coherent there and ordering barriers alone are
	  sufficient, even on cached SoCs such as nRF54H20. Note that the cache
	  maintenance runs inside the ZLI, so it adds to the RT ISR time budget and
	  is not part of the minimal BLE-coexistence fast path.

config RT_FW_ISR_TEST_LOAD
	bool "Inject an artificial busy-loop load into the RT ZLI ISR"
	default n
	help
	  Adds a controlled busy-loop to the RT zero-latency ISR. Used to study
	  how a longer RT ISR affects BLE timing and to establish the RT ISR time
	  budget. This matters most on SoCs where MPSL/radio ISRs share the
	  application core (e.g. nRF54L), where the ZLI runs at the same NVIC
	  priority as the radio ISRs.

config RT_FW_ISR_TEST_LOAD_CYCLES
	int "Number of NOP iterations for the RT ISR test load"
	depends on RT_FW_ISR_TEST_LOAD
	default 100
	help
	  Number of NOP iterations executed inside the RT ZLI ISR when
	  RT_FW_ISR_TEST_LOAD is enabled.

config RT_FW_DEBUG_PIN
	bool "Drive a debug GPIO high for the duration of the RT ISR"
	default n
	help
	  Drives a second RT-owned GPIO high on ISR entry and low on ISR exit,
	  so the RT ISR execution time can be measured directly with a logic
	  analyzer or oscilloscope.

source "Kconfig.zephyr"
```

## samples/rt_framework/boards/nrf54h20dk_nrf54h20_cpuapp.conf
```kconfig
#
# Copyright (c) 2026 Nordic Semiconductor
#
# SPDX-License-Identifier: LicenseRef-Nordic-5-Clause
#
# On nRF54H20 the Bluetooth controller runs on the radio core. This sample is a
# single application-core image, so the optional BLE coexistence load is
# disabled here. The RT mechanism (timer + ZLI + GPIO + control/data plane) is
# exercised on its own. The coexistence scenario is demonstrated on the nRF54L
# target where MPSL shares the application core.
#
CONFIG_BT=n
CONFIG_BT_PERIPHERAL=n
CONFIG_BT_LBS=n
```

## samples/rt_framework/sample.yaml
```yaml
sample:
  description: App-domain real-time framework (TIMER + ZLI + GPIO + control plane)
  name: App-domain RT framework

tests:
  # nRF54L: single-core SoC, MPSL shares the application core. BLE runs as the
  # coexistence load.
  sample.rt_framework:
    sysbuild: false
    build_only: true
    tags:
      - bluetooth
    platform_allow:
      - nrf54lm20dk/nrf54lm20b/cpuapp
    integration_platforms:
      - nrf54lm20dk/nrf54lm20b/cpuapp

  sample.rt_framework.data_plane:
    sysbuild: false
    build_only: true
    tags:
      - bluetooth
    platform_allow:
      - nrf54lm20dk/nrf54lm20b/cpuapp
    integration_platforms:
      - nrf54lm20dk/nrf54lm20b/cpuapp
    extra_configs:
      - CONFIG_RT_FW_DATA_PLANE=y

  # nRF54H20: multi-core SoC with a managed data cache. The RT component still
  # runs only on the application core. The radio/MPSL live on the radio core, so
  # the BLE coexistence load is not built here (single app-core image).
  sample.rt_framework.nrf54h20:
    sysbuild: true
    build_only: true
    platform_allow:
      - nrf54h20dk/nrf54h20/cpuapp
    integration_platforms:
      - nrf54h20dk/nrf54h20/cpuapp

  sample.rt_framework.nrf54h20.data_plane:
    sysbuild: true
    build_only: true
    platform_allow:
      - nrf54h20dk/nrf54h20/cpuapp
    integration_platforms:
      - nrf54h20dk/nrf54h20/cpuapp
    extra_configs:
      - CONFIG_RT_FW_DATA_PLANE=y

  # Build coverage for the explicit cache-maintenance path (sys_cache_*) on a
  # target that has a data cache. Verifies the code and the cache-line
  # alignment asserts compile. Actual cross-master visibility additionally
  # needs board-specific memory placement (see README).
  sample.rt_framework.nrf54h20.dma_visible:
    sysbuild: true
    build_only: true
    platform_allow:
      - nrf54h20dk/nrf54h20/cpuapp
    integration_platforms:
      - nrf54h20dk/nrf54h20/cpuapp
    extra_configs:
      - CONFIG_RT_FW_DATA_PLANE=y
      - CONFIG_RT_FW_SHARED_DMA_VISIBLE=y
```

## samples/sdfw/ssf_client/Kconfig
```kconfig
#
# Copyright (c) 2024 Nordic Semiconductor ASA
#
# SPDX-License-Identifier: LicenseRef-Nordic-5-Clause
#

menuconfig SSF_CLIENT_SAMPLE
	bool "SDFW Service Framework Client Sample"
	help
	   "Enable sample-specific configurations."

if SSF_CLIENT_SAMPLE

config ENABLE_ECHO_REQUEST
	bool "Enable SSF dummy request service(s)"
	depends on SSF_ECHO_SERVICE_ENABLED
	default y

config ENABLE_RESET_EVT_SUBSCRIBE_REQUEST
	bool "Enable the reset event subscription service"
	depends on SSF_RESET_EVT_SERVICE_ENABLED
	default y

module = SSF_CLIENT_SAMPLE
module-str = SSF Client Sample
source "${ZEPHYR_BASE}/subsys/logging/Kconfig.template.log_config"

endif # SSF_CLIENT_SAMPLE

source "Kconfig.zephyr"
```

## samples/sdfw/ssf_client/Kconfig.sysbuild
```kconfig
#
# Copyright (c) 2024 Nordic Semiconductor
#
# SPDX-License-Identifier: LicenseRef-Nordic-5-Clause
#

source "${ZEPHYR_BASE}/share/sysbuild/Kconfig"

config BUILD_ALSO_FOR_RADIO_CORE
	bool "Build also for the radio CPU"

config RADIO_BOARD_TARGET_CPUCLUSTER
	string
	depends on BUILD_ALSO_FOR_RADIO_CORE
	default "cpurad" if SOC_NRF54H20_CPUAPP || SOC_NRF9280_CPUAPP
```

## samples/sdfw/ssf_client/sample.yaml
```yaml
sample:
  name: SSF Client Sample
  description: |
    Sample demonstrating how to build application with sdfw service framework
    enabled and how to request services from secure domain.

common:
  build_only: true
  tags: ci_build ci_samples_sdfw

tests:
  samples.sdfw.ssf_client:
    sysbuild: true
    tags: sysbuild ci_samples_sdfw
    platform_allow:
      - nrf54h20dk/nrf54h20/cpuapp
      - nrf54h20dk/nrf54h20/cpurad
      - nrf9280pdk/nrf9280/cpuapp
      - nrf9280pdk/nrf9280/cpurad
    integration_platforms:
      - nrf54h20dk/nrf54h20/cpuapp
      - nrf54h20dk/nrf54h20/cpurad
      - nrf9280pdk/nrf9280/cpuapp
      - nrf9280pdk/nrf9280/cpurad

  samples.sdfw.ssf_client.multi_cpu:
    tags: ci_build ci_samples_sdfw sysbuild
    sysbuild: true
    platform_allow:
      - nrf54h20dk/nrf54h20/cpuapp
      - nrf9280pdk/nrf9280/cpuapp
    integration_platforms:
      - nrf54h20dk/nrf54h20/cpuapp
      - nrf9280pdk/nrf9280/cpuapp
    extra_args:
      SB_CONFIG_BUILD_ALSO_FOR_RADIO_CORE=y
```

## samples/sensor/bh1749/sample.yaml
```yaml
sample:
  name: BH1749 Sensor Sample
tests:
  sample.sensor.bh1749:
    sysbuild: true
    depends_on: i2c
    harness: sensor
    integration_platforms:
      - thingy91/nrf9160
    platform_allow: thingy91/nrf9160
    tags: sensors sysbuild
```

## samples/sensor/bme68x_iaq/Kconfig
```kconfig
#
# Copyright (c) 2023 Nordic Semiconductor
#
# SPDX-License-Identifier: LicenseRef-Nordic-5-Clause
#

menu "Zephyr"
source "Kconfig.zephyr"
endmenu

config APP_TRIGGER
	bool "Print sensor values on trigger"
	default y

module = APP
module-str = APP
source "subsys/logging/Kconfig.template.log_config"
```

## samples/sensor/bme68x_iaq/Kconfig.sysbuild
```kconfig
#
# Copyright (c) 2025 Nordic Semiconductor ASA
#
# SPDX-License-Identifier: LicenseRef-Nordic-5-Clause
#

config PARTITION_MANAGER
	default y if BOARD_THINGY53

source "share/sysbuild/Kconfig"
```

## samples/sensor/bme68x_iaq/sample.yaml
```yaml
sample:
  name: BME68X Sensor Sample
tests:
  sample.sensor.bme68x.i2c:
    sysbuild: true
    depends_on: i2c
    harness: sensor
    integration_platforms:
      - thingy91/nrf9160
      - thingy91/nrf9160/ns
      - thingy53/nrf5340/cpuapp
      - thingy53/nrf5340/cpuapp/ns
    platform_allow: >-
      thingy91/nrf9160
      thingy91/nrf9160/ns
      thingy53/nrf5340/cpuapp
      thingy53/nrf5340/cpuapp/ns
    tags: sensors sysbuild
  sample.sensor.bme68x.polling:
    sysbuild: true
    depends_on: i2c
    integration_platforms:
      - thingy91/nrf9160
      - thingy91/nrf9160/ns
      - thingy53/nrf5340/cpuapp
      - thingy53/nrf5340/cpuapp/ns
    extra_args: CONFIG_APP_TRIGGER=n
    platform_allow: >-
      thingy91/nrf9160
      thingy91/nrf9160/ns
      thingy53/nrf5340/cpuapp
      thingy53/nrf5340/cpuapp/ns
    tags: sensors sysbuild
    harness: console
    harness_config:
      type: multi_line
      ordered: true
      regex:
        - "(\\d+\\.\\d+); press: (\\d+\\.\\d+); humidity: (\\d+\\.\\d+); iaq: (\\d+)"
  sample.sensor.bme68x.spi:
    sysbuild: true
    depends_on: spi
    harness: sensor
    platform_allow: >-
      nrf9160dk/nrf9160/ns
    tags: sensors sysbuild
```

## samples/serialization/entropy_nrf53/cpuapp/sample.yaml
```yaml
sample:
  name: Entropy remote application core
  description: Entropy driver application core sample
tests:
  test_build:
    build_only: true
    build_on_all: true
    platform_whitelist: nrf5340_dk_nrf5340_cpuapp
```

## samples/serialization/entropy_nrf53/cpunet/sample.yaml
```yaml
sample:
  name: Entropy remote network core
  description: Entropy remote network core sample
tests:
  test_build:
    build_only: true
    build_on_all: true
    platform_whitelist: nrf5340_dk_nrf5340_cpunet
```
