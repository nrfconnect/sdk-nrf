## samples/smp_svr/sample.yaml
```yaml
sample:
  name: smp_svr example
tests:
  sample.smp_svr:
    tags: introduction
    platform_allow: >
      nrf54l15pdk_nrf54l15_cpuapp
    harness: console
    harness_config:
      type: multi_line
      regex:
        - ".*smp_sample.*"
    integration_platforms:
      - nrf54l15pdk_nrf54l15_cpuapp
  # Build integration regression protection.
```

## samples/spm/sample.yaml
```yaml
sample:
  name: spm Sample
tests:
  sample.spm:
    build_only: true
    integration_platforms:
      - nrf5340dk_nrf5340_cpuapp
      - nrf9160dk_nrf9160
    platform_allow: nrf5340dk_nrf5340_cpuapp nrf9160dk_nrf9160
    tags: ci_build
  sample.spm_shared_uart:
    build_only: true
    extra_args: DTC_OVERLAY_FILE="spm_uart.overlay"
    extra_configs:
      - CONFIG_SPM_SHARE_CONSOLE_UART=y
    integration_platforms:
      - nrf5340dk_nrf5340_cpuapp
      - nrf9160dk_nrf9160
    platform_allow: nrf5340dk_nrf5340_cpuapp nrf9160dk_nrf9160
    tags: ci_build
```

## samples/suit/ab/Kconfig
```kconfig
#
# Copyright (c) 2025 Nordic Semiconductor ASA
#
# SPDX-License-Identifier: LicenseRef-Nordic-5-Clause
#

config N_BLINKS
	int "Number of fast blinks"
	default 1

config ID_VAR_BOOT_STATUS
	int "Id of Manfiest-controlled variable representing a boot status"
	default 256

config ID_VAR_BOOT_PREFERENCE
	int "Id of Manfiest-controlled variable representing a boot prefrence"
	default 0

config ID_VAR_SET_TO_UPDATE
	int "Id of Manfiest-controlled variable representing image set to be updated"
	default 1

config ID_VAR_CONFIRM_SET_A
	int "Id of Manfiest-controlled variable representing after-update confirmation state for image set A"
	default 2

config ID_VAR_CONFIRM_SET_B
	int "Id of Manfiest-controlled variable representing after-update confirmation state for image set B"
	default 3

config EMULATE_APP_HEALTH_CHECK_FAILURE
	bool "Blocks confirmation of being healthy after the update"

source "Kconfig.zephyr"
```

## samples/suit/ab/sample.yaml
```yaml
#
# Copyright (c) 2025 Nordic Semiconductor ASA
#
# SPDX-License-Identifier: LicenseRef-Nordic-5-Clause
#

sample:
  name: SUIT A/B update through SMP sample
  description: Sample application that A/B updates firmware using SUIT and SMP protocol
common:
  platform_allow: nrf54h20dk/nrf54h20/cpuapp
  build_only: true
  sysbuild: true
tests:
  sample.suit.ab:
    extra_args:
    - SB_EXTRA_CONF_FILE="suit_mpi.conf"
    tags:
    - suit
    - bluetooth
    - ci_samples_suit
```

## samples/suit/recovery/Kconfig
```kconfig
#
# Copyright (c) 2024 Nordic Semiconductor ASA
#
# SPDX-License-Identifier: LicenseRef-Nordic-5-Clause
#

config SUIT_RECOVERY_EXTMEM
	bool "External memory support for recovery application"
	depends on $(dt_chosen_enabled,extmem-device)
	default y
	select GPIO

if SUIT_RECOVERY_EXTMEM

choice SUIT_DFU_CANDIDATE_PROCESSING_LEVEL
	default SUIT_DFU_CANDIDATE_PROCESSING_PUSH_TO_CACHE

endchoice # SUIT_APP_ENVELOPE_PROCESSING_LEVEL

endif # SUIT_RECOVERY_EXTMEM

source "Kconfig.zephyr"
```

## samples/suit/smp_transfer/Kconfig
```kconfig
#
# Copyright (c) 2023 Nordic Semiconductor ASA
#
# SPDX-License-Identifier: LicenseRef-Nordic-5-Clause
#

config N_BLINKS
	int "Number of fast blinks"
	default 1

source "Kconfig.zephyr"
```

## samples/suit/smp_transfer/sample.yaml
```yaml
#
# Copyright (c) 2023 Nordic Semiconductor ASA
#
# SPDX-License-Identifier: LicenseRef-Nordic-5-Clause
#

sample:
  name: SUIT update through SMP sample
  description: Sample application that updates firmware using SUIT and SMP protocol
common:
  platform_allow: nrf54h20dk/nrf54h20/cpuapp
  build_only: true
  sysbuild: true
tests:
  sample.suit.smp_transfer:
    tags: suit ci_samples_suit

  sample.suit.smp_transfer.bt:
    extra_args:
      - FILE_SUFFIX=bt
    tags: suit bluetooth ci_samples_suit

  sample.suit.smp_transfer.full_processing:
    extra_configs:
      - CONFIG_SUIT_DFU_CANDIDATE_PROCESSING_FULL=y
    tags: suit ci_samples_suit

  sample.suit.smp_transfer.full_processing.bt:
    extra_args:
      - FILE_SUFFIX=bt
    extra_configs:
      - CONFIG_SUIT_DFU_CANDIDATE_PROCESSING_FULL=y
    tags: suit bluetooth ci_samples_suit

  sample.suit.smp_transfer.full_processing.extflash:
    extra_args:
      - EXTRA_DTC_OVERLAY_FILE="boards/nrf54h20dk_nrf54h20_cpuapp_extflash.overlay"
      - SB_CONFIG_SUIT_BUILD_FLASH_COMPANION=y
      # Workaround for sample.yaml - problems with strings. In the command line simply use:
      # -D'SB_CONFIG_SUIT_ENVELOPE_ROOT_TEMPLATE_FILENAME="root_with_binary_nordic_top_extflash.yaml.jinja2"'
      - SB_EXTRA_CONF_FILE="sysbuild_extflash_template.conf"
    extra_configs:
      - CONFIG_SUIT_ENVELOPE_TEMPLATE_FILENAME="app_envelope_extflash.yaml.jinja2"
      - CONFIG_SUIT_STREAM_SOURCE_FLASH=y
      - CONFIG_SUIT_DFU_CANDIDATE_PROCESSING_FULL=y
    tags: suit ci_samples_suit

  sample.suit.smp_transfer.recovery:
    extra_args:
      - FILE_SUFFIX=bt
      - SB_CONFIG_SUIT_BUILD_RECOVERY=y
    tags: suit bluetooth ci_samples_suit

  sample.suit.smp_transfer.full_processing.extflash.bt:
    extra_args:
      - FILE_SUFFIX=bt
      - EXTRA_DTC_OVERLAY_FILE="boards/nrf54h20dk_nrf54h20_cpuapp_extflash.overlay"
      - SB_CONFIG_SUIT_BUILD_FLASH_COMPANION=y
      # Workaround for sample.yaml - problems with strings. In the command line simply use:
      # -D'SB_CONFIG_SUIT_ENVELOPE_ROOT_TEMPLATE_FILENAME="root_with_binary_nordic_top_extflash.yaml.jinja2"'
      - SB_EXTRA_CONF_FILE="sysbuild_extflash_template.conf"
      # Workaround for sample.yaml (part also in sysbuild.cmake), in the command line simply use:
      # -D'hci_ipc_CONFIG_SUIT_ENVELOPE_TEMPLATE_FILENAME="rad_envelope_extflash.yaml.jinja2"'
      - hci_ipc_TARGET_EXTRA_CONF_FILE="sysbuild/hci_ipc_extflash_template.conf"
    extra_configs:
      - CONFIG_SUIT_ENVELOPE_TEMPLATE_FILENAME="app_envelope_extflash.yaml.jinja2"
      - CONFIG_SUIT_STREAM_SOURCE_FLASH=y
      - CONFIG_SUIT_DFU_CANDIDATE_PROCESSING_FULL=y
    tags: suit bluetooth ci_samples_suit

  sample.suit.smp_transfer.cache_push.extflash:
    extra_args:
      - EXTRA_DTC_OVERLAY_FILE="boards/nrf54h20dk_nrf54h20_cpuapp_extflash.overlay"
      - SUIT_DFU_CACHE_PARTITION_1_EB_SIZE=4096
      - SB_CONFIG_SUIT_BUILD_FLASH_COMPANION=y
      # Workaround for sample.yaml - problems with strings. In the command line simply use:
      # -D'SB_CONFIG_SUIT_ENVELOPE_ROOT_TEMPLATE_FILENAME="root_with_binary_nordic_top_extflash.yaml.jinja2"'
      - SB_EXTRA_CONF_FILE="sysbuild_extflash_template.conf"
    extra_configs:
      - CONFIG_SUIT_ENVELOPE_TEMPLATE_FILENAME="app_envelope_extflash.yaml.jinja2"
      - CONFIG_SUIT_DFU_CACHE_EXTRACT_IMAGE=y
      - CONFIG_SUIT_DFU_CANDIDATE_PROCESSING_PUSH_TO_CACHE=y
    tags: suit ci_samples_suit

  sample.suit.smp_transfer.cache_push.extflash.bt:
    extra_args:
      - FILE_SUFFIX=bt
      - EXTRA_DTC_OVERLAY_FILE="boards/nrf54h20dk_nrf54h20_cpuapp_extflash.overlay"
      - SUIT_DFU_CACHE_PARTITION_1_EB_SIZE=4096
      - SB_CONFIG_SUIT_BUILD_FLASH_COMPANION=y
      # Workaround for sample.yaml - problems with strings. In the command line simply use:
      # -D'SB_CONFIG_SUIT_ENVELOPE_ROOT_TEMPLATE_FILENAME="root_with_binary_nordic_top_extflash.yaml.jinja2"'
      - SB_EXTRA_CONF_FILE="sysbuild_extflash_template.conf"
      # Workaround for sample.yaml (part also in sysbuild.cmake), in the command line simply use:
      # -D'hci_ipc_CONFIG_SUIT_ENVELOPE_TEMPLATE_FILENAME="rad_envelope_extflash.yaml.jinja2"'
      - hci_ipc_TARGET_EXTRA_CONF_FILE="sysbuild/hci_ipc_extflash_template.conf"
      - hci_ipc_CONFIG_SUIT_DFU_CACHE_EXTRACT_IMAGE=y
    extra_configs:
      - CONFIG_SUIT_ENVELOPE_TEMPLATE_FILENAME="app_envelope_extflash.yaml.jinja2"
      - CONFIG_SUIT_DFU_CACHE_EXTRACT_IMAGE=y
      - CONFIG_SUIT_DFU_CANDIDATE_PROCESSING_PUSH_TO_CACHE=y

    tags: suit bluetooth ci_samples_suit
```
