## samples/cellular/gnss/Kconfig
```kconfig
#
# Copyright (c) 2020 Nordic Semiconductor ASA
#
# SPDX-License-Identifier: LicenseRef-Nordic-5-Clause
#

menu "GNSS sample"

choice
	default GNSS_SAMPLE_MODE_CONTINUOUS
	prompt "Select GNSS operation mode"

config GNSS_SAMPLE_MODE_CONTINUOUS
	bool "Continuous tracking"

config GNSS_SAMPLE_MODE_PERIODIC
	bool "Periodic fixes"

config GNSS_SAMPLE_MODE_TTFF_TEST
	bool "Time-to-first-fix (TTFF) test mode"
	select GNSS_SAMPLE_NMEA_ONLY

endchoice

if GNSS_SAMPLE_MODE_PERIODIC

config GNSS_SAMPLE_PERIODIC_INTERVAL
	int "Fix interval for periodic fixes"
	range 10 65535
	default 120
	help
	  Fix interval (in seconds) for periodic fixes.

config GNSS_SAMPLE_PERIODIC_TIMEOUT
	int "Fix timeout for periodic fixes"
	range 0 65535
	default 120
	help
	  Fix timeout (in seconds) for periodic fixes.
	  If set to zero, GNSS is allowed to run indefinitely until a valid PVT estimate is produced.

endif # GNSS_SAMPLE_MODE_PERIODIC

if GNSS_SAMPLE_MODE_TTFF_TEST

config GNSS_SAMPLE_MODE_TTFF_TEST_COLD_START
	bool "Delete GNSS data before each start (cold start)"
	help
	  When enabled, deletes all stored data from GNSS to force a cold start every time GNSS is started.

config GNSS_SAMPLE_MODE_TTFF_TEST_INTERVAL
	int "Time to wait between TTFF tests in seconds"
	range 1 604800
	default 120

endif # GNSS_SAMPLE_MODE_TTFF_TEST

config GNSS_SAMPLE_NMEA_ONLY
	bool "Output only NMEA strings"
	help
	  Outputs only NMEA strings from the GNSS.

endmenu

choice
	default GNSS_SAMPLE_ASSISTANCE_NONE
	prompt "Select whether GNSS assistance is used or not"

config GNSS_SAMPLE_ASSISTANCE_NONE
	bool "Assistance not used"

config GNSS_SAMPLE_ASSISTANCE_NRF_CLOUD
	bool "Use nRF Cloud A-GNSS"
	select NRF_CLOUD_REST
	imply NRF_CLOUD_AGNSS
	select MODEM_JWT
	select MODEM_INFO
	select DATE_TIME

config GNSS_SAMPLE_ASSISTANCE_SUPL
	bool "Use SUPL assistance"
	select SUPL_CLIENT_LIB

config GNSS_SAMPLE_ASSISTANCE_MINIMAL
	bool "Use factory almanac, LTE network time and MCC based location"
	select GNSS_SAMPLE_LTE_ON_DEMAND
	select SETTINGS
	select FCB
	select FLASH
	select FLASH_MAP

endchoice

if !GNSS_SAMPLE_ASSISTANCE_NONE

config GNSS_SAMPLE_LTE_ON_DEMAND
	bool "LTE is activated only when needed to fetch A-GNSS data"
	depends on !NRF_CLOUD_PGPS
	help
	  Activates LTE only when it is needed to fetch A-GNSS data. This is not supported when
	  P-GPS is enabled.

endif # !GNSS_SAMPLE_ASSISTANCE_NONE

if GNSS_SAMPLE_ASSISTANCE_SUPL

config GNSS_SAMPLE_SUPL_HOSTNAME
	string "SUPL server hostname"
	help
	  SUPL server hostname.

config GNSS_SAMPLE_SUPL_PORT
	int "SUPL server port number"
	range 0 65535
	default 7276
	help
	  SUPL server port number.

endif # GNSS_SAMPLE_ASSISTANCE_SUPL

if GNSS_SAMPLE_MODE_CONTINUOUS

choice
	default GNSS_SAMPLE_POWER_SAVING_DISABLED
	prompt "Select GNSS power saving mode (duty-cycling)"

config GNSS_SAMPLE_POWER_SAVING_DISABLED
	bool "No power saving"

config GNSS_SAMPLE_POWER_SAVING_MODERATE
	bool "Power saving without significant performance degradation"

config GNSS_SAMPLE_POWER_SAVING_HIGH
	bool "Power saving with acceptable performance degradation"

endchoice

endif # GNSS_SAMPLE_MODE_CONTINUOUS

config GNSS_SAMPLE_REFERENCE_LATITUDE
	string "Reference position latitude in decimal degrees"
	help
	  When set, the sample calculates the distance from the reference position for each fix.
	  Given in decimal degrees (DD), for example "61.500000".

config GNSS_SAMPLE_REFERENCE_LONGITUDE
	string "Reference position longitude in decimal degrees"
	help
	  When set, the sample calculates the distance from the reference position for each fix.
	  Given in decimal degrees (DD), for example "23.800000".

config GNSS_SAMPLE_LOW_ACCURACY
	bool "Allow low accuracy fixes"
	help
	  Allows fixes with lower accuracy.

if GNSS_SAMPLE_ASSISTANCE_MINIMAL && GNSS_SAMPLE_LOW_ACCURACY

config GNSS_SAMPLE_ASSISTANCE_REFERENCE_ALT
	int "Reference altitude for 3-sat first fix in meters"
	range -32767 32767
	default -32767
	help
	  Reference altitude for 3-sat first fix in meters above the reference ellipsoid surface.
	  The default value -32767 implies that reference altitude is not injected.

endif # GNSS_SAMPLE_ASSISTANCE_MINIMAL && GNSS_SAMPLE_LOW_ACCURACY

menu "Zephyr Kernel"
source "Kconfig.zephyr"
endmenu

module = GNSS_SAMPLE
module-str = GNSS sample
source "${ZEPHYR_BASE}/subsys/logging/Kconfig.template.log_config"
```

## samples/cellular/gnss/sample.yaml
```yaml
sample:
  name: GNSS sample
tests:
  sample.cellular.gnss:
    sysbuild: true
    build_only: true
    integration_platforms:
      - nrf9151dk/nrf9151/ns
      - nrf9160dk/nrf9160/ns
      - nrf9161dk/nrf9161/ns
    platform_allow:
      - nrf9151dk/nrf9151/ns
      - nrf9160dk/nrf9160/ns
      - nrf9161dk/nrf9161/ns
    tags:
      - ci_build
      - sysbuild
      - ci_samples_cellular
  # Following configurations will be used by the positioning CI integration job to verify PRs
  sample.cellular.gnss.integration_config_positioning_agnss_nrfcloud_ltem_pvt:
    sysbuild: true
    build_only: true
    extra_configs:
      - CONFIG_LTE_NETWORK_MODE_LTE_M_GPS=y
      - CONFIG_LTE_NETWORK_MODE_NBIOT_GPS=n
      - CONFIG_GNSS_SAMPLE_LTE_ON_DEMAND=y
      - CONFIG_GNSS_SAMPLE_ASSISTANCE_NRF_CLOUD=y
      - CONFIG_GNSS_SAMPLE_NMEA_ONLY=n
      - CONFIG_GNSS_SAMPLE_MODE_PERIODIC=n
      - CONFIG_GNSS_SAMPLE_ASSISTANCE_MINIMAL=n
      - CONFIG_LTE_LC_EDRX_MODULE=y
      - CONFIG_LTE_EDRX_REQ=y
      - CONFIG_FPU=y
      - CONFIG_GNSS_SAMPLE_REFERENCE_LATITUDE="61.49375330"
      - CONFIG_GNSS_SAMPLE_REFERENCE_LONGITUDE="23.77588976"
      - CONFIG_MODEM_ANTENNA_GNSS_EXTERNAL=y
      - CONFIG_LOG_BUFFER_SIZE=2048
    extra_args: gnss_SNIPPET="nrf91-modem-trace-uart"
    integration_platforms:
      - nrf9151dk/nrf9151/ns
    platform_allow:
      - nrf9151dk/nrf9151/ns
    tags:
      - ci_build
      - sysbuild
      - ci_samples_cellular
  sample.cellular.gnss.integration_config_positioning_agnss_nrfcloud_nbiot_nmea_lte_on:
    sysbuild: true
    build_only: true
    extra_configs:
      - CONFIG_LTE_NETWORK_MODE_LTE_M_GPS=n
      - CONFIG_LTE_NETWORK_MODE_NBIOT_GPS=y
      - CONFIG_GNSS_SAMPLE_LTE_ON_DEMAND=n
      - CONFIG_GNSS_SAMPLE_ASSISTANCE_NRF_CLOUD=y
      - CONFIG_GNSS_SAMPLE_NMEA_ONLY=y
      - CONFIG_GNSS_SAMPLE_MODE_PERIODIC=n
      - CONFIG_GNSS_SAMPLE_ASSISTANCE_MINIMAL=n
      - CONFIG_LTE_LC_EDRX_MODULE=y
      - CONFIG_LTE_EDRX_REQ=y
      - CONFIG_FPU=y
      - CONFIG_GNSS_SAMPLE_REFERENCE_LATITUDE="61.49375330"
      - CONFIG_GNSS_SAMPLE_REFERENCE_LONGITUDE="23.77588976"
      - CONFIG_MODEM_ANTENNA_GNSS_EXTERNAL=y
      - CONFIG_LOG_BUFFER_SIZE=2048
    extra_args: gnss_SNIPPET="nrf91-modem-trace-uart"
    integration_platforms:
      - nrf9151dk/nrf9151/ns
    platform_allow:
      - nrf9151dk/nrf9151/ns
    tags:
      - ci_build
      - sysbuild
      - ci_samples_cellular
  sample.cellular.gnss.integration_config_positioning_pgps_nrfcloud_ltem_nmea:
    sysbuild: true
    build_only: true
    extra_configs:
      - CONFIG_LTE_NETWORK_MODE_LTE_M_GPS=y
      - CONFIG_LTE_NETWORK_MODE_NBIOT_GPS=n
      - CONFIG_GNSS_SAMPLE_LTE_ON_DEMAND=n
      - CONFIG_GNSS_SAMPLE_ASSISTANCE_NRF_CLOUD=n
      - CONFIG_GNSS_SAMPLE_NMEA_ONLY=y
      - CONFIG_GNSS_SAMPLE_MODE_PERIODIC=n
      - CONFIG_GNSS_SAMPLE_ASSISTANCE_MINIMAL=n
      - CONFIG_LTE_EDRX_REQ=n
      - CONFIG_FPU=y
      - CONFIG_GNSS_SAMPLE_REFERENCE_LATITUDE="61.49375330"
      - CONFIG_GNSS_SAMPLE_REFERENCE_LONGITUDE="23.77588976"
      - CONFIG_MODEM_ANTENNA_GNSS_EXTERNAL=y
      - CONFIG_LOG_BUFFER_SIZE=2048
    extra_args:
      - EXTRA_CONF_FILE=overlay-pgps.conf
      - gnss_SNIPPET="nrf91-modem-trace-uart"
    integration_platforms:
      - nrf9151dk/nrf9151/ns
    platform_allow:
      - nrf9151dk/nrf9151/ns
    tags:
      - ci_build
      - sysbuild
      - ci_samples_cellular
  sample.cellular.gnss.integration_config_positioning_gnss_ltem_pvt:
    sysbuild: true
    build_only: true
    extra_configs:
      - CONFIG_LTE_NETWORK_MODE_LTE_M_GPS=y
      - CONFIG_LTE_NETWORK_MODE_NBIOT_GPS=n
      - CONFIG_GNSS_SAMPLE_LTE_ON_DEMAND=n
      - CONFIG_GNSS_SAMPLE_ASSISTANCE_NRF_CLOUD=n
      - CONFIG_GNSS_SAMPLE_NMEA_ONLY=n
      - CONFIG_GNSS_SAMPLE_MODE_PERIODIC=n
      - CONFIG_GNSS_SAMPLE_ASSISTANCE_MINIMAL=n
      - CONFIG_LTE_LC_EDRX_MODULE=y
      - CONFIG_LTE_EDRX_REQ=y
      - CONFIG_FPU=y
      - CONFIG_GNSS_SAMPLE_REFERENCE_LATITUDE="61.49375330"
      - CONFIG_GNSS_SAMPLE_REFERENCE_LONGITUDE="23.77588976"
      - CONFIG_MODEM_ANTENNA_GNSS_EXTERNAL=y
      - CONFIG_LOG_BUFFER_SIZE=2048
    extra_args: gnss_SNIPPET="nrf91-modem-trace-uart"
    integration_platforms:
      - nrf9151dk/nrf9151/ns
    platform_allow:
      - nrf9151dk/nrf9151/ns
    tags:
      - ci_build
      - sysbuild
      - ci_samples_cellular
```

## samples/cellular/http_update/application_update/Kconfig
```kconfig
#
# Copyright (c) 2019 Nordic Semiconductor ASA
#
# SPDX-License-Identifier: LicenseRef-Nordic-5-Clause
#

menu "HTTP application update sample"

config DOWNLOAD_HOST
	string "Application update host name"
	help
	  Host part of URL to application update binary. For example
	  if the file is stored in http://foo.bar/update.bin the value
	  of this configuration should be 'foo.bar'

config DOWNLOAD_FILE_V2
	string "Application update file name (application version 2)"
	help
	  File part of URL to application update binary version 2. For example
	  if the file is stored in http://foo.bar/update.bin the value
	  of this configuration should be 'update.bin'

config DOWNLOAD_FILE_V1
	string "Application downgrade file name (application version 1)"
	help
	  File part of URL to application update binary version 1. For example
	  if the file is stored in http://foo.bar/downgrade.bin the value
	  of this configuration should be 'downgrade.bin'

config APPLICATION_VERSION
	int "Application version"
	default 1

config USE_HTTPS
	bool
	prompt "Use HTTPS for download"

endmenu

menu "Zephyr Kernel"
source "Kconfig.zephyr"
endmenu
```

## samples/cellular/http_update/application_update/boards/nrf9151dk_nrf9151_ns.conf
```kconfig
#
# Copyright (c) 2024 Nordic Semiconductor ASA
#
# SPDX-License-Identifier: LicenseRef-Nordic-5-Clause
#

# Sample configuration
CONFIG_DOWNLOAD_HOST="nrfconnectsdk.s3.eu-central-1.amazonaws.com"
CONFIG_DOWNLOAD_FILE_V1="app_nRF9151dk_pre1_v1.bin"
CONFIG_DOWNLOAD_FILE_V2="app_nRF9151dk_pre1_v2.bin"
CONFIG_APPLICATION_VERSION=1
```

## samples/cellular/http_update/application_update/boards/nrf9160dk_nrf9160_ns.conf
```kconfig
#
# Copyright (c) 2023 Nordic Semiconductor ASA
#
# SPDX-License-Identifier: LicenseRef-Nordic-5-Clause
#

# Sample configuration
CONFIG_DOWNLOAD_HOST="nrfconnectsdk.s3.eu-central-1.amazonaws.com"
CONFIG_DOWNLOAD_FILE_V1="app_nRF9160dk_2.5.0_v1.bin"
CONFIG_DOWNLOAD_FILE_V2="app_nRF9160dk_2.5.0_v2.bin"
CONFIG_APPLICATION_VERSION=1
```

## samples/cellular/http_update/application_update/sample.yaml
```yaml
sample:
  name: HTTP application update sample
tests:
  sample.cellular.http_update.application_update:
    sysbuild: true
    build_only: true
    integration_platforms:
      - nrf9151dk/nrf9151/ns
      - nrf9160dk/nrf9160/ns
      - nrf9161dk/nrf9161/ns
    platform_allow:
      - nrf9151dk/nrf9151/ns
      - nrf9160dk/nrf9160/ns
      - nrf9161dk/nrf9161/ns
    tags: ci_build sysbuild
  sample.cellular.http_update.application_update.lwm2m_carrier:
    sysbuild: true
    build_only: true
    extra_args: OVERLAY_CONFIG=overlay-carrier.conf
    integration_platforms:
      - nrf9151dk/nrf9151/ns
      - nrf9160dk/nrf9160/ns
      - nrf9161dk/nrf9161/ns
    platform_allow:
      - nrf9151dk/nrf9151/ns
      - nrf9160dk/nrf9160/ns
      - nrf9161dk/nrf9161/ns
    tags: ci_build sysbuild
```

## samples/cellular/http_update/full_modem_update/Kconfig
```kconfig
#
# Copyright (c) 2021 Nordic Semiconductor ASA
#
# SPDX-License-Identifier: LicenseRef-Nordic-5-Clause
#

menu "HTTP full modem update sample"

config USE_HTTPS
	bool
	prompt "Use HTTPS for download"

config DOWNLOAD_HOST
	string "Modem firmware host name"
	help
	  Host part of URL to two modem firmwares. For example, the value of
	  this configuration should be 'http://foo.bar/' if the file is stored
	  in http://foo.bar/mfu_0.bin

config DOWNLOAD_MODEM_0_FILE
	string "Modem firmware 0 file name"
	help
	  File part of URL to the first of two modem firmwares. For example,
	  the value of this configuration should be 'mfu_0.bin' if the file
	  is stored in http://foo.bar/mfu_0.bin.

config DOWNLOAD_MODEM_0_VERSION
	string "Version string of modem firmware 0"
	help
	  This value is used to ensure that the sample does not download
	  the same modem firmware as what is already installed in the modem.
	  This is typically found in the file name of the ZIP which
	  contains the modem firmware, e.g. 'mfw_nrf9160_1.2.1'.

config DOWNLOAD_MODEM_1_FILE
	string "Modem firmware 1 file name"
	help
	  File part of URL to the second of two modem firmwares. For example,
	  the value of this configuration should be 'mfu_1.bin' if the file
	  is stored in http://foo.bar/mfu_1.bin.

endmenu

menu "Zephyr Kernel"
source "Kconfig.zephyr"
endmenu
```

## samples/cellular/http_update/full_modem_update/sample.yaml
```yaml
sample:
  name: HTTP full modem update sample
tests:
  sample.cellular.http_update.full_modem_update:
    build_only: true
    integration_platforms:
      - nrf9160dk_nrf9160_ns
    platform_allow: nrf9160dk_nrf9160_ns
    tags: ci_build
```

## samples/cellular/http_update/modem_delta_update/Kconfig
```kconfig
#
# Copyright (c) 2020 Nordic Semiconductor ASA
#
# SPDX-License-Identifier: LicenseRef-Nordic-5-Clause
#

menu "HTTP modem delta update sample"

config DOWNLOAD_FILE_BASE_TO_FOTA_TEST
	string "File to update modem from base to test firmware"
	help
	  This sample uses the delta patches included in the modem firmware
	  releases. These delta patches only work for the modem firmware
	  version which they are bundled with. This option specifies the file part
	  of the URL to the delta patch from '[SUPPORTED_BASE_VERSION]' to
	  '[SUPPORTED_BASE_VERSION]-FOTA-TEST' modem firmware version.

config DOWNLOAD_FILE_FOTA_TEST_TO_BASE
	string "File to update modem from test firmware base"
	help
	  This sample uses the delta patches included in the modem firmware
	  releases. These delta patches only work for the modem firmware
	  version which they are bundled with. This option specifies the file part
	  of the URL to the delta patch from
	  '[SUPPORTED_BASE_VERSION]-FOTA-TEST' to '[SUPPORTED_BASE_VERSION]'
	   modem firmware version.

config DOWNLOAD_HOST
	string "Host part of URL to download files"

config SUPPORTED_BASE_VERSION
	string "Supported base version"
	help
	  This sample uses the delta patches included in the modem firmware
	  releases. These delta patches only work for the modem firmware
	  version which they are bundled with. This option specifies the version
	  string of the modem firmware version which the `DOWNLOAD_FILE_*`
	  options are compatible with.

config USE_HTTPS
	bool
	prompt "Use HTTPS for download"

endmenu

menu "Zephyr Kernel"
source "Kconfig.zephyr"
endmenu
```

## samples/cellular/http_update/modem_delta_update/boards/nrf9151dk_nrf9151_ns.conf
```kconfig
# Copyright (c) 2024 Nordic Semiconductor ASA
#
# SPDX-License-Identifier: LicenseRef-Nordic-5-Clause
#

# Modem firmware version configuration
CONFIG_SUPPORTED_BASE_VERSION="mfw_nrf91x1_2.0.1"
CONFIG_DOWNLOAD_FILE_BASE_TO_FOTA_TEST="mfw_nrf91x1_update_from_2.0.1_to_2.0.1-FOTA-TEST.bin"
CONFIG_DOWNLOAD_FILE_FOTA_TEST_TO_BASE="mfw_nrf91x1_update_from_2.0.1-FOTA-TEST_to_2.0.1.bin"
```
