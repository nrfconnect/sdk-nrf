## samples/caf_sensor_manager/remote/boards/nrf54h20dk_nrf54h20_cpuppr.conf
```kconfig
#
# Copyright (c) 2024 Nordic Semiconductor ASA
#
# SPDX-License-Identifier: LicenseRef-Nordic-5-Clause
#
################################################################################

CONFIG_OPENAMP=n

CONFIG_ASSERT=n
CONFIG_BOOT_BANNER=n
CONFIG_HEAP_MEM_POOL_SIZE=512
CONFIG_SIZE_OPTIMIZATIONS=y

CONFIG_CAF_INIT_LOG_SENSOR_EVENTS=y
```

## samples/caf_sensor_manager/sample.yaml
```yaml
sample:
  description: Sample showing CAF sensor manager usage
  name: CAF sensor manager sample

tests:
  sample.caf_sensor_manager.correctness_test:
    sysbuild: true
    build_only: false
    harness: console
    platform_allow: nrf52840dk/nrf52840 nrf5340dk/nrf5340/cpuapp qemu_cortex_m3
    integration_platforms:
      - nrf52840dk/nrf52840
      - nrf5340dk/nrf5340/cpuapp
      - qemu_cortex_m3
    harness_config:
      type: multi_line
      ordered: true
      regex:
        - "main: Event manager initialized"
        - "main state:READY"
        - "Send sensor buffer desc address:"
        - "sensor_data_aggregator_release_buffer_event"
    tags: sysbuild ci_samples_caf_sensor_manager
  sample.caf_sensor_manager.nrf52840dk.power_consumption_test:
    sysbuild: true
    build_only: true
    platform_allow: nrf52840dk/nrf52840
    integration_platforms:
      - nrf52840dk/nrf52840
    extra_args: CONFIG_SERIAL=n CONFIG_CONSOLE=n CONFIG_UART_CONSOLE=n CONFIG_LOG=n
    tags: sysbuild ci_samples_caf_sensor_manager
  sample.caf_sensor_manager.multi_core.power_consumption_test:
    sysbuild: true
    build_only: true
    platform_allow: nrf5340dk/nrf5340/cpuapp
    integration_platforms:
      - nrf5340dk/nrf5340/cpuapp
    extra_args: >
      CONFIG_SERIAL=n CONFIG_CONSOLE=n CONFIG_UART_CONSOLE=n CONFIG_LOG=n remote_CONFIG_SERIAL=n
      remote_CONFIG_CONSOLE=n remote_CONFIG_UART_CONSOLE=n remote_CONFIG_LOG=n
    tags: sysbuild ci_samples_caf_sensor_manager
  sample.caf_sensor_manager.nrf5340dk_singlecore.power_consumption_test:
    sysbuild: true
    build_only: true
    platform_allow: nrf5340dk/nrf5340/cpuapp
    integration_platforms:
      - nrf5340dk/nrf5340/cpuapp
    extra_args: >
      FILE_SUFFIX=singlecore
      CONFIG_CONSOLE=n CONFIG_UART_CONSOLE=n CONFIG_LOG=n
    tags: sysbuild ci_samples_caf_sensor_manager
  sample.caf_sensor_manager.nrf5340dk_singlecore.correctness_test:
    sysbuild: true
    build_only: false
    platform_allow: nrf5340dk/nrf5340/cpuapp
    integration_platforms:
      - nrf5340dk/nrf5340/cpuapp
    extra_args:
      FILE_SUFFIX=singlecore
    harness: console
    harness_config:
      type: multi_line
      ordered: true
      regex:
        - "main: Event manager initialized"
        - "main state:READY"
        - "Send sensor buffer desc address:"
        - "sensor_data_aggregator_release_buffer_event"
    tags: sysbuild ci_samples_caf_sensor_manager
  sample.caf_sensor_manager.nrf54h20.multicore:
    build_only: true
    sysbuild: true
    platform_allow:
      - nrf54h20dk/nrf54h20/cpuapp
    integration_platforms:
      - nrf54h20dk/nrf54h20/cpuapp
    extra_args:
      caf_sensor_manager_SNIPPET=nordic-ppr
    tags: sysbuild ci_samples_caf_sensor_manager

  sample.caf_sensor_manager.nrf54h20.singlecore:
    build_only: true
    sysbuild: true
    platform_allow:
      - nrf54h20dk/nrf54h20/cpuapp
    integration_platforms:
      - nrf54h20dk/nrf54h20/cpuapp
    extra_args:
      FILE_SUFFIX=singlecore
    tags: sysbuild ci_samples_caf_sensor_manager
```

## samples/caf_sensor_manager/src/modules/Kconfig
```kconfig
#
# Copyright (c) 2022 Nordic Semiconductor ASA
#
# SPDX-License-Identifier: LicenseRef-Nordic-5-Clause
#

config APP_SENSOR_MANAGER_REMOTE_CORE_INITIALIZATION_TIMEOUT
	int "Waiting period for the remote core to finish the initialization"
	range 10 10000
	default 1000
	help
	  The time to wait for second core to report its readiness to transport the events.
	  The time is given in miliseconds.


menuconfig APP_WORKLOAD_SIM
	bool "Simulated workload"

if APP_WORKLOAD_SIM

config APP_WORKLOAD_TIME_PER_SAMPLE
	int "CPU load time per sample [us]"
	default 10
	help
	  Simulated CPU busy time when processing sensor aggregator event.
	  Sensor aggregator event comes with number of aggregated events.
	  Simulated busy time is multiplied by this value.

endif # APP_WORKLOAD_SIM

menuconfig APP_SENSOR_STUB_GEN
	bool "Implement the generator functions for sensor stub"
	default y if SENSOR_STUB

if APP_SENSOR_STUB_GEN

module = APP_SENSOR_STUB_GEN
module-str = sensor stub controller
source "subsys/logging/Kconfig.template.log_config"

endif # APP_SENSOR_STUB_GEN
```

## samples/cellular/at_client/Kconfig.sysbuild
```kconfig
#
# Copyright (c) 2026 Nordic Semiconductor ASA
#
# SPDX-License-Identifier: LicenseRef-Nordic-5-Clause
#

config PARTITION_MANAGER
	default n if !BOARD_THINGY91X

source "share/sysbuild/Kconfig"
```

## samples/cellular/at_client/sample.yaml
```yaml
sample:
  name: AT Client sample
  description: AT Client sample for cellular devices
tests:
  sample.cellular.at_client:
    sysbuild: true
    build_only: true
    extra_configs:
      - CONFIG_CLOCK_CONTROL_NRF=n
    integration_platforms:
      - nrf9151dk/nrf9151/ns
      - nrf9160dk/nrf9160/ns
      - nrf9161dk/nrf9161/ns
      - thingy91x/nrf9151/ns
    platform_allow:
      - nrf9151dk/nrf9151/ns
      - nrf9160dk/nrf9160/ns
      - nrf9161dk/nrf9161/ns
      - thingy91x/nrf9151/ns
    tags:
      - ci_build
      - sysbuild
      - ci_samples_cellular
  sample.cellular.at_client.tracing:
    sysbuild: true
    build_only: true
    extra_configs:
      - CONFIG_CLOCK_CONTROL_NRF=n
    integration_platforms:
      - nrf9151dk/nrf9151/ns
      - nrf9160dk/nrf9160/ns
      - nrf9161dk/nrf9161/ns
      - thingy91/nrf9160/ns
      - thingy91x/nrf9151/ns
    platform_allow:
      - nrf9151dk/nrf9151/ns
      - nrf9160dk/nrf9160/ns
      - nrf9161dk/nrf9161/ns
      - thingy91/nrf9160/ns
      - thingy91x/nrf9151/ns
    tags:
      - ci_build
      - sysbuild
      - ci_samples_cellular
    extra_args:
      - at_client_SNIPPET=nrf91-modem-trace-uart
  sample.cellular.at_client.legacy:
    sysbuild: true
    build_only: true
    extra_configs:
      - CONFIG_CLOCK_CONTROL_NRF=y
    integration_platforms:
      - nrf9151dk/nrf9151/ns
      - nrf9160dk/nrf9160/ns
      - nrf9161dk/nrf9161/ns
      - thingy91x/nrf9151/ns
    platform_allow:
      - nrf9151dk/nrf9151/ns
      - nrf9160dk/nrf9160/ns
      - nrf9161dk/nrf9161/ns
      - thingy91x/nrf9151/ns
    tags:
      - ci_build
      - sysbuild
      - ci_samples_cellular
  sample.cellular.at_client.tracing.legacy:
    sysbuild: true
    build_only: true
    extra_configs:
      - CONFIG_CLOCK_CONTROL_NRF=y
    integration_platforms:
      - nrf9151dk/nrf9151/ns
      - nrf9160dk/nrf9160/ns
      - nrf9161dk/nrf9161/ns
      - thingy91/nrf9160/ns
      - thingy91x/nrf9151/ns
    platform_allow:
      - nrf9151dk/nrf9151/ns
      - nrf9160dk/nrf9160/ns
      - nrf9161dk/nrf9161/ns
      - thingy91/nrf9160/ns
      - thingy91x/nrf9151/ns
    tags:
      - ci_build
      - sysbuild
      - ci_samples_cellular
    extra_args:
      - at_client_SNIPPET=nrf91-modem-trace-uart
```

## samples/cellular/at_monitor/sample.yaml
```yaml
sample:
  name: AT monitor sample
tests:
  sample.cellular.at_monitor:
    build_only: true
    integration_platforms:
      - nrf9160dk_nrf9160_ns
    platform_allow: nrf9160dk_nrf9160_ns
    tags: ci_build
```

## samples/cellular/aws_iot/boards/qemu_x86.conf
```kconfig
#
# Copyright (c) 2020 Nordic Semiconductor ASA
#
# SPDX-License-Identifier: LicenseRef-Nordic-5-Clause
#
# General config
CONFIG_FPU=y

# NEWLIB C
CONFIG_NEWLIB_LIBC=y
CONFIG_NEWLIB_LIBC_FLOAT_PRINTF=y

# Date Time library
CONFIG_DATE_TIME_MODEM=n

# LTE link control
CONFIG_LTE_LINK_CONTROL=n

# AWS IoT library
CONFIG_AWS_IOT_LAST_WILL=n
CONFIG_AWS_IOT_TOPIC_GET_ACCEPTED_SUBSCRIBE=n
CONFIG_AWS_IOT_TOPIC_GET_REJECTED_SUBSCRIBE=n

# TLS configuration
CONFIG_MBEDTLS=y
CONFIG_MBEDTLS_BUILTIN=y
CONFIG_MBEDTLS_ENABLE_HEAP=y
CONFIG_MBEDTLS_HEAP_SIZE=120000
CONFIG_MBEDTLS_SSL_MAX_CONTENT_LEN=16384
CONFIG_MBEDTLS_PEM_CERTIFICATE_FORMAT=y
CONFIG_MBEDTLS_KEY_EXCHANGE_RSA_ENABLED=y
CONFIG_MBEDTLS_MAC_SHA256_ENABLED=y
CONFIG_NET_SOCKETS_SOCKOPT_TLS=y

# Networking config
CONFIG_NET_NATIVE=y
CONFIG_NET_IPV4=y
CONFIG_NET_TCP=y
CONFIG_NET_SOCKETS=y
CONFIG_NET_SOCKETS_POSIX_NAMES=y
CONFIG_NET_CONTEXT_SNDTIMEO=y

CONFIG_DNS_RESOLVER=y
CONFIG_DNS_SERVER_IP_ADDRESSES=y
CONFIG_DNS_SERVER1="8.8.8.8"

# Network address config
CONFIG_NET_CONFIG_SETTINGS=y
CONFIG_NET_CONFIG_NEED_IPV4=y
CONFIG_NET_CONFIG_MY_IPV4_ADDR="192.0.2.1"
CONFIG_NET_CONFIG_MY_IPV4_GW="192.0.2.2"

# MCUBOOT
CONFIG_BOOTLOADER_MCUBOOT=n
CONFIG_MCUBOOT_IMG_MANAGER=n

# Image manager
CONFIG_IMG_MANAGER=n
CONFIG_STREAM_FLASH=n
CONFIG_FLASH=n
CONFIG_IMG_ERASE_PROGRESSIVELY=n

# AWS FOTA
CONFIG_AWS_FOTA=n
CONFIG_FOTA_DOWNLOAD=n
CONFIG_DFU_TARGET=n

# Modem library
CONFIG_NRF_MODEM_LIB=n

# Modem information
CONFIG_MODEM_INFO=n

# AT Host
CONFIG_AT_HOST_LIBRARY=n
```

## samples/cellular/aws_iot/sample.yaml
```yaml
sample:
  name: AWS IoT sample
tests:
  sample.cellular.aws_iot:
    build_only: true
    integration_platforms:
      - nrf9160dk_nrf9160_ns
      - thingy91_nrf9160_ns
    platform_allow: nrf9160dk_nrf9160_ns thingy91_nrf9160_ns
    tags: ci_build
```

## samples/cellular/azure_fota/sample.yaml
```yaml
sample:
  name: Azure FOTA sample
tests:
  sample.cellular.azure_fota:
    build_only: true
    integration_platforms:
      - nrf9160dk_nrf9160_ns
    platform_allow: nrf9160dk_nrf9160_ns
    tags: ci_build
```

## samples/cellular/azure_iot_hub/sample.yaml
```yaml
sample:
  name: Azure IoT Hub sample
tests:
  sample.cellular.azure_iot_hub:
    build_only: true
    integration_platforms:
      - nrf9160dk_nrf9160_ns
    platform_allow: nrf9160dk_nrf9160_ns
    tags: ci_build
  sample.cellular.azure_iot_hub.dps:
    build_only: true
    integration_platforms:
      - nrf9160dk_nrf9160_ns
    platform_allow: nrf9160dk_nrf9160_ns
    extra_args: OVERLAY_CONFIG=overlay-dps.conf
    extra_configs:
      - CONFIG_AZURE_IOT_HUB_DPS_ID_SCOPE="test-scope"
    tags: ci_build
```

## samples/cellular/battery/Kconfig
```kconfig
menu "Battery sample"

config HIGH_BAT_REFRESH_INTERVAL_SEC
	int "Refresh interval (sec) while battery voltage is high"
	default 5

config LOW_BAT_REFRESH_INTERVAL_SEC
	int "Refresh interval (sec) while battery voltage is low"
	default 60

config POFWARN_REFRESH_INTERVAL_SEC
	int "Refresh interval (sec) after receiving power-off warning"
	default 120

endmenu

menu "Zephyr Kernel"
source "Kconfig.zephyr"

module = BATTERY_SAMPLE
module-str = Battery sample
source "${ZEPHYR_BASE}/subsys/logging/Kconfig.template.log_config"

endmenu
```

## samples/cellular/battery/sample.yaml
```yaml
sample:
  name: battery
tests:
  sample.cellular.battery:
    build_only: true
    integration_platforms:
      - nrf9160dk_nrf9160_ns
      - nrf9161dk_nrf9161_ns
    platform_allow: nrf9160dk_nrf9160_ns nrf9161dk_nrf9161_ns
    tags: ci_build
```

## samples/cellular/ciphersuites/sample.yaml
```yaml
sample:
  name: TLS Ciphersuites sample
tests:
  sample.cellular.ciphersuites:
    build_only: true
    platform_allow: nrf9160dk_nrf9160_ns
    integration_platforms:
      - nrf9160dk_nrf9160_ns
    tags: ci_build
```

## samples/cellular/coap_client/sample.yaml
```yaml
sample:
  name: nRF CoAP client sample
tests:
  sample.cellular.coap_client:
    build_only: true
    integration_platforms:
      - nrf9160dk_nrf9160_ns
      - nrf9161dk_nrf9161_ns
    platform_allow: nrf9160dk_nrf9160_ns nrf9161dk_nrf9161_ns
    tags: ci_build
```

## samples/cellular/download/sample.yaml
```yaml
sample:
  name: Download sample
tests:
  sample.cellular.download.tfm:
    build_only: true
    extra_args: OVERLAY_CONFIG="overlay-tfm.conf"
    integration_platforms:
      - nrf9160dk_nrf9160_ns
    platform_allow: nrf9160dk_nrf9160_ns
    tags: ci_build
  sample.cellular.download_client:
    build_only: true
    extra_configs:
      - CONFIG_SHELL=y
      - CONFIG_COAP=y
      - CONFIG_DOWNLOAD_CLIENT_SHELL=y
      - CONFIG_SAMPLE_COMPUTE_HASH=y
    integration_platforms:
      - nrf9160dk_nrf9160_ns
    platform_allow: nrf9160dk_nrf9160_ns
    tags: ci_build
```
