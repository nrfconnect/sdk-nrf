## samples/ironside_se/snapshot_suspend_to_ram/Kconfig.sysbuild
```kconfig
#
# Copyright (c) 2026 Nordic Semiconductor ASA
#
# SPDX-License-Identifier: LicenseRef-Nordic-5-Clause
#

# Build the local remote/ image as the network (radio) core image through the
# standard sysbuild network-core infrastructure. A dedicated image is used
# instead of SB_CONFIG_NETCORE_EMPTY so the radio core wakes periodically as a
# liveness signal; see remote/src/main.c.

choice NETCORE
	default NETCORE_REMOTE

config NETCORE_REMOTE
	bool "Remote radio idle image"
	help
	  Use the local remote/ idle image as the network core image.

endchoice

config NETCORE_IMAGE_NAME
	default "remote" if NETCORE_REMOTE

config NETCORE_IMAGE_PATH
	default "$(ZEPHYR_NRF_MODULE_DIR)/samples/ironside_se/snapshot_suspend_to_ram/remote" if NETCORE_REMOTE

source "share/sysbuild/Kconfig"
```

## samples/ironside_se/snapshot_suspend_to_ram/sample.yaml
```yaml
#
# Copyright (c) 2026 Nordic Semiconductor ASA
#
# SPDX-License-Identifier: LicenseRef-Nordic-5-Clause
#

sample:
  name: IronSide SE snapshot and suspend-to-RAM
  description: |
    Demonstrates IronSide SE snapshot capture and recovery, followed by a
    suspend-to-RAM low-power idle loop.

common:
  sysbuild: true

tests:
  samples.ironside_se.snapshot_suspend_to_ram:
    build_only: true
    tags:
      - sysbuild
      - ironside_se
    platform_allow:
      - nrf54h20dk/nrf54h20/cpuapp
    integration_platforms:
      - nrf54h20dk/nrf54h20/cpuapp
    timeout: 30
```

## samples/ironside_se/wdtstart_sample/sample.yaml
```yaml
sample:
  name: WDTSTART sample
  description: |
    Sample demonstrating UICR.WDTSTART configuration for automatic watchdog
    timer start on nRF54H20DK. The sample shows how to detect watchdog resets
    and feed the watchdog to prevent further resets.

common:
  sysbuild: true
  harness: console
  harness_config:
    type: multi_line
    regex:
      - "=== IronSide SE WDTSTART Sample ==="
      - "Reset cause:"
      - "Watchdog fed 1 times"

tests:
  samples.ironside_se.wdtstart:
    tags:
      - sysbuild
      - ci_samples_sdfw
    platform_allow:
      - nrf54h20dk/nrf54h20/cpuapp
    integration_platforms:
      - nrf54h20dk/nrf54h20/cpuapp
```

## samples/jwt/Kconfig
```kconfig
#
# Copyright (c) 2024 Nordic Semiconductor ASA
#
# SPDX-License-Identifier: LicenseRef-Nordic-5-Clause
#

menu "JWT Sample"

module = JWT_SAMPLE
module-str = JWT Sample
source "${ZEPHYR_BASE}/subsys/logging/Kconfig.template.log_config"

endmenu

menu "Zephyr Kernel"
	source "Kconfig.zephyr"
endmenu
```

## samples/jwt/boards/nrf9280pdk_nrf9280_cpuapp.conf
```kconfig
#
# Copyright (c) 2024 Nordic Semiconductor
#
# SPDX-License-Identifier: LicenseRef-Nordic-5-Clause
#

# Disable Data Cache
CONFIG_DCACHE=n
```

## samples/jwt/sample.yaml
```yaml
sample:
  name: JWT Sample
  description: |
    Sample demonstrating how to generate a JSON web token (JWT).

common:
  build_only: true
  tags: ci_build ci_samples_jwt

tests:
  samples.jwt.logging.uart:
    sysbuild: true
    tags: sysbuild ci_samples_jwt
    platform_allow:
      - nrf9280pdk/nrf9280/cpuapp
    integration_platforms:
      - nrf9280pdk/nrf9280/cpuapp
    extra_args:
      - EXTRA_CONF_FILE=uart_logging.conf
      - SB_CONFIG_SUIT_ENVELOPE=y
    extra_configs:
      - CONFIG_LOG_BUFFER_SIZE=8196
      - CONFIG_SUIT=y
      - CONFIG_ZCBOR=y
      - CONFIG_ZCBOR_CANONICAL=y
      - CONFIG_SUIT_ENVELOPE_TARGET="application"
      - CONFIG_SUIT_ENVELOPE_TEMPLATE_FILENAME="app_envelope.yaml.jinja2"
      - CONFIG_SUIT_LOCAL_ENVELOPE_GENERATE=y
```

## samples/keys/hw_unique_key/boards/nrf52840dk_nrf52840.conf
```kconfig
#
# Copyright (c) 2021 Nordic Semiconductor ASA
#
# SPDX-License-Identifier: LicenseRef-Nordic-5-Clause
#

CONFIG_SECURE_BOOT=y
CONFIG_REBOOT=y
CONFIG_MBEDTLS_PSA_CRYPTO_C=y
CONFIG_MAIN_STACK_SIZE=4096
CONFIG_MBEDTLS_ENABLE_HEAP=y
```

## samples/keys/hw_unique_key/boards/nrf9160dk_nrf9160.conf
```kconfig
#
# Copyright (c) 2021 Nordic Semiconductor ASA
#
# SPDX-License-Identifier: LicenseRef-Nordic-5-Clause
#

CONFIG_MBEDTLS_PSA_CRYPTO_C=y
CONFIG_MAIN_STACK_SIZE=4096
CONFIG_MBEDTLS_ENABLE_HEAP=y
CONFIG_HW_UNIQUE_KEY=y
CONFIG_HW_UNIQUE_KEY_RANDOM=y
```

## samples/keys/hw_unique_key/boards/nrf9160dk_nrf9160_ns.conf
```kconfig
#
# Copyright (c) 2021 Nordic Semiconductor ASA
#
# SPDX-License-Identifier: LicenseRef-Nordic-5-Clause
#

CONFIG_BUILD_WITH_TFM=y
CONFIG_TFM_PROFILE_TYPE_NOT_SET=y
```

## samples/keys/hw_unique_key/boards/nrf9161dk_nrf9161.conf
```kconfig
#
# Copyright (c) 2024 Nordic Semiconductor ASA
#
# SPDX-License-Identifier: LicenseRef-Nordic-5-Clause
#

CONFIG_MBEDTLS_PSA_CRYPTO_C=y
CONFIG_MAIN_STACK_SIZE=4096
CONFIG_MBEDTLS_ENABLE_HEAP=y
```

## samples/keys/hw_unique_key/sample.yaml
```yaml
sample:
  description: Generate and write random keys to the KMU.
  name: Random HW Unique Key
common:
  tags: huk
  platform_allow:
    - nrf5340dk/nrf5340/cpuapp
    - nrf5340dk/nrf5340/cpuapp/ns
    - nrf9160dk/nrf9160
    - nrf9160dk/nrf9160/ns
    - nrf9161dk/nrf9161
    - nrf9161dk/nrf9161/ns
    - nrf9151dk/nrf9151
    - nrf9151dk/nrf9151/ns
    - nrf52840dk/nrf52840
    - nrf21540dk/nrf52840
    - nrf54l15pdk/nrf54l15/cpuapp
  integration_platforms:
    - nrf5340dk/nrf5340/cpuapp
    - nrf5340dk/nrf5340/cpuapp/ns
    - nrf9160dk/nrf9160
    - nrf9160dk/nrf9160/ns
    - nrf9161dk/nrf9161
    - nrf9161dk/nrf9161/ns
    - nrf9151dk/nrf9151
    - nrf9151dk/nrf9151/ns
    - nrf52840dk/nrf52840
    - nrf21540dk/nrf52840
    - nrf54l15pdk/nrf54l15/cpuapp
  harness: console
  harness_config:
    type: multi_line
    regex:
      - ".*Example finished successfully!.*"
tests:
  sample.keys.hw_unique_key:
    sysbuild: true
    tags: huk ci_build sysbuild
```
