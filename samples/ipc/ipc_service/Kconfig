## samples/ipc/ipc_service/Kconfig
```kconfig
#
# Copyright (c) 2022 Nordic Semiconductor ASA
#
# SPDX-License-Identifier: LicenseRef-Nordic-5-Clause
#

source "Kconfig.zephyr"
rsource "Kconfig.common"

if SOC_SERIES_NRF53X

config APP_INCLUDE_REMOTE_IMAGE
	bool "Include remote image as sub image"
	default y
	select PARTITION_MANAGER_ENABLED

config APP_REMOTE_BOARD
	string "The name of the CORE to be used by remote image"
	default "nrf5340dk/nrf5340/cpunet"
	depends on APP_INCLUDE_REMOTE_IMAGE

endif # SOC_SERIES_NRF53X
```

## samples/ipc/ipc_service/Kconfig.common
```kconfig
#
# Copyright (c) 2024 Nordic Semiconductor ASA
#
# SPDX-License-Identifier: LicenseRef-Nordic-5-Clause
#

config APP_IPC_SERVICE_SEND_INTERVAL
	int "Ipc service sending interval [us]"
	default 30 if BOARD_NRF5340DK_NRF5340_CPUNET
	default 70
	help
	  Time in micro seconds between sending subsequent data packages over
	  IPC service. Since kernel timeout has 1 ms resolution, the value is
	  rounded down. If value of this option is lower than 1000 us, busy
	  wait is used instead of sleep.

config APP_IPC_SERVICE_MESSAGE_LEN
	int "Length of single IPC message in bytes"
	default 100
```

## samples/ipc/ipc_service/boards/nrf5340dk_nrf5340_cpuapp.conf
```kconfig
#
# Copyright (c) 2022 Nordic Semiconductor ASA
#
# SPDX-License-Identifier: LicenseRef-Nordic-5-Clause
#

CONFIG_BOARD_ENABLE_CPUNET=y
CONFIG_OPENAMP=y
CONFIG_OPENAMP_SLAVE=n
```

## samples/ipc/ipc_service/boards/nrf5340dk_nrf5340_cpuapp_icmsg.conf
```kconfig
#
# Copyright (c) 2024 Nordic Semiconductor ASA
#
# SPDX-License-Identifier: LicenseRef-Nordic-5-Clause
#

CONFIG_BOARD_ENABLE_CPUNET=y
CONFIG_APP_IPC_SERVICE_SEND_INTERVAL=60
```

## samples/ipc/ipc_service/boards/nrf54h20dk_nrf54h20_cpuapp.conf
```kconfig
# Copyright (c) 2024 Nordic Semiconductor ASA
# SPDX-License-Identifier: LicenseRef-Nordic-5-Clause

CONFIG_APP_IPC_SERVICE_SEND_INTERVAL=900
CONFIG_SOC_NRF54H20_CPURAD_ENABLE=y
```

## samples/ipc/ipc_service/boards/nrf7002dk_nrf5340_cpuapp_icmsg.conf
```kconfig
#
# Copyright (c) 2024 Nordic Semiconductor ASA
#
# SPDX-License-Identifier: LicenseRef-Nordic-5-Clause
#

CONFIG_SOC_NRF53_CPUNET_ENABLE=y
CONFIG_APP_IPC_SERVICE_SEND_INTERVAL=60
```

## samples/ipc/ipc_service/remote/boards/nrf5340dk_nrf5340_cpunet.conf
```kconfig
# Copyright (c) 2024 Nordic Semiconductor ASA
# SPDX-License-Identifier: LicenseRef-Nordic-5-Clause

CONFIG_OPENAMP=y
CONFIG_OPENAMP_MASTER=n
```

## samples/ipc/ipc_service/remote/boards/nrf5340dk_nrf5340_cpunet_icmsg.conf
```kconfig
# Copyright (c) 2024 Nordic Semiconductor ASA
# SPDX-License-Identifier: LicenseRef-Nordic-5-Clause

CONFIG_APP_IPC_SERVICE_SEND_INTERVAL=25
```

## samples/ipc/ipc_service/remote/boards/nrf54h20dk_nrf54h20_cpurad_cpuapp_rpmsg.conf
```kconfig
# Copyright (c) 2024 Nordic Semiconductor ASA
# SPDX-License-Identifier: LicenseRef-Nordic-5-Clause

CONFIG_APP_IPC_SERVICE_SEND_INTERVAL=1000
CONFIG_OPENAMP_WITH_DCACHE=y
CONFIG_IPC_SERVICE_STATIC_VRINGS_MEM_ALIGNMENT=32
```

## samples/ipc/ipc_service/sample.yaml
```yaml
sample:
  name: IPC Service integration test
  description: IPC Service integration and efficiency test

common:
  sysbuild: true
  tags:
    - ipc
    - ci_samples_ipc
  harness: console
  harness_config:
    type: multi_line
    ordered: true
    regex:
      - "IPC-service .* demo started"
      - "Δpkt: (?!0)\\d* ((?!0)\\d* B/pkt) | throughput: (?!0)\\d* bit/s"
      - "Δpkt: (?!0)\\d* ((?!0)\\d* B/pkt) | throughput: (?!0)\\d* bit/s"
      - "Δpkt: (?!0)\\d* ((?!0)\\d* B/pkt) | throughput: (?!0)\\d* bit/s"

tests:
  sample.ipc.ipc_service.nrf5340dk_rpmsg_default:
    platform_allow:
      - nrf5340dk/nrf5340/cpuapp
    integration_platforms:
      - nrf5340dk/nrf5340/cpuapp
  sample.ipc.ipc_service.nrf5340dk_rpmsg_cpuapp_sending:
    platform_allow:
      - nrf5340dk/nrf5340/cpuapp
    integration_platforms:
      - nrf5340dk/nrf5340/cpuapp
    extra_configs:
      - CONFIG_APP_IPC_SERVICE_SEND_INTERVAL=1
    extra_args:
      - remote_CONFIG_APP_IPC_SERVICE_SEND_INTERVAL=200000000
  sample.ipc.ipc_service.nrf5340dk_rpmsg_cpunet_sending:
    platform_allow:
      - nrf5340dk/nrf5340/cpuapp
    integration_platforms:
      - nrf5340dk/nrf5340/cpuapp
    extra_configs:
      - CONFIG_APP_IPC_SERVICE_SEND_INTERVAL=200000000
    extra_args:
      - remote_CONFIG_APP_IPC_SERVICE_SEND_INTERVAL=1
    harness_config:
      type: multi_line
      ordered: true
      regex:
        - "IPC-service .* demo started"
        # there will be only single tranfser from this core
        - "Δpkt: (?!0)\\d+ ((?!0)\\d+ B/pkt) | throughput: (?!0)\\d+ bit/s"
        - "Δpkt: \\d+ (\\d+ B/pkt) | throughput: \\d+ bit/s"
        - "Δpkt: \\d+ (\\d+ B/pkt) | throughput: \\d+ bit/s"
  sample.ipc.ipc_service.nrf5340dk_icmsg_default:
    platform_allow:
      - nrf5340dk/nrf5340/cpuapp
    integration_platforms:
      - nrf5340dk/nrf5340/cpuapp
    extra_args:
      - FILE_SUFFIX=icmsg
  sample.ipc.ipc_service.nrf5340dk_icbmsg_default:
    platform_allow:
      - nrf5340dk/nrf5340/cpuapp
    integration_platforms:
      - nrf5340dk/nrf5340/cpuapp
    extra_args:
      - FILE_SUFFIX=icbmsg
  sample.ipc.ipc_service.nrf5340dk_icmsg_cpuapp_sending:
    platform_allow:
      - nrf5340dk/nrf5340/cpuapp
    integration_platforms:
      - nrf5340dk/nrf5340/cpuapp
    extra_configs:
      - CONFIG_APP_IPC_SERVICE_SEND_INTERVAL=35
    extra_args:
      - FILE_SUFFIX=icmsg
      - remote_CONFIG_APP_IPC_SERVICE_SEND_INTERVAL=200000000
  sample.ipc.ipc_service.nrf5340dk_icmsg_cpunet_sending:
    platform_allow:
      - nrf5340dk/nrf5340/cpuapp
    integration_platforms:
      - nrf5340dk/nrf5340/cpuapp
    extra_configs:
      - CONFIG_APP_IPC_SERVICE_SEND_INTERVAL=200000000
    extra_args:
      - FILE_SUFFIX=icmsg
      - remote_CONFIG_APP_IPC_SERVICE_SEND_INTERVAL=1
    harness_config:
      type: multi_line
      ordered: true
      regex:
        - "IPC-service .* demo started"
        # there will be only single tranfser from this core
        - "Δpkt: (?!0)\\d+ ((?!0)\\d+ B/pkt) | throughput: (?!0)\\d+ bit/s"
        - "Δpkt: \\d+ (\\d+ B/pkt) | throughput: \\d+ bit/s"
        - "Δpkt: \\d+ (\\d+ B/pkt) | throughput: \\d+ bit/s"
  sample.ipc.ipc_service.nrf7002dk_rpmsg_default:
    platform_allow:
      - nrf7002dk/nrf5340/cpuapp
    integration_platforms:
      - nrf7002dk/nrf5340/cpuapp
  sample.ipc.ipc_service.nrf7002dk_rpmsg_cpuapp_sending:
    platform_allow:
      - nrf7002dk/nrf5340/cpuapp
    integration_platforms:
      - nrf7002dk/nrf5340/cpuapp
    extra_configs:
      - CONFIG_APP_IPC_SERVICE_SEND_INTERVAL=1
    extra_args:
      - remote_CONFIG_APP_IPC_SERVICE_SEND_INTERVAL=200000000
  sample.ipc.ipc_service.nrf7002dk_rpmsg_cpunet_sending:
    platform_allow:
      - nrf7002dk/nrf5340/cpuapp
    integration_platforms:
      - nrf7002dk/nrf5340/cpuapp
    extra_configs:
      - CONFIG_APP_IPC_SERVICE_SEND_INTERVAL=200000000
    extra_args:
      - remote_CONFIG_APP_IPC_SERVICE_SEND_INTERVAL=1
    harness_config:
      type: multi_line
      ordered: true
      regex:
        - "IPC-service .* demo started"
        # there will be only single tranfser from this core
        - "Δpkt: (?!0)\\d+ ((?!0)\\d+ B/pkt) | throughput: (?!0)\\d+ bit/s"
        - "Δpkt: \\d+ (\\d+ B/pkt) | throughput: \\d+ bit/s"
        - "Δpkt: \\d+ (\\d+ B/pkt) | throughput: \\d+ bit/s"
  sample.ipc.ipc_service.nrf7002dk_icmsg_default:
    platform_allow:
      - nrf7002dk/nrf5340/cpuapp
    integration_platforms:
      - nrf7002dk/nrf5340/cpuapp
    extra_args:
      - FILE_SUFFIX=icmsg
  sample.ipc.ipc_service.nrf7002dk_icbmsg_default:
    platform_allow:
      - nrf7002dk/nrf5340/cpuapp
    integration_platforms:
      - nrf7002dk/nrf5340/cpuapp
    extra_args:
      - FILE_SUFFIX=icbmsg
  sample.ipc.ipc_service.nrf7002dk_icmsg_cpuapp_sending:
    platform_allow:
      - nrf7002dk/nrf5340/cpuapp
    integration_platforms:
      - nrf7002dk/nrf5340/cpuapp
    extra_configs:
      - CONFIG_APP_IPC_SERVICE_SEND_INTERVAL=35
    extra_args:
      - FILE_SUFFIX=icmsg
      - remote_CONFIG_APP_IPC_SERVICE_SEND_INTERVAL=200000000
  sample.ipc.ipc_service.nrf7002dk_icmsg_cpunet_sending:
    platform_allow:
      - nrf7002dk/nrf5340/cpuapp
    integration_platforms:
      - nrf7002dk/nrf5340/cpuapp
    extra_configs:
      - CONFIG_APP_IPC_SERVICE_SEND_INTERVAL=200000000
    extra_args:
      - FILE_SUFFIX=icmsg
      - remote_CONFIG_APP_IPC_SERVICE_SEND_INTERVAL=1
    harness_config:
      type: multi_line
      ordered: true
      regex:
        - "IPC-service .* demo started"
        # there will be only single tranfser from this core
        - "Δpkt: (?!0)\\d+ ((?!0)\\d+ B/pkt) | throughput: (?!0)\\d+ bit/s"
        - "Δpkt: \\d+ (\\d+ B/pkt) | throughput: \\d+ bit/s"
        - "Δpkt: \\d+ (\\d+ B/pkt) | throughput: \\d+ bit/s"
  sample.ipc.ipc_service.nrf54h20dk_cpuapp_cpurad_icbmsg:
    platform_allow:
      - nrf54h20dk/nrf54h20/cpuapp
    integration_platforms:
      - nrf54h20dk/nrf54h20/cpuapp
    extra_args:
      - ipc_service_CONFIG_SOC_NRF54H20_CPURAD_ENABLE=y
    timeout: 20
  sample.ipc.ipc_service.nrf54h20dk_cpuapp_cpuppr_icmsg:
    platform_allow:
      - nrf54h20dk/nrf54h20/cpuapp
    integration_platforms:
      - nrf54h20dk/nrf54h20/cpuapp
    extra_args:
      - FILE_SUFFIX=cpuppr
      - ipc_service_SNIPPET=nordic-ppr
    timeout: 20
  sample.ipc.ipc_service.nrf54l15dk_cpuapp_cpuflpr_icmsg:
    extra_args:
      - ipc_service_SNIPPET=nordic-flpr
    platform_allow:
      - nrf54l15dk/nrf54l15/cpuapp
    integration_platforms:
      - nrf54l15dk/nrf54l15/cpuapp
    timeout: 20
  sample.ipc.ipc_service.nrf54l15dk_cpuapp_cpuflpr_icbmsg:
    extra_args:
      - ipc_service_SNIPPET=nordic-flpr
      - ipc_service_CONFIG_IPC_SERVICE_BACKEND_ICBMSG_NUM_EP=1
      - ipc_service_DTC_OVERLAY_FILE="boards/nrf54l15dk_nrf54l15_cpuapp_icbmsg.overlay"
      - remote_CONFIG_IPC_SERVICE_BACKEND_ICBMSG_NUM_EP=1
      - remote_DTC_OVERLAY_FILE="boards/nrf54l15dk_nrf54l15_cpuflpr_icbmsg.overlay"
    platform_allow:
      - nrf54l15dk/nrf54l15/cpuapp
    integration_platforms:
      - nrf54l15dk/nrf54l15/cpuapp
    timeout: 20
  sample.ipc.ipc_service.nrf54lm20dk_cpuapp_cpuflpr_icmsg:
    extra_args:
      - ipc_service_SNIPPET=nordic-flpr
    platform_allow:
      - nrf54lm20dk/nrf54lm20a/cpuapp
    integration_platforms:
      - nrf54lm20dk/nrf54lm20a/cpuapp
    timeout: 20
  sample.ipc.ipc_service.nrf54lm20dk_cpuapp_cpuflpr_icbmsg:
    extra_args:
      - ipc_service_SNIPPET=nordic-flpr
      - ipc_service_CONFIG_IPC_SERVICE_BACKEND_ICBMSG_NUM_EP=1
      - ipc_service_DTC_OVERLAY_FILE="boards/nrf54lm20dk_nrf54lm20a_cpuapp_icbmsg.overlay"
      - remote_CONFIG_IPC_SERVICE_BACKEND_ICBMSG_NUM_EP=1
      - remote_DTC_OVERLAY_FILE="boards/nrf54lm20dk_nrf54lm20a_cpuflpr_icbmsg.overlay"
    platform_allow:
      - nrf54lm20dk/nrf54lm20a/cpuapp
    integration_platforms:
      - nrf54lm20dk/nrf54lm20a/cpuapp
    timeout: 20
  sample.ipc.ipc_service.nrf54lv10dk_cpuapp_cpuflpr_icmsg:
    extra_args:
      - ipc_service_SNIPPET=nordic-flpr
    platform_allow:
      - nrf54lv10dk/nrf54lv10a/cpuapp
      - nrf54lv10dk@0.2.0/nrf54lv10a/cpuapp
      - nrf54lv10dk/nrf54lv10a/cpuapp/ns
    integration_platforms:
      - nrf54lv10dk/nrf54lv10a/cpuapp
    timeout: 20
  sample.ipc.ipc_service.nrf54lv10dk_cpuapp_cpuflpr_icbmsg:
    extra_args:
      - ipc_service_SNIPPET=nordic-flpr
      - ipc_service_CONFIG_IPC_SERVICE_BACKEND_ICBMSG_NUM_EP=1
      - ipc_service_DTC_OVERLAY_FILE="boards/nrf54lv10dk_nrf54lv10a_cpuapp_icbmsg.overlay"
      - remote_CONFIG_IPC_SERVICE_BACKEND_ICBMSG_NUM_EP=1
      - remote_DTC_OVERLAY_FILE="boards/nrf54lv10dk_nrf54lv10a_cpuflpr_icbmsg.overlay"
    platform_allow:
      - nrf54lv10dk/nrf54lv10a/cpuapp
      - nrf54lv10dk@0.2.0/nrf54lv10a/cpuapp
      - nrf54lv10dk/nrf54lv10a/cpuapp/ns
    integration_platforms:
      - nrf54lv10dk/nrf54lv10a/cpuapp
    timeout: 20
```

## samples/ironside_se/customer_uicr/sample.yaml
```yaml
sample:
  name: CUSTOMER UICR Sample
  description: |
    Sample demonstrating UICR.CUSTOMER to store persistent data.
    The sample adds a customer.bin file to the uicr image, which
    will then build with the customer data as part of the uicr.hex.

common:
  sysbuild: true
  harness: console
  harness_config:
    type: multi_line
    regex:
      # deadbeef as the word we write and then the UICR magic words
      - ".*deadbeef bd2328a8 bd2328a8 bd2328a8 .*"

tests:
  samples.customer_uicr.nrf54h20dk:
    tags:
      - sysbuild
      - ci_samples_sdfw
    platform_allow:
      - nrf54h20dk/nrf54h20/cpuapp
    integration_platforms:
      - nrf54h20dk/nrf54h20/cpuapp
    timeout: 7
```

## samples/ironside_se/protectedmem_periphconf/sample.yaml
```yaml
sample:
  name: Protected Memory PERIPHCONF Sample
  description: |
    Sample demonstrating UICR.PROTECTEDMEM protection of the periphconf_partition.
    The sample relocates periphconf_partition to be right after
    cpuapp_boot_partition and configures PROTECTEDMEM to protect both partitions.
    The sample writes to the protected area, reboots, and demonstrates that the
    integrity check fails on boot. The secondary firmware then reverts the
    corruption and reboots back into the primary firmware.

common:
  sysbuild: true
  harness: console
  harness_config:
    type: multi_line
    ordered: true
    regex:
      - "Writing test pattern to protected memory\\.\\.\\."
      - "Rebooting after 1s\\."
      - "Secondary: Secondary firmware booted"
      - "Secondary: Booted because of PROTECTEDMEM failure"
      - "Secondary: Rebooting after 1s\\."

tests:
  samples.protectedmem_periphconf.nrf54h20dk:
    tags:
      - sysbuild
      - ci_samples_sdfw
    platform_allow:
      - nrf54h20dk/nrf54h20/cpuapp
    integration_platforms:
      - nrf54h20dk/nrf54h20/cpuapp
    timeout: 7
```

## samples/ironside_se/secondary_boot_gen_uicr/sample.yaml
```yaml
sample:
  name: Secondary Boot Sample
  description: |
    Sample demonstrating secondary application image boot on nRF54H20DK.
    The primary image prints hello world, calls stub functions for UICR
    update and secure domain service to boot the secondary image. The
    secondary image prints its own hello world message.

common:
  sysbuild: true
  harness: console
  harness_config:
    type: multi_line
    regex:
      - "=== Hello World from Primary Image ==="
      - "=== Hello World from Secondary Image ==="

tests:
  samples.secondary_boot.nrf54h20dk:
    tags:
      - sysbuild
      - ci_samples_secondary_boot
    platform_allow:
      - nrf54h20dk/nrf54h20/cpuapp
    integration_platforms:
      - nrf54h20dk/nrf54h20/cpuapp
```

## samples/ironside_se/snapshot_capture_recover/sample.yaml
```yaml
#
# Copyright (c) 2026 Nordic Semiconductor ASA
#
# SPDX-License-Identifier: LicenseRef-Nordic-5-Clause
#

sample:
  name: IronSide SE snapshot capture and recover
  description: |
    Demonstrates IronSide SE snapshot capture and recovery.

common:
  sysbuild: true

tests:
  samples.ironside_se.snapshot_capture_recover:
    build_only: true
    tags:
      - sysbuild
      - ironside_se
    platform_allow:
      - nrf54h20dk/nrf54h20/cpuapp
    integration_platforms:
      - nrf54h20dk/nrf54h20/cpuapp
    timeout: 30
```
