/*
 * Copyright (c) 2024 Nordic Semiconductor ASA
 *
 * SPDX-License-Identifier: LicenseRef-Nordic-5-Clause
 */

 /delete-node/ &ipc0;

 / {
	 chosen {
		 /delete-property/ zephyr,ipc_shm;
	 };

	 ipc0: ipc0 {
		 compatible = "zephyr,ipc-icmsg";
		 tx-region = <&cpunet_cpuapp_ipc_shm>;
		 rx-region = <&cpuapp_cpunet_ipc_shm>;
		 mboxes = <&mbox 0>, <&mbox 1>;
		 mbox-names = "rx", "tx";
		 status = "okay";
	 };
 };
