/*
 * Copyright (c) 2024 Nordic Semiconductor ASA
 * SPDX-License-Identifier: LicenseRef-Nordic-5-Clause
 */

ipc0: &cpuapp_cpurad_ipc {
	status = "okay";
};

&cpuapp_cpurad_ram0x_region {
	status = "okay";
};

&cpurad_bellboard {
	status = "okay";
};

&cpuapp_bellboard {
	status = "okay";
};
