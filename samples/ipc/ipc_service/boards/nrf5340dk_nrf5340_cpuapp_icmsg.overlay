/*
* Copyright (c) 2022 Nordic Semiconductor ASA
*
* SPDX-License-Identifier: LicenseRef-Nordic-5-Clause
*/

/delete-node/ &ipc0;

/ {
	chosen {
		/delete-property/ zephyr,ipc_shm;
		/delete-property/ zephyr,bt-hci;
	};

	ipc0: ipc0 {
		compatible = "zephyr,ipc-icmsg";
		tx-region = <&cpuapp_cpunet_ipc_shm>;
		rx-region = <&cpunet_cpuapp_ipc_shm>;
		mboxes = <&mbox 0>, <&mbox 1>;
		mbox-names = "tx", "rx";
		status = "okay";
	};
};
