/*
 * Copyright (c) 2024 Nordic Semiconductor ASA
 * SPDX-License-Identifier: LicenseRef-Nordic-5-Clause
 */

ipc0: &cpuapp_cpurad_ipc {
	/* convert default IPC to zephyr,ipc-openamp-static-vrings */
	compatible = "zephyr,ipc-openamp-static-vrings";
	memory-region = <&cpuapp_cpurad_ram0x_region>;
	role = "host";
	/delete-property/ tx-region;
	/delete-property/ rx-region;
	/delete-property/ tx-blocks;
	/delete-property/ rx-blocks;
	status = "okay";
};
