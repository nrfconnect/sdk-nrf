/*
 * Copyright (c) 2024 Nordic Semiconductor ASA
 * SPDX-License-Identifier: LicenseRef-Nordic-5-Clause
 */

/ {
	ipc0: ipc0 {
		compatible = "zephyr,ipc-icmsg";
		tx-region = <&cpuapp_cpuppr_ipc_shm>;
		rx-region = <&cpuppr_cpuapp_ipc_shm>;
		mboxes = <&cpuppr_vevif 12>,
			 <&cpuapp_bellboard 12>;
		mbox-names = "tx", "rx";
		status = "okay";
	};
};

&cpuppr_vevif {
	status = "okay";
};

&cpuapp_bellboard {
	status = "okay";
	nordic,interrupt-mapping = <0x00001000 0>;
};
