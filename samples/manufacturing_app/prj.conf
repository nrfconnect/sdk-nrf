## CMakeLists.txt
```
#
# Copyright (c) 2026 Nordic Semiconductor ASA
#
# SPDX-License-Identifier: LicenseRef-Nordic-5-Clause
#
cmake_minimum_required(VERSION 3.20.0)

find_package(Zephyr REQUIRED HINTS $ENV{ZEPHYR_BASE})

project(manufacturing_app)

# ---------------------------------------------------------------------------
# Side-loaded manufacturing key blob
# ---------------------------------------------------------------------------
include(cmake/keys.cmake)

# ---------------------------------------------------------------------------
# Include path for application headers
# ---------------------------------------------------------------------------
target_include_directories(app PRIVATE src)

# ---------------------------------------------------------------------------
# Expose the keys/ directory path as a string literal available at runtime.
# ---------------------------------------------------------------------------
file(RELATIVE_PATH _keys_rel ${WEST_TOPDIR} ${CMAKE_CURRENT_SOURCE_DIR}/keys)
target_compile_definitions(app PRIVATE
  SAMPLE_KEYS_DIR="WEST_TOPDIR/${_keys_rel}"
)

# ---------------------------------------------------------------------------
# Application sources
# ---------------------------------------------------------------------------
target_sources(app PRIVATE
  src/main.c
  src/mfg_key_blob.c
  src/recovery.c
  src/kmu_check.c
  src/image_validation.c
  src/key_provisioning.c
  src/erase_protection.c
  src/huk_provisioning.c
  src/product_tests.c
  src/asset_provisioning.c
)
```

## Kconfig
```
#
# Copyright (c) 2026 Nordic Semiconductor ASA
#
# SPDX-License-Identifier: LicenseRef-Nordic-5-Clause
#

config SAMPLE_MFG_LOG_MACHINE_READABLE
	bool "Machine-readable log output"
	default n
	help
	  When enabled, the manufacturing application emits minimal, line-oriented
	  output suitable for automated test equipment:

	    STEP:<name>        — a step is starting
	    ERR:<message>      — an error condition was detected
	    KV:<key>:<value>   — structured datum (LCS state, IAK public key, ...)
	    DONE:PASS          — manufacturing completed successfully
	    DONE:FAIL          — manufacturing halted with an error

	  MFG_LOG_INF lines (verbose human-readable explanations) are suppressed.

	  When disabled (default), the application emits verbose human-readable
	  output including source file and line numbers for each step.

config SAMPLE_BLOCK_ERASE_ALL
	bool "Block erase-all by programming UICR.ERASEPROTECT during manufacturing"
	default n
	help
	  When enabled, the manufacturing application programs
	  UICR.ERASEPROTECT.PROTECT0 and UICR.ERASEPROTECT.PROTECT1 to
	  0x50FA50FA, permanently blocking the SWD erase-all command on the
	  device.

	  WARNING: This operation is irreversible without authenticated erase-all.
	  Do not enable this option for engineering/development devices.

	  UICR is accessible directly on the privileged cpuapp target via
	  nrfx_rramc_word_write(). See src/erase_protection.c for details.

config SAMPLE_MFG_APP_KEY_KMU_SLOT
	int "KMU slot holding the manufacturing application authentication key"
	default 224
	help
	  KMU slot number that holds the key used to authenticate this
	  manufacturing application. This key is revoked in Step 12 of the
	  manufacturing flow once provisioning is complete.

	  The key must be pre-loaded into this slot before the manufacturing
	  application runs.

	  This value is intentionally aligned with the bootloader's
	  CONFIG_NCS_MCUBOOT_MANUFACTURING_APP_KEY_IDENTIFIER (default 224
	  when BOOT_SIGNATURE_USING_KMU=y) and with the MANUFACTURING_APP_PUBKEY
	  entry in scripts/west_commands/ncs_provision.py. Keep them in sync
	  if you change one of them.

config SAMPLE_MFG_UROT_KEY_GEN0_KMU_SLOT
	int "KMU slot for UROT public key generation 0 (urot_pubkey_gen0)"
	default 226
	help
	  First physical KMU slot for the UROT generation-0 public key.
	  Ed25519 keys occupy 2 consecutive slots.

	  Aligned with the bootloader's CONFIG_NCS_BOOT_SIGNATURE_KMU_BASE_SLOT
	  (default 226 with NCS_BOOT_SIGNATURE_KMU_UROT_MAPPING) and the
	  UROT_PUBKEY entry in scripts/west_commands/ncs_provision.py
	  (slots [226, 228, 230]).

config SAMPLE_MFG_UROT_KEY_GEN1_KMU_SLOT
	int "KMU slot for UROT public key generation 1 (urot_pubkey_gen1)"
	default 228
	help
	  First physical KMU slot for the UROT generation-1 public key.
	  Ed25519 keys occupy 2 consecutive slots; gen1 follows gen0
	  (default 226) by 2 slots.

source "Kconfig.zephyr"
```

## sample.yaml
```
sample:
  description: >
    Manufacturing application sample for nRF54LV10A.
  name: Manufacturing Application
common:
  tags:
    - keys
    - manufacturing
  platform_allow:
    - nrf54lv10dk/nrf54lv10a/cpuapp
  integration_platforms:
    - nrf54lv10dk/nrf54lv10a/cpuapp
```

## prj.conf
```kconfig
#
# Copyright (c) 2026 Nordic Semiconductor ASA
#
# SPDX-License-Identifier: LicenseRef-Nordic-5-Clause
#

# Console and logging
CONFIG_CONSOLE=y
CONFIG_LOG=y
CONFIG_LOG_MODE_IMMEDIATE=y

# LCS (Life Cycle State) subsystem
CONFIG_NRF_LCS=y
# The bl_storage backend supplies the nrf_lcs_mem_*() symbols that
# nrf_lcs.c calls. SECURE_BOOT_STORAGE pulls subsys/bootloader/bl_storage
# into the build; NRF_LCS_MEM_BL_STORAGE then activates the
# nrf_lcs_mem_* implementations inside bl_storage.c.
CONFIG_SECURE_BOOT_STORAGE=y
CONFIG_NRF_LCS_MEM_BL_STORAGE=y
# Suppress INFO-level lcs log messages (e.g. "Performing LCS transition ...").
# The manufacturing app already logs the LCS state explicitly via MFG_LOG_KV,
# so the subsystem's informational messages are redundant. Errors are kept.
CONFIG_NRF_LCS_LOG_LEVEL_ERR=y

# nRF Security / CRACEN PSA Crypto driver
CONFIG_PSA_CRYPTO=y
CONFIG_MBEDTLS_PSA_CRYPTO_C=y
CONFIG_PSA_CRYPTO_DRIVER_OBERON=n
CONFIG_PSA_CRYPTO_DRIVER_CRACEN=y

# CRACEN Internal Key Generator (IKG seed provisioning)
CONFIG_CRACEN_IKG=y

# Do not auto-provision or push the protected RAM invalidation slots during
# psa_crypto_init(). The manufacturing app provisions slots 248/249 manually
# in Step 7. The push is deferred until after provisioning so that
# psa_crypto_init() succeeds on a virgin device.
CONFIG_CRACEN_PROVISION_PROT_RAM_INV_SLOTS_ON_INIT=n
CONFIG_CRACEN_PUSH_PROT_RAM_INV_SLOTS_ON_INIT=ns
# Allow Step 7 to provision slots 248/249 via psa_import_key(). CRACEN ignores
# the provided key material and generates 256 bits of hardware random data,
# provisioning both slots atomically.
# TODO: Update to use externally provided random data once the CRACEN driver
# supports importing caller-supplied material into PROTECTED-scheme slots.
CONFIG_CRACEN_PROVISION_PROT_RAM_INV_SLOTS_WITH_IMPORT=y

# Hardware Unique Key API (used to provision IKG seed with supplied data)
CONFIG_HW_UNIQUE_KEY=y
# Disable automatic seed generation on crypto init. The manufacturing app
# provisions the seed manually in Step 8.
CONFIG_HW_UNIQUE_KEY_WRITE_ON_CRYPTO_INIT=n

# PSA algorithms and key types needed by the manufacturing flow
CONFIG_PSA_WANT_ALG_SHA_256=y
CONFIG_PSA_WANT_ALG_ECDSA=y
CONFIG_PSA_WANT_ALG_PURE_EDDSA=y
CONFIG_PSA_WANT_KEY_TYPE_ECC_PUBLIC_KEY=y
CONFIG_PSA_WANT_KEY_TYPE_ECC_KEY_PAIR_EXPORT=y
CONFIG_PSA_WANT_ECC_TWISTED_EDWARDS_255=y
CONFIG_PSA_WANT_ECC_SECP_R1_256=y
CONFIG_PSA_WANT_GENERATE_RANDOM=y

# Flash subsystem (mfg_keys partition is read/erased via flash_area_*)
CONFIG_FLASH=y
CONFIG_FLASH_MAP=y

# Stack size
CONFIG_MAIN_STACK_SIZE=4096
CONFIG_SYSTEM_WORKQUEUE_STACK_SIZE=2048

# Reboot support (used in Step 12)
CONFIG_REBOOT=y
```

## boards/nrf54lv10dk_nrf54lv10a_cpuapp.overlay
```dts
/*
 * Copyright (c) 2026 Nordic Semiconductor ASA
 *
 * SPDX-License-Identifier: LicenseRef-Nordic-5-Clause
 */

/* Replace storage_partition (unused: this sample uses bl_storage in UICR,
 * not Zephyr settings) with a 4 KB partition for the side-loaded
 * manufacturing key blob. The remaining 32 KB at 0xe5000-0xed000 is left
 * unallocated.
 */

&cpuapp_rram {
	partitions {
		/delete-node/ partition@e4000;

		mfg_keys_partition: partition@e4000 {
			compatible = "zephyr,mapped-partition";
			label = "mfg_keys";
			reg = <0xe4000 DT_SIZE_K(4)>;
		};
	};
};
```

## src/main.c
```c
/*
 * Copyright (c) 2026 Nordic Semiconductor ASA.
 *
 * SPDX-License-Identifier: LicenseRef-Nordic-5-Clause
 */

/**
 * @file main.c
 *
 * Manufacturing application: 12-step provisioning flow for nRF54LV10A.
 *
 * Overview
 * --------
 * This application is a reference implementation of the manufacturing flow
 * for Nordic Semiconductor devices using CRACEN.
 *
 * LCS-aware execution
 * -------------------
 * The main switch dispatches to one of two handlers based on the current
 * Lifecycle State:
 *
 *   NRF_LCS_ASSEMBLY_AND_TEST     -> assembly_and_test_handler()  (Steps 2–6)
 *   NRF_LCS_PSA_ROT_PROVISIONING  -> psa_rot_provisioning_handler() (Steps 7–12)
 *
 * Execution flow
 * --------------
 * Assembly and Test state:
 *   Step  2: Validate no IKG seed or KeyRAM random present.
 *   Step  3: Validate digests of all sub-images.
 *   Step  4: Provision and verify secure-boot and ADAC public keys.
 *   Step  5: Block erase-all via UICR.ERASEPROTECT (if CONFIG_SAMPLE_BLOCK_ERASE_ALL).
 *   Step  6: Advance LCS to 'PROT Provisioning'.
 *
 * PROT Provisioning state:
 *   Step  7: Provision KeyRAM random data (KMU slots 248, 249).
 *   Step  8: Provision IKG seed; log IAK / MKEK / MEXT identifiers.
 *   Step  9: End product tests (placeholder: customise for your product).
 *   Step 10: Provision remaining assets and device enrolment (placeholder).
 *   Step 11: Advance LCS to 'Secured'.
 *   Step 12: Revoke manufacturing app key; reboot to install target application.
 */

#include <zephyr/kernel.h>
#include <zephyr/logging/log.h>
#include <zephyr/sys/reboot.h>
#include <nrf_lcs/nrf_lcs.h>

#include "mfg_key_blob.h"
#include "mfg_log.h"
#include "recovery.h"
#include "kmu_check.h"
#include "image_validation.h"
#include "key_provisioning.h"
#include "erase_protection.h"
#include "huk_provisioning.h"
#include "product_tests.h"
#include "asset_provisioning.h"

LOG_MODULE_REGISTER(manufacturing_app, LOG_LEVEL_DBG);

static const char *lcs_to_str(enum nrf_lcs state)
{
	switch (state) {
	case NRF_LCS_ASSEMBLY_AND_TEST:    return "Assembly and Test";
	case NRF_LCS_PSA_ROT_PROVISIONING: return "PSA RoT Provisioning";
	case NRF_LCS_SECURED:              return "Secured";
	case NRF_LCS_DECOMMISSIONED:       return "Decommissioned";
	case NRF_LCS_UNKNOWN:              return "Unknown";
	default:                           return "<invalid>";
	}
}

static void step1_lcs_check(void)
{
	enum nrf_lcs lcs = nrf_lcs_get();

	MFG_LOG_STEP("Checking LCS");
	MFG_LOG_KV("lcs", lcs_to_str(lcs));

	if (lcs != NRF_LCS_ASSEMBLY_AND_TEST &&
	    lcs != NRF_LCS_PSA_ROT_PROVISIONING) {
		MFG_LOG_ERR("Manufacturing application is not allowed to run in LCS '%s'.\n",
			    lcs_to_str(lcs));
		MFG_LOG_ERR("Expected ASSEMBLY_AND_TEST or PSA_ROT_PROVISIONING. "
			    "If LCS is SECURED or DECOMMISSIONED this indicates "
			    "a serious defect in the second-stage bootloader.\n");
		recovery_suspend(false);
	}
}

/* Wrap nrf_lcs_set() with a read-back so that a silently failed
 * transition (glitch / tamper / hardware fault) suspends immediately
 * instead of letting the caller continue in the wrong state.
 */
static void lcs_set_and_verify(enum nrf_lcs target, const char *step_name)
{
	enum nrf_lcs actual;

	MFG_LOG_STEP(step_name);
	nrf_lcs_set(target);

	actual = nrf_lcs_get();
	MFG_LOG_KV("lcs", lcs_to_str(actual));

	if (actual != target) {
		MFG_LOG_ERR("LCS transition failed: requested '%s', read back '%s'\n",
			    lcs_to_str(target), lcs_to_str(actual));
		recovery_suspend(false);
	}
}

static int assembly_and_test_handler(void)
{
	/* Step 2: Validate no IKG seed or KeyRAM random present */
	step2_kmu_check_empty();

	/* Step 3: Validate sub-image digests */
	step3_image_validate_all();

	/* Step 4: Provision secure-boot and ADAC keys */
	step4_key_provision_all();

	/* Step 5: Block erase-all via UICR.ERASEPROTECT */
	step5_erase_block_if_needed();

	/* Step 6: Advance LCS to 'PROT Provisioning' */
	lcs_set_and_verify(NRF_LCS_PSA_ROT_PROVISIONING,
			   "Transitioning LCS to 'PSA RoT Provisioning'");

	return 0;
}

static int psa_rot_provisioning_handler(void)
{
	/* Step 7: Provision KeyRAM random data */
	step7_provision_keyram_random();

	/* Step 8: Provision IKG seed */
	step8_huk_provision_ikg_seed();

	/* Step 9: End product tests */
	step9_tests_run();

	/* Step 10: Provision remaining assets */
	step10_assets_provision();

	/* Step 11: Advance LCS to 'Secured' */
	lcs_set_and_verify(NRF_LCS_SECURED,
			   "Transitioning LCS to 'Secured'");

	/* Step 12: Revoke manufacturing app key and reboot. */
	MFG_LOG_STEP("Cleaning up");
	step12_key_revoke_mfg_key();

	MFG_LOG_INF("\nManufacturing process is completed. The device is about to reboot\n");
	MFG_LOG_INF("and the target application will be installed.\n");
	MFG_LOG_DONE(true);

	k_sleep(K_MSEC(100));
	sys_reboot(SYS_REBOOT_COLD);

	return 0;
}

int main(void)
{
	if (mfg_key_blob_get() == NULL) {
		MFG_LOG_ERR("mfg_keys partition is missing or invalid.\n");
		MFG_LOG_ERR("Flash mfg_keys.bin to the mfg_keys partition (see README).\n");
		recovery_suspend(false);
	}

	/*
	 * TODO: Remove once BL1/NSIB provisions the manufacturing app key.
	 * CONFIG_SAMPLE_MFG_APP_KEY_KMU_SLOT before this application runs. This call
	 * is a temporary workaround that makes the sample self-contained.
	 */
	key_provision_mfg_app_key();

	/* Step 1: Check LCS. nrf_lcs_get() reads OTP directly; no PSA init required. */
	step1_lcs_check();

	if (nrf_lcs_get() == NRF_LCS_ASSEMBLY_AND_TEST) {
		int ret = assembly_and_test_handler();

		if (ret != 0) {
			MFG_LOG_ERR("Assembly and test handler failed (err=%d)\n", ret);
			MFG_LOG_DONE(false);
			return ret;
		}
	}

	if (nrf_lcs_get() == NRF_LCS_PSA_ROT_PROVISIONING) {
		int ret = psa_rot_provisioning_handler();

		if (ret != 0) {
			MFG_LOG_ERR("PSA RoT provisioning handler failed (err=%d)\n", ret);
			MFG_LOG_DONE(false);
			return ret;
		}

		return 0;
	}

	MFG_LOG_ERR("Device in an unbootable LCS: %s\n", lcs_to_str(nrf_lcs_get()));
	recovery_suspend(false);
}
```

## src/asset_provisioning.c
```c
/*
 * Copyright (c) 2026 Nordic Semiconductor ASA
 *
 * SPDX-License-Identifier: LicenseRef-Nordic-5-Clause
 */

/**
 * Step 10: Provision remaining assets and device enrollment.
 *
 * At this stage of the manufacturing flow the device is:
 *   - Authenticated (ADAC / secure-boot keys provisioned, Step 4)
 *   - Running with IKG seed and IAK available (Step 8)
 *   - In LCS = 'PROT Provisioning' (Step 6)
 *
 * Security note:
 *   Secure delivery or derivation of private keys and symmetric keys,
 *   while technically feasible using the MKEK/MEXT derivation chain,
 *   is out of scope of this reference application.
 */

#include "asset_provisioning.h"
#include "mfg_log.h"

void step10_assets_provision(void)
{
	MFG_LOG_STEP("Provisioning of remaining assets");

	MFG_LOG_INF("This is a good place to add code for provisioning of other assets.\n");
	MFG_LOG_INF("Manufacturing app is authenticated at that stage, so it is possible to\n");
	MFG_LOG_INF("establish a trusted secure channel to an external system, to enroll the\n");
	MFG_LOG_INF("device to Device Management System, and get/negotiate any other required\n");
	MFG_LOG_INF("assets (i.e. certificates, keys etc.)\n\n");
	MFG_LOG_INF("Secure delivery/derivation of private/symmetric keys, however feasible,\n");
	MFG_LOG_INF("is out of scope of this application.\n");
}
```

## src/asset_provisioning.h
```c
/*
 * Copyright (c) 2026 Nordic Semiconductor ASA
 *
 * SPDX-License-Identifier: LicenseRef-Nordic-5-Clause
 */

/**
 * @file asset_provisioning.h
 *
 * Step 10: Provision remaining assets and enrol the device.
 *
 * This is a placeholder for product-specific provisioning beyond what the
 * mandatory manufacturing flow covers.
 */

#ifndef ASSET_PROVISIONING_H_
#define ASSET_PROVISIONING_H_

/**
 * @brief Step 10: Provision remaining assets and enrol the device.
 *
 * Placeholder implementation. Extend this function with any additional
 * provisioning required by your product.
 */
void step10_assets_provision(void);

#endif /* ASSET_PROVISIONING_H_ */
```

## src/erase_protection.c
```c
/*
 * Copyright (c) 2026 Nordic Semiconductor ASA
 *
 * SPDX-License-Identifier: LicenseRef-Nordic-5-Clause
 */

/**
 * Step 5: Block erase-all via UICR.ERASEPROTECT.
 *
 * Hardware background (nRF54LV10A):
 *   UICR.ERASEPROTECT register pair (UICR base 0xFFD000):
 *     NRF_UICR_S->ERASEPROTECT[0].PROTECT0  @ 0xFFD060  (reset: 0xFFFFFFFF)
 *     NRF_UICR_S->ERASEPROTECT[0].PROTECT1  @ 0xFFD07C  (reset: 0xFFFFFFFF)
 *
 *   Valid states:
 *     0xFFFFFFFF / 0xFFFFFFFF — protection NOT active (erase-all allowed)
 *     0x50FA50FA / 0x50FA50FA — protection active (erase-all blocked)
 *
 *   Any other value is suspicious and logged as an error.
 *
 * Write mechanism:
 *   Writes use nrfx_rramc_word_write() with the direct register address.
 *   The write is one-time (OTP-like) because once set to 0x50FA50FA the ERASEPROTECT
 *   value can only be cleared by an authenticated erase-all.
 */

#include "erase_protection.h"
#include "mfg_log.h"
#include "recovery.h"

#include <autoconf.h>
#include <nrfx_rramc.h>
#include <nrfx.h>

#define ERASEPROTECT_ACTIVE_VALUE   0x50FA50FAU
#define ERASEPROTECT_INACTIVE_VALUE 0xFFFFFFFFU

/* ---------------------------------------------------------------------------
 * Read UICR.ERASEPROTECT registers directly (privileged MMIO).
 * ---------------------------------------------------------------------------
 */
static void eraseprotect_read(uint32_t *protect0, uint32_t *protect1)
{
	*protect0 = NRF_UICR_S->ERASEPROTECT[0].PROTECT0;
	*protect1 = NRF_UICR_S->ERASEPROTECT[0].PROTECT1;
}

/* ---------------------------------------------------------------------------
 * Write UICR.ERASEPROTECT registers via RRAMC word write.
 * Only used when CONFIG_SAMPLE_BLOCK_ERASE_ALL is enabled.
 * ---------------------------------------------------------------------------
 */
#ifdef CONFIG_SAMPLE_BLOCK_ERASE_ALL
static int eraseprotect_activate(void)
{
	nrfx_rramc_word_write((uint32_t)&NRF_UICR_S->ERASEPROTECT[0].PROTECT0,
			      ERASEPROTECT_ACTIVE_VALUE);
	nrfx_rramc_word_write((uint32_t)&NRF_UICR_S->ERASEPROTECT[0].PROTECT1,
			      ERASEPROTECT_ACTIVE_VALUE);
	return 0;
}
#endif /* CONFIG_SAMPLE_BLOCK_ERASE_ALL */

/* ---------------------------------------------------------------------------
 * Step 5 entry point
 * ---------------------------------------------------------------------------
 */
void step5_erase_block_if_needed(void)
{
	MFG_LOG_STEP("Checking erase-all policy");

#ifdef CONFIG_SAMPLE_BLOCK_ERASE_ALL
	MFG_LOG_INF("CONFIG_SAMPLE_BLOCK_ERASE_ALL is active\n");
#else
	MFG_LOG_INF("CONFIG_SAMPLE_BLOCK_ERASE_ALL is not active\n");
#endif

	uint32_t protect0 = 0;
	uint32_t protect1 = 0;

	eraseprotect_read(&protect0, &protect1);

	MFG_LOG_INF("UICR.ERASEPROTECT.PROTECT0 = 0x%08X\n", protect0);
	MFG_LOG_INF("UICR.ERASEPROTECT.PROTECT1 = 0x%08X\n", protect1);

	bool p0_active   = (protect0 == ERASEPROTECT_ACTIVE_VALUE);
	bool p1_active   = (protect1 == ERASEPROTECT_ACTIVE_VALUE);
	bool p0_inactive = (protect0 == ERASEPROTECT_INACTIVE_VALUE);
	bool p1_inactive = (protect1 == ERASEPROTECT_INACTIVE_VALUE);
	bool p0_valid    = p0_active || p0_inactive;
	bool p1_valid    = p1_active || p1_inactive;

	/* ----- Suspicious values ----- */
	if (!p0_valid || !p1_valid) {
		MFG_LOG_ERR("\nSuspicious UICR.ERASEPROTECT value detected.\n");
		MFG_LOG_ERR("Expected 0xFFFFFFFF (inactive) or 0x50FA50FA (active).\n");
		recovery_suspend(false);
	}

	bool currently_active = p0_active && p1_active;

#ifdef CONFIG_SAMPLE_BLOCK_ERASE_ALL

	if (currently_active) {
		MFG_LOG_INF("erase-all is blocked in UICR, nothing to do.\n");
		return;
	}

	MFG_LOG_INF("\nBlocking erase-all...\n");

	int err = eraseprotect_activate();

	if (err != 0) {
		MFG_LOG_ERR("Failed to activate ERASEPROTECT (err=%d).\n", err);
		recovery_suspend(false);
	}

	MFG_LOG_INF("Verifying erase-all...\n");

	eraseprotect_read(&protect0, &protect1);

	MFG_LOG_INF("UICR.ERASEPROTECT.PROTECT0 = 0x%08X\n", protect0);
	MFG_LOG_INF("UICR.ERASEPROTECT.PROTECT1 = 0x%08X\n", protect1);

	if (protect0 != ERASEPROTECT_ACTIVE_VALUE || protect1 != ERASEPROTECT_ACTIVE_VALUE) {
		MFG_LOG_ERR("\nFailed to activate UICR.ERASEPROTECT.\n");
		recovery_suspend(false);
	}

	MFG_LOG_INF("\nerase-all is successfully blocked in UICR.\n");

#else /* CONFIG_SAMPLE_BLOCK_ERASE_ALL not set */

	if (!currently_active) {
		MFG_LOG_INF("erase-all is not blocked in UICR, nothing to do.\n");
		MFG_LOG_INF("\nNotice: the device is not protected against erase-all.\n");
		MFG_LOG_INF("Anyone with SWD access can wipe the RRAM content.\n");
		MFG_LOG_INF("Expected for engineering devices; consider enabling for end-devices.\n");
	} else {
		MFG_LOG_INF("erase-all is blocked in UICR.\n");
	}

#endif /* CONFIG_SAMPLE_BLOCK_ERASE_ALL */
}
```

## src/erase_protection.h
```c
/*
 * Copyright (c) 2026 Nordic Semiconductor ASA
 *
 * SPDX-License-Identifier: LicenseRef-Nordic-5-Clause
 */

/**
 * @file erase_protection.h
 *
 * Step 5: Check and optionally block the SWD erase-all command via
 * UICR.ERASEPROTECT on the nRF54LV10A.
 */

#ifndef ERASE_PROTECTION_H_
#define ERASE_PROTECTION_H_

/**
 * @brief Step 5: Check and optionally block erase-all.
 *
 * Reads UICR.ERASEPROTECT.PROTECT0 and PROTECT1 and logs their content.
 * If CONFIG_SAMPLE_BLOCK_ERASE_ALL is enabled and the protection is not yet active,
 * programs the protection values via nrfx_rramc_word_write() and verifies.
 *
 */
void step5_erase_block_if_needed(void);

#endif /* ERASE_PROTECTION_H_ */
```

## src/huk_provisioning.c
```c
/*
 * Copyright (c) 2026 Nordic Semiconductor ASA
 *
 * SPDX-License-Identifier: LicenseRef-Nordic-5-Clause
 */

/**
 * Steps 7 and 8: Provision KeyRAM random data and IKG seed.
 *
 * Step 7: KeyRAM random (PROTECTED scheme):
 *   KMU slots 248 (PROTECTED_RAM_INVALIDATION_DATA_SLOT1) and
 *             249 (PROTECTED_RAM_INVALIDATION_DATA_SLOT2).
 *
 *   These are AES keys that CRACEN uses to overwrite its protected RAM after
 *   each key use. They are provisioned by calling cracen_provision_prot_ram_inv_slots()
 *   directly, which generates 256 bits of hardware random data and populates
 *   both slots atomically. CONFIG_CRACEN_PROVISION_PROT_RAM_INV_SLOTS_WITH_IMPORT=y
 *   ensures this function is compiled into the driver.
 *
 * Step 8: IKG seed (SEED scheme):
 *   Stored in CONFIG_CRACEN_IKG_SEED_KMU_SLOT using CRACEN_KMU_KEY_USAGE_SCHEME_SEED.
 *   From this seed CRACEN derives:
 *     IAK  (Initial Attestation Key)   — 0x7FFFC001
 *     MKEK (Master Key Encryption Key) — 0x7FFFC002
 *     MEXT (Master External Key)       — 0x7FFFC003
 *
 */

#include "huk_provisioning.h"
#include "mfg_key_blob.h"
#include "mfg_log.h"
#include "recovery.h"

#include <zephyr/kernel.h>
#include <psa/crypto.h>
#include <cracen/cracen_kmu.h>
#include <cracen_psa_key_ids.h>
#include <hw_unique_key.h>

BUILD_ASSERT(MFG_IKG_SEED_LEN == HUK_SIZE_BYTES,
	     "MFG_IKG_SEED_LEN must match HUK_SIZE_BYTES");

/* ---------------------------------------------------------------------------
 * Helpers
 * ---------------------------------------------------------------------------
 */

static bool ikg_seed_is_provisioned(void)
{
	return hw_unique_key_are_any_written();
}

static bool all_zeros(const uint8_t *data, size_t len)
{
	for (size_t i = 0; i < len; i++) {
		if (data[i] != 0U) {
			return false;
		}
	}
	return true;
}

/* ---------------------------------------------------------------------------
 * Step 7: Provision KeyRAM random data
 *
 * cracen_provision_prot_ram_inv_slots() generates 256 bits of hardware random
 * data and provisions both slots 248 and 249 atomically.
 *
 * CONFIG_CRACEN_PROVISION_PROT_RAM_INV_SLOTS_WITH_IMPORT=y ensures this
 * function is compiled into the CRACEN driver.
 *
 * TODO: Update to use externally provided random data once the CRACEN driver
 * supports importing caller-supplied material into PROTECTED-scheme slots.
 * ---------------------------------------------------------------------------
 */
void step7_provision_keyram_random(void)
{
	MFG_LOG_STEP("Provisioning KeyRAM random data");
	MFG_LOG_INF("Provisioning KeyRAM random (slots %d and %d)...",
		    PROTECTED_RAM_INVALIDATION_DATA_SLOT1,
		    PROTECTED_RAM_INVALIDATION_DATA_SLOT2);

	psa_status_t status = cracen_provision_prot_ram_inv_slots();

	if (status != PSA_SUCCESS) {
		MFG_LOG_INF(" FAIL (%d)\n", status);
		MFG_LOG_ERR("Failed to provision KeyRAM random slots.\n");
		recovery_suspend(false);
	}

	MFG_LOG_INF(" OK (hardware-generated random)\n");
}

/* ---------------------------------------------------------------------------
 * Verify the IKG seed is functional by exporting the IAK public key.
 * If the seed was written with bad data (e.g. all-zeros), CRACEN cannot
 * derive the IAK and psa_export_public_key() will fail.
 * ---------------------------------------------------------------------------
 */
static void verify_ikg_seed(void)
{
	/* IAK is a secp256r1 (P-256) key pair. Uncompressed public point = 65 bytes. */
	uint8_t iak_pub[65];
	size_t  iak_pub_len = 0;

	psa_status_t status = psa_export_public_key(CRACEN_BUILTIN_IDENTITY_KEY_ID,
						    iak_pub, sizeof(iak_pub),
						    &iak_pub_len);

	if (status != PSA_SUCCESS) {
		MFG_LOG_ERR("IKG seed verification FAILED: psa_export_public_key(IAK) = %d\n",
			    status);
		MFG_LOG_ERR("The IKG seed may not have been provisioned correctly.\n");
		recovery_suspend(false);
	}

	MFG_LOG_INF("IKG-derived key identifiers:\n");
	MFG_LOG_INF("  IAK  (0x%08x, secp256r1, %zu bytes):\n",
		    (unsigned int)CRACEN_BUILTIN_IDENTITY_KEY_ID, iak_pub_len);
	mfg_log_bytes("iak_pubkey", iak_pub, iak_pub_len);
	MFG_LOG_INF("  MKEK (0x%08x)\n", (unsigned int)CRACEN_BUILTIN_MKEK_ID);
	MFG_LOG_INF("  MEXT (0x%08x)\n", (unsigned int)CRACEN_BUILTIN_MEXT_ID);
}

/* ---------------------------------------------------------------------------
 * Step 8: Provision IKG seed and verify derived key availability
 * ---------------------------------------------------------------------------
 */
void step8_huk_provision_ikg_seed(void)
{
	MFG_LOG_STEP("Provisioning IKG seed");

	if (ikg_seed_is_provisioned()) {
		MFG_LOG_INF("IKG seed already provisioned — verifying derivation.\n");
		verify_ikg_seed();
		return;
	}

	const struct mfg_key_blob *blob = mfg_key_blob_get();

	if (blob == NULL) {
		MFG_LOG_ERR("mfg_keys blob unavailable — cannot provision IKG seed.\n");
		recovery_suspend(false);
	}

	if (all_zeros(blob->ikg_seed, sizeof(blob->ikg_seed))) {
		MFG_LOG_INF("\nWARNING: ikg_seed is all-zeros.\n");
		MFG_LOG_INF("Replace the placeholder with per-device random data.\n");
		MFG_LOG_INF("Continuing in 5 seconds...\n");
		k_sleep(K_SECONDS(5));
	}

	MFG_LOG_INF("Writing IKG seed to KMU slot %d...", CONFIG_CRACEN_IKG_SEED_KMU_SLOT);

	/* hw_unique_key_write() wraps cracen_import_key with
	 * CRACEN_KMU_KEY_USAGE_SCHEME_SEED. On CRACEN the slot is always
	 * CONFIG_CRACEN_IKG_SEED_KMU_SLOT and the key_slot argument is ignored,
	 * so we just pass any valid enumerator.
	 */
	int err = hw_unique_key_write(HUK_KEYSLOT_MKEK, blob->ikg_seed);

	if (err != HW_UNIQUE_KEY_SUCCESS) {
		MFG_LOG_INF(" FAIL (hw_unique_key_write returned %d)\n", err);
		MFG_LOG_ERR("Failed to provision IKG seed.\n");
		recovery_suspend(false);
	}

	MFG_LOG_INF(" OK\n");
	verify_ikg_seed();
}
```

## src/huk_provisioning.h
```c
/*
 * Copyright (c) 2026 Nordic Semiconductor ASA
 *
 * SPDX-License-Identifier: LicenseRef-Nordic-5-Clause
 */

/**
 * @file huk_provisioning.h
 *
 * Steps 7 and 8: Provision KeyRAM random data and IKG seed.
 *
 * "KeyRAM random" refers to the protected RAM invalidation slots (KMU slots
 * 248 and 249, defined as PROTECTED_RAM_INVALIDATION_DATA_SLOT1/2 in
 * cracen_kmu.h). These hold random data that CRACEN pushes to its protected
 * RAM to overwrite key material after each use.
 *
 * "IKG seed" is the 384-bit (48-byte) seed for CRACEN's Internal Key
 * Generator. From the seed, CRACEN derives all device-unique keys:
 *   - Initial Attestation Key (IAK, also known as Identity Key) — ID 0x7FFFC001
 *   - Master Key Encryption Key (MKEK) — ID 0x7FFFC002
 *   - Master External Key (MEXT) — ID 0x7FFFC003
 */

#ifndef HUK_PROVISIONING_H_
#define HUK_PROVISIONING_H_

/**
 * @brief Step 7: Provision KeyRAM random data to KMU slots 248 and 249.
 *
 * If already provisioned, logs that fact and returns. Otherwise generates
 * random data and provisions both slots. Suspends on failure.
 * TODO: Update to use externally provided random data once the CRACEN driver
 * supports importing caller-supplied material into PROTECTED-scheme slots.
 */
void step7_provision_keyram_random(void);

/**
 * @brief Step 8: Provision the IKG seed and log derived key information.
 *
 * If already provisioned, logs that fact and returns. Otherwise generates
 * and provisions the 384-bit IKG seed. After provisioning, logs the public
 * representation of IAK, MKEK ID, MEXT ID, and PSA Instance ID.
 * Suspends on failure.
 */
void step8_huk_provision_ikg_seed(void);

#endif /* HUK_PROVISIONING_H_ */
```

## src/image_validation.c
```c
/*
 * Copyright (c) 2026 Nordic Semiconductor ASA
 *
 * SPDX-License-Identifier: LicenseRef-Nordic-5-Clause
 */

/**
 * Step 3: Image digest validation.
 *
 * TODO
 *
 */

#include "image_validation.h"
#include "mfg_key_blob.h"
#include "mfg_log.h"
#include "recovery.h"

#include <psa/crypto.h>

static bool __attribute__((unused)) digests_equal(const uint8_t *first_digest,
						  const uint8_t *second_digest,
						  size_t len)
{
	uint8_t diff = 0;

	for (size_t i = 0; i < len; i++) {
		diff |= first_digest[i] ^ second_digest[i];
	}
	return diff == 0;
}

static void validate_image_digest(const char *label, const uint8_t *digest)
{
	MFG_LOG_INF("Validating %s...", label);

	if (digest == NULL || mfg_digest_is_zero(digest)) {
		MFG_LOG_INF(" SKIP (no expected digest provided at build time)\n");
		return;
	}

	/* TODO: read the image from its partition, hash it, compare to digest. */
	MFG_LOG_INF(" SKIP (partition address integration not yet implemented)\n");
}

static void validate_manufacturing_app(void)
{
	MFG_LOG_INF("Validating Manufacturing application (self-check)...");
	/* TODO */
	MFG_LOG_INF(" SKIP (self-check not yet implemented)\n");
}

/* ---------------------------------------------------------------------------
 * Step 3 entry point
 * ---------------------------------------------------------------------------
 */
void step3_image_validate_all(void)
{
	MFG_LOG_STEP("Validating images");

	const struct mfg_key_blob *blob = mfg_key_blob_get();

	validate_image_digest("Bootloader 1",
			      blob ? blob->bl1_digest : NULL);
	validate_image_digest("Bootloader 2, slot A",
			      blob ? blob->bl2_slot_a_digest : NULL);
	validate_image_digest("Bootloader 2, slot B",
			      blob ? blob->bl2_slot_b_digest : NULL);
	validate_manufacturing_app();
	validate_image_digest("Application candidate",
			      blob ? blob->app_candidate_digest : NULL);
}
```

## src/image_validation.h
```c
/*
 * Copyright (c) 2026 Nordic Semiconductor ASA
 *
 * SPDX-License-Identifier: LicenseRef-Nordic-5-Clause
 */

/**
 * @file image_validation.h
 *
 * Step 3: Validate digests of all sub-images in the initial image.
 */

#ifndef IMAGE_VALIDATION_H_
#define IMAGE_VALIDATION_H_

/**
 * @brief Step 3: Validate all sub-image digests.
 *
 * Checks SHA-256 digests of:
 *   - BL1
 *   - BL2, slot A
 *   - BL2, slot B
 *   - Manufacturing application
 *   - Application candidate
 *
 * Suspends execution if any verification fails.
 *
 * @note BL1/BL2 validation is currently stubbed
 *       pending partition address integration.
 */
void step3_image_validate_all(void);

#endif /* IMAGE_VALIDATION_H_ */
```

## src/key_provisioning.h
```c
/*
 * Copyright (c) 2026 Nordic Semiconductor ASA
 *
 * SPDX-License-Identifier: LicenseRef-Nordic-5-Clause
 */

/**
 * @file key_provisioning.h
 *
 * Steps 4 and 12 — Provision and verify secure-boot / ADAC public keys,
 * and revoke the manufacturing application authentication key.
 */

#ifndef KEY_PROVISIONING_H_
#define KEY_PROVISIONING_H_

/**
 * @brief Provision the manufacturing application authentication key.
 *
 * Writes the mfg_app_pubkey (Ed25519) to KMU slot CONFIG_SAMPLE_MFG_APP_KEY_KMU_SLOT
 * with a REVOKABLE persistence policy so it can be destroyed in Step 12 but
 * never reloaded after that.
 *
 * TODO: Remove this call once the bootloader chain (BL1/NSIB) is updated to
 * provision the manufacturing app key before handing over to this application.
 * In production the key must already be present in the KMU slot when main()
 * is entered; the manufacturing app should only revoke it, not provision it.
 *
 * Suspends execution on any error.
 */
void key_provision_mfg_app_key(void);

/**
 * @brief Step 4 — Provision and verify all secure-boot and ADAC keys.
 *
 * For each UROT public key carried in the mfg_keys blob:
 *   1. Skips the key if its bytes in the blob are all-zero (placeholder slot).
 *   2. Checks whether the target KMU slot is already occupied; if so, validates
 *      that the key's PSA attributes match the expected UROT configuration.
 *   3. Otherwise writes the key bytes to KMU.
 *   4. Verifies the key by performing a signature check using the detached
 *      Ed25519 signature carried alongside it in the blob and a known
 *      verification message.
 *
 * Suspends execution on any error that cannot be recovered from.
 */
void step4_key_provision_all(void);

/**
 * @brief Step 12 — Revoke the manufacturing application authentication key.
 *
 * Destroys the key held in KMU slot CONFIG_SAMPLE_MFG_APP_KEY_KMU_SLOT.
 * After this call the manufacturing application's signing key is revoked and
 * the device will reject any future manufacturing image signed with that key
 * (provided the slot used LIB_KMU_REV_POLICY_ROTATING or REVOKABLE policy).
 */
void step12_key_revoke_mfg_key(void);

#endif /* KEY_PROVISIONING_H_ */
```

## src/kmu_check.c
```c
/*
 * Copyright (c) 2025 Nordic Semiconductor ASA
 *
 * SPDX-License-Identifier: LicenseRef-Nordic-5-Clause
 */

/**
 * Step 2 — Validate that no IKG seed or KeyRAM random data is already present.
 *
 * Check strategy:
 *
 * IKG seed presence:
 *   hw_unique_key_are_any_written() directly queries the KMU slot for the
 *   CRACEN_KMU_KEY_USAGE_SCHEME_SEED entry via cracen_kmu_get_key_slot().
 *   This is more reliable than trying to derive the IAK via psa_export_public_key(),
 *   which returns driver-specific error codes that vary depending on heap state
 *   and CRACEN configuration.
 *     - returns true  → seed IS present (error — must suspend).
 *     - returns false → seed not present (good).
 *
 * KeyRAM random slots (PROTECTED_RAM_INVALIDATION_DATA_SLOT1 = 248,
 *                      PROTECTED_RAM_INVALIDATION_DATA_SLOT2 = 249):
 *   We probe the KMU slot directly via cracen_kmu_get_key_slot():
 *     - PSA_SUCCESS                → slot occupied (error — must suspend).
 *     - any other status           → slot empty (good).
 */

#include "kmu_check.h"
#include "mfg_log.h"
#include "recovery.h"

#include <psa/crypto.h>
#include <cracen/cracen_kmu.h>
#include <cracen_psa_kmu.h>
#include <cracen_psa_key_ids.h>
#include <hw_unique_key.h>

/* ---------------------------------------------------------------------------
 * IKG seed presence check via direct KMU slot query
 * ---------------------------------------------------------------------------
 */
static void check_ikg_seed_slots(void)
{
	MFG_LOG_INF("Verifying KMU IKG seed slots...");

	if (hw_unique_key_are_any_written()) {
		MFG_LOG_INF(" FAIL (not empty)\n");
		MFG_LOG_ERR("\nSeems IKG seed is already provisioned. Secrecy and entropy level\n");
		MFG_LOG_ERR("of that data cannot be trusted.\n");
		recovery_suspend(false);
	}

	MFG_LOG_INF(" OK (empty)\n");
}

/* ---------------------------------------------------------------------------
 * KeyRAM random slot presence check
 *
 * cracen_kmu_get_key_slot() is the same direct KMU probe used internally by
 * hw_unique_key_are_any_written(). It returns PSA_SUCCESS if and only if the
 * slot holds a valid key, without performing any cryptographic operation.
 *
 * Slot numbers are defined in cracen_kmu.h:
 *   PROTECTED_RAM_INVALIDATION_DATA_SLOT1 = 248
 *   PROTECTED_RAM_INVALIDATION_DATA_SLOT2 = 249
 * ---------------------------------------------------------------------------
 */
static void check_one_keyram_slot(int slot_id)
{
	MFG_LOG_INF("Verifying KMU KeyRAM random slot %d...", slot_id);

	psa_key_id_t key_id = PSA_KEY_HANDLE_FROM_CRACEN_KMU_SLOT(
		CRACEN_KMU_KEY_USAGE_SCHEME_PROTECTED, slot_id);

	psa_key_lifetime_t lifetime;
	psa_drv_slot_number_t slot_number;
	psa_status_t status = cracen_kmu_get_key_slot(key_id, &lifetime, &slot_number);

	if (status != PSA_SUCCESS) {
		MFG_LOG_INF(" OK (empty)\n");
		return;
	}

	MFG_LOG_INF(" FAIL (not empty)\n");
	MFG_LOG_ERR("\nSeems KeyRAM random (slot %d) is already provisioned.\n", slot_id);
	MFG_LOG_ERR("Secrecy and entropy level of that data cannot be trusted.\n");
	recovery_suspend(false);
}

/* ---------------------------------------------------------------------------
 * Step 2 entry point
 * ---------------------------------------------------------------------------
 */
void step2_kmu_check_empty(void)
{
	MFG_LOG_STEP("Checking KMU slots");

	check_ikg_seed_slots();

	check_one_keyram_slot(PROTECTED_RAM_INVALIDATION_DATA_SLOT1);
	check_one_keyram_slot(PROTECTED_RAM_INVALIDATION_DATA_SLOT2);
}
```

## src/kmu_check.h
```c
/*
 * Copyright (c) 2026 Nordic Semiconductor ASA
 *
 * SPDX-License-Identifier: LicenseRef-Nordic-5-Clause
 */

/**
 * @file kmu_check.h
 *
 * Step 2 — Validate that no IKG seed or KeyRAM random data is already
 * present in KMU in LCS = 'Manufacturing and Test'.
 *
 * A pre-existing seed would indicate either a leftover from previous
 * activity on the device or an intentional malicious action. Either case
 * is a serious security flaw and manufacturing must halt.
 */

#ifndef KMU_CHECK_H_
#define KMU_CHECK_H_

/**
 * @brief Step 2 — Check that IKG seed and KeyRAM random slots are empty.
 *
 * Only call this function when LCS = 'Manufacturing and Test'. It verifies:
 *   1. The IKG seed KMU slots (used by CRACEN's internal key generator) are
 *      empty — confirmed via hw_unique_key_are_any_written().
 *   2. The KeyRAM random invalidation slots (248, 249) are empty.
 *
 * Suspends execution if either check finds pre-existing data.
 */
void step2_kmu_check_empty(void);

#endif /* KMU_CHECK_H_ */
```
