## CMakeLists.txt
```
#
# Copyright (c) 2019 Nordic Semiconductor
#
# SPDX-License-Identifier: LicenseRef-BSD-5-Clause-Nordic
#

cmake_minimum_required(VERSION 3.8.2)

include($ENV{ZEPHYR_BASE}/cmake/app/boilerplate.cmake NO_POLICY_SCOPE)
project("GPIO frontend sample")

target_sources(app PRIVATE src/main.c)
```

## sample.yaml
```
sample:
  description: Sample showing GPIO frontend
  name: GPIO frontend sample
tests:
  test_build:
    build_only: true
    build_on_all: true
    platform_whitelist: nrf52_pca10040 nrf52840_pca10056 nrf9160_pca10090
    tags: ci_build
```

## prj.conf
```kconfig
CONFIG_LOG=y
CONFIG_LOG_FRONTEND=y
CONFIG_LOG_FRONTEND_GPIO=y
CONFIG_LOG_FRONTEND_PORT_NUMBER=1
CONFIG_LOG_FRONTEND_LSB_PIN_NUMBER=1
```

## prj_nrf9160_pca10090.conf
```kconfig
CONFIG_LOG=y
CONFIG_LOG_FRONTEND=y
CONFIG_LOG_FRONTEND_GPIO=y
CONFIG_LOG_FRONTEND_PORT_NUMBER=0
CONFIG_LOG_FRONTEND_LSB_PIN_NUMBER=22
```

## src/main.c
```c
/*
 * Copyright (c) 2019 Nordic Semiconductor ASA
 *
 * SPDX-License-Identifier: LicenseRef-BSD-5-Clause-Nordic
 */

#include <zephyr.h>
#include <logging/log.h>
LOG_MODULE_REGISTER(app, LOG_LEVEL_DBG);

static const u32_t beef = 0xBEEF;

void main(void)
{
	u32_t x = 0xDEADCAFE;

	while (true) {
		LOG_ERR("Hello World!");
		LOG_WRN("beef: %x", beef);
		LOG_INF("beef: %x    x: %x", beef, x);
		LOG_DBG("beef: %x %d x: %x", beef, beef, x);
		LOG_INF("beef: %x %d x: %x %d", beef, beef, x, x);
		LOG_HEXDUMP_WRN((uint8_t *)&x, sizeof(x), "");
		k_sleep(1000);
	}
}
```
