## CMakeLists.txt
```
#
# Copyright (c) 2019 Nordic Semiconductor
#
# SPDX-License-Identifier: LicenseRef-Nordic-5-Clause
#

cmake_minimum_required(VERSION 3.20.0)

find_package(Zephyr REQUIRED HINTS $ENV{ZEPHYR_BASE})
project("PPI trace sample")

# NORDIC SDK APP START
target_sources(app PRIVATE src/main.c)
# NORDIC SDK APP END
target_sources_ifdef(CONFIG_USE_BLUETOOTH_RADIO_EVENTS app PRIVATE src/bluetooth.c)
```

## Kconfig
```
# Config options for PPI trace sample
#
# Copyright (c) 2019 Nordic Semiconductor ASA
#
# SPDX-License-Identifier: LicenseRef-Nordic-5-Clause
#

mainmenu "PPI trace sample"

menu "PPI trace pins configuration"

config PPI_TRACE_PIN_RTC_COMPARE_EVT
	int "Trace pin for RTC Compare event"
	default 10 if BOARD_NRF9160DK_NRF9160 || BOARD_NRF9160DK_NRF9160_NS
	default 10 if BOARD_NRF9161DK_NRF9161 || BOARD_NRF9161DK_NRF9161_NS
	default 1 if BOARD_NRF51DK_NRF51422
	default 3
	help
	  Pin is toggled when an RTC Compare event occurs.

config PPI_TRACE_PIN_RTC_TICK_EVT
	int "Trace pin for RTC Tick event"
	default 11 if BOARD_NRF9160DK_NRF9160 || BOARD_NRF9160DK_NRF9160_NS
	default 11 if BOARD_NRF9161DK_NRF9161 || BOARD_NRF9161DK_NRF9161_NS
	default 2 if BOARD_NRF51DK_NRF51422
	default 4
	help
	  Pin is toggled when an RTC Tick event occurs.

config PPI_TRACE_PIN_LFCLOCK_STARTED_EVT
	int "Trace pin for LFCLOCK Started event"
	default 12 if BOARD_NRF9160DK_NRF9160 || BOARD_NRF9160DK_NRF9160_NS
	default 12 if BOARD_NRF9161DK_NRF9161 || BOARD_NRF9161DK_NRF9161_NS
	default 3 if BOARD_NRF51DK_NRF51422
	default 28
	help
	  Pin is toggled when an LFCLOCK Started event occurs.

config USE_BLUETOOTH_RADIO_EVENTS
	bool
	default y
	select BT
	depends on SOC_SERIES_NRF52

if USE_BLUETOOTH_RADIO_EVENTS

config PPI_TRACE_PIN_RADIO_ACTIVE
	int "Trace pin for radio activity"
	default 29
	help
	  Pin is high when the radio is active.

endif # USE_BLUETOOTH_RADIO_EVENTS

endmenu

source "Kconfig.zephyr"
```

## Kconfig.sysbuild
```
#
# Copyright (c) 2024 Nordic Semiconductor
#
# SPDX-License-Identifier: LicenseRef-Nordic-5-Clause
#

config PARTITION_MANAGER
	default n if !BOARD_THINGY91X && !BOARD_THINGY91

source "share/sysbuild/Kconfig"
```

## sample.yaml
```
sample:
  description: Sample showing PPI trace
  name: PPI trace sample
tests:
  sample.debug.ppi_trace:
    sysbuild: true
    build_only: true
    integration_platforms:
      - nrf52840dk/nrf52840
      - nrf9160dk/nrf9160
    platform_allow: nrf52dk/nrf52832 nrf52840dk/nrf52840 nrf9160dk/nrf9160 nrf21540dk/nrf52840
    tags: ci_build sysbuild ci_samples_debug
```

## prj.conf
```kconfig
#
# Copyright (c) 2019 Nordic Semiconductor ASA
#
# SPDX-License-Identifier: LicenseRef-Nordic-5-Clause
#
CONFIG_PPI_TRACE=y
CONFIG_COUNTER=y
CONFIG_SYSTEM_CLOCK_NO_WAIT=y
```

## boards/nrf21540dk_nrf52840.conf
```kconfig
CONFIG_BT_LL_SW_SPLIT=y

# CC310 is disabled to speed up bootup time
CONFIG_HW_CC3XX=n
CONFIG_ENTROPY_CC3XX=n
CONFIG_ENTROPY_NRF5_RNG=y
```

## boards/nrf52840dk_nrf52840.conf
```kconfig
CONFIG_BT_LL_SW_SPLIT=y

#CC310 is disabled to speed up bootup time
CONFIG_HW_CC3XX=n
```

## boards/nrf52dk_nrf52832.conf
```kconfig
CONFIG_BT_LL_SW_SPLIT=y
```

## boards/nrf21540dk_nrf52840.overlay
```dts
&rtc2 {
	status = "okay";
};

/ {
	zephyr,user {
		ppi-trace-rtc = <&rtc2>;
	};
};
```

## boards/nrf52840dk_nrf52840.overlay
```dts
&rtc2 {
	status = "okay";
};

/ {
	chosen {
		zephyr,entropy = &rng;
	};

	zephyr,user {
		ppi-trace-rtc = <&rtc2>;
	};
};
```

## boards/nrf9160dk_nrf9160.overlay
```dts
/*
 * Copyright (c) 2026 Nordic Semiconductor ASA
 *
 * SPDX-License-Identifier: LicenseRef-Nordic-5-Clause
 */

#include <samples/cellular/nrf91_no_bootloader_partitions.dtsi>

#include <samples/cellular/nrf91_sram_partitions.dtsi>

&rtc0 {
	status = "okay";
};

/ {
	zephyr,user {
		ppi-trace-rtc = <&rtc0>;
	};
};
```

## src/main.c
```c
/*
 * Copyright (c) 2019 Nordic Semiconductor ASA
 *
 * SPDX-License-Identifier: LicenseRef-Nordic-5-Clause
 */

#include <zephyr/kernel.h>
#include <debug/ppi_trace.h>
#include <zephyr/drivers/counter.h>
#include <hal/nrf_rtc.h>
#include <hal/nrf_clock.h>
#include <zephyr/device.h>
#include <zephyr/devicetree.h>
#include <zephyr/logging/log.h>

LOG_MODULE_REGISTER(app);

#define ALARM_PERIOD_US 50000

#define ZEPHYR_USER_NODE DT_PATH(zephyr_user)
#if DT_NODE_HAS_PROP(ZEPHYR_USER_NODE, ppi_trace_rtc)
#define RTC_NODE DT_PROP(ZEPHYR_USER_NODE, ppi_trace_rtc)
#define RTC ((NRF_RTC_Type*)DT_REG_ADDR(RTC_NODE))
#else
/*
 * This sample now relies on the /zephyr,user node having a
 * ppi-trace-rtc property that is a phandle to the RTC node you wish
 * to use on your board. See the overlay files in the boards/
 * subdirectory of this sample for examples.
 */
#error "Missing ppi-trace-rtc property in /zephyr,user; see source comments for details"
#define RTC_NODE DT_INVALID_NODE
#define RTC ((NRF_RTC_Type*)0)
#endif

static void alarm_callback(const struct device *dev, uint8_t chan_id, uint32_t ticks,
			   void *user_data);

static struct counter_alarm_cfg alarm_cfg = {
	.callback = alarm_callback,
	.flags = COUNTER_ALARM_CFG_ABSOLUTE,
};

extern void bluetooth_enable(void);

static void ppi_trace_pin_setup(uint32_t pin, uint32_t evt)
{
	void *handle;

	handle = ppi_trace_config(pin, evt);
	__ASSERT(handle != NULL,
		"Failed to initialize trace pin, no PPI or GPIOTE resources?");

	ppi_trace_enable(handle);
}

static void ppi_trace_setup(void)
{
	ppi_trace_pin_setup(CONFIG_PPI_TRACE_PIN_RTC_COMPARE_EVT,
		nrf_rtc_event_address_get(RTC, NRF_RTC_EVENT_COMPARE_0));

	/* Due to low power domain events must be explicitly enabled in RTC. */
	nrf_rtc_event_enable(RTC, NRF_RTC_INT_TICK_MASK);
	ppi_trace_pin_setup(CONFIG_PPI_TRACE_PIN_RTC_TICK_EVT,
		nrf_rtc_event_address_get(RTC, NRF_RTC_EVENT_TICK));

	ppi_trace_pin_setup(CONFIG_PPI_TRACE_PIN_LFCLOCK_STARTED_EVT,
		nrf_clock_event_address_get(NRF_CLOCK,
					    NRF_CLOCK_EVENT_LFCLKSTARTED));

	LOG_INF("PPI trace setup done.");
}

static void alarm_callback(const struct device *dev, uint8_t chan_id,
			   uint32_t ticks, void *user_data)
{
	int err;
	uint32_t alarm_cnt = (uint32_t)user_data + 1;

	alarm_cfg.ticks = ticks + counter_us_to_ticks(dev, ALARM_PERIOD_US);
	alarm_cfg.user_data = (void *)alarm_cnt;

	err = counter_set_channel_alarm(dev, 0, &alarm_cfg);
	__ASSERT_NO_MSG(err == 0);
	(void)err;
}

static void counter_setup(void)
{
	int err;
	const struct device *dev = DEVICE_DT_GET(RTC_NODE);

	__ASSERT(device_is_ready(dev), "RTC device not ready");

	alarm_cfg.ticks = counter_us_to_ticks(dev, ALARM_PERIOD_US);
	err = counter_set_channel_alarm(dev, 0, &alarm_cfg);
	__ASSERT_NO_MSG(err == 0);

	err = counter_start(dev);
	__ASSERT_NO_MSG(err == 0);
}

int main(void)
{
	ppi_trace_setup();
	counter_setup();

	if (IS_ENABLED(CONFIG_BT)) {
		bluetooth_enable();
	}

	return 0;
}
```

## src/bluetooth.c
```c
/*
 * Copyright (c) 2019 Nordic Semiconductor ASA
 *
 * SPDX-License-Identifier: LicenseRef-Nordic-5-Clause
 */

#include <zephyr/bluetooth/bluetooth.h>
#include <zephyr/bluetooth/hci.h>
#include <zephyr/logging/log.h>
#include <debug/ppi_trace.h>
#include <hal/nrf_radio.h>
#include <hal/nrf_uarte.h>

LOG_MODULE_DECLARE(app);

#define DEVICE_NAME CONFIG_BT_DEVICE_NAME
#define DEVICE_NAME_LEN (sizeof(DEVICE_NAME) - 1)

static const struct bt_data ad[] = {
	BT_DATA_BYTES(BT_DATA_FLAGS, BT_LE_AD_NO_BREDR),
	BT_DATA_BYTES(BT_DATA_UUID16_ALL, 0xaa, 0xfe),
};

/* Set Scan Response data */
static const struct bt_data sd[] = {
	BT_DATA(BT_DATA_NAME_COMPLETE, DEVICE_NAME, DEVICE_NAME_LEN),
};

static void radio_ppi_trace_setup(void)
{
	uint32_t start_evt;
	uint32_t stop_evt;
	void *handle;

	start_evt = nrf_radio_event_address_get(NRF_RADIO,
				NRF_RADIO_EVENT_READY);
	stop_evt = nrf_radio_event_address_get(NRF_RADIO,
				NRF_RADIO_EVENT_DISABLED);

	handle = ppi_trace_pair_config(CONFIG_PPI_TRACE_PIN_RADIO_ACTIVE,
				start_evt, stop_evt);
	__ASSERT(handle != NULL, "Failed to configure PPI trace pair.\n");

	ppi_trace_enable(handle);
}

static void bt_ready(int err)
{
	radio_ppi_trace_setup();

	__ASSERT(err == 0, "Bluetooth init failed (err %d)\n", err);

	/* Start advertising */
	err = bt_le_adv_start(BT_LE_ADV_NCONN, ad, ARRAY_SIZE(ad),
			      sd, ARRAY_SIZE(sd));
	__ASSERT(err == 0, "Advertising start failed (err %d)\n", err);

	LOG_INF("Bluetooth advertising started.");
}

void bluetooth_enable(void)
{
	int err;

	LOG_INF("Starting Bluetooth advertising.");


	/* Initialize the Bluetooth Subsystem */
	err = bt_enable(bt_ready);
	__ASSERT(err == 0, "Bluetooth enabling failed (err %d)\n", err);
}
```
