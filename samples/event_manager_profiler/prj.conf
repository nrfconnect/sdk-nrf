## sample.yaml
```
sample:
  description: Sample showing usage of profiling Event Manager events
  name: Event Manager profiler tracer sample
tests:
  samples.event_manager_profiler:
    build_only: true
    integration_platforms:
      - nrf52dk_nrf52832
      - nrf52840dk_nrf52840
      - nrf9160dk_nrf9160_ns
      - nrf21540dk_nrf52840
    tags: ci_build
```

## prj.conf
```kconfig
#
# Copyright (c) 2021 Nordic Semiconductor ASA
#
# SPDX-License-Identifier: LicenseRef-Nordic-5-Clause
#
# Enabling assert
CONFIG_ASSERT=y

# Logger configuration
CONFIG_LOG=y
CONFIG_LOG_DEFAULT_LEVEL=2
CONFIG_LOG_BACKEND_UART=y
CONFIG_LOG_STRDUP_BUF_COUNT=10

# Configuration required by Event Manager
CONFIG_EVENT_MANAGER=y
CONFIG_LINKER_ORPHAN_SECTION_PLACE=y
CONFIG_HEAP_MEM_POOL_SIZE=2048
CONFIG_REBOOT=y

# Configuration required by Event Manager profiler tracer
CONFIG_EVENT_MANAGER_PROFILER=y
CONFIG_EVENT_MANAGER_PROFILER_PROFILE_EVENT_DATA=y
```

## src/main.c
```c
/*
 * Copyright (c) 2021 Nordic Semiconductor ASA
 *
 * SPDX-License-Identifier: LicenseRef-Nordic-5-Clause
 */

#include <event_manager.h>
#include <config_event.h>
#include <logging/log.h>

#define MODULE main

LOG_MODULE_REGISTER(MODULE);

void main(void)
{
	if (event_manager_init()) {
		LOG_ERR("Event Manager not initialized");
	} else {
		struct config_event *event = new_config_event();

		EVENT_SUBMIT(event);
	}
}
```
