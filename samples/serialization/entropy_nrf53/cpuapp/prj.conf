## CMakeLists.txt
```
#
# Copyright (c) 2020 Nordic Semiconductor
#
# SPDX-License-Identifier: LicenseRef-BSD-5-Clause-Nordic
#
cmake_minimum_required(VERSION 3.8)

set(NRF_SUPPORTED_BOARDS
  nrf5340_dk_nrf5340_cpuapp
)

include(../../../../cmake/boilerplate.cmake)
include($ENV{ZEPHYR_BASE}/cmake/app/boilerplate.cmake NO_POLICY_SCOPE)
project(NONE)

# NORDIC SDK APP START
target_sources(app PRIVATE
  src/main.c
  src/entropy_ser.c
)

# NORDIC SDK APP END

target_link_libraries(app PRIVATE TINYCBOR)
```

## sample.yaml
```
sample:
  name: Entropy remote application core
  description: Entropy driver application core sample
tests:
  test_build:
    build_only: true
    build_on_all: true
    platform_whitelist: nrf5340_dk_nrf5340_cpuapp
```

## prj.conf
```kconfig
CONFIG_IPM=y
CONFIG_IPM_NRFX=y
CONFIG_IPM_MSG_CH_1_ENABLE=y
CONFIG_IPM_MSG_CH_1_TX=y
CONFIG_IPM_MSG_CH_0_ENABLE=y
CONFIG_IPM_MSG_CH_0_RX=y

CONFIG_HEAP_MEM_POOL_SIZE=4096

CONFIG_OPENAMP=y
CONFIG_TINYCBOR=y

CONFIG_RP_SERIALIZATION=y
CONFIG_RPMSG_MASTER=y
```

## src/main.c
```c
/*
 * Copyright (c) 2020 Nordic Semiconductor ASA
 *
 * SPDX-License-Identifier: LicenseRef-BSD-5-Clause-Nordic
 */

#include <zephyr.h>

#include <rp_ser.h>

#include "entropy_ser.h"

#define BUFFER_LENGTH 10

static u8_t buffer[BUFFER_LENGTH];

void main(void)
{
	int err;

	printk("Entropy sample started[APP Core].\n");

	err = entropy_remote_init();
	if (err) {
		printk("Remote entropy driver initialization failed\n");
		return;
	}

	while (true) {
		err = entropy_remote_get(buffer, sizeof(buffer));
		if (err) {
			printk("Entropy remote get failed: %d\n", err);
			continue;
		}

		for (int i = 0; i < BUFFER_LENGTH; i++) {
			printk("  0x%02x", buffer[i]);
		}

		printk("\n");

		k_sleep(K_MSEC(1000));
	}
}
```

## src/entropy_ser.c
```c
/*
 * Copyright (c) 2020 Nordic Semiconductor ASA
 *
 * SPDX-License-Identifier: LicenseRef-BSD-5-Clause-Nordic
 */
#include <errno.h>
#include <init.h>

#include <rp_ser.h>
#include <cbor.h>

#include "../../ser_common.h"

struct entropy_rsp {
	u8_t *buffer;
	u16_t length;
	int err_code;
};

RP_SER_DEFINE(entropy_ser, struct k_sem, 0, 1000, 0);

static struct entropy_rsp rsp_data;

static rp_err_t rsp_error_code_handle(CborValue *it)
{
	int err;

	if (!cbor_value_is_integer(it) ||
	    cbor_value_get_int(it, &err)) {
		return RP_ERROR_INVALID_PARAM;
	}

	rsp_data.err_code = err;

	return RP_SUCCESS;
}

static rp_err_t entropy_get_rsp(CborValue *it)
{
	int err;
	size_t buf_len = rsp_data.length;

	if (!cbor_value_is_integer(it) ||
	    cbor_value_get_int(it, &err)) {
		return RP_ERROR_INTERNAL;
	}

	rsp_data.err_code = err;

	if (cbor_value_advance_fixed(it) != CborNoError) {
		return -RP_ERROR_INTERNAL;
	}

	if (!cbor_value_is_byte_string(it) ||
	    cbor_value_copy_byte_string(it, rsp_data.buffer, &buf_len, it)) {
		return RP_ERROR_INTERNAL;
	}

	if (buf_len != rsp_data.length) {
		return RP_ERROR_INTERNAL;
	}

	return RP_SUCCESS;
}

int entropy_remote_init(void)
{
	rp_err_t err;
	CborEncoder encoder;
	size_t packet_size = SERIALIZATION_BUFFER_SIZE;

	rp_ser_buf_alloc(cmd_buf, entropy_ser, packet_size);

	err = rp_ser_cmd_init(&cmd_buf, &encoder, SER_COMMAND_ENTROPY_INIT);
	if (err) {
		return -EINVAL;
	}

	err = rp_ser_cmd_send(&entropy_ser, &cmd_buf,
			      &encoder, rsp_error_code_handle);
	if (err) {
		return -EINVAL;
	}

	return rsp_data.err_code;
}

int entropy_remote_get(u8_t *buffer, u16_t length)
{
	rp_err_t err;
	CborEncoder encoder;
	size_t packet_size = SERIALIZATION_BUFFER_SIZE;

	if (!buffer || length < 1) {
		return -EINVAL;
	}

	rsp_data.buffer = buffer;
	rsp_data.length = length;

	rp_ser_buf_alloc(cmd_buf, entropy_ser, packet_size);

	err = rp_ser_cmd_init(&cmd_buf, &encoder, SER_COMMAND_ENTROPY_GET);
	if (err) {
		return -EINVAL;
	}

	if (cbor_encode_int(&encoder, length) != CborNoError) {
		return -EINVAL;
	}

	err = rp_ser_cmd_send(&entropy_ser, &cmd_buf,
			      &encoder, entropy_get_rsp);
	if (err) {
		return -EINVAL;
	}

	return rsp_data.err_code;
}


static int serialization_init(struct device *dev)
{
	ARG_UNUSED(dev);

	rp_err_t err;

	err = rp_ser_init(&entropy_ser);
	if (err) {
		return -EINVAL;
	}

	return 0;
}

SYS_INIT(serialization_init, POST_KERNEL, CONFIG_APPLICATION_INIT_PRIORITY);
```

## src/entropy_ser.h
```c
/*
 * Copyright (c) 2020 Nordic Semiconductor ASA
 *
 * SPDX-License-Identifier: Apache-2.0
 */

#ifndef ENTROPY_SER_H_
#define ENTROPY_SER_H_

#include <zephyr/types.h>

/**
 * @file
 * @defgroup entropy_ser Entropy driver serialization
 * @{
 * @brief Entropy serialization API.
 */

#ifdef __cplusplus
extern "C" {
#endif

/**@brief Function for initializing the remote Entropy driver instance.
 *
 * @retval 0 If the operation was successful.
 *           Otherwise, a (negative) error code is returned.
 */
int entropy_remote_init(void);

/**@brief Function for getting entropy value from the remote driver.
 *
 * @param[out] buffer Received entropy data.
 * @param[in] length Requested entropy length.
 *
 * @retval 0 If the operation was successful.
 *           Otherwise, a (negative) error code is returned.
 */
int entropy_remote_get(u8_t *buffer, u16_t length);

#ifdef __cplusplus
}
#endif

/**
 * @}
 */

#endif /* ENTROPY_SER_H_ */
```
