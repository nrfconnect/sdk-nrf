## samples/net/mqtt/boards/native_sim.conf
```kconfig
#
# Copyright (c) 2023 Nordic Semiconductor ASA
#
# SPDX-License-Identifier: LicenseRef-Nordic-5-Clause
#

# Networking
CONFIG_NET_SOCKETS_OFFLOAD=n

CONFIG_DNS_RESOLVER=y
CONFIG_DNS_SERVER_IP_ADDRESSES=y
CONFIG_DNS_SERVER1="8.8.8.8"

# Network address config
CONFIG_NET_CONFIG_SETTINGS=y
CONFIG_NET_CONFIG_NEED_IPV4=y
CONFIG_NET_CONFIG_MY_IPV4_ADDR="192.0.2.1"
CONFIG_NET_CONFIG_PEER_IPV4_ADDR="192.0.2.2"
CONFIG_NET_CONFIG_MY_IPV4_GW="192.0.2.2"
CONFIG_NET_CONTEXT_SNDTIMEO=y
```

## samples/net/mqtt/boards/nrf7002dk_nrf5340_cpuapp.conf
```kconfig
#
# Copyright (c) 2023 Nordic Semiconductor ASA
#
# SPDX-License-Identifier: LicenseRef-Nordic-5-Clause
#

# Configuration file for nRF7002 DK
# This file is merged with prj.conf in the application folder, and options
# set here will take precedence if they are present in both files.

# General
CONFIG_POSIX_CLOCK=y
CONFIG_POSIX_MAX_FDS=8
CONFIG_SYSTEM_WORKQUEUE_STACK_SIZE=4096
CONFIG_LOG_BUFFER_SIZE=3072
CONFIG_HEAP_MEM_POOL_SIZE=153600
CONFIG_HW_STACK_PROTECTION=y
CONFIG_HW_ID_LIBRARY_SOURCE_NET_MAC=y
CONFIG_DK_LIBRARY=y

# Set newlib C to prevent build error complaining that string.h is not supported
CONFIG_NEWLIB_LIBC=y

# Wi-Fi
CONFIG_WIFI=y
CONFIG_WIFI_NRF700X=y
CONFIG_WIFI_LOG_LEVEL_ERR=y
CONFIG_WIFI_MGMT_EXT=y
CONFIG_WIFI_CREDENTIALS=y
CONFIG_WIFI_CREDENTIALS_BACKEND_SETTINGS=y
CONFIG_WIFI_CREDENTIALS_STATIC=y
CONFIG_FLASH=y
CONFIG_FLASH_PAGE_LAYOUT=y
CONFIG_FLASH_MAP=y
CONFIG_NVS=y
CONFIG_SETTINGS=y
CONFIG_SETTINGS_NVS=y

# Zephyr NET Connection Manager Connectivity layer.
CONFIG_L2_WIFI_CONNECTIVITY=y
CONFIG_L2_WIFI_CONNECTIVITY_AUTO_DOWN=n

# WPA
CONFIG_WPA_SUPP=y
CONFIG_WPA_SUPP_LOG_LEVEL_ERR=y

# NET sockets
CONFIG_NET_L2_ETHERNET=y
CONFIG_NET_TCP_WORKQ_STACK_SIZE=2048
CONFIG_NET_UDP=y
CONFIG_NET_SOCKETS_OFFLOAD=n
CONFIG_NET_DHCPV4=y
CONFIG_NET_CONTEXT_SNDTIMEO=y
CONFIG_NET_MGMT_EVENT_STACK_SIZE=4096

# DNS
CONFIG_DNS_RESOLVER=y
```

## samples/net/mqtt/boards/nrf7002dk_nrf5340_cpuapp_ns.conf
```kconfig
#
# Copyright (c) 2023 Nordic Semiconductor ASA
#
# SPDX-License-Identifier: LicenseRef-Nordic-5-Clause
#

# Configuration file for nRF7002 DK
# This file is merged with prj.conf in the application folder, and options
# set here will take precedence if they are present in both files.

# General
CONFIG_POSIX_CLOCK=y
CONFIG_SYSTEM_WORKQUEUE_STACK_SIZE=4096
CONFIG_MAIN_STACK_SIZE=2048
CONFIG_LOG_BUFFER_SIZE=3072
CONFIG_HEAP_MEM_POOL_SIZE=81920
CONFIG_HW_STACK_PROTECTION=y
CONFIG_HW_ID_LIBRARY_SOURCE_NET_MAC=y
CONFIG_DK_LIBRARY=y

# Optimize Wi-Fi stack to save some memory
CONFIG_NRF700X_RX_NUM_BUFS=16
CONFIG_NRF700X_MAX_TX_AGGREGATION=4

# Set newlib C to prevent build error complaining that string.h is not supported
CONFIG_NEWLIB_LIBC=y

# Wi-Fi
CONFIG_WIFI=y
CONFIG_WIFI_NRF700X=y
CONFIG_WIFI_NRF700X_LOG_LEVEL_ERR=y
CONFIG_WIFI_MGMT_EXT=y
CONFIG_WIFI_CREDENTIALS=y

# Shell
CONFIG_SHELL=y
CONFIG_SHELL_STACK_SIZE=4096

# Zephyr NET Connection Manager Connectivity layer.
CONFIG_L2_WIFI_CONNECTIVITY=y
CONFIG_L2_WIFI_CONNECTIVITY_AUTO_CONNECT=n
CONFIG_L2_WIFI_CONNECTIVITY_AUTO_DOWN=n

# WPA
CONFIG_WPA_SUPP=y
CONFIG_WPA_SUPP_LOG_LEVEL_ERR=y
CONFIG_MBEDTLS_HEAP_SIZE=16384

# NET sockets
CONFIG_NET_L2_ETHERNET=y
CONFIG_NET_TCP_WORKQ_STACK_SIZE=2048
CONFIG_NET_UDP=y
CONFIG_NET_SOCKETS_OFFLOAD=n
CONFIG_NET_DHCPV4=y
CONFIG_NET_CONTEXT_SNDTIMEO=y
CONFIG_NET_MGMT_EVENT_STACK_SIZE=4096

# DNS
CONFIG_DNS_RESOLVER=y

# Optimize TF-M
CONFIG_TFM_PROFILE_TYPE_SMALL=y
CONFIG_PM_PARTITION_SIZE_TFM_SRAM=0xc000
CONFIG_PM_PARTITION_SIZE_TFM=0x20000
```

## samples/net/mqtt/boards/thingy91_nrf9160_ns.conf
```kconfig
#
# Copyright (c) 2023 Nordic Semiconductor ASA
#
# SPDX-License-Identifier: LicenseRef-Nordic-5-Clause
#

# Configuration file for Thingy:91
# This file is merged with prj.conf in the application folder, and options
# set here will take precedence if they are present in both files.

# General
CONFIG_HW_STACK_PROTECTION=y
CONFIG_HW_ID_LIBRARY_SOURCE_IMEI=y
CONFIG_PICOLIBC=y
CONFIG_DK_LIBRARY=y

# Disable Duplicate Address Detection (DAD)
# due to not being properly implemented for offloaded interfaces.
CONFIG_NET_IPV6_NBR_CACHE=n
CONFIG_NET_IPV6_MLD=n

# Connection Manager and Connectivity layer
CONFIG_NET_CONNECTION_MANAGER=y
CONFIG_NET_CONNECTION_MANAGER_STACK_SIZE=1024
CONFIG_LTE_CONNECTIVITY=y
CONFIG_NRF_MODEM_LIB_ON_FAULT_APPLICATION_SPECIFIC=y

# Turn off automatic behavior to give more control to the application
CONFIG_NRF_MODEM_LIB_NET_IF_AUTO_START=n
CONFIG_LTE_CONNECTIVITY_AUTO_CONNECT=n
CONFIG_LTE_CONNECTIVITY_AUTO_DOWN=n
```

## samples/net/mqtt/sample.yaml
```yaml
sample:
  name: mqtt
tests:
  sample.net.mqtt:
    sysbuild: true
    build_only: true
    build_on_all: true
    integration_platforms:
      - nrf9160dk/nrf9160/ns
      - nrf9151dk/nrf9151/ns
      - thingy91x/nrf9151/ns
      - native_sim
    platform_allow:
      - nrf9160dk/nrf9160/ns
      - nrf9161dk/nrf9161/ns
      - nrf9151dk/nrf9151/ns
      - thingy91/nrf9160/ns
      - thingy91x/nrf9151/ns
      - native_sim
    tags:
      - ci_build
      - sysbuild
      - ci_samples_net
  sample.net.mqtt.wifi:
    sysbuild: true
    build_only: true
    build_on_all: true
    integration_platforms:
      - nrf7002dk/nrf5340/cpuapp/ns
    platform_allow:
      - nrf7002dk/nrf5340/cpuapp/ns
    tags:
      - ci_build
      - sysbuild
      - ci_samples_net
    extra_args:
      - mqtt_EXTRA_CONF_FILE="wifi.conf;nrf70.conf"
  # nRF7120 uses the integrated nRF71 driver; its tuning lives in the board conf.
  sample.net.mqtt.nrf7120.wifi:
    sysbuild: true
    build_only: true
    build_on_all: true
    integration_platforms:
      - nrf7120dk/nrf7120/cpuapp/ns
    platform_allow:
      - nrf7120dk/nrf7120/cpuapp/ns
    tags:
      - ci_build
      - sysbuild
      - ci_samples_net
    extra_args:
      - mqtt_EXTRA_CONF_FILE=wifi.conf
  sample.net.mqtt.nrf70.tls:
    sysbuild: true
    build_only: true
    build_on_all: true
    integration_platforms:
      - nrf7002dk/nrf5340/cpuapp/ns
    platform_allow: nrf7002dk/nrf5340/cpuapp/ns
    tags:
      - ci_build
      - sysbuild
      - ci_samples_net
    extra_args:
      - mqtt_EXTRA_CONF_FILE="wifi.conf;wifi-tls.conf;nrf70.conf"
  sample.net.mqtt.nrf54h20.wifi:
    sysbuild: true
    build_only: true
    platform_allow: nrf54h20dk/nrf54h20/cpuapp
    tags:
      - ci_build
      - sysbuild
      - ci_samples_net
    extra_args:
      - mqtt_SHIELD="nrf7002eb_interposer_p1;nrf7002eb"
      - mqtt_SNIPPET="nrf70-wifi;wifi-credentials"
      - mqtt_EXTRA_CONF_FILE="wifi.conf;nrf70.conf"
  sample.net.mqtt.nrf54lm20_nrf7002eb2.wifi:
    sysbuild: true
    build_only: true
    platform_allow:
      - nrf54lm20dk/nrf54lm20a/cpuapp
      - nrf54lm20dk/nrf54lm20b/cpuapp
    tags:
      - ci_build
      - sysbuild
      - ci_samples_net
    extra_args:
      - mqtt_SHIELD="nrf7002eb2"
      - mqtt_SNIPPET=wifi-credentials
      - mqtt_EXTRA_CONF_FILE="wifi.conf;nrf70.conf"
  sample.net.mqtt.nrf54lm20_nrf7002eb2.wifi.tls:
    sysbuild: true
    build_only: true
    platform_allow:
      - nrf54lm20dk/nrf54lm20a/cpuapp
      - nrf54lm20dk/nrf54lm20b/cpuapp
    tags:
      - ci_build
      - sysbuild
      - ci_samples_net
    extra_args:
      - mqtt_SHIELD="nrf7002eb2"
      - mqtt_SNIPPET=wifi-credentials
      - mqtt_EXTRA_CONF_FILE="wifi.conf;wifi-tls.conf;nrf70.conf"
  sample.net.mqtt.nrf91.tls:
    sysbuild: true
    build_only: true
    build_on_all: true
    integration_platforms:
      - nrf9160dk/nrf9160/ns
      - nrf9161dk/nrf9161/ns
      - nrf9151dk/nrf9151/ns
      - thingy91/nrf9160/ns
      - thingy91x/nrf9151/ns
    platform_allow:
      - nrf9160dk/nrf9160/ns
      - nrf9161dk/nrf9161/ns
      - nrf9151dk/nrf9151/ns
      - thingy91/nrf9160/ns
      - thingy91x/nrf9151/ns
    tags:
      - ci_build
      - sysbuild
      - ci_samples_net
    extra_args: EXTRA_CONF_FILE=overlay-tls-nrf91.conf
  sample.net.mqtt.native_sim.tls:
    sysbuild: true
    build_only: true
    build_on_all: true
    platform_allow: native_sim
    tags:
      - ci_build
      - sysbuild
      - ci_samples_net
    extra_args: EXTRA_CONF_FILE=overlay-tls-native_sim.conf
  sample.net.mqtt.nrf7120.wifi.tls:
    sysbuild: true
    build_only: true
    build_on_all: true
    integration_platforms:
      - nrf7120dk/nrf7120/cpuapp/ns
    platform_allow:
      - nrf7120dk/nrf7120/cpuapp/ns
    tags:
      - ci_build
      - sysbuild
      - ci_samples_net
    extra_args:
      - mqtt_EXTRA_CONF_FILE="wifi.conf;wifi-tls.conf"
```

## samples/net/mqtt/src/modules/error/Kconfig.error
```kconfig
#
# Copyright (c) 2023 Nordic Semiconductor
#
# SPDX-License-Identifier: LicenseRef-Nordic-5-Clause
#

menu "Error"

config MQTT_SAMPLE_ERROR_REBOOT_ON_FATAL
	bool "Reboot on fatal error"
	depends on REBOOT
	default y
	help
	  Enabling this option will cause the device to reboot on errors that are considered fatal.
	  Note that this configuration only applies for sample specific errors.
	  Other parts of the stack will still reboot or not based on
	  the CONFIG_RESET_ON_FATAL_ERROR option.

module = MQTT_SAMPLE_ERROR
module-str = Error
source "subsys/logging/Kconfig.template.log_config"

endmenu # Error
```

## samples/net/mqtt/src/modules/led/Kconfig.led
```kconfig
#
# Copyright (c) 2023 Nordic Semiconductor
#
# SPDX-License-Identifier: LicenseRef-Nordic-5-Clause
#

# Hidden symbol to group conditions
config NRF7002EB2_NRF54L15DK_LED1_CONFLICT
	bool
	default y if (SHIELD_NRF7002EB2 || SHIELD_NRF7002EB2_NRF7001 || \
		SHIELD_NRF7002EB2_NRF7000) && BOARD_NRF54L15DK


menuconfig MQTT_SAMPLE_LED
	bool "LED"
	depends on !NRF7002EB2_NRF54L15DK_LED1_CONFLICT
	select LED
	default y if !BOARD_NATIVE_SIM && !NRF7002EB2_NRF54L15DK_LED1_CONFLICT

if MQTT_SAMPLE_LED

module = MQTT_SAMPLE_LED
module-str = LED
source "subsys/logging/Kconfig.template.log_config"

endif # MQTT_SAMPLE_LED
```

## samples/net/mqtt/src/modules/network/Kconfig.network
```kconfig
#
# Copyright (c) 2023 Nordic Semiconductor
#
# SPDX-License-Identifier: LicenseRef-Nordic-5-Clause
#

menu "Network"
	depends on NRF_MODEM_LIB_NET_IF || (WIFI_NRF70 && WIFI_MGMT_EXT) || BOARD_NATIVE_SIM

config MQTT_SAMPLE_NETWORK_THREAD_STACK_SIZE
	int "Thread stack size"
	default 4096

module = MQTT_SAMPLE_NETWORK
module-str = Network
source "subsys/logging/Kconfig.template.log_config"

endmenu # Network
```

## samples/net/mqtt/src/modules/sampler/Kconfig.sampler
```kconfig
#
# Copyright (c) 2023 Nordic Semiconductor
#
# SPDX-License-Identifier: LicenseRef-Nordic-5-Clause
#

menu "Sampler"

config MQTT_SAMPLE_SAMPLER_THREAD_STACK_SIZE
	int "Thread stack size"
	default 1024

config MQTT_SAMPLE_SAMPLER_MESSAGE_QUEUE_SIZE
	int "Message queue size"
	default 5
	help
	  ZBus subscriber message queue size.

module = MQTT_SAMPLE_SAMPLER
module-str = Sampler
source "subsys/logging/Kconfig.template.log_config"

endmenu # Sampler
```

## samples/net/mqtt/src/modules/transport/Kconfig.transport
```kconfig
#
# Copyright (c) 2023 Nordic Semiconductor
#
# SPDX-License-Identifier: LicenseRef-Nordic-5-Clause
#

menu "Transport"
	depends on MQTT_HELPER
	depends on HW_ID_LIBRARY

config MQTT_SAMPLE_TRANSPORT_RECONNECTION_TIMEOUT_SECONDS
	int "Reconnection timeout in seconds"
	default 60
	help
	  Time in between reconnection attempts to the MQTT broker.

config MQTT_SAMPLE_TRANSPORT_THREAD_STACK_SIZE
	int "Thread stack size"
	default 2048

config MQTT_SAMPLE_TRANSPORT_MESSAGE_QUEUE_SIZE
	int "Message queue size"
	default 5
	help
	  ZBus subscriber message queue size.

config MQTT_SAMPLE_TRANSPORT_WORKQUEUE_STACK_SIZE
	int "Workqueue stack size"
	default 4096
	help
	  Stack size of the module's internal workqueue.

config MQTT_SAMPLE_TRANSPORT_BROKER_HOSTNAME
	string "MQTT broker hostname"
	default "test.mosquitto.org"

config MQTT_SAMPLE_TRANSPORT_CLIENT_ID
	string "MQTT Client ID"
	default ""
	help
	  Use a custom client ID string. If not set, the client ID will default to the
	  modem's IMEI number for nRF9160 boards, MAC address for the nRF7002 DK,
	  or a random number for Native Posix.

config MQTT_SAMPLE_TRANSPORT_CLIENT_ID_BUFFER_SIZE
	int "MQTT Client ID buffer size"
	default 50
	help
	  Size of buffer used to store the MQTT client ID.

config MQTT_SAMPLE_TRANSPORT_PUBLISH_TOPIC
	string "MQTT publish topic"
	default "my/publish/topic"

config MQTT_SAMPLE_TRANSPORT_SUBSCRIBE_TOPIC
	string "MQTT subscribe topic"
	default "my/subscribe/topic"

module = MQTT_SAMPLE_TRANSPORT
module-str = Transport
source "subsys/logging/Kconfig.template.log_config"

endmenu # Transport
```

## samples/net/ntn/Kconfig
```kconfig
#
# Copyright (c) 2023 Nordic Semiconductor ASA
#
# SPDX-License-Identifier: LicenseRef-Nordic-5-Clause
#

menu "NTN sample settings"

config NTN_SAMPLE_DATA_UPLOAD_SIZE_BYTES
	int "Number of bytes transmitted to the server"
	default 10

config NTN_SAMPLE_DATA_UPLOAD_FREQUENCY_SECONDS
	int "How often data is transmitted to the server"
	default 900

config NTN_SAMPLE_SERVER_ADDRESS_STATIC
	string "UDP server IP address"
	default "8.8.8.8"

config NTN_SAMPLE_SERVER_PORT
	int "UDP server port number"
	default "2469"

endmenu

module = NTN_SAMPLE
module-str = NTN sample
source "$(ZEPHYR_BASE)/subsys/logging/Kconfig.template.log_config"

menu "Zephyr Kernel"
source "Kconfig.zephyr"
endmenu
```

## samples/net/ntn/boards/thingy91x_nrf9151_ns.conf
```kconfig
#
# Copyright (c) 2025 Nordic Semiconductor ASA
#
# SPDX-License-Identifier: LicenseRef-Nordic-5-Clause
#

# Disable Duplicate Address Detection (DAD)
# due to not being properly implemented for offloaded interfaces.
CONFIG_NET_IPV6_NBR_CACHE=n
CONFIG_NET_IPV6_MLD=n

# Offload  network operations to the modem.
CONFIG_NET_SOCKETS_OFFLOAD=y

## PSM
CONFIG_LTE_PSM_REQ=y
CONFIG_LTE_PSM_REQ_RPTAU="00100001"
CONFIG_LTE_PSM_REQ_RAT="00000000"

## eDRX
CONFIG_LTE_EDRX_REQ=n
CONFIG_LTE_EDRX_REQ_VALUE_LTE_M="1001"

## RAI
CONFIG_LTE_RAI_REQ=n
```

## samples/net/udp/Kconfig
```kconfig
#
# Copyright (c) 2023 Nordic Semiconductor ASA
#
# SPDX-License-Identifier: LicenseRef-Nordic-5-Clause
#

menu "UDP sample settings"

config UDP_SAMPLE_DATA_UPLOAD_SIZE_BYTES
	int "Number of bytes transmitted to the server"
	default 10

config UDP_SAMPLE_DATA_UPLOAD_FREQUENCY_SECONDS
	int "How often data is transmitted to the server"
	default 900

config UDP_SAMPLE_SERVER_ADDRESS_STATIC
	string "UDP server IP address"
	default "8.8.8.8"

config UDP_SAMPLE_SERVER_PORT
	int "UDP server port number"
	default "2469"

endmenu

module = UDP_SAMPLE
module-str = UDP sample
source "${ZEPHYR_BASE}/subsys/logging/Kconfig.template.log_config"

menu "Zephyr Kernel"
source "Kconfig.zephyr"
endmenu
```

## samples/net/udp/Kconfig.sysbuild
```kconfig
#
# Copyright (c) 2024 Nordic Semiconductor ASA
#
# SPDX-License-Identifier: LicenseRef-Nordic-5-Clause
#

config WIFI_NRF70
	default y if BOARD_NRF7002DK_NRF5340_CPUAPP_NS || \
		     BOARD_NRF5340DK_NRF5340_CPUAPP_NS || \
		     BOARD_NRF54L15DK_NRF54L15_CPUAPP || \
		     BOARD_NRF54H20DK_NRF54H20_CPUAPP || \
		     BOARD_NRF54LM20DK_NRF54LM20A_CPUAPP

config PARTITION_MANAGER
	default n if !SOC_SERIES_NRF53 && !BOARD_THINGY91X && !BOARD_THINGY91

source "share/sysbuild/Kconfig"
```
