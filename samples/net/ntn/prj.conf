## CMakeLists.txt
```
#
# Copyright (c) 2023 Nordic Semiconductor
#
# SPDX-License-Identifier: LicenseRef-Nordic-5-Clause
#

cmake_minimum_required(VERSION 3.20.0)

find_package(Zephyr REQUIRED HINTS $ENV{ZEPHYR_BASE})
project(ntn)

# NORDIC SDK APP START
target_sources(app PRIVATE src/main.c)
# NORDIC SDK APP END

zephyr_include_directories(src)
```

## Kconfig
```
#
# Copyright (c) 2023 Nordic Semiconductor ASA
#
# SPDX-License-Identifier: LicenseRef-Nordic-5-Clause
#

menu "NTN sample settings"

config NTN_SAMPLE_DATA_UPLOAD_SIZE_BYTES
	int "Number of bytes transmitted to the server"
	default 10

config NTN_SAMPLE_DATA_UPLOAD_FREQUENCY_SECONDS
	int "How often data is transmitted to the server"
	default 900

config NTN_SAMPLE_SERVER_ADDRESS_STATIC
	string "UDP server IP address"
	default "8.8.8.8"

config NTN_SAMPLE_SERVER_PORT
	int "UDP server port number"
	default "2469"

endmenu

module = NTN_SAMPLE
module-str = NTN sample
source "$(ZEPHYR_BASE)/subsys/logging/Kconfig.template.log_config"

menu "Zephyr Kernel"
source "Kconfig.zephyr"
endmenu
```

## prj.conf
```kconfig
#
# Copyright (c) 2023 Nordic Semiconductor ASA
#
# SPDX-License-Identifier: LicenseRef-Nordic-5-Clause
#

# General configurations
CONFIG_LOG=y

# Network
CONFIG_NETWORKING=y
CONFIG_NET_NATIVE=y
CONFIG_NET_IPV4=y
CONFIG_NET_IPV6=n
CONFIG_NET_SOCKETS=y
CONFIG_POSIX_API=y
CONFIG_NET_CONNECTION_MANAGER=y
CONFIG_NET_IF_MAX_IPV4_COUNT=2

# Heap and stacks
CONFIG_HEAP_MEM_POOL_SIZE=1280
CONFIG_MAIN_STACK_SIZE=4096
CONFIG_SYSTEM_WORKQUEUE_STACK_SIZE=2048

# FPU
CONFIG_PICOLIBC=y
CONFIG_FPU=y

# NTN
CONFIG_NTN_SAMPLE_DATA_UPLOAD_SIZE_BYTES=128
CONFIG_NTN_SAMPLE_SERVER_ADDRESS_STATIC=""
CONFIG_NTN_SAMPLE_SERVER_PORT=

# NRF_MODEM_LIB
CONFIG_NRF_MODEM_LIB_NET_IF=y
CONFIG_NRF_MODEM_LIB_NET_IF_NTN=y
CONFIG_NRF_MODEM_LIB_NET_IF_AUTO_START=n
CONFIG_NRF_MODEM_LIB_NET_IF_AUTO_CONNECT=n
CONFIG_NRF_MODEM_LIB_NET_IF_NTN_AUTO_START=n
CONFIG_NRF_MODEM_LIB_NET_IF_NTN_AUTO_CONNECT=n
CONFIG_NRF_MODEM_LIB_NET_IF_CONNECTION_PERSISTENCE=n
CONFIG_NRF_MODEM_LIB_NET_IF_NTN_CONNECTION_PERSISTENCE=n

# Datetime
CONFIG_DATE_TIME=y
CONFIG_DATE_TIME_THREAD_STACK_SIZE=576

# AT commands interface
CONFIG_UART_INTERRUPT_DRIVEN=y
CONFIG_SHELL=y
CONFIG_SHELL_WILDCARD=n
CONFIG_SHELL_STACK_SIZE=2048
CONFIG_SHELL_CMD_BUFF_SIZE=2048
CONFIG_SHELL_BACKEND_SERIAL_RX_RING_BUFFER_SIZE=2048
CONFIG_AT_SHELL=y
CONFIG_LTE_SHELL=n

# Adjusted stack sizes
CONFIG_TFM_SPM_LOG_LEVEL_DEBUG=y
CONFIG_TFM_SECURE_UART_SHARE_INSTANCE=n
CONFIG_DATE_TIME_THREAD_STACK_SIZE=2048
CONFIG_AT_MONITOR_HEAP_SIZE=1024
CONFIG_LTE_LC_WORKQUEUE_STACK_SIZE=2048
CONFIG_NET_MGMT_EVENT_STACK_SIZE=2048
CONFIG_NET_RX_STACK_SIZE=2048
CONFIG_NET_TX_STACK_SIZE=2048
CONFIG_NRF_MODEM_LIB_NET_IF_WORKQUEUE_STACK_SIZE=2048
CONFIG_NET_CONNECTION_MANAGER_MONITOR_STACK_SIZE=2048

# # DEBUG
# CONFIG_LOG_MODE_IMMEDIATE=y
# CONFIG_NET_CONNECTION_MANAGER_LOG_LEVEL_DBG=y
# CONFIG_LTE_LINK_CONTROL_LOG_LEVEL_DBG=y
# CONFIG_NET_LOG=y
# CONFIG_NET_IF_LOG_LEVEL_DBG=y
# CONFIG_DATE_TIME_LOG_LEVEL_DBG=y
# CONFIG_NRF_MODEM_LIB_NET_IF_LOG_LEVEL_DBG=y
# CONFIG_NRF_MODEM_LIB_NET_IF_NTN_LOG_LEVEL_DBG=y
# CONFIG_NRF_MODEM_LIB_NET_IF_NTN_LOG_SV_DATA_ENABLE=y
```

## overlay-ntn-skylo-DT.conf
```kconfig
# Skylo
CONFIG_APP_NTN_BANDLOCK_ENABLE=y
CONFIG_APP_NTN_BANDLOCK=256
# CONFIG_APP_NTN_CHANNEL_SELECT_ENABLE=y
# CONFIG_APP_NTN_CHANNEL_SELECT=228841
CONFIG_APP_NTN_APN_ENABLE=y
CONFIG_APP_NTN_APN="internet.m2mportal.de"
CONFIG_APP_NTN_DISABLE_EPCO=y
```

## boards/nrf9151dk_nrf9151_ns.conf
```kconfig
#
# Copyright (c) 2025 Nordic Semiconductor ASA
#
# SPDX-License-Identifier: LicenseRef-Nordic-5-Clause
#

# Disable Duplicate Address Detection (DAD)
# due to not being properly implemented for offloaded interfaces.
CONFIG_NET_IPV6_NBR_CACHE=n
CONFIG_NET_IPV6_MLD=n

# Offload  network operations to the modem.
CONFIG_NET_SOCKETS_OFFLOAD=y

## PSM
CONFIG_LTE_PSM_REQ=y
CONFIG_LTE_PSM_REQ_RPTAU="00100001"
CONFIG_LTE_PSM_REQ_RAT="00000000"

## eDRX
CONFIG_LTE_EDRX_REQ=n
CONFIG_LTE_EDRX_REQ_VALUE_LTE_M="1001"

## RAI
CONFIG_LTE_RAI_REQ=n

# SMA DK
CONFIG_MODEM_ANTENNA_GNSS_EXTERNAL=y
```

## boards/thingy91x_nrf9151_ns.conf
```kconfig
#
# Copyright (c) 2025 Nordic Semiconductor ASA
#
# SPDX-License-Identifier: LicenseRef-Nordic-5-Clause
#

# Disable Duplicate Address Detection (DAD)
# due to not being properly implemented for offloaded interfaces.
CONFIG_NET_IPV6_NBR_CACHE=n
CONFIG_NET_IPV6_MLD=n

# Offload  network operations to the modem.
CONFIG_NET_SOCKETS_OFFLOAD=y

## PSM
CONFIG_LTE_PSM_REQ=y
CONFIG_LTE_PSM_REQ_RPTAU="00100001"
CONFIG_LTE_PSM_REQ_RAT="00000000"

## eDRX
CONFIG_LTE_EDRX_REQ=n
CONFIG_LTE_EDRX_REQ_VALUE_LTE_M="1001"

## RAI
CONFIG_LTE_RAI_REQ=n
```

## boards/thingy91x_nrf9151_ns.overlay
```dts
/*
 * Copyright (c) 2025 Nordic Semiconductor ASA
 *
 * SPDX-License-Identifier: LicenseRef-Nordic-5-Clause
 */

/* Enable uart1 for tracing. */
&uart1 {
	status = "okay";
	current-speed = < 1000000 >;
	hw-flow-control;
};

/ {
	chosen {
		nordic,modem-trace-uart = &uart1;
	};
};
```

## src/main.c
```c
/*
 * Copyright (c) 2025 Nordic Semiconductor ASA
 *
 * SPDX-License-Identifier: LicenseRef-Nordic-5-Clause
 */

#include <stdio.h>
#include <zephyr/kernel.h>
#include <zephyr/logging/log.h>
#include <zephyr/logging/log_ctrl.h>
#include <zephyr/sys/reboot.h>
#include <zephyr/net/socket.h>
#include <zephyr/net/conn_mgr_connectivity.h>
#include <zephyr/net/conn_mgr_monitor.h>

#if defined(CONFIG_POSIX_API)
#include <zephyr/posix/arpa/inet.h>
#include <zephyr/posix/unistd.h>
#include <zephyr/posix/sys/socket.h>
#endif

LOG_MODULE_REGISTER(ntn_sample, CONFIG_NTN_SAMPLE_LOG_LEVEL);

#define UDP_IP_HEADER_SIZE 28

/* Macros used to subscribe to specific Zephyr NET management events. */
#define L4_EVENT_MASK (NET_EVENT_L4_CONNECTED | NET_EVENT_L4_DISCONNECTED)
#define CONN_LAYER_EVENT_MASK (NET_EVENT_CONN_IF_FATAL_ERROR)

/* Macro called upon a fatal error, reboots the device. */
#define FATAL_ERROR()					\
	LOG_ERR("Fatal error! Rebooting the device.");	\
	LOG_PANIC();					\
	IF_ENABLED(CONFIG_REBOOT, (sys_reboot(0)))

/* Zephyr NET management event callback structures. */
static struct net_mgmt_event_callback l4_cb;
static struct net_mgmt_event_callback conn_cb;

/* Variables used to perform socket operations. */
static int fd;
static struct sockaddr_storage host_addr;

static K_SEM_DEFINE(data_sent, 0, 1);

/* Forward declarations */
static void server_transmission_work_fn(struct k_work *work);

/* Work item used to schedule periodic UDP transmissions. */
static K_WORK_DELAYABLE_DEFINE(server_transmission_work, server_transmission_work_fn);

static void server_transmission_work_fn(struct k_work *work)
{
	int err;
	char buffer[CONFIG_NTN_SAMPLE_DATA_UPLOAD_SIZE_BYTES] = {"\0"};

	snprintf(buffer, sizeof(buffer),
		"ntn sample");

	LOG_INF("Transmitting UDP/IP payload of %d bytes to the "
		"IP address %s, port number %d",
		CONFIG_NTN_SAMPLE_DATA_UPLOAD_SIZE_BYTES + UDP_IP_HEADER_SIZE,
		CONFIG_NTN_SAMPLE_SERVER_ADDRESS_STATIC,
		CONFIG_NTN_SAMPLE_SERVER_PORT);

	err = send(fd, buffer, sizeof(buffer), 0);
	if (err < 0) {
		LOG_ERR("Failed to transmit UDP packet, %d", -errno);
		return;
	}

	k_sem_give(&data_sent);
}

static int server_addr_construct(void)
{
	int err;

	struct sockaddr_in *server4 = ((struct sockaddr_in *)&host_addr);

	server4->sin_family = AF_INET;
	server4->sin_port = htons(CONFIG_NTN_SAMPLE_SERVER_PORT);

	err = inet_pton(AF_INET, CONFIG_NTN_SAMPLE_SERVER_ADDRESS_STATIC, &server4->sin_addr);
	if (err < 0) {
		LOG_ERR("inet_pton, error: %d", -errno);
		return err;
	}

	return 0;
}

static void on_net_event_l4_connected(void)
{
	int err;

	fd = socket(AF_INET, SOCK_DGRAM, IPPROTO_UDP);
	if (fd < 0) {
		LOG_ERR("Failed to create UDP socket: %d", -errno);
		FATAL_ERROR();
		return;
	}

	err = connect(fd, (struct sockaddr *)&host_addr, sizeof(struct sockaddr_in));
	if (err < 0) {
		LOG_ERR("connect, error: %d", -errno);
		FATAL_ERROR();
		return;
	}

	(void)k_work_reschedule(&server_transmission_work, K_NO_WAIT);
}

static void on_net_event_l4_disconnected(void)
{
	(void)close(fd);
	(void)k_work_cancel_delayable(&server_transmission_work);
}

static void l4_event_handler(struct net_mgmt_event_callback *cb,
			     uint64_t event,
			     struct net_if *iface)
{
	switch (event) {
	case NET_EVENT_L4_CONNECTED:
		LOG_INF("Network connectivity established");
		on_net_event_l4_connected();
		break;
	case NET_EVENT_L4_DISCONNECTED:
		LOG_INF("Network connectivity lost");
		on_net_event_l4_disconnected();
		break;
	default:
		/* Don't care */
		return;
	}
}

static void connectivity_event_handler(struct net_mgmt_event_callback *cb,
				       uint64_t event,
				       struct net_if *iface)
{
	if (event == NET_EVENT_CONN_IF_FATAL_ERROR) {
		LOG_ERR("NET_EVENT_CONN_IF_FATAL_ERROR");
		FATAL_ERROR();
		return;
	}
}

int main(void)
{
	int err;

	LOG_INF("NTN sample has started");

	/* Setup handler for Zephyr NET Connection Manager events. */
	net_mgmt_init_event_callback(&l4_cb, l4_event_handler, L4_EVENT_MASK);
	net_mgmt_add_event_callback(&l4_cb);

	/* Setup handler for Zephyr NET Connection Manager Connectivity layer. */
	net_mgmt_init_event_callback(&conn_cb, connectivity_event_handler, CONN_LAYER_EVENT_MASK);
	net_mgmt_add_event_callback(&conn_cb);

	err = server_addr_construct();
	if (err) {
		LOG_INF("server_addr_construct, error: %d", err);
		FATAL_ERROR();
		return err;
	}

	/* Get references to both interfaces: TODO - Use better naming for ifaces, perhaps a suffix? */
	struct net_if *lte_if = net_if_get_by_index(net_if_get_by_name("cell_if"));
	struct net_if *ntn_if = net_if_get_by_index(net_if_get_by_name("ntn_if"));

	if (!lte_if || !ntn_if) {
		LOG_ERR("Failed to get network interfaces");
		FATAL_ERROR();
		return -ENODEV;
	}

	LOG_INF("Cellular interface found: %p, NTN interface found: %p", lte_if, ntn_if);

	LOG_INF("Bringing up Cellular network interface");

	/* Bring up cellular interface */
	err = net_if_up(lte_if);
	if (err) {
		LOG_ERR("conn_mgr_all_if_up, error: %d", err);
		FATAL_ERROR();
		return err;
	}

	/* Connect to the cellular interface */
	err = conn_mgr_if_connect(lte_if);
	if (err) {
		LOG_ERR("conn_mgr_if_connect cellular, error: %d", err);
		FATAL_ERROR();
		return err;
	}

	k_sem_take(&data_sent, K_FOREVER);

	/* Disconnect from the LTE cellular interface */
	err = conn_mgr_if_disconnect(lte_if);
	if (err) {
		LOG_ERR("conn_mgr_if_disconnect LTE, error: %d", err);
		FATAL_ERROR();
		return err;
	}

	k_sleep(K_SECONDS(5));

	/* Bring down cellular interface */
	err = net_if_down(lte_if);
	if (err) {
		LOG_ERR("net_if_down cellular, error: %d", err);
		FATAL_ERROR();
		return err;
	}

	LOG_INF("Cellular interface down");

	k_sleep(K_SECONDS(5));

	LOG_INF("Bringing up NTN network interface");

	/* Bring up NTN interface */
	err = net_if_up(ntn_if);
	if (err) {
		LOG_ERR("conn_mgr_all_if_up NTN, error: %d", err);
		FATAL_ERROR();
		return err;
	}

	/* Connect to the NTN cellular interface */
	err = conn_mgr_if_connect(ntn_if);
	if (err) {
		LOG_ERR("conn_mgr_if_connect NTN, error: %d", err);
		FATAL_ERROR();
		return err;
	}

	k_sem_take(&data_sent, K_FOREVER);

	/* Put the NTN cellular interface to dormant mode */
	err = conn_mgr_if_disconnect(ntn_if);
	if (err) {
		LOG_ERR("conn_mgr_if_disconnect NTN, error: %d", err);
		FATAL_ERROR();
		return err;
	}

	k_sleep(K_SECONDS(5));

	/* Tear down the NTN cellular interface */
	err = net_if_down(ntn_if);
	if (err) {
		LOG_ERR("net_if_down, error: %d", err);
		FATAL_ERROR();
		return err;
	}

	LOG_INF("Finished");


	return 0;
}
```
