## CMakeLists.txt
```
#
# Copyright (c) 2020 Nordic Semiconductor
#
# SPDX-License-Identifier: LicenseRef-Nordic-5-Clause
#

cmake_minimum_required(VERSION 3.20.0)

find_package(Zephyr REQUIRED HINTS $ENV{ZEPHYR_BASE})
project(download)

set(gen_dir "${ZEPHYR_BINARY_DIR}/include/generated")

# Generate hex file from pem file
if(CONFIG_SAMPLE_PROVISION_CERT)
  generate_inc_file_for_target(
    app
    ${CONFIG_SAMPLE_CERT_FILE}
    "${gen_dir}/sample_cert.inc"
  )
endif()

if(CONFIG_SAMPLE_PROVISION_CLIENT_CERT)
  generate_inc_file_for_target(
    app
    ${CONFIG_SAMPLE_CLIENT_CERT_FILE}
    "${gen_dir}/sample_client_cert.inc"
  )

  generate_inc_file_for_target(
    app
    ${CONFIG_SAMPLE_CLIENT_KEY_FILE}
    "${gen_dir}/sample_client_key.inc"
  )
endif()

# NORDIC SDK APP START
target_sources(app PRIVATE src/main.c)
# NORDIC SDK APP END
```

## Kconfig
```
menu "Download sample"

config SAMPLE_SECURE_SOCKET
	bool "Use TLS/DTLS"
	default y

if SAMPLE_SECURE_SOCKET

config SAMPLE_SEC_TAG
	int "Security tag"
	default 42

config SAMPLE_PROVISION_CERT
	bool "Provision root CA certificate"
	default y
	help
	  Provision the root CA certificate for the server to the device. This is needed for secure
	  connections.
	  Disable this option to avoid overwriting an existing root CA certificate already stored in
	  the device.

config SAMPLE_CERT_FILE
	string "Certificate file name"
	default "cert/file-example.pem"
	depends on SAMPLE_PROVISION_CERT

config SAMPLE_PROVISION_CLIENT_CERT
	bool "Provision client certificate and key for mutual TLS"
	depends on SAMPLE_PROVISION_CERT
	depends on !MODEM_KEY_MGMT
	help
	  Provision a client certificate and private key in addition to the CA certificate.
	  Required for DTLS/TLS mutual authentication (e.g. with the Californium interop server).
	  Only supported when using the Zephyr TLS credentials store. Not available together with
	  CONFIG_MODEM_KEY_MGMT yet.

config SAMPLE_CLIENT_CERT_FILE
	string "Client certificate file"
	default "cert/cf-client.pem"
	depends on SAMPLE_PROVISION_CLIENT_CERT

config SAMPLE_CLIENT_KEY_FILE
	string "Client private key file"
	default "cert/cf-client-key.pem"
	depends on SAMPLE_PROVISION_CLIENT_CERT

endif

choice SAMPLE_FILE
	prompt "Test file"

config SAMPLE_FILE_HTTP
	bool "HTTP test file"
	depends on !SAMPLE_SECURE_SOCKET
config SAMPLE_FILE_HTTPS
	bool "HTTPS test file"
	depends on SAMPLE_SECURE_SOCKET
config SAMPLE_FILE_CUSTOM
	bool "Custom test file"

endchoice

config SAMPLE_FILE_URL
	string "URL of resource to download" if SAMPLE_FILE_CUSTOM
	default "http://nrfconnectsdk.s3.dualstack.eu-central-1.amazonaws.com/sample-img-100kb.png" if SAMPLE_FILE_HTTP
	default "https://nrfconnectsdk.s3.dualstack.eu-central-1.amazonaws.com/sample-img-100kb.png" if SAMPLE_FILE_HTTPS

config SAMPLE_COMPUTE_HASH
	bool "Compute sha256 hash"
	select PSA_CRYPTO
	select PSA_WANT_ALG_SHA_256
	default y

config SAMPLE_COMPARE_HASH
	bool "Compare hash"
	depends on SAMPLE_COMPUTE_HASH
	default y

config SAMPLE_SHA256_HASH
	string "sha256 hash"
	depends on SAMPLE_COMPARE_HASH
	default "344577d739dc0e9f9498c13be2fbc7fb947abd291e9e57db9e9ca4a89ccd5f63" if SAMPLE_FILE_HTTP || SAMPLE_FILE_HTTPS

endmenu

menu "Zephyr Kernel"
source "Kconfig.zephyr"
endmenu
```

## Kconfig.sysbuild
```
#
# Copyright (c) 2024 Nordic Semiconductor ASA
#
# SPDX-License-Identifier: LicenseRef-Nordic-5-Clause
#

config WIFI_NRF70
	default y if BOARD_NRF7002DK_NRF5340_CPUAPP_NS || \
		     BOARD_NRF54L15DK_NRF54L15_CPUAPP || \
		     BOARD_NRF54H20DK_NRF54H20_CPUAPP || \
		     BOARD_NRF5340DK_NRF5340_CPUAPP_NS || \
		     BOARD_NRF54LM20DK_NRF54LM20A_CPUAPP

config PARTITION_MANAGER
	default n if !SOC_SERIES_NRF53 && !BOARD_THINGY91X && !BOARD_THINGY91

source "share/sysbuild/Kconfig"
```

## sample.yaml
```
sample:
  name: Download sample
tests:
  sample.net.downloader:
    sysbuild: true
    build_only: true
    integration_platforms:
      - native_sim
    platform_allow:
      - nrf9151dk/nrf9151/ns
      - native_sim
    tags:
      - ci_build
      - sysbuild
      - ci_samples_net
  sample.net.downloader.wifi:
    sysbuild: true
    build_only: true
    integration_platforms:
      - nrf7002dk/nrf5340/cpuapp/ns
      - nrf7120dk/nrf7120/cpuapp/ns
    platform_allow:
      - nrf7002dk/nrf5340/cpuapp/ns
      - nrf7120dk/nrf7120/cpuapp/ns
    tags:
      - ci_build
      - sysbuild
      - ci_samples_net
    extra_args:
      - download_EXTRA_CONF_FILE=wifi.conf
  sample.net.downloader.wifi.dtls_cert:
    sysbuild: true
    build_only: true
    integration_platforms:
      - nrf7002dk/nrf5340/cpuapp/ns
      - nrf7120dk/nrf7120/cpuapp/ns
    platform_allow:
      - nrf7002dk/nrf5340/cpuapp/ns
      - nrf7120dk/nrf7120/cpuapp/ns
    tags:
      - ci_build
      - sysbuild
      - ci_samples_net
    extra_args:
      - download_EXTRA_CONF_FILE="wifi.conf;wifi-mutual-dtls.conf"
  sample.net.downloader.wifi.tls_cert:
    sysbuild: true
    build_only: true
    integration_platforms:
      - nrf7002dk/nrf5340/cpuapp/ns
      - nrf7120dk/nrf7120/cpuapp/ns
    platform_allow:
      - nrf7002dk/nrf5340/cpuapp/ns
      - nrf7120dk/nrf7120/cpuapp/ns
    extra_args:
      - download_EXTRA_CONF_FILE=wifi.conf
    # No real mutual-TLS-enabled HTTPS server is used; this reuses the sample's
    # example Californium client certificate purely for Twister build coverage.
    extra_configs:
      - CONFIG_SAMPLE_PROVISION_CLIENT_CERT=y
    tags:
      - ci_build
      - sysbuild
      - ci_samples_net
  sample.net.downloader.nrf54lm20_nrf7002eb2.wifi:
    sysbuild: true
    tags:
      - ci_build
      - sysbuild
      - ci_samples_net
    build_only: true
    integration_platforms:
      - nrf54lm20dk/nrf54lm20a/cpuapp
      - nrf54lm20dk/nrf54lm20b/cpuapp
    platform_allow:
      - nrf54lm20dk/nrf54lm20a/cpuapp
      - nrf54lm20dk/nrf54lm20b/cpuapp
    extra_args:
      - download_SHIELD="nrf7002eb2"
      - download_SNIPPET=wifi-credentials
      - download_EXTRA_CONF_FILE="wifi.conf"
  sample.net.downloader.nrf54lm20_nrf7002eb2.wifi.dtls_cert:
    sysbuild: true
    tags:
      - ci_build
      - sysbuild
      - ci_samples_net
    build_only: true
    integration_platforms:
      - nrf54lm20dk/nrf54lm20a/cpuapp
      - nrf54lm20dk/nrf54lm20b/cpuapp
    platform_allow:
      - nrf54lm20dk/nrf54lm20a/cpuapp
      - nrf54lm20dk/nrf54lm20b/cpuapp
    extra_args:
      - download_SHIELD="nrf7002eb2"
      - download_SNIPPET=wifi-credentials
      - download_EXTRA_CONF_FILE="wifi.conf;wifi-mutual-dtls.conf"
  sample.net.downloader.nrf54lm20_nrf7002eb2.wifi.tls_cert:
    sysbuild: true
    tags:
      - ci_build
      - sysbuild
      - ci_samples_net
    build_only: true
    integration_platforms:
      - nrf54lm20dk/nrf54lm20a/cpuapp
      - nrf54lm20dk/nrf54lm20b/cpuapp
    platform_allow:
      - nrf54lm20dk/nrf54lm20a/cpuapp
      - nrf54lm20dk/nrf54lm20b/cpuapp
    extra_args:
      - download_SHIELD="nrf7002eb2"
      - download_SNIPPET=wifi-credentials
      - download_EXTRA_CONF_FILE=wifi.conf
    # No real mutual-TLS-enabled HTTPS server is used; this reuses the sample's
    # example Californium client certificate purely for Twister build coverage.
    extra_configs:
      - CONFIG_SAMPLE_PROVISION_CLIENT_CERT=y
```

## prj.conf
```kconfig
#
# Copyright (c) 2021 Nordic Semiconductor ASA
#
# SPDX-License-Identifier: LicenseRef-Nordic-5-Clause
#

CONFIG_LOG=y

CONFIG_DOWNLOADER=y
CONFIG_DOWNLOADER_STACK_SIZE=8192

# Networking
CONFIG_NETWORKING=y
CONFIG_NET_CONNECTION_MANAGER=y
CONFIG_NET_SOCKETS=y
CONFIG_POSIX_API=y
CONFIG_NET_IPV4=y
CONFIG_NET_IPV6=y
CONFIG_HEAP_MEM_POOL_SIZE=1280
CONFIG_COAP=y
CONFIG_DOWNLOADER_TRANSPORT_COAP=y
```

## wifi-mutual-dtls.conf
```kconfig
#
# Copyright (c) 2026 Nordic Semiconductor ASA
#
# SPDX-License-Identifier: LicenseRef-Nordic-5-Clause
#

# Extra conf file for mutual DTLS.

# Different cert file than in the default HTTPS case.
CONFIG_SAMPLE_CERT_FILE="cert/cf-ca.pem"
# Mutual DTLS. Client cert and key are under cert/.
CONFIG_SAMPLE_PROVISION_CLIENT_CERT=y

# The file to download.
CONFIG_SAMPLE_FILE_CUSTOM=y
CONFIG_SAMPLE_FILE_URL="coaps://californium.eclipseprojects.io/large"
CONFIG_SAMPLE_SHA256_HASH="a26bd312022f497cb0c9451aa145b04fd5ceab7af0da59766a8bbb962e60d872"
```

## wifi.conf
```kconfig
#
# Copyright (c) 2026 Nordic Semiconductor ASA
#
# SPDX-License-Identifier: LicenseRef-Nordic-5-Clause
#

# Common Wi-Fi + networking + TLS configuration shared by all Wi-Fi builds of
# this sample (nRF70 and nRF71).

# Logging
CONFIG_LOG=y
CONFIG_NET_LOG=y

# Wi-Fi stack
CONFIG_WIFI=y
CONFIG_WIFI_NM_WPA_SUPPLICANT=y
CONFIG_NET_L2_ETHERNET=y

# Wi-Fi credentials. TF-M (_ns) builds use PSA Protected Storage. Non-TF-M
# builds use the Settings subsystem, requiring the wifi-credentials snippet.
CONFIG_WIFI_CREDENTIALS=y

# Zephyr NET Connection Manager Connectivity layer.
CONFIG_L2_WIFI_CONNECTIVITY=y
CONFIG_L2_WIFI_CONNECTIVITY_AUTO_CONNECT=n
CONFIG_L2_WIFI_CONNECTIVITY_AUTO_DOWN=n

# Networking
CONFIG_NET_SOCKETS=y
CONFIG_NET_SOCKETS_OFFLOAD=n
CONFIG_NET_IPV6=y
CONFIG_NET_UDP=y
CONFIG_NET_TCP=y
CONFIG_NET_DHCPV4=y
# Run DHCPv6 on RA, covering both stateful and stateless configurations
CONFIG_NET_DHCPV6=y
CONFIG_NET_DHCPV6_START_ON_RA=y
CONFIG_NET_CONTEXT_SNDTIMEO=y
CONFIG_NET_CONTEXT_RCVTIMEO=y

# DNS
CONFIG_DNS_RESOLVER=y
CONFIG_NET_SOCKETS_DNS_TIMEOUT=30000

# Wi-Fi shell
CONFIG_SHELL=y
CONFIG_SHELL_CMDS_RESIZE=n
CONFIG_NET_L2_WIFI_SHELL=y

# POSIX API memory optimizations
CONFIG_POSIX_NETWORKING=y
CONFIG_POSIX_FD_MGMT=n
CONFIG_POSIX_MESSAGE_PASSING=n
CONFIG_POSIX_THREAD_THREADS_MAX=0

# Network resource sizing (workload-specific for this sample)
CONFIG_NET_MAX_CONN=8
CONFIG_NET_MAX_CONTEXTS=6
CONFIG_ZVFS_POLL_MAX=8
CONFIG_NET_PKT_TX_COUNT=6
CONFIG_NET_PKT_RX_COUNT=6
CONFIG_NET_BUF_TX_COUNT=12
CONFIG_NET_BUF_RX_COUNT=6

# NET sockets TLS
CONFIG_NET_SOCKETS_SOCKOPT_TLS=y
CONFIG_NET_SOCKETS_TLS_MAX_CONTEXTS=1
CONFIG_NET_SOCKETS_ENABLE_DTLS=y
CONFIG_TLS_CREDENTIALS=y
# Persist TLS credentials across reboots.
CONFIG_TLS_CREDENTIALS_BACKEND_PROTECTED_STORAGE=y

# mbedTLS
CONFIG_MBEDTLS=y
CONFIG_MBEDTLS_ENABLE_HEAP=y
CONFIG_MBEDTLS_HEAP_SIZE=81920
CONFIG_MBEDTLS_SSL_KEEP_PEER_CERTIFICATE=n
CONFIG_MBEDTLS_SSL_SERVER_NAME_INDICATION=y
# CA certificate provisioned by the sample is PEM-encoded.
CONFIG_MBEDTLS_PEM_PARSE_C=y
CONFIG_MBEDTLS_CIPHERSUITE_TLS_ECDHE_RSA_WITH_AES_128_CBC_SHA256=y
# ECDHE-ECDSA ciphersuite for DTLS with ECDSA-signed servers (e.g. Californium)
CONFIG_MBEDTLS_CIPHERSUITE_TLS_ECDHE_ECDSA_WITH_AES_128_GCM_SHA256=y
# Server certificate chain may be ECDSA-signed (ciphersuite enables only RSA sig verify)
CONFIG_PSA_WANT_ALG_ECDSA=y
# Set MPI (Multiple Precision Integer) size limit to 512 bytes for handling of 4 kb certificates
# in cryptographic operations.
CONFIG_MBEDTLS_MPI_MAX_SIZE=512

# Stack sizes
CONFIG_MAIN_STACK_SIZE=6144
CONFIG_SHELL_STACK_SIZE=6144
CONFIG_SYSTEM_WORKQUEUE_STACK_SIZE=4096
CONFIG_NET_CONNECTION_MANAGER_MONITOR_STACK_SIZE=5000
CONFIG_NET_TX_STACK_SIZE=4096
CONFIG_NET_RX_STACK_SIZE=4096
CONFIG_NET_SOCKETS_SERVICE_STACK_SIZE=2048

# Heap sizes
CONFIG_HEAP_MEM_POOL_IGNORE_MIN=y
CONFIG_HEAP_MEM_POOL_SIZE=40144
CONFIG_NRF_WIFI_DATA_HEAP_SIZE=65536

# Floating-point printf support (Wi-Fi shell prints PHY TX rate as %f)
CONFIG_CBPRINTF_FP_SUPPORT=y
```

## boards/native_sim.conf
```kconfig
#
# Copyright (c) 2024 Nordic Semiconductor ASA
#
# SPDX-License-Identifier: LicenseRef-Nordic-5-Clause
#

# Networking config
CONFIG_NETWORKING=y
CONFIG_NET_CONFIG_SETTINGS=y
CONFIG_NET_CONNECTION_MANAGER=y
CONFIG_NET_IPV4=y
CONFIG_NET_IPV6=y
CONFIG_NET_TCP=y
CONFIG_NET_UDP=y
CONFIG_NET_SOCKETS=y
CONFIG_POSIX_API=y
CONFIG_NET_CONTEXT_RCVTIMEO=y
CONFIG_NET_CONTEXT_SNDTIMEO=y

# Network address config
CONFIG_NET_CONFIG_SETTINGS=y
CONFIG_NET_CONFIG_NEED_IPV6=n
CONFIG_NET_CONFIG_NEED_IPV4=y
CONFIG_NET_CONFIG_MY_IPV4_ADDR="192.0.2.1"
CONFIG_NET_CONFIG_MY_IPV4_GW="192.0.2.2"

# TLS networking
CONFIG_NET_SOCKETS_ENABLE_DTLS=n
CONFIG_NET_SOCKETS_TLS_MAX_CONTEXTS=2
CONFIG_NET_SOCKETS_SOCKOPT_TLS=y

# TLS configuration
CONFIG_MBEDTLS=y
CONFIG_MBEDTLS_ENABLE_HEAP=y
CONFIG_MBEDTLS_HEAP_SIZE=40000
CONFIG_MBEDTLS_SSL_MAX_CONTENT_LEN=7168
CONFIG_MBEDTLS_PEM_PARSE_C=y
CONFIG_MBEDTLS_PEM_WRITE_C=y
CONFIG_MBEDTLS_CIPHERSUITE_TLS_ECDHE_RSA_WITH_AES_128_CBC_SHA256=y

# DNS
CONFIG_DNS_RESOLVER=y
CONFIG_DNS_SERVER_IP_ADDRESSES=y
CONFIG_DNS_RESOLVER_MAX_SERVERS=2
CONFIG_DNS_SERVER1="8.8.8.8"
```

## boards/nrf5340dk_nrf5340_cpuapp_ns.conf
```kconfig
#
# Copyright (c) 2025 Nordic Semiconductor ASA
#
# SPDX-License-Identifier: LicenseRef-Nordic-5-Clause
#

# General
CONFIG_LOG=y
CONFIG_LOG_MODE_IMMEDIATE=y
CONFIG_POSIX_TIMERS=y
CONFIG_SYSTEM_WORKQUEUE_STACK_SIZE=4096
CONFIG_HEAP_MEM_POOL_SIZE=40144
CONFIG_NRF_WIFI_CTRL_HEAP_SIZE=20000
CONFIG_NRF_WIFI_DATA_HEAP_SIZE=59856
CONFIG_HEAP_MEM_POOL_IGNORE_MIN=y
CONFIG_MAIN_STACK_SIZE=6144

# Optimize Wi-Fi stack to save some memory
CONFIG_NRF70_RX_NUM_BUFS=16
CONFIG_NRF70_MAX_TX_AGGREGATION=4

# Zephyr NET Connection Manager connectivity layer.
CONFIG_L2_WIFI_CONNECTIVITY=y
CONFIG_L2_WIFI_CONNECTIVITY_AUTO_DOWN=n
CONFIG_L2_WIFI_CONNECTIVITY_AUTO_CONNECT=n

# Wi-Fi
CONFIG_WIFI=y
CONFIG_WIFI_NRF70=y
CONFIG_WIFI_NRF70_LOG_LEVEL_ERR=y
CONFIG_WIFI_CREDENTIALS=y

# Shell
CONFIG_SHELL=y
CONFIG_SHELL_STACK_SIZE=6144
CONFIG_NET_L2_WIFI_SHELL=y

# WPA
CONFIG_WIFI_NM_WPA_SUPPLICANT=y
CONFIG_WIFI_NM_WPA_SUPPLICANT_LOG_LEVEL_ERR=y

# NET sockets
CONFIG_NET_L2_ETHERNET=y
CONFIG_NET_UDP=y
CONFIG_NET_DHCPV4=y
CONFIG_NET_CONTEXT_SNDTIMEO=y
CONFIG_NET_CONTEXT_RCVTIMEO=y
CONFIG_NET_TCP=y
CONFIG_NET_NATIVE=y
CONFIG_NET_SOCKETS_SOCKOPT_TLS=y

# DNS
CONFIG_DNS_RESOLVER=y
CONFIG_NET_SOCKETS_DNS_TIMEOUT=30000

# TLS
CONFIG_MBEDTLS=y
CONFIG_MBEDTLS_ENABLE_HEAP=y
CONFIG_MBEDTLS_HEAP_SIZE=81920
# Legacy API is required for RSA
CONFIG_MBEDTLS_DECLARE_PRIVATE_IDENTIFIERS=y
# CA certificate provisioned by the sample is PEM-encoded.
CONFIG_MBEDTLS_PEM_PARSE_C=y
CONFIG_MBEDTLS_MD_C=y
CONFIG_MBEDTLS_HMAC_DRBG_C=y
CONFIG_MBEDTLS_SHA256_C=y
CONFIG_MBEDTLS_ECP_C=y
CONFIG_MBEDTLS_RSA_C=y
CONFIG_PSA_WANT_KEY_TYPE_RSA_KEY_PAIR_IMPORT=y
CONFIG_PSA_WANT_KEY_TYPE_RSA_KEY_PAIR_EXPORT=y
CONFIG_PSA_WANT_KEY_TYPE_RSA_KEY_PAIR_GENERATE=y
CONFIG_MBEDTLS_SSL_SERVER_NAME_INDICATION=y
# Set MPI (Multiple Precision Integer) size limit to 512 bytes for handling of 4 kb certificates
# in cryptographic operations.
CONFIG_MBEDTLS_MPI_MAX_SIZE=512
# ECDH/ECDSA are needed for TLS handshake
CONFIG_PSA_WANT_ALG_ECDH=y
CONFIG_PSA_WANT_ALG_ECDSA=y
CONFIG_TLS_CREDENTIALS_BACKEND_PROTECTED_STORAGE=y

# Optimize TF-M
CONFIG_TFM_PROFILE_TYPE_SMALL=y

# Floating-point printf support
CONFIG_CBPRINTF_FP_SUPPORT=y
```

## boards/nrf54h20dk_nrf54h20_cpuapp.conf
```kconfig
#
# Copyright (c) 2024 Nordic Semiconductor ASA
#
# SPDX-License-Identifier: LicenseRef-Nordic-5-Clause
#

# Logging
CONFIG_LOG=y
CONFIG_LOG_MODE_IMMEDIATE=y

# Wi-Fi
CONFIG_WIFI=y
CONFIG_WIFI_NRF70=y
CONFIG_WIFI_CREDENTIALS=y
# Needed for Wi-Fi credentials
CONFIG_FLASH=y
CONFIG_FLASH_PAGE_LAYOUT=y
CONFIG_FLASH_MAP=y
CONFIG_ZMS=y
CONFIG_SETTINGS=y

# WPA supplicant
CONFIG_WIFI_NM_WPA_SUPPLICANT=y
CONFIG_WIFI_NM_WPA_SUPPLICANT_LOG_LEVEL_INF=y

# Networking
CONFIG_NET_L2_ETHERNET=y
CONFIG_NET_SOCKETS=y
CONFIG_NET_IPV6=y
CONFIG_NET_UDP=y
CONFIG_NET_TCP=y
CONFIG_NET_DHCPV4=y
CONFIG_DNS_RESOLVER=y
CONFIG_DNS_RESOLVER_AI_MAX_ENTRIES=4

# NET sockets
CONFIG_NET_UDP=y
CONFIG_NET_TCP=y
CONFIG_NET_MAX_CONN=6
CONFIG_NET_MAX_CONTEXTS=5
CONFIG_NET_SOCKETS_POLL_MAX=8
CONFIG_NET_SOCKETS_OFFLOAD=n
CONFIG_NET_DHCPV4=y
CONFIG_NET_CONTEXT_SNDTIMEO=y
CONFIG_NET_CONTEXT_RCVTIMEO=y
CONFIG_NET_MAX_CONTEXTS=3

# NET buffers
CONFIG_NET_PKT_TX_COUNT=6
CONFIG_NET_PKT_RX_COUNT=6
CONFIG_NET_BUF_TX_COUNT=12
CONFIG_NET_BUF_RX_COUNT=6
CONFIG_NRF70_RX_NUM_BUFS=6
CONFIG_NET_PKT_BUF_RX_DATA_POOL_SIZE=4096
CONFIG_NET_PKT_BUF_TX_DATA_POOL_SIZE=4096
CONFIG_NRF70_MAX_TX_AGGREGATION=1

# Kernel options
CONFIG_POSIX_NETWORKING=y
CONFIG_ZVFS_OPEN_MAX=21

# Shell
CONFIG_SHELL=y
CONFIG_SHELL_CMDS_RESIZE=n
CONFIG_NET_L2_WIFI_SHELL=y

# TLS
CONFIG_NET_SOCKETS_SOCKOPT_TLS=y
CONFIG_NET_SOCKETS_TLS_MAX_CONTEXTS=1
CONFIG_MBEDTLS=y
CONFIG_MBEDTLS_ENABLE_HEAP=y
CONFIG_MBEDTLS_SSL_KEEP_PEER_CERTIFICATE=n
CONFIG_MBEDTLS_SSL_SERVER_NAME_INDICATION=y
CONFIG_TLS_CREDENTIALS=y
CONFIG_TLS_CREDENTIALS_BACKEND_VOLATILE=y
CONFIG_TLS_CREDENTIALS_BACKEND_PROTECTED_STORAGE=y
# Legacy API is required for RSA
CONFIG_MBEDTLS_LEGACY_CRYPTO_C=y
CONFIG_MBEDTLS_RSA_C=y
CONFIG_PSA_WANT_KEY_TYPE_RSA_KEY_PAIR_IMPORT=y
CONFIG_PSA_WANT_KEY_TYPE_RSA_KEY_PAIR_EXPORT=y
CONFIG_PSA_WANT_KEY_TYPE_RSA_KEY_PAIR_GENERATE=y
# Set MPI (Multiple Precision Integer) size limit to 512 bytes for handling of 4 kb certificates
# in cryptographic operations.
CONFIG_MBEDTLS_MPI_MAX_SIZE=512
# ECDH/ECDSA are needed for TLS handshake
CONFIG_PSA_WANT_ALG_ECDH=y
CONFIG_PSA_WANT_ALG_ECDSA=y

# Zephyr NET Connection Manager Connectivity layer.
CONFIG_L2_WIFI_CONNECTIVITY=y
CONFIG_L2_WIFI_CONNECTIVITY_AUTO_CONNECT=y
CONFIG_L2_WIFI_CONNECTIVITY_AUTO_DOWN=n

# Stack sizes
CONFIG_NET_CONNECTION_MANAGER_MONITOR_STACK_SIZE=5000
CONFIG_MAIN_STACK_SIZE=6144
CONFIG_NET_TX_STACK_SIZE=2048
CONFIG_NET_RX_STACK_SIZE=2048
CONFIG_NET_MGMT_EVENT_STACK_SIZE=4096
CONFIG_SYSTEM_WORKQUEUE_STACK_SIZE=3100
CONFIG_NRF70_IRQ_WQ_STACK_SIZE=1024
CONFIG_NRF70_BH_WQ_STACK_SIZE=2300
CONFIG_SHELL_STACK_SIZE=4400
CONFIG_ISR_STACK_SIZE=512

# Heap sizes
CONFIG_HEAP_MEM_POOL_IGNORE_MIN=y
CONFIG_MBEDTLS_HEAP_SIZE=65000
CONFIG_HEAP_MEM_POOL_SIZE=32000
CONFIG_NRF_WIFI_CTRL_HEAP_SIZE=20000
CONFIG_NRF_WIFI_DATA_HEAP_SIZE=40000
# POSIX API memory optimizations
CONFIG_POSIX_FD_MGMT=n
CONFIG_POSIX_MESSAGE_PASSING=n
CONFIG_POSIX_THREAD_THREADS_MAX=0

# Floating-point printf support
CONFIG_CBPRINTF_FP_SUPPORT=y
```

## boards/nrf54l15dk_nrf54l15_cpuapp.conf
```kconfig
#
# Copyright (c) 2024 Nordic Semiconductor ASA
#
# SPDX-License-Identifier: LicenseRef-Nordic-5-Clause
#

# Logging
CONFIG_LOG=y
CONFIG_LOG_MODE_IMMEDIATE=y

# Wi-Fi
CONFIG_WIFI=y
CONFIG_WIFI_NRF70=y
CONFIG_WIFI_CREDENTIALS=y
# Needed for Wi-Fi credentials
CONFIG_FLASH=y
CONFIG_FLASH_PAGE_LAYOUT=y
CONFIG_FLASH_MAP=y
CONFIG_ZMS=y
CONFIG_SETTINGS=y

# WPA supplicant
CONFIG_WIFI_NM_WPA_SUPPLICANT=y
CONFIG_WIFI_NM_WPA_SUPPLICANT_LOG_LEVEL_INF=y

# Networking
CONFIG_NET_L2_ETHERNET=y
CONFIG_NET_SOCKETS=y
CONFIG_NET_IPV6=y
CONFIG_NET_UDP=y
CONFIG_NET_TCP=y
CONFIG_NET_DHCPV4=y
CONFIG_DNS_RESOLVER=y
CONFIG_DNS_RESOLVER_AI_MAX_ENTRIES=4

# NET sockets
CONFIG_NET_UDP=y
CONFIG_NET_TCP=y
CONFIG_NET_MAX_CONN=6
CONFIG_NET_MAX_CONTEXTS=5
CONFIG_ZVFS_POLL_MAX=8
CONFIG_NET_SOCKETS_OFFLOAD=n
CONFIG_NET_DHCPV4=y
CONFIG_NET_CONTEXT_SNDTIMEO=y
CONFIG_NET_CONTEXT_RCVTIMEO=y
CONFIG_NET_MAX_CONTEXTS=3

# NET buffers
CONFIG_NET_PKT_TX_COUNT=6
CONFIG_NET_PKT_RX_COUNT=6
CONFIG_NET_BUF_TX_COUNT=12
CONFIG_NET_BUF_RX_COUNT=6
CONFIG_NRF70_RX_NUM_BUFS=6
CONFIG_NET_PKT_BUF_RX_DATA_POOL_SIZE=4096
CONFIG_NET_PKT_BUF_TX_DATA_POOL_SIZE=4096
CONFIG_NRF70_MAX_TX_AGGREGATION=1

# Kernel options
CONFIG_POSIX_NETWORKING=y

# Shell
CONFIG_SHELL=y
CONFIG_SHELL_CMDS_RESIZE=n
CONFIG_NET_L2_WIFI_SHELL=y

# TLS
CONFIG_NET_SOCKETS_SOCKOPT_TLS=y
CONFIG_NET_SOCKETS_TLS_MAX_CONTEXTS=1
CONFIG_MBEDTLS=y
CONFIG_MBEDTLS_ENABLE_HEAP=y
CONFIG_MBEDTLS_SSL_KEEP_PEER_CERTIFICATE=n
CONFIG_MBEDTLS_SSL_SERVER_NAME_INDICATION=y
CONFIG_TLS_CREDENTIALS=y
CONFIG_TLS_CREDENTIALS_BACKEND_VOLATILE=y
CONFIG_MBEDTLS_DECLARE_PRIVATE_IDENTIFIERS=y
# CA certificate provisioned by the sample is PEM-encoded.
CONFIG_MBEDTLS_PEM_PARSE_C=y
CONFIG_MBEDTLS_MD_C=y
CONFIG_MBEDTLS_HMAC_DRBG_C=y
CONFIG_MBEDTLS_SHA256_C=y
CONFIG_MBEDTLS_ECP_C=y
CONFIG_MBEDTLS_CTR_DRBG_C=y
CONFIG_MBEDTLS_AES_C=y
CONFIG_MBEDTLS_ENTROPY_C=y
CONFIG_MBEDTLS_RSA_C=y
CONFIG_PSA_WANT_KEY_TYPE_RSA_KEY_PAIR_IMPORT=y
CONFIG_PSA_WANT_KEY_TYPE_RSA_KEY_PAIR_EXPORT=y
CONFIG_PSA_WANT_KEY_TYPE_RSA_KEY_PAIR_GENERATE=y
# Set MPI (Multiple Precision Integer) size limit to 512 bytes for handling of 4 kb certificates
# in cryptographic operations.
CONFIG_MBEDTLS_MPI_MAX_SIZE=512
# ECDH/ECDSA are needed for TLS handshake
CONFIG_PSA_WANT_ALG_ECDH=y
CONFIG_PSA_WANT_ALG_ECDSA=y

# Zephyr NET Connection Manager Connectivity layer.
CONFIG_L2_WIFI_CONNECTIVITY=y
CONFIG_L2_WIFI_CONNECTIVITY_AUTO_CONNECT=y
CONFIG_L2_WIFI_CONNECTIVITY_AUTO_DOWN=n

# Stack sizes
CONFIG_MAIN_STACK_SIZE=6144
CONFIG_NET_TX_STACK_SIZE=2048
CONFIG_NET_RX_STACK_SIZE=2048
CONFIG_NET_MGMT_EVENT_STACK_SIZE=4096
CONFIG_SYSTEM_WORKQUEUE_STACK_SIZE=3100
CONFIG_NRF70_IRQ_WQ_STACK_SIZE=1024
CONFIG_NRF70_BH_WQ_STACK_SIZE=2300
CONFIG_SHELL_STACK_SIZE=4400
CONFIG_ISR_STACK_SIZE=512

# Heap sizes
CONFIG_HEAP_MEM_POOL_IGNORE_MIN=y
CONFIG_MBEDTLS_HEAP_SIZE=60000
CONFIG_HEAP_MEM_POOL_SIZE=28000
CONFIG_NRF_WIFI_CTRL_HEAP_SIZE=20000
CONFIG_NRF_WIFI_DATA_HEAP_SIZE=40000
# POSIX API memory optimizations
CONFIG_POSIX_FD_MGMT=n
CONFIG_POSIX_MESSAGE_PASSING=n
CONFIG_POSIX_THREAD_THREADS_MAX=0

# Floating-point printf support
CONFIG_CBPRINTF_FP_SUPPORT=y
```

## src/main.c
```c
/*
 * Copyright (c) 2020 Nordic Semiconductor ASA
 *
 * SPDX-License-Identifier: LicenseRef-Nordic-5-Clause
 */

#include <string.h>
#include <stdlib.h>
#include <zephyr/kernel.h>
#include <zephyr/net/socket.h>
#include <zephyr/net/net_if.h>
#include <zephyr/net/conn_mgr_connectivity.h>
#include <zephyr/net/conn_mgr_monitor.h>
#include <net/downloader.h>

#include <zephyr/logging/log.h>
LOG_MODULE_REGISTER(download, LOG_LEVEL_INF);


#if CONFIG_MODEM_KEY_MGMT
#include <modem/modem_key_mgmt.h>
#else
#include <zephyr/net/tls_credentials.h>
#endif

#define URL CONFIG_SAMPLE_FILE_URL
#if defined(CONFIG_SAMPLE_SEC_TAG)
#define SEC_TAG CONFIG_SAMPLE_SEC_TAG
#else
#define SEC_TAG 0
#endif

/* Macro used to subscribe to specific Zephyr NET management events. */
#define CONN_LAYER_EVENT_MASK (NET_EVENT_CONN_IF_FATAL_ERROR)

#define PROGRESS_WIDTH 50
#define STARTING_OFFSET 0
#define RETRY_BACKOFF_INITIAL_MS 1000
#define RETRY_BACKOFF_MAX_MS 30000
#define MAX_ATTEMPTS 8
/* Any IP family, and DNS to resolve the server host name */
#define READY_MASK (CONN_MGR_READY_IP_ANY | CONN_MGR_READY_DNS)

static K_SEM_DEFINE(download_result_sem, 0, 1);
static bool download_succeeded;

static int sec_tag_list[] = { SEC_TAG };
static const char cert[] = {
#if defined(CONFIG_SAMPLE_PROVISION_CERT)
	#include "sample_cert.inc"

	/* Null terminate certificate if running Mbed TLS on the application core.
	 * Required by TLS credentials API.
	 */
	IF_ENABLED(CONFIG_TLS_CREDENTIALS, (0x00))
#else
	0x00
#endif
};
BUILD_ASSERT(sizeof(cert) < KB(4), "Certificate too large");

static const char client_cert[] = {
#if defined(CONFIG_SAMPLE_PROVISION_CLIENT_CERT)
	#include "sample_client_cert.inc"
	IF_ENABLED(CONFIG_TLS_CREDENTIALS, (0x00))
#else
	0x00
#endif
};
BUILD_ASSERT(!IS_ENABLED(CONFIG_SAMPLE_PROVISION_CLIENT_CERT) || sizeof(client_cert) < KB(4),
	     "Client certificate too large");
static const char client_key[] = {
#if defined(CONFIG_SAMPLE_PROVISION_CLIENT_CERT)
	#include "sample_client_key.inc"
	IF_ENABLED(CONFIG_TLS_CREDENTIALS, (0x00))
#else
	0x00
#endif
};
BUILD_ASSERT(!IS_ENABLED(CONFIG_SAMPLE_PROVISION_CLIENT_CERT) || sizeof(client_key) < KB(4),
	     "Client private key too large");

static char dl_buf[2048];

static int callback(const struct downloader_evt *event);

static struct downloader downloader;
static struct downloader_cfg dl_cfg = {
	.callback = callback,
	.buf = dl_buf,
	.buf_size = sizeof(dl_buf),
};
static struct downloader_host_cfg host_dl_cfg = {
	.sec_tag_list = IS_ENABLED(CONFIG_SAMPLE_SECURE_SOCKET) ? sec_tag_list : 0,
	.sec_tag_count = IS_ENABLED(CONFIG_SAMPLE_SECURE_SOCKET) ? ARRAY_SIZE(sec_tag_list) : 0,
	.range_override = 0,
};

#if CONFIG_SAMPLE_COMPUTE_HASH
#include <psa/crypto.h>
static psa_hash_operation_t hash_ctx;

#if defined(CONFIG_SAMPLE_COMPARE_HASH)
BUILD_ASSERT(sizeof(CONFIG_SAMPLE_SHA256_HASH) == 65,
	     "CONFIG_SAMPLE_SHA256_HASH is not set or wrong length");
#else
#define CONFIG_SAMPLE_SHA256_HASH 0
#endif /* CONFIG_SAMPLE_COMPARE_HASH */
#endif

static int64_t ref_time;

static int cert_provision(void)
{
	int err;

	LOG_INF("Provisioning certificate");

#if CONFIG_MODEM_KEY_MGMT
	bool exists;

	err = modem_key_mgmt_exists(SEC_TAG,
				    MODEM_KEY_MGMT_CRED_TYPE_CA_CHAIN,
				    &exists);
	if (err) {
		LOG_ERR("Failed to check for certificates err %d", err);
		return err;
	}

	if (exists) {
		/* Let's compare the existing credential */
		err = modem_key_mgmt_cmp(SEC_TAG,
					 MODEM_KEY_MGMT_CRED_TYPE_CA_CHAIN,
					 cert, sizeof(cert));

		LOG_INF("Certificate %s", err ? "mismatch" : "match");

		if (!err) {
			return 0;
		}
	}

	/*  Provision certificate to the modem */
	err = modem_key_mgmt_write(SEC_TAG,
				   MODEM_KEY_MGMT_CRED_TYPE_CA_CHAIN,
				   cert, sizeof(cert));
	if (err) {
		LOG_ERR("Failed to provision certificate, err %d", err);
		return err;
	}

	/* NB: Client certificate/key provisioning (CONFIG_SAMPLE_PROVISION_CLIENT_CERT) is not
	 * implemented for modem-managed credentials yet.
	 */
#else /* CONFIG_MODEM_KEY_MGMT */
	err = tls_credential_add(SEC_TAG,
				 TLS_CREDENTIAL_CA_CERTIFICATE,
				 cert,
				 sizeof(cert));
	if (err == -EEXIST) {
		LOG_INF("CA certificate already exists, sec tag: %d", SEC_TAG);
	} else if (err < 0) {
		LOG_ERR("Failed to register CA certificate: %d", err);
		return err;
	}

	if (IS_ENABLED(CONFIG_SAMPLE_PROVISION_CLIENT_CERT)) {
		err = tls_credential_add(SEC_TAG,
					 TLS_CREDENTIAL_PUBLIC_CERTIFICATE,
					 client_cert,
					 sizeof(client_cert));
		if (err == -EEXIST) {
			LOG_INF("Client certificate already exists, sec tag: %d", SEC_TAG);
		} else if (err < 0) {
			LOG_ERR("Failed to register client certificate: %d", err);
			return err;
		}

		err = tls_credential_add(SEC_TAG,
					 TLS_CREDENTIAL_PRIVATE_KEY,
					 client_key,
					 sizeof(client_key));
		if (err == -EEXIST) {
			LOG_INF("Client private key already exists, sec tag: %d", SEC_TAG);
		} else if (err < 0) {
			LOG_ERR("Failed to register client private key: %d", err);
			return err;
		}
	}
#endif /* !CONFIG_MODEM_KEY_MGMT */

	return 0;
}

static void connectivity_event_handler(uint64_t event, struct net_if *iface, void *info,
				       size_t info_length, void *user_data)
{
	int err;
	if (event == NET_EVENT_CONN_IF_FATAL_ERROR) {
		LOG_ERR("Fatal error received from the connectivity layer, "
			"rebooting network interface");

		(void)conn_mgr_if_disconnect(iface);
		(void)conn_mgr_all_if_down(true);

		err = conn_mgr_all_if_up(true);
		if (err) {
			LOG_ERR("conn_mgr_all_if_up, error: %d", err);
			return;
		}

		LOG_INF("Reconnecting to network");

		err = conn_mgr_all_if_connect(true);
		if (err) {
			LOG_ERR("conn_mgr_all_if_connect, error: %d", err);
			return;
		}

		return;
	}
}

/* Registered statically to not miss events raised before main() */
NET_MGMT_REGISTER_EVENT_HANDLER(conn_events, CONN_LAYER_EVENT_MASK, connectivity_event_handler,
				NULL);

static int callback(const struct downloader_evt *event)
{
	static size_t downloaded;
	static size_t file_size;
	uint32_t speed;
	int64_t ms_elapsed;
#if CONFIG_SAMPLE_COMPUTE_HASH
	psa_status_t status;
#endif
	if (downloaded == 0) {
		downloader_file_size_get(&downloader, &file_size);
		downloaded += STARTING_OFFSET;
	}

	switch (event->id) {
	case DOWNLOADER_EVT_FRAGMENT:
		downloaded += event->fragment.len;

#if CONFIG_SAMPLE_COMPUTE_HASH
		status = psa_hash_update(&hash_ctx, event->fragment.buf, event->fragment.len);
		if (status != PSA_SUCCESS) {
			LOG_ERR("Error during hash update: %d", status);
			return status;
		}
#endif
		return 0;

	case DOWNLOADER_EVT_DONE:
		ms_elapsed = k_uptime_delta(&ref_time);
		speed = ((float)file_size / ms_elapsed) * MSEC_PER_SEC;
		LOG_INF("Download completed in %lld ms @ %u bytes per sec, total %zu bytes",
			ms_elapsed, speed, downloaded);

#if CONFIG_SAMPLE_COMPUTE_HASH
		uint8_t hash[32];
		char hash_str[64 + 1];
		size_t hash_length;

		status = psa_hash_finish(&hash_ctx, hash, sizeof(hash), &hash_length);
		if (status != PSA_SUCCESS) {
			LOG_ERR("Error during hash finish: %d", status);
			k_sem_give(&download_result_sem);
			return status;
		}

		bin2hex(hash, sizeof(hash), hash_str, sizeof(hash_str));

		LOG_INF("SHA256: %s", hash_str);

		if (IS_ENABLED(CONFIG_SAMPLE_COMPARE_HASH) &&
		    strcmp(hash_str, CONFIG_SAMPLE_SHA256_HASH)) {
			LOG_ERR("Expect: %s", CONFIG_SAMPLE_SHA256_HASH);
			LOG_ERR("SHA256 mismatch!");
		}
#endif /* CONFIG_SAMPLE_COMPUTE_HASH */

		LOG_INF("Done");
		download_succeeded = true;
		k_sem_give(&download_result_sem);
		return 0;

	case DOWNLOADER_EVT_ERROR:
		if (event->error == -ECONNRESET) {
			/* With ECONNRESET, allow library to attempt a reconnect by returning 0 */
		} else {
			LOG_ERR("Error %d during download", event->error);
			/* Stop download */
			return -1;
		}
		break;
	case DOWNLOADER_EVT_STOPPED:
		LOG_WRN("Download canceled");
		downloaded = 0;
		file_size = 0;
		download_succeeded = false;
		k_sem_give(&download_result_sem);
		break;
	case DOWNLOADER_EVT_DEINITIALIZED:
		LOG_INF("Client deinitialized");
		break;
	}

	return 0;
}

int main(void)
{
	int err;

	LOG_INF("Download client sample started");

	err = conn_mgr_all_if_up(true);
	if (err) {
		LOG_ERR("conn_mgr_all_if_up, error: %d", err);
		return err;
	}

	if (IS_ENABLED(CONFIG_SAMPLE_PROVISION_CERT)) {
		/* Provision certificates before connecting to the network */
		err = cert_provision();
		if (err) {
			return 0;
		}
	}
	LOG_INF("Connecting to network");

	err = conn_mgr_all_if_connect(true);
	if (err) {
		LOG_ERR("conn_mgr_all_if_connect, error: %d", err);
		return err;
	}

	LOG_INF("Waiting for network...");
	(void)conn_mgr_wait_ready(READY_MASK, NULL, K_FOREVER);
	LOG_INF("Network ready");

	err = downloader_init(&downloader, &dl_cfg);
	if (err) {
		LOG_ERR("Failed to initialize the client, err %d", err);
		return 0;
	}

	/* Retry the download a few times with an increasing backoff until it completes
	 * successfully, retrying early if the network changes.
	 */
	int32_t retry_backoff_ms = RETRY_BACKOFF_INITIAL_MS;
	int attempt = 0;
	uint32_t last_seen = 0;

	while (attempt < MAX_ATTEMPTS) {
		/* At once the first time, then after the backoff or a network change */
		err = conn_mgr_wait_ready(READY_MASK, &last_seen, K_MSEC(retry_backoff_ms));
		if (err == -EAGAIN) {
			/* The network is not ready. Keep waiting. */
			continue;
		} else if (err != 0) {
			return err;
		}

		attempt++;

#if CONFIG_SAMPLE_COMPUTE_HASH
		psa_status_t status;

		/* Abort any previous (possibly incomplete) operation before starting over. */
		(void)psa_hash_abort(&hash_ctx);

		status = psa_hash_setup(&hash_ctx, PSA_ALG_SHA_256);
		if (status != PSA_SUCCESS) {
			LOG_ERR("psa_hash_setup, error: %d", status);
			break;
		}
#endif

		ref_time = k_uptime_get();

		err = downloader_get(&downloader, &host_dl_cfg, URL, STARTING_OFFSET);
		if (err) {
			LOG_ERR("Failed to start the downloader, err %d", err);
		} else {
			LOG_INF("Downloading %s", URL);

			k_sem_take(&download_result_sem, K_FOREVER);
			if (download_succeeded) {
				break;
			}
		}

		retry_backoff_ms = MIN(retry_backoff_ms * 2, RETRY_BACKOFF_MAX_MS);
	}

	if (!download_succeeded) {
		LOG_ERR("Giving up after %d failed attempts", attempt);
	}

	LOG_INF("Download finished, bringing network interfaces down");
	(void)conn_mgr_all_if_disconnect(true);
	(void)conn_mgr_all_if_down(true);

	return 0;
}
```
