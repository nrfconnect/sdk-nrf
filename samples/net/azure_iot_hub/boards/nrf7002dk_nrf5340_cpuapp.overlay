/*
 * Copyright (c) 2023 Nordic Semiconductor ASA
 *
 * SPDX-License-Identifier: LicenseRef-Nordic-5-Clause
 */

 / {
	/* Configure partition manager to use mx25r64 as the external flash */
	chosen {
		nordic,pm-ext-flash = &mx25r64;
	};
};

&mx25r64 {
	status = "okay";
};
