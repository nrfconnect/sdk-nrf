/*
 * Copyright (c) 2026 Nordic Semiconductor ASA
 *
 * SPDX-License-Identifier: LicenseRef-Nordic-5-Clause
 */

/ {
	/* Configure partition manager to use mx25r64 as the external flash */
	chosen {
		nordic,pm-ext-flash = &mx25r64;
	};
};

&mx25r64 {
	status = "okay";
};

/*
 * Board NS DTS keeps &uart30 disabled for the default TF-M UARTE30 logging case.
 * With CONFIG_TFM_LOG_LEVEL_SILENCE=y TF-M does not use that UART; re-enable UARTE30 for NS.
 */
&uart30 {
	status = "okay";
};
