## samples/net/http_server/sample.yaml
```yaml
sample:
  name: HTTP server sample
tests:
  sample.net.http_server.wifi:
    sysbuild: true
    build_only: true
    integration_platforms:
      - nrf7002dk/nrf5340/cpuapp/ns
    platform_allow:
      - nrf7002dk/nrf5340/cpuapp/ns
    tags:
      - ci_build
      - sysbuild
      - ci_samples_net
    extra_args:
      - http_server_EXTRA_CONF_FILE="wifi.conf;nrf70.conf"
  # nRF7120 uses the integrated nRF71 driver; its tuning lives in the board conf.
  sample.net.http_server.nrf7120.wifi:
    sysbuild: true
    build_only: true
    integration_platforms:
      - nrf7120dk/nrf7120/cpuapp/ns
    platform_allow:
      - nrf7120dk/nrf7120/cpuapp/ns
    tags:
      - ci_build
      - sysbuild
      - ci_samples_net
    extra_args:
      - http_server_EXTRA_CONF_FILE=wifi.conf
  sample.net.http_server.wifi.tls:
    sysbuild: true
    build_only: true
    integration_platforms:
      - nrf7002dk/nrf5340/cpuapp/ns
    platform_allow:
      - nrf7002dk/nrf5340/cpuapp/ns
    extra_args: http_server_EXTRA_CONF_FILE="wifi.conf;wifi-tls.conf;nrf70.conf"
    tags:
      - ci_build
      - sysbuild
      - ci_samples_net
  # nRF7120 uses the integrated nRF71 driver; its tuning lives in the board conf.
  sample.net.http_server.nrf7120.wifi.tls:
    sysbuild: true
    build_only: true
    integration_platforms:
      - nrf7120dk/nrf7120/cpuapp/ns
    platform_allow:
      - nrf7120dk/nrf7120/cpuapp/ns
    extra_args: http_server_EXTRA_CONF_FILE="wifi.conf;wifi-tls.conf"
    tags:
      - ci_build
      - sysbuild
      - ci_samples_net
  sample.net.http_server.lte:
    sysbuild: true
    build_only: true
    integration_platforms:
      - nrf9151dk/nrf9151/ns
      - nrf9160dk/nrf9160/ns
    platform_allow:
      - nrf9161dk/nrf9161/ns
      - nrf9151dk/nrf9151/ns
      - nrf9160dk/nrf9160/ns
    tags:
      - ci_build
      - sysbuild
      - ci_samples_net
  sample.net.http_server.lte.tls:
    sysbuild: true
    build_only: true
    integration_platforms:
      - nrf9151dk/nrf9151/ns
      - nrf9160dk/nrf9160/ns
    platform_allow:
      - nrf9161dk/nrf9161/ns
      - nrf9151dk/nrf9151/ns
      - nrf9160dk/nrf9160/ns
    extra_args: EXTRA_CONF_FILE=overlay-tls-nrf91.conf
    tags:
      - ci_build
      - sysbuild
      - ci_samples_net
  sample.net.http_server.emulation:
    build_only: true
    integration_platforms:
      - native_sim
    platform_allow:
      - native_sim
    tags:
      - ci_build
      - ci_samples_net
  sample.net.http_server.nrf54h20.wifi:
    sysbuild: true
    build_only: true
    integration_platforms:
      - nrf54h20dk/nrf54h20/cpuapp
    platform_allow:
      - nrf54h20dk/nrf54h20/cpuapp
    tags:
      - ci_build
      - sysbuild
      - ci_samples_net
    extra_args:
      - http_server_SHIELD="nrf7002eb_interposer_p1;nrf7002eb"
      - http_server_SNIPPET="nrf70-wifi;wifi-credentials"
      - http_server_EXTRA_CONF_FILE="wifi.conf;nrf70.conf"
  sample.net.http_server.nrf54lm20_nrf7002eb2.wifi:
    sysbuild: true
    build_only: true
    integration_platforms:
      - nrf54lm20dk/nrf54lm20a/cpuapp
      - nrf54lm20dk/nrf54lm20b/cpuapp
    platform_allow:
      - nrf54lm20dk/nrf54lm20a/cpuapp
      - nrf54lm20dk/nrf54lm20b/cpuapp
    tags:
      - ci_build
      - sysbuild
      - ci_samples_net
    extra_args:
      - http_server_SHIELD="nrf7002eb2"
      - http_server_SNIPPET=wifi-credentials
      - http_server_EXTRA_CONF_FILE="wifi.conf;nrf70.conf"
```

## samples/net/https_client/Kconfig
```kconfig
#
# Copyright (c) 2021 Nordic Semiconductor ASA
#
# SPDX-License-Identifier: LicenseRef-Nordic-5-Clause
#

menu "HTTPS client sample"

config SAMPLE_TFM_MBEDTLS
	bool "Use TF-M and MbedTLS"
	depends on NRF_MODEM_LIB
	help
	  Use TF-M and MbedTLS in this sample instead of using
	  the offloaded TLS stack in the modem.

config HTTPS_HOSTNAME
	string "HTTPS hostname"
	default "example.com"

endmenu

# Default the TLS credentials backend by build type: NS builds use Protected
# Storage, secure-only builds fall back to the volatile backend. nRF91 keeps
# its own NRF_MODEM backend default.
choice TLS_CREDENTIALS_BACKEND
	default TLS_CREDENTIALS_BACKEND_PROTECTED_STORAGE if BUILD_WITH_TFM && !NRF_MODEM_LIB
endchoice

menu "Zephyr Kernel"
source "Kconfig.zephyr"
endmenu
```

## samples/net/https_client/boards/native_sim.conf
```kconfig
#
# Copyright (c) 2024 Nordic Semiconductor ASA
#
# SPDX-License-Identifier: LicenseRef-Nordic-5-Clause
#

# Networking config
CONFIG_NETWORKING=y
CONFIG_NET_CONFIG_SETTINGS=y
CONFIG_NET_CONNECTION_MANAGER=y
CONFIG_NET_IPV4=y
CONFIG_NET_IPV6=y
CONFIG_NET_TCP=y
CONFIG_NET_UDP=y
CONFIG_NET_SOCKETS=y
CONFIG_POSIX_API=y

# TLS networking
CONFIG_NET_SOCKETS_ENABLE_DTLS=n
CONFIG_NET_SOCKETS_TLS_MAX_CONTEXTS=2
CONFIG_NET_SOCKETS_SOCKOPT_TLS=y

# TLS configuration
CONFIG_MBEDTLS=y
CONFIG_MBEDTLS_BUILTIN=y
CONFIG_MBEDTLS_ENABLE_HEAP=y
CONFIG_MBEDTLS_HEAP_SIZE=40000
CONFIG_MBEDTLS_SSL_MAX_CONTENT_LEN=7168
CONFIG_MBEDTLS_PEM_CERTIFICATE_FORMAT=y
CONFIG_MBEDTLS_KEY_EXCHANGE_RSA_ENABLED=y
CONFIG_MBEDTLS_MAC_SHA256_ENABLED=y

# DNS
CONFIG_DNS_RESOLVER=y
CONFIG_DNS_SERVER_IP_ADDRESSES=y
CONFIG_DNS_RESOLVER_MAX_SERVERS=2
CONFIG_DNS_SERVER1="8.8.8.8"
```

## samples/net/https_client/boards/nrf7002dk_nrf5340_cpuapp.conf
```kconfig
#
# Copyright (c) 2023 Nordic Semiconductor ASA
#
# SPDX-License-Identifier: LicenseRef-Nordic-5-Clause
#

# General
CONFIG_POSIX_CLOCK=y

# Heap and stacks
CONFIG_SYSTEM_WORKQUEUE_STACK_SIZE=4096
CONFIG_HEAP_MEM_POOL_SIZE=153600
CONFIG_NET_RX_STACK_SIZE=2048

# Wi-Fi
CONFIG_WIFI=y
CONFIG_WIFI_NRF700X=y
CONFIG_WIFI_NRF700X_LOG_LEVEL_ERR=y
CONFIG_WIFI_MGMT_EXT=y
CONFIG_WIFI_CREDENTIALS=y
CONFIG_WIFI_CREDENTIALS_BACKEND_SETTINGS=y
CONFIG_WIFI_CREDENTIALS_STATIC=y
CONFIG_FLASH=y
CONFIG_FLASH_PAGE_LAYOUT=y
CONFIG_FLASH_MAP=y
CONFIG_NVS=y
CONFIG_SETTINGS=y
CONFIG_SETTINGS_NVS=y

# Wi-Fi credentials
CONFIG_WIFI_CREDENTIALS_STATIC_SSID=""
CONFIG_WIFI_CREDENTIALS_STATIC_PASSWORD=""

# WPA supplicant
CONFIG_WPA_SUPP=y
CONFIG_WPA_SUPP_LOG_LEVEL_ERR=y

# Zephyr NET Connection Manager connectivity layer
CONFIG_L2_WIFI_CONNECTIVITY=y
CONFIG_L2_WIFI_CONNECTIVITY_AUTO_DOWN=n
CONFIG_L2_WIFI_CONNECTIVITY_AUTO_CONNECT=n

# DNS
CONFIG_DNS_RESOLVER=y

# NET sockets
CONFIG_NET_NATIVE=y
CONFIG_NET_L2_ETHERNET=y
CONFIG_NET_TCP=y
CONFIG_NET_TCP_WORKQ_STACK_SIZE=2048
CONFIG_NET_UDP=y
CONFIG_NET_SOCKETS_OFFLOAD=n
CONFIG_NET_DHCPV4=y
CONFIG_NET_CONTEXT_SNDTIMEO=y

# TLS networking
CONFIG_NET_SOCKETS_ENABLE_DTLS=n
CONFIG_NET_SOCKETS_TLS_MAX_CONTEXTS=2
CONFIG_NET_SOCKETS_SOCKOPT_TLS=y

# nRF Security
CONFIG_NRF_SECURITY=y
CONFIG_PSA_CRYPTO_DRIVER_OBERON=n
CONFIG_CC3XX_BACKEND=y

# mbedTLS
CONFIG_MBEDTLS=y
CONFIG_MBEDTLS_ENABLE_HEAP=y
CONFIG_MBEDTLS_HEAP_SIZE=120000
CONFIG_MBEDTLS_RSA_C=y
CONFIG_MBEDTLS_TLS_LIBRARY=y
```

## samples/net/https_client/boards/nrf7002dk_nrf5340_cpuapp_ns.conf
```kconfig
#
# Copyright (c) 2023 Nordic Semiconductor ASA
#
# SPDX-License-Identifier: LicenseRef-Nordic-5-Clause
#

# General
CONFIG_POSIX_CLOCK=y
CONFIG_SYSTEM_WORKQUEUE_STACK_SIZE=4096
CONFIG_HEAP_MEM_POOL_SIZE=81920
CONFIG_NET_RX_STACK_SIZE=2048

# Optimize Wi-Fi stack to save some memory
CONFIG_NRF700X_RX_NUM_BUFS=16
CONFIG_NRF700X_MAX_TX_AGGREGATION=4

# Wi-Fi
CONFIG_WIFI=y
CONFIG_WIFI_NRF700X=y
CONFIG_WIFI_NRF700X_LOG_LEVEL_ERR=y
CONFIG_WIFI_MGMT_EXT=y
CONFIG_WIFI_CREDENTIALS=y

# Shell
CONFIG_SHELL=y
CONFIG_SHELL_STACK_SIZE=6144

# WPA supplicant
CONFIG_WPA_SUPP=y
CONFIG_WPA_SUPP_LOG_LEVEL_ERR=y

# Zephyr NET Connection Manager connectivity layer
CONFIG_L2_WIFI_CONNECTIVITY=y
CONFIG_L2_WIFI_CONNECTIVITY_AUTO_DOWN=n
CONFIG_L2_WIFI_CONNECTIVITY_AUTO_CONNECT=n

# DNS
CONFIG_DNS_RESOLVER=y

# NET sockets
CONFIG_NET_NATIVE=y
CONFIG_NET_L2_ETHERNET=y
CONFIG_NET_TCP=y
CONFIG_NET_TCP_WORKQ_STACK_SIZE=2048
CONFIG_NET_UDP=y
CONFIG_NET_SOCKETS_OFFLOAD=n
CONFIG_NET_DHCPV4=y
CONFIG_NET_CONTEXT_SNDTIMEO=y

# TLS networking
CONFIG_NET_SOCKETS_ENABLE_DTLS=n
CONFIG_NET_SOCKETS_TLS_MAX_CONTEXTS=2
CONFIG_NET_SOCKETS_SOCKOPT_TLS=y

# TLS credentials
CONFIG_TLS_CREDENTIALS_BACKEND_PROTECTED_STORAGE=y

# mbedTLS
CONFIG_NRF_SECURITY=y
CONFIG_MBEDTLS=y
CONFIG_MBEDTLS_ENABLE_HEAP=y
CONFIG_MBEDTLS_HEAP_SIZE=81920
CONFIG_MBEDTLS_RSA_C=y
CONFIG_MBEDTLS_TLS_LIBRARY=y

# Optimize T-FM
CONFIG_TFM_PROFILE_TYPE_SMALL=y
CONFIG_PM_PARTITION_SIZE_TFM_SRAM=0xc000
CONFIG_PM_PARTITION_SIZE_TFM=0x20000
```

## samples/net/https_client/boards/nrf7120dk_nrf7120_cpuapp_ns.conf
```kconfig
#
# Copyright (c) 2026 Nordic Semiconductor ASA
#
# SPDX-License-Identifier: LicenseRef-Nordic-5-Clause
#

# MM_IOVEC is not compatible with TFM_ITS_ENCRYPTED
CONFIG_TFM_PSA_FRAMEWORK_HAS_MM_IOVEC=n
# Necessary for TLS with MM-less IOVEC.
# 36864 = 2 * MBEDTLS_SSL_MAX_CONTENT_LEN (16384) + overhead
CONFIG_TFM_CRYPTO_IOVEC_BUFFER_SIZE=36864

# nRF71 (nrf7120 integrated) Wi-Fi driver tuning.
CONFIG_NRF71_RX_NUM_BUFS=16
CONFIG_NRF71_MAX_TX_AGGREGATION=4
CONFIG_NRF71_BH_WQ_STACK_SIZE=2300
```

## samples/net/https_client/boards/nrf9161dk_nrf9161_ns.conf
```kconfig
#
# Copyright (c) 2023 Nordic Semiconductor ASA
#
# SPDX-License-Identifier: LicenseRef-Nordic-5-Clause
#

# Heap and stacks
CONFIG_HEAP_MEM_POOL_SIZE=4096
CONFIG_MAIN_STACK_SIZE=4096
CONFIG_SYSTEM_WORKQUEUE_STACK_SIZE=4096

# LED control
CONFIG_DK_LIBRARY=y

# Disable Duplicate Address Detection (DAD)
# due to not being properly implemented for offloaded interfaces.
CONFIG_NET_IPV6_NBR_CACHE=n
CONFIG_NET_IPV6_MLD=n

# Connection Manager and Connectivity layer
CONFIG_LTE_CONNECTIVITY=y
# Has to be disabled in order to write certificates
CONFIG_LTE_CONNECTIVITY_AUTO_CONNECT=n
CONFIG_NRF_MODEM_LIB_ON_FAULT_APPLICATION_SPECIFIC=y

# Turn off automatic behavior to give more control to the application
CONFIG_NRF_MODEM_LIB_NET_IF_AUTO_START=n
CONFIG_LTE_CONNECTIVITY_AUTO_DOWN=n

# AT Host
CONFIG_UART_INTERRUPT_DRIVEN=y
CONFIG_AT_HOST_LIBRARY=y

# Modem key management
CONFIG_MODEM_KEY_MGMT=y
```

## samples/net/https_client/sample.yaml
```yaml
sample:
  name: HTTPS client sample
tests:
  sample.net.https_client:
    sysbuild: true
    build_only: true
    integration_platforms:
      - nrf9160dk/nrf9160/ns
      - nrf9161dk/nrf9161/ns
      - nrf9151dk/nrf9151/ns
      - nrf7002dk/nrf5340/cpuapp/ns
      - native_sim
    platform_allow:
      - nrf9160dk/nrf9160/ns
      - nrf9161dk/nrf9161/ns
      - nrf9151dk/nrf9151/ns
      - nrf7002dk/nrf5340/cpuapp/ns
      - native_sim
    tags: ci_build sysbuild ci_samples_net
  sample.net.https_client.lte.tfm-mbedtls:
    sysbuild: true
    build_only: true
    extra_args: OVERLAY_CONFIG="overlay-tfm-nrf91.conf"
    integration_platforms:
      - nrf9160dk/nrf9160/ns
      - nrf9161dk/nrf9161/ns
    platform_allow:
      - nrf9160dk/nrf9160/ns
      - nrf9161dk/nrf9161/ns
      - nrf9151dk/nrf9151/ns
    tags: ci_build sysbuild ci_samples_net
  sample.net.https_client.lte.pdn-ipv4:
    sysbuild: true
    build_only: true
    extra_args: OVERLAY_CONFIG="overlay-pdn-nrf91-ipv4.conf"
    integration_platforms:
      - nrf9160dk/nrf9160/ns
      - nrf9161dk/nrf9161/ns
      - nrf9151dk/nrf9151/ns
    platform_allow:
      - nrf9160dk/nrf9160/ns
      - nrf9161dk/nrf9161/ns
      - nrf9151dk/nrf9151/ns
    tags: ci_build sysbuild ci_samples_net
  sample.net.https_client.nrf54l15.wifi:
    sysbuild: true
    build_only: true
    integration_platforms:
      - nrf54l15dk/nrf54l15/cpuapp
    platform_allow:
      - nrf54l15dk/nrf54l15/cpuapp
    tags: ci_build sysbuild ci_samples_net
    extra_args: https_client_SHIELD="nrf7002eb_interposer_p1;nrf7002eb"
```

## samples/net/mqtt/Kconfig
```kconfig
#
# Copyright (c) 2023 Nordic Semiconductor ASA
#
# SPDX-License-Identifier: LicenseRef-Nordic-5-Clause
#

menu "MQTT sample"

config MQTT_SAMPLE_PAYLOAD_CHANNEL_STRING_MAX_SIZE
	int "Payload maximum string size"
	default 100
	help
	  Maximum size of the string included messages that are sent over the payload channel.

rsource "src/modules/trigger/Kconfig.trigger"
rsource "src/modules/sampler/Kconfig.sampler"
rsource "src/modules/network/Kconfig.network"
rsource "src/modules/transport/Kconfig.transport"
rsource "src/modules/error/Kconfig.error"
rsource "src/modules/led/Kconfig.led"

endmenu

# Default the TLS credentials backend by build type: NS builds use Protected
# Storage, secure-only builds fall back to the volatile backend. nRF91 keeps
# its own NRF_MODEM backend default.
choice TLS_CREDENTIALS_BACKEND
	default TLS_CREDENTIALS_BACKEND_PROTECTED_STORAGE if BUILD_WITH_TFM && !NRF_MODEM_LIB
endchoice

menu "Zephyr Kernel"
source "Kconfig.zephyr"
endmenu
```

## samples/net/mqtt/Kconfig.sysbuild
```kconfig
#
# Copyright (c) 2024 Nordic Semiconductor ASA
#
# SPDX-License-Identifier: LicenseRef-Nordic-5-Clause
#

config WIFI_NRF70
	default y if BOARD_NRF7002DK_NRF5340_CPUAPP_NS || \
		BOARD_NRF54L15DK_NRF54L15_CPUAPP || \
		BOARD_NRF54H20DK_NRF54H20_CPUAPP || \
		BOARD_NRF7002DK_NRF5340_CPUAPP || \
		BOARD_NRF5340DK_NRF5340_CPUAPP_NS || \
		BOARD_NRF54LM20DK_NRF54LM20A_CPUAPP || \
		BOARD_NRF54LM20DK_NRF54LM20B_CPUAPP

config PARTITION_MANAGER
	default n if !BOARD_NRF9160DK_NRF9160_NS && \
		!BOARD_NRF9161DK_NRF9161_NS && \
		!BOARD_NRF9151DK_NRF9151_NS && \
		!BOARD_THINGY91_NRF9160_NS && \
		!BOARD_THINGY91X_NRF9151_NS

source "share/sysbuild/Kconfig"
```
