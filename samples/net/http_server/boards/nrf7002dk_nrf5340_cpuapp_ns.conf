## samples/nfc/writable_ndef_msg/Kconfig
```kconfig
#
# Copyright (c) 2025 Nordic Semiconductor
#
# SPDX-License-Identifier: LicenseRef-Nordic-5-Clause
#

source "Kconfig.zephyr"

config NDEF_FILE_STORAGE_RAM
	bool "Keep NDEF file in RAM only (no flash persistence)"
	default y if RISCV_CORE_NORDIC_VPR
	help
	  Nordic VPR cores (for example nRF9251 CPUPPR/CPUFLPR) cannot use the MRAM
	  flash driver (see SOC_FLASH_NRF_MRAM). Enable this to store the NDEF
	  file in RAM, which is lost on reset.

config ZMS
	select CRC
	default y if (SOC_FLASH_NRF_RRAM || SOC_FLASH_NRF_MRAM) && !NDEF_FILE_STORAGE_RAM

config NVS
	default y if !(SOC_FLASH_NRF_RRAM || SOC_FLASH_NRF_MRAM) && !NDEF_FILE_STORAGE_RAM
```

## samples/nfc/writable_ndef_msg/Kconfig.sysbuild
```kconfig
#
# Copyright (c) 2026 Nordic Semiconductor ASA
#
# SPDX-License-Identifier: LicenseRef-Nordic-5-Clause
#

choice NETCORE
	default NETCORE_EMPTY

endchoice

if SUPPORT_PPRCORE

choice PPRCORE
	default PPRCORE_REMOTE

config PPRCORE_REMOTE
	bool "Remote image (NFC sample on CPUPPR)"

endchoice

config PPRCORE_IMAGE_NAME
	default "remote_ppr" if PPRCORE_REMOTE

config PPRCORE_IMAGE_PATH
	default "$(APP_DIR)/remote" if PPRCORE_REMOTE

endif # SUPPORT_PPRCORE

source "share/sysbuild/Kconfig"
```

## samples/nfc/writable_ndef_msg/boards/nrf9251dk_nrf9251_cpuapp.conf
```kconfig
#
# Copyright (c) 2026 Nordic Semiconductor ASA
#
# SPDX-License-Identifier: LicenseRef-Nordic-5-Clause
#

# Disable NFC low latency IRQ
CONFIG_NFC_LOW_LATENCY_IRQ=n

# Application core stays idle
CONFIG_PM=y
CONFIG_PM_DEVICE=y
CONFIG_PM_DEVICE_RUNTIME=y
CONFIG_POWEROFF=y

CONFIG_NFC_T4T_NRFXLIB=n
CONFIG_NFC_NDEF=n
CONFIG_NFC_NDEF_MSG=n
CONFIG_NFC_NDEF_RECORD=n
CONFIG_NFC_NDEF_URI_REC=n
CONFIG_NFC_NDEF_URI_MSG=n

CONFIG_DK_LIBRARY=n
CONFIG_FLASH=n
CONFIG_FLASH_PAGE_LAYOUT=n
CONFIG_MPU_ALLOW_FLASH_WRITE=n

CONFIG_SERIAL=n
CONFIG_CONSOLE=n
CONFIG_UART_CONSOLE=n
CONFIG_PRINTK=n
CONFIG_LOG=n
CONFIG_BOOT_BANNER=n
CONFIG_NCS_BOOT_BANNER=n
```

## samples/nfc/writable_ndef_msg/boards/nrf9251dk_nrf9251_cpuflpr.conf
```kconfig
#
# Copyright (c) 2026 Nordic Semiconductor ASA
#
# SPDX-License-Identifier: LicenseRef-Nordic-5-Clause
#

# Disable NFC low latency IRQ
CONFIG_NFC_LOW_LATENCY_IRQ=n

CONFIG_DK_LIBRARY=n

CONFIG_FLASH=n
CONFIG_FLASH_PAGE_LAYOUT=n
CONFIG_MPU_ALLOW_FLASH_WRITE=n

CONFIG_REBOOT=n
CONFIG_ASSERT=n
```

## samples/nrf5340/netboot/sample.yaml
```yaml
sample:
  name: Network core bootloader sample
  description: Network core bootloader sample for nRF5340
tests:
  sample.nrf5340.netboot:
    sysbuild: true
    build_only: true
    integration_platforms:
      - nrf5340dk/nrf5340/cpunet
    platform_allow:
      - nrf5340dk/nrf5340/cpunet
    # These used to live in prj.conf, but minimal-size.conf sets CONFIG_LOG=n,
    # so they were only ever effective in this scenario.
    extra_configs:
      - CONFIG_SECURE_BOOT_VALIDATION_LOG_LEVEL_INF=y
      - CONFIG_LOG_MODE_MINIMAL=y
      - CONFIG_LOG_DEFAULT_LEVEL=0
    extra_args:
      - DTC_OVERLAY_FILE="test.overlay"
    tags:
      - ci_build
      - sysbuild
      - ci_samples_nrf5340
  sample.nrf5340.netboot.minimal_size:
    sysbuild: true
    build_only: true
    extra_args:
      - DTC_OVERLAY_FILE="test.overlay"
      - EXTRA_CONF_FILE="minimal-size.conf"
    integration_platforms:
      - nrf5340dk/nrf5340/cpunet
    platform_allow:
      - nrf5340dk/nrf5340/cpunet
    tags:
      - ci_build
      - sysbuild
      - ci_samples_nrf5340
```

## samples/nrf93m1dk/modem_bypass/Kconfig.sysbuild
```kconfig
#
# Copyright (c) 2026 Nordic Semiconductor
#
# SPDX-License-Identifier: LicenseRef-Nordic-5-Clause
#

#
# Support building a modem_bypass combined with
# radio_test application for nRF93M1 DK
#

if BOARD_NRF93M1DK_NRF54L15_CPUFLPR

config SUPPORT_APPCORE
	default y

choice APPCORE
	default APPCORE_RADIO_TEST

config APPCORE_RADIO_TEST
	bool "Radio test application"
	depends on !VPR_LAUNCHER
	help
	  Build the radio_test application for the application core.

endchoice

config APPCORE_IMAGE_NAME
	default "radio_test" if APPCORE_RADIO_TEST

config APPCORE_IMAGE_PATH
	default "${ZEPHYR_NRF_MODULE_DIR}/samples/peripheral/radio_test" if APPCORE_RADIO_TEST

endif # BOARD_NRF93M1DK_NRF54L15_CPUFLPR

source "share/sysbuild/Kconfig"
```

## samples/nrf93m1dk/modem_bypass/boards/nrf93m1dk_nrf54l15_cpuflpr.conf
```kconfig
# Copyright (c) 2026 Nordic Semiconductor ASA
#
# SPDX-License-Identifier: LicenseRef-Nordic-5-Clause
#

CONFIG_TIMEOUT_64BIT=y
CONFIG_POWER_DOMAIN=y
CONFIG_PM_DEVICE_POWER_DOMAIN=y
CONFIG_GPIO=y
CONFIG_APPLICATION_INIT_PRIORITY=93
CONFIG_SERIAL=n
CONFIG_UART_CONSOLE=n
```

## samples/nrf_audio_eb/Kconfig
```kconfig
#
# Copyright (c) 2024 Nordic Semiconductor ASA
#
# SPDX-License-Identifier: LicenseRef-Nordic-5-Clause
#

menu "Logging"

module = NRF_AUDIO_EB
module-str = nrf-audio-eb
source "subsys/logging/Kconfig.template.log_config"

endmenu # Log levels

source "Kconfig.zephyr"
```

## samples/nrf_audio_eb/sample.yaml
```yaml
sample:
  name: nRF-Audio-EB smoke test
  description: >
    Bring-up test for the nRF-Audio-EB shield: RGB LED, line-in detect,
    TAC5112 codec probe, SD card, PDM microphone and the I2S/TDM audio port.
tests:
  sample.nrf_audio_eb.smoke:
    build_only: true
    tags: shield audio
    extra_args:
      - SHIELD=nrf_audio_eb
    platform_allow:
      - nrf54lm20dk/nrf54lm20/cpuapp
      - nrf5340_audio_dk/nrf5340/cpuapp
      - nrf5340dk/nrf5340/cpuapp
    integration_platforms:
      - nrf54lm20dk/nrf54lm20/cpuapp
```

## samples/openthread/cli/Kconfig
```kconfig
#
# Copyright (c) 2020 Nordic Semiconductor ASA
#
# SPDX-License-Identifier: LicenseRef-Nordic-5-Clause
#

# Set product string for USB device
config CDC_ACM_SERIAL_PRODUCT_STRING
	default "Thread CLI"
	depends on USB_DEVICE_STACK_NEXT

menu "Zephyr Kernel"
source "Kconfig.zephyr"
endmenu

module = OT_COMMAND_LINE_INTERFACE
module-str = ot_cli
source "$(ZEPHYR_BASE)/subsys/logging/Kconfig.template.log_config"

config CLI_SAMPLE_LOW_POWER
	bool "Low power mode for the CLI sample"

config CLI_SAMPLE_LOW_POWER_KEEP_CONSOLE_ALIVE
	bool "Keep console while using low power mode"
	depends on CLI_SAMPLE_LOW_POWER
	help
	  This debug configuration keeps the console active when a CLI device connects to
	  a Thread network. If disabled, the console automatically turns off when a device
	  in SED or SSED mode joins the network.

config CLI_SAMPLE_MULTIPROTOCOL
	bool "Multiprotocol for the CLI sample"
```

## samples/openthread/coprocessor/boards/nrf52833dk_nrf52833.conf
```kconfig
#
# Copyright (c) 2026 Nordic Semiconductor
#
# SPDX-License-Identifier: LicenseRef-Nordic-5-Clause
#

CONFIG_SYSTEM_WORKQUEUE_STACK_SIZE=400
```

## samples/peripheral/radio_test/Kconfig.sysbuild
```kconfig
#
# Copyright (c) 2023 Nordic Semiconductor ASA
#
# SPDX-License-Identifier: LicenseRef-Nordic-5-Clause
#

if SOC_NRF5340_CPUNET

choice APPCORE
	default APPCORE_NONE if BOARD_NRF7002DK
	default APPCORE_REMOTE_SHELL

config APPCORE_REMOTE_SHELL
	bool "remote_shell image"

endchoice

config APPCORE_IMAGE_NAME
	default "remote_shell" if APPCORE_REMOTE_SHELL

config APPCORE_IMAGE_PATH
	default "$(ZEPHYR_NRF_MODULE_DIR)/samples/nrf5340/remote_shell" if APPCORE_REMOTE_SHELL

endif # SOC_NRF5340_CPUNET

source "share/sysbuild/Kconfig"
```

## samples/peripheral/vpr_offloading/Kconfig.sysbuild
```kconfig
#
# Copyright (c) 2026 Nordic Semiconductor ASA
#
# SPDX-License-Identifier: LicenseRef-Nordic-5-Clause
#

choice NETCORE
	default NETCORE_EMPTY

endchoice

if SUPPORT_PPRCORE

choice PPRCORE
	default PPRCORE_REMOTE

config PPRCORE_REMOTE
	bool "remote image"

endchoice

config PPRCORE_IMAGE_NAME
	default "remote" if PPRCORE_REMOTE

config PPRCORE_IMAGE_PATH
	default "$(APP_DIR)/remote" if PPRCORE_REMOTE

endif # SUPPORT_PPRCORE

if SUPPORT_FLPRCORE && !SUPPORT_PPRCORE

choice FLPRCORE
	default FLPRCORE_REMOTE

config FLPRCORE_REMOTE
	bool "remote image"

endchoice

config FLPRCORE_IMAGE_NAME
	default "remote" if FLPRCORE_REMOTE

config FLPRCORE_IMAGE_PATH
	default "$(APP_DIR)/remote" if FLPRCORE_REMOTE

endif # SUPPORT_FLPRCORE && !SUPPORT_PPRCORE

source "share/sysbuild/Kconfig"
```

## samples/subsys/rtfw/hid/Kconfig
```kconfig
#
# Copyright (c) 2026 Nordic Semiconductor
#
# SPDX-License-Identifier: LicenseRef-Nordic-5-Clause
#

mainmenu "RTFW HID/GPIOTE backend"

config SAMPLE_RTFW_IRQ_PRIORITY
	int "GPIOTE zero-latency IRQ priority"
	default 1 if SOC_SERIES_NRF54L
	default 0
	range 0 7
	help
	  Select the priority of the sample-owned GPIOTE source interrupt.
	  nRF54L uses priority 1 so MPSL priority 0 can preempt it, while
	  nRF54H20 uses priority 0 because the radio runs on another core.

config SAMPLE_RTFW_ISR_TEST_LOAD
	bool "Inject a controlled busy loop into the GPIOTE fast path"
	help
	  Add a bounded NOP loop to the source ISR for stress and
	  coexistence measurements. The configured iteration count is
	  executed after the registered fast-path callback. Keep this
	  option disabled for baseline latency measurements.

config SAMPLE_RTFW_ISR_TEST_LOAD_CYCLES
	int "NOP iterations in the injected ISR load"
	depends on SAMPLE_RTFW_ISR_TEST_LOAD
	default 100
	range 1 1000000

config SAMPLE_RTFW_DEBUG_PIN
	bool "Expose GPIOTE ISR execution time on a debug pin"
	help
	  Drive the board-specific debug pin while the direct source ISR
	  executes so its latency and duration can be measured with a
	  logic analyzer. The output includes framework command handling
	  and the registered sample fast-path callback.

source "Kconfig.zephyr"
```

## samples/subsys/rtfw/hid/sample.yaml
```yaml
sample:
  description: Event-driven RTFW GPIOTE input with Bluetooth HIDS delivery
  name: RTFW HID

tests:
  sample.rtfw.hid.nrf54l:
    build_only: true
    platform_allow:
      - nrf54lm20dk/nrf54lm20b/cpuapp
    integration_platforms:
      - nrf54lm20dk/nrf54lm20b/cpuapp
    tags:
      - bluetooth
      - rtfw

  sample.rtfw.hid.nrf54l.instrumentation:
    build_only: true
    platform_allow:
      - nrf54lm20dk/nrf54lm20b/cpuapp
    extra_configs:
      - CONFIG_SAMPLE_RTFW_DEBUG_PIN=y
      - CONFIG_SAMPLE_RTFW_ISR_TEST_LOAD=y
    tags:
      - bluetooth
      - rtfw

  sample.rtfw.hid.nrf54h20:
    sysbuild: true
    build_only: true
    platform_allow:
      - nrf54h20dk/nrf54h20/cpuapp
    integration_platforms:
      - nrf54h20dk/nrf54h20/cpuapp
    tags:
      - bluetooth
      - rtfw

  sample.rtfw.hid.nrf54h20.instrumentation:
    sysbuild: true
    build_only: true
    platform_allow:
      - nrf54h20dk/nrf54h20/cpuapp
    extra_configs:
      - CONFIG_SAMPLE_RTFW_DEBUG_PIN=y
      - CONFIG_SAMPLE_RTFW_ISR_TEST_LOAD=y
    tags:
      - bluetooth
      - rtfw
```

## samples/subsys/rtfw/timer_gpio/Kconfig
```kconfig
#
# Copyright (c) 2026 Nordic Semiconductor
#
# SPDX-License-Identifier: LicenseRef-Nordic-5-Clause
#

mainmenu "RTFW timer/GPIO backend"

config SAMPLE_RTFW_IRQ_PRIORITY
	int "TIMER zero-latency IRQ priority"
	default 1 if SOC_SERIES_NRF54L
	default 0
	range 0 7
	help
	  Select the priority of the sample-owned TIMER source interrupt.
	  nRF54L uses priority 1 so MPSL priority 0 can preempt it, while
	  nRF54H20 uses priority 0 because the radio runs on another core.

config SAMPLE_RTFW_TIMER_MIN_PERIOD_US
	int "Minimum accepted timer period (us)"
	default 10
	range 2 2147483647
	help
	  Set the shortest period accepted by the sample API. The TIMER runs at
	  1 MHz and requires at least two counter ticks. Values below this
	  limit are rejected instead of being silently rounded by the
	  zero-latency command handler.

config SAMPLE_RTFW_TIMER_MAX_PERIOD_US
	int "Maximum accepted timer period (us)"
	default 1000000
	range 2 2147483647
	help
	  Set the longest period accepted by the sample API. This value must be
	  greater than or equal to the configured minimum period. The default
	  sample period must remain within the resulting accepted range or the
	  build is rejected.

config SAMPLE_RTFW_TIMER_TELEMETRY_DECIMATION
	int "Emit one tick event every N timer events (0 disables)"
	default 0
	range 0 1000000
	help
	  Tick telemetry is disabled by default. Configuration changes remain
	  event-on-change and are not affected by this setting.

config SAMPLE_RTFW_ISR_TEST_LOAD
	bool "Inject a controlled busy loop into the TIMER fast path"
	help
	  Add a bounded NOP loop to the source ISR for stress and
	  coexistence measurements. The configured iteration count is
	  executed after the registered fast-path callback. Keep this
	  option disabled for baseline latency measurements.

config SAMPLE_RTFW_ISR_TEST_LOAD_CYCLES
	int "NOP iterations in the injected ISR load"
	depends on SAMPLE_RTFW_ISR_TEST_LOAD
	default 100
	range 1 1000000

config SAMPLE_RTFW_DEBUG_PIN
	bool "Expose TIMER ISR execution time on a debug pin"
	help
	  Drive the board-specific debug pin while the direct source ISR
	  executes so its latency and duration can be measured with a
	  logic analyzer. The output includes framework command handling
	  and the registered sample fast-path callback.

source "Kconfig.zephyr"
```

## samples/subsys/rtfw/timer_gpio/boards/nrf54lm20dk_nrf54lm20b_cpuapp.conf
```kconfig
CONFIG_BT=y
CONFIG_BT_PERIPHERAL=y
CONFIG_BT_DEVICE_NAME="Nordic_RTFW_Timer"
CONFIG_BT_LBS=y
CONFIG_SAMPLE_RTFW_IRQ_PRIORITY=1
```
