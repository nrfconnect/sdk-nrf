## CMakeLists.txt
```
#
# Copyright (c) 2019 Nordic Semiconductor
#
# SPDX-License-Identifier: LicenseRef-Nordic-5-Clause
#

cmake_minimum_required(VERSION 3.20.0)

find_package(Zephyr REQUIRED HINTS $ENV{ZEPHYR_BASE})
project("Application Event Manager sample")

# Include application application event headers
zephyr_library_include_directories(src/events)

# Application sources
# NORDIC SDK APP START
target_sources(app PRIVATE src/main.c)

target_sources(app PRIVATE
  src/events/ack_event.c
  src/events/config_event.c
  src/events/control_event.c
  src/events/measurement_event.c
)

target_sources(app PRIVATE
  src/modules/controller.c
  src/modules/sensor_simulated.c
  src/modules/stats.c
)
# NORDIC SDK APP END
```

## sample.yaml
```
sample:
  description: Sample showing Application Event Manager usage
  name: Application Event Manager sample
common:
  harness: console
  harness_config:
    ordered: false
    regex:
      - "config_event"
      - "measurement_event"
      - "control_event"
      - "ack_event"
      - "Average value3: 45"
    type: multi_line
tests:
  sample.app_event_manager:
    sysbuild: true
    build_only: false
    platform_allow:
      - qemu_cortex_m3
      - nrf52dk/nrf52832
      - nrf52840dk/nrf52840
      - nrf5340dk/nrf5340/cpuapp
      - nrf5340dk/nrf5340/cpuapp/ns
      - nrf9160dk/nrf9160/ns
      - nrf21540dk/nrf52840
      - nrf54h20dk/nrf54h20/cpuapp
      - nrf54h20dk/nrf54h20/cpuapp/iron
    integration_platforms:
      - qemu_cortex_m3
      - nrf52dk/nrf52832
      - nrf52840dk/nrf52840
      - nrf5340dk/nrf5340/cpuapp
      - nrf5340dk/nrf5340/cpuapp/ns
      - nrf9160dk/nrf9160/ns
      - nrf21540dk/nrf52840
      - nrf54h20dk/nrf54h20/cpuapp
      - nrf54h20dk/nrf54h20/cpuapp/iron
    tags:
      - sysbuild
      - ci_samples_app_event_manager
  sample.app_event_manager_shell:
    sysbuild: true
    build_only: false
    platform_allow:
      - qemu_cortex_m3
      - nrf52dk/nrf52832
      - nrf52840dk/nrf52840
      - nrf5340dk/nrf5340/cpuapp
      - nrf5340dk/nrf5340/cpuapp/ns
      - nrf9160dk/nrf9160/ns
      - nrf21540dk/nrf52840
      - nrf54h20dk/nrf54h20/cpuapp
      - nrf54h20dk/nrf54h20/cpuapp/iron
    integration_platforms:
      - qemu_cortex_m3
      - nrf52dk/nrf52832
      - nrf52840dk/nrf52840
      - nrf5340dk/nrf5340/cpuapp
      - nrf5340dk/nrf5340/cpuapp/ns
      - nrf9160dk/nrf9160/ns
      - nrf21540dk/nrf52840
      - nrf54h20dk/nrf54h20/cpuapp
      - nrf54h20dk/nrf54h20/cpuapp/iron
    extra_configs:
      - CONFIG_SHELL=y
    platform_exclude: native_sim
    tags:
      - sysbuild
      - ci_samples_app_event_manager
  sample.app_event_manager_shell.native_sim:
    sysbuild: true
    build_only: false
    extra_configs:
      - CONFIG_SHELL=y
      - CONFIG_NATIVE_UART_0_ON_STDINOUT=y
    platform_allow: native_sim
    integration_platforms:
      - native_sim
    tags:
      - sysbuild
      - ci_samples_app_event_manager
```

## prj.conf
```kconfig
#
# Copyright (c) 2019 Nordic Semiconductor ASA
#
# SPDX-License-Identifier: LicenseRef-Nordic-5-Clause
#
# Enabling assert
CONFIG_ASSERT=y

# Logger configuration
CONFIG_LOG=y
CONFIG_LOG_BACKEND_UART=y

# Configuration required by Application Event Manager
CONFIG_APP_EVENT_MANAGER=y
CONFIG_HEAP_MEM_POOL_SIZE=2048
CONFIG_REBOOT=y
```

## src/main.c
```c
/*
 * Copyright (c) 2019 Nordic Semiconductor ASA
 *
 * SPDX-License-Identifier: LicenseRef-Nordic-5-Clause
 */

#include <app_event_manager.h>
#include <config_event.h>
#include <zephyr/logging/log.h>

#define MODULE main

LOG_MODULE_REGISTER(MODULE);

#define INIT_VALUE1 3

int main(void)
{
	if (app_event_manager_init()) {
		LOG_ERR("Application Event Manager not initialized");
	} else {
		struct config_event *event = new_config_event();

		event->init_value1 = INIT_VALUE1;
		APP_EVENT_SUBMIT(event);
	}
	return 0;
}
```
