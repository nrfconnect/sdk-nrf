## CMakeLists.txt
```
#
# Copyright (c) 2018 Nordic Semiconductor
#
# SPDX-License-Identifier: LicenseRef-BSD-5-Clause-Nordic
#

cmake_minimum_required(VERSION 3.8.2)

set(NRF_SUPPORTED_BOARDS
  nrf52840_pca20041
  nrf52840_pca10056
  nrf52840_pca10059
  nrf52_pca20037
  )

set(NRF_SUPPORTED_BUILD_TYPES
  ZDebug
  ZDebugWithShell
  ZDebugMCUBoot
  ZRelease
  ZReleaseMCUBoot
  )

if (NOT CMAKE_BUILD_TYPE)
  set(CMAKE_BUILD_TYPE ZDebug)
endif()

include(../../cmake/boilerplate.cmake)

if (EXISTS "${CMAKE_CURRENT_SOURCE_DIR}/configuration/${BOARD}/dts.overlay")
  set(DTC_OVERLAY_FILE "${CMAKE_CURRENT_SOURCE_DIR}/configuration/${BOARD}/dts.overlay")
endif()

set(mcuboot_CONF_FILE
  ${CMAKE_CURRENT_SOURCE_DIR}/configuration/${BOARD}/mcuboot_${CMAKE_BUILD_TYPE}.conf
  )

# Define configuration files.
set(CONF_FILE "configuration/${BOARD}/app_${CMAKE_BUILD_TYPE}.conf")

################################################################################

include($ENV{ZEPHYR_BASE}/cmake/app/boilerplate.cmake NO_POLICY_SCOPE)
project("nRF52 Desktop"
        VERSION 0.1)

################################################################################

assert(CONFIG_DESKTOP_REPORT_DESC "HID report descriptor file must be specified")

target_sources(app PRIVATE
  src/main.c
  ${CONFIG_DESKTOP_REPORT_DESC}
  )

# Include application events and configuration headers
zephyr_library_include_directories(
  src/events
  configuration/common
  configuration/${BOARD}
  )

# Application sources
add_subdirectory(src/events)
add_subdirectory(src/hw_interface)
add_subdirectory(src/modules)
add_subdirectory(src/services)

if(CONFIG_BOOTLOADER_MCUBOOT)
  assert_exists(mcuboot_CONF_FILE)
endif()
```

## Kconfig
```
#
# Copyright (c) 2018 Nordic Semiconductor ASA
#
# SPDX-License-Identifier: LicenseRef-BSD-5-Clause-Nordic
#

menu "nRF52 Desktop"
rsource "src/events/Kconfig"
rsource "src/hw_interface/Kconfig"
rsource "src/modules/Kconfig"
rsource "src/services/Kconfig"
endmenu

menu "Zephyr Kernel"
source "$ZEPHYR_BASE/Kconfig.zephyr"
endmenu
```

## sample.yaml
```
sample:
  description: nRF52 Desktop
  name: BLE HID device reference design
tests:
  test:
    build_only: true
    build_on_all: true
    platform_whitelist: nrf52840_pca20041 nrf52840_pca10056 nrf52840_pca10059 nrf52_pca20037
    tags: bluetooth ci_build
  test_debug_mcuboot:
    build_only: true
    build_on_all: true
    platform_whitelist: nrf52840_pca20041 nrf52840_pca10059 nrf52_pca20037
    tags: bluetooth ci_build
    extra_args: "CMAKE_BUILD_TYPE=ZDebugMCUBoot"
  test_zrelease:
    build_only: true
    build_on_all: true
    platform_whitelist: nrf52840_pca20041 nrf52840_pca10056 nrf52840_pca10059 nrf52_pca20037
    tags: bluetooth ci_build
    extra_args: "CMAKE_BUILD_TYPE=ZRelease"
  test_zrelease_mcuboot:
    build_only: true
    build_on_all: true
    platform_whitelist: nrf52840_pca20041 nrf52840_pca10059 nrf52_pca20037
    tags: bluetooth ci_build
    extra_args: "CMAKE_BUILD_TYPE=ZReleaseMCUBoot"
```

## prj.conf
```kconfig
CONFIG_EVENT_MANAGER=y
```

## src/main.c
```c
/*
 * Copyright (c) 2018 Nordic Semiconductor ASA
 *
 * SPDX-License-Identifier: LicenseRef-BSD-5-Clause-Nordic
 */

#include <event_manager.h>

#define MODULE main
#include "module_state_event.h"

#include <logging/log.h>
LOG_MODULE_REGISTER(MODULE);


void main(void)
{
	if (event_manager_init()) {
		LOG_ERR("Event manager not initialized");
	} else {
		module_set_state(MODULE_STATE_READY);
	}
}
```
