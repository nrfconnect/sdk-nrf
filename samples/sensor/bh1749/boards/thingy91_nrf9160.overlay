/*
 * Copyright (c) 2026 Nordic Semiconductor ASA
 *
 * SPDX-License-Identifier: LicenseRef-Nordic-5-Clause
 */
/delete-node/ &slot0_ns_partition;
/delete-node/ &slot1_ns_partition;

&slot0_partition {
	/* Increase secure flash partition for this secure only build. */
	reg = <0x0000c000 0x69000>;
};

&slot1_partition {
	/* Increase secondary secure flash partition for this secure only build. */
	reg = <0x00750000 0x69000>;
};
