/*
 * Copyright (c) 2023 Nordic Semiconductor ASA
 *
 * SPDX-License-Identifier: LicenseRef-Nordic-5-Clause
 */

/ {
	/* Support Wi-Fi-BLE coexistence when nRF7002 EK shield is used */
	nrf_radio_coex: nrf7002-coex {
		status = "okay";
		compatible = "nordic,nrf700x-coex";
		status0-gpios = <&arduino_header 8 GPIO_ACTIVE_HIGH>;   /* D2 */
		req-gpios = <&arduino_header 9 GPIO_ACTIVE_HIGH>; 	/* D3 */
		grant-gpios = <&arduino_header 10 GPIO_ACTIVE_HIGH>;    /* D4 */
		swctrl1-gpios = <&arduino_header 12 GPIO_ACTIVE_HIGH>;  /* D6 */
	};
};
