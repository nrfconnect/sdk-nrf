## samples/matter/template/boards/nrf54lc10dk_nrf54lc10a_cpuapp.conf
```kconfig
#
# Copyright (c) 2026 Nordic Semiconductor ASA
#
# SPDX-License-Identifier: LicenseRef-Nordic-5-Clause
#

# CHIP_BOOTLOADER_MCUBOOT selects IMG_MANAGER, which depends on STREAM_FLASH.
# Matter OTA is disabled on this board (single slot), so OTA defaults do not enable it.
CONFIG_STREAM_FLASH=y
```

## samples/matter/template/boards/nrf54lm20pdk_nrf54lm20a_cpuapp_internal.conf
```kconfig
#
# Copyright (c) 2025 Nordic Semiconductor ASA
#
# SPDX-License-Identifier: LicenseRef-Nordic-5-Clause
#

# Multirole is the only currently supported role by SoftDevice.
CONFIG_BT_LL_SOFTDEVICE_MULTIROLE=y

# Workaround required as Zephyr L2 implies usage of NVS backend for settings.
# It should be removed once the proper fix will be applied in Zephyr.
CONFIG_NVS=n

# Disable SPI
CONFIG_CHIP_SPI_NOR=n

# Disable features based on IKG
CONFIG_CHIP_CRYPTO_PSA_DAC_PRIV_KEY_KMU_ENCRYPTED=n
CONFIG_TRUSTED_STORAGE_BACKEND_AEAD_KEY_HASH_UID=y
```

## samples/matter/template/boards/nrf7002dk_nrf5340_cpuapp.conf
```kconfig
#
# Copyright (c) 2024 Nordic Semiconductor ASA
#
# SPDX-License-Identifier: LicenseRef-Nordic-5-Clause
#

# Enable LTO to decrease the flash usage.
CONFIG_LTO=y
CONFIG_ISR_TABLES_LOCAL_DECLARATION=y
# To trigger chip
CONFIG_NRF70_WORKQ_STACK_SIZE=4096
```

## samples/matter/template/sample.yaml
```yaml
sample:
  description: Matter Template sample
  name: Matter Template
common:
  tags:
    - sysbuild
    - ci_samples_matter
tests:
  sample.matter.template.debug:
    sysbuild: true
    build_only: true
    extra_args:
      - CONFIG_NCS_SAMPLE_MATTER_OPERATIONAL_KEYS_MIGRATION_TO_ITS=y
    integration_platforms:
      - nrf52840dk/nrf52840
      - nrf5340dk/nrf5340/cpuapp
      - nrf7002dk/nrf5340/cpuapp
      - nrf54l15dk/nrf54l15/cpuapp
      - nrf54l15dk/nrf54l15/cpuapp/ns
      - nrf54l15dk/nrf54l10/cpuapp
      - nrf54lm20dk/nrf54lm20a/cpuapp
    platform_allow:
      - nrf52840dk/nrf52840
      - nrf5340dk/nrf5340/cpuapp
      - nrf7002dk/nrf5340/cpuapp
      - nrf54l15dk/nrf54l15/cpuapp
      - nrf54l15dk/nrf54l15/cpuapp/ns
      - nrf54l15dk/nrf54l10/cpuapp
      - nrf54lm20dk/nrf54lm20a/cpuapp
  sample.matter.template.nrf7002eb2.debug:
    sysbuild: true
    build_only: true
    extra_args:
      - template_SHIELD=nrf7002eb2
      - SB_CONFIG_WIFI_NRF70=y
    integration_platforms:
      - nrf54lm20dk/nrf54lm20a/cpuapp
    platform_allow:
      - nrf54lm20dk/nrf54lm20a/cpuapp
  sample.matter.template.release:
    sysbuild: true
    build_only: true
    extra_args:
      - FILE_SUFFIX=release
      - CONFIG_NCS_SAMPLE_MATTER_OPERATIONAL_KEYS_MIGRATION_TO_ITS=y
    integration_platforms:
      - nrf52840dk/nrf52840
      - nrf5340dk/nrf5340/cpuapp
      - nrf7002dk/nrf5340/cpuapp
      - nrf54l15dk/nrf54l15/cpuapp
      - nrf54l15dk/nrf54l15/cpuapp/ns
      - nrf54l15dk/nrf54l10/cpuapp
      - nrf54lm20dk/nrf54lm20a/cpuapp
    platform_allow:
      - nrf52840dk/nrf52840
      - nrf5340dk/nrf5340/cpuapp
      - nrf7002dk/nrf5340/cpuapp
      - nrf54l15dk/nrf54l15/cpuapp
      - nrf54l15dk/nrf54l15/cpuapp/ns
      - nrf54l15dk/nrf54l10/cpuapp
      - nrf54lm20dk/nrf54lm20a/cpuapp
  sample.matter.template.nrf7002eb2.release:
    sysbuild: true
    build_only: true
    extra_args:
      - FILE_SUFFIX=release
      - SB_CONFIG_BOOTLOADER_MCUBOOT=y
      - SB_CONFIG_PARTITION_MANAGER=y
      - template_SHIELD=nrf7002eb2
      - SB_CONFIG_WIFI_NRF70=y
    integration_platforms:
      - nrf54lm20dk/nrf54lm20a/cpuapp
    platform_allow:
      - nrf54lm20dk/nrf54lm20a/cpuapp
  sample.matter.template.smp_dfu:
    sysbuild: true
    build_only: true
    extra_args:
      - CONFIG_CHIP_DFU_OVER_BT_SMP=y
      - CONFIG_NCS_SAMPLE_MATTER_OPERATIONAL_KEYS_MIGRATION_TO_ITS=y
    integration_platforms:
      - nrf52840dk/nrf52840
      - nrf5340dk/nrf5340/cpuapp
      - nrf7002dk/nrf5340/cpuapp
      - nrf54l15dk/nrf54l15/cpuapp
      - nrf54l15dk/nrf54l15/cpuapp/ns
      - nrf54l15dk/nrf54l10/cpuapp
      - nrf54lm20dk/nrf54lm20a/cpuapp
    platform_allow:
      - nrf52840dk/nrf52840
      - nrf5340dk/nrf5340/cpuapp
      - nrf7002dk/nrf5340/cpuapp
      - nrf54l15dk/nrf54l15/cpuapp
      - nrf54l15dk/nrf54l15/cpuapp/ns
      - nrf54l15dk/nrf54l10/cpuapp
      - nrf54lm20dk/nrf54lm20a/cpuapp
  sample.matter.template.nrf7002eb2.smp_dfu:
    sysbuild: true
    build_only: true
    extra_args:
      - CONFIG_CHIP_DFU_OVER_BT_SMP=y
      - template_SHIELD=nrf7002eb2
      - SB_CONFIG_WIFI_NRF70=y
    integration_platforms:
      - nrf54lm20dk/nrf54lm20a/cpuapp
    platform_allow:
      - nrf54lm20dk/nrf54lm20a/cpuapp
  sample.matter.template.release.internal:
    sysbuild: true
    build_only: true
    extra_args:
      - FILE_SUFFIX=internal
      - template_EXTRA_CONF_FILE=prj_release.conf
    integration_platforms:
      - nrf54l15dk/nrf54l15/cpuapp
      - nrf54lm20dk/nrf54lm20a/cpuapp
    platform_allow:
      - nrf54l15dk/nrf54l15/cpuapp
      - nrf54lm20dk/nrf54lm20a/cpuapp
  sample.matter.template.nrf7002eb2.release.internal:
    sysbuild: true
    build_only: true
    extra_args:
      - FILE_SUFFIX=internal
      - template_EXTRA_CONF_FILE=prj_release.conf
      - template_SHIELD=nrf7002eb2
      - SB_CONFIG_WIFI_NRF70=y
    integration_platforms:
      - nrf54lm20dk/nrf54lm20a/cpuapp
    platform_allow:
      - nrf54lm20dk/nrf54lm20a/cpuapp
  sample.matter.template.release.internal.smp_dfu:
    sysbuild: true
    build_only: true
    extra_args:
      - FILE_SUFFIX=internal
      - CONFIG_CHIP_DFU_OVER_BT_SMP=y
      - template_EXTRA_CONF_FILE=prj_release.conf
    integration_platforms:
      - nrf54l15dk/nrf54l15/cpuapp
      - nrf54lm20dk/nrf54lm20a/cpuapp
    platform_allow:
      - nrf54l15dk/nrf54l15/cpuapp
      - nrf54lm20dk/nrf54lm20a/cpuapp
  sample.matter.template.nrf7002eb2.release.internal.smp_dfu:
    sysbuild: true
    build_only: true
    extra_args:
      - FILE_SUFFIX=internal
      - CONFIG_CHIP_DFU_OVER_BT_SMP=y
      - template_EXTRA_CONF_FILE=prj_release.conf
      - template_SHIELD=nrf7002eb2
      - SB_CONFIG_WIFI_NRF70=y
    integration_platforms:
      - nrf54lm20dk/nrf54lm20a/cpuapp
    platform_allow:
      - nrf54lm20dk/nrf54lm20a/cpuapp
  sample.matter.template.cc3xx_backend:
    sysbuild: true
    build_only: true
    extra_args:
      - CONFIG_PSA_CRYPTO_DRIVER_CC3XX=y
    integration_platforms:
      - nrf52840dk/nrf52840
      - nrf5340dk/nrf5340/cpuapp
    platform_allow:
      - nrf52840dk/nrf52840
      - nrf5340dk/nrf5340/cpuapp
  sample.matter.template.smp_dfu.old_ec:
    sysbuild: true
    build_only: true
    extra_args:
      - CONFIG_CHIP_DFU_OVER_BT_SMP=y
      - SB_CONFIG_BOOT_SIGNATURE_TYPE_RSA=y
      - CONFIG_SETTINGS_ZMS_LEGACY=y
    integration_platforms:
      - nrf54l15dk/nrf54l15/cpuapp
    platform_allow:
      - nrf54l15dk/nrf54l15/cpuapp
  sample.matter.template.certification:
    sysbuild: true
    build_only: true
    extra_args:
      - CONFIG_NCS_SAMPLE_MATTER_CERTIFICATION=y
      - OVERLAY_CONFIG="../common/src/certification/thread_platform/overlay-thread_platform.conf"
      - template_SNIPPET="matter-diagnostic-logs;matter-debug"
    integration_platforms:
      - nrf52840dk/nrf52840
      - nrf5340dk/nrf5340/cpuapp
      - nrf54l15dk/nrf54l15/cpuapp
      - nrf54lm20dk/nrf54lm20a/cpuapp
    platform_allow:
      - nrf52840dk/nrf52840
      - nrf5340dk/nrf5340/cpuapp
      - nrf54l15dk/nrf54l15/cpuapp
      - nrf54lm20dk/nrf54lm20a/cpuapp
```

## samples/matter/template/sysbuild/ipc_radio/boards/nrf54h20dk_nrf54h20_cpurad.conf
```kconfig
#
# Copyright (c) 2024 Nordic Semiconductor ASA
#
# SPDX-License-Identifier: LicenseRef-Nordic-5-Clause
#

# Disable serial and UART interface.
CONFIG_SERIAL=n
CONFIG_UART_CONSOLE=n
CONFIG_LOG=n

# RAM usage configuration
CONFIG_HEAP_MEM_POOL_SIZE=8192
CONFIG_MAIN_STACK_SIZE=2048
CONFIG_SYSTEM_WORKQUEUE_STACK_SIZE=2048

# BT configuration
CONFIG_BT=y
CONFIG_BT_HCI_RAW=y
CONFIG_BT_MAX_CONN=1
CONFIG_BT_CTLR_ASSERT_HANDLER=y
CONFIG_BT_PERIPHERAL=y
CONFIG_BT_CENTRAL=n
CONFIG_BT_BUF_ACL_RX_SIZE=502
CONFIG_BT_BUF_ACL_TX_SIZE=251
CONFIG_BT_CTLR_DATA_LENGTH_MAX=251
CONFIG_BT_CTLR_PHY_2M=n

# 802.15.4 configuration
CONFIG_NRF_802154_SER_RADIO=y
CONFIG_NRF_802154_ENCRYPTION=y
CONFIG_NRF_RTC_TIMER_USER_CHAN_COUNT=2

# ipc_radio
CONFIG_IPC_RADIO_BT=y
CONFIG_IPC_RADIO_BT_HCI_IPC=y
CONFIG_IPC_RADIO_802154=y

# Set SUIT template paths
CONFIG_SUIT_ENVELOPE_TEMPLATE="suit_templates/rad_envelope.yaml.jinja2"
```

## samples/matter/template/sysbuild/mcuboot/boards/nrf54l15dk_nrf54l15_cpuapp_internal.conf
```kconfig
#
# Copyright (c) 2024 Nordic Semiconductor ASA
#
# SPDX-License-Identifier: LicenseRef-Nordic-5-Clause
#

# TODO: Workaround, disable memory guard to avoid false faults in application after boot
CONFIG_HW_STACK_PROTECTION=n

CONFIG_BOOT_WATCHDOG_FEED=n

# Disable all debug features
CONFIG_ASSERT_VERBOSE=n
CONFIG_ASSERT_NO_FILE_INFO=y
CONFIG_PRINTK=n

# Bootloader size optimization to fit into 28 KB partition.
# These options can be safely disabled because in this configuration,
# the secondary slot resides in the internal RRAM, so features
# needed to handle the external flash are not needed.
CONFIG_SPI_NOR=n
CONFIG_SPI=n

# Currently, without tickless kernel, the SYSCOUNTER value after the software
# reset is not set properly and due to that the first system interrupt is not called
# in the proper time - the SYSCOUNTER value is set to the value from before
# reset + 1. Hence, the reboot time increases more and more.
# To avoid it enable tickles kernel for mcuboot.
CONFIG_TICKLESS_KERNEL=y
```

## samples/matter/template/sysbuild/mcuboot/boards/nrf54l15pdk_nrf54l15_cpuapp_internal.conf
```kconfig
#
# Copyright (c) 2024 Nordic Semiconductor ASA
#
# SPDX-License-Identifier: LicenseRef-Nordic-5-Clause
#

# TODO: Workaround Fprotect is not supported on nRF54l15 yet.
CONFIG_FPROTECT=n
# TODO: Workaround, disable memory guard to avoid false faults in application after boot
CONFIG_HW_STACK_PROTECTION=n

CONFIG_BOOT_WATCHDOG_FEED=n

# Disable all debug features
CONFIG_USE_SEGGER_RTT=n
CONFIG_SHELL=n
CONFIG_OPENTHREAD_SHELL=n
CONFIG_CONSOLE=n
CONFIG_UART_CONSOLE=n
CONFIG_SERIAL=n
CONFIG_LOG=n
CONFIG_LOG_MODE_MINIMAL=n
CONFIG_ASSERT_VERBOSE=n
CONFIG_ASSERT_NO_FILE_INFO=y
CONFIG_PRINTK=n
CONFIG_PRINTK_SYNC=n
CONFIG_THREAD_NAME=n
CONFIG_BOOT_BANNER=n

# Bootloader size optimization to fit into 28 KB partition.
# These options can be safely disabled because in this configuration,
# the secondary slot resides in the internal MRAM, so features
# needed to handle the external flash are not needed.
CONFIG_GPIO=n
CONFIG_SPI_NOR=n
CONFIG_SPI=n
CONFIG_MULTITHREADING=n
CONFIG_PM_OVERRIDE_EXTERNAL_DRIVER_CHECK=n

# Currently, without tickless kernel, the SYSCOUNTER value after the software
# reset is not set properly and due to that the first system interrupt is not called
# in the proper time - the SYSCOUNTER value is set to the value from before
# reset + 1. Hence, the reboot time increases more and more.
# To avoid it enable tickles kernel for mcuboot.
CONFIG_TICKLESS_KERNEL=y
```

## samples/matter/template/sysbuild/mcuboot/boards/nrf54lm20pdk_nrf54lm20a_cpuapp.conf
```kconfig
#
# Copyright (c) 2025 Nordic Semiconductor ASA
#
# SPDX-License-Identifier: LicenseRef-Nordic-5-Clause
#

CONFIG_HW_STACK_PROTECTION=n

CONFIG_BOOT_WATCHDOG_FEED=n

# nRF54LM20DK uses SPI NOR external flash
CONFIG_GPIO=y
CONFIG_SPI=y
CONFIG_SPI_NOR=y
CONFIG_SPI_NOR_SFDP_DEVICETREE=y
CONFIG_SPI_NOR_FLASH_LAYOUT_PAGE_SIZE=4096

# required by SPI driver
CONFIG_MULTITHREADING=y

CONFIG_PM_OVERRIDE_EXTERNAL_DRIVER_CHECK=y

# Disable CRACEN KMU
CONFIG_CRACEN_LIB_KMU=n

# Make sure oberon driver is enabled
CONFIG_PSA_CRYPTO_DRIVER_OBERON=y
# Enable CRACEN driver
CONFIG_PSA_CRYPTO_DRIVER_CRACEN=y
# Fallback to oberon driver for cipher operations (AES-modes)
CONFIG_PSA_USE_CRACEN_CIPHER_DRIVER=n
# Fallback to oberon for authenticated encryption (AES-GCM, CCM, Chachapoly)
CONFIG_PSA_USE_CRACEN_AEAD_DRIVER=n
# Fallback to oberon for hashes (SHA-*)
CONFIG_PSA_USE_CRACEN_HASH_DRIVER=n
# Fallback to oberon for MAC (CMAC, HMAC)
CONFIG_PSA_USE_CRACEN_MAC_DRIVER=n
# Fallback to oberon for ECDH
CONFIG_PSA_USE_CRACEN_KEY_AGREEMENT_DRIVER=n
# Fallback to oberon for asymmetric encryption
CONFIG_PSA_USE_CRACEN_ASYMMETRIC_DRIVER=n
# Fallback to oberon for all key management
CONFIG_PSA_USE_CRACEN_KEY_MANAGEMENT_DRIVER=n
# Fallback to oberon nfor KDFs
CONFIG_PSA_USE_CRACEN_KEY_DERIVATION_DRIVER=n
# Fallback to oberon for PAKES (EC J-PAKE, SPAKE2+)
CONFIG_PSA_USE_CRACEN_PAKE_DRIVER=n
# Fallback to oberon for signatures (ECDSA, EDDSA, RSA)
CONFIG_PSA_USE_CRACEN_ASYMMETRIC_SIGNATURE_DRIVER=n
```

## samples/matter/template/sysbuild/mcuboot/boards/nrf54lm20pdk_nrf54lm20a_cpuapp_internal.conf
```kconfig
#
# Copyright (c) 2025 Nordic Semiconductor ASA
#
# SPDX-License-Identifier: LicenseRef-Nordic-5-Clause
#

# Disable SPI
CONFIG_GPIO=n
CONFIG_SPI_NOR=n
CONFIG_SPI=n
CONFIG_MULTITHREADING=n

CONFIG_PM_OVERRIDE_EXTERNAL_DRIVER_CHECK=y

# Disable CRACEN KMU
CONFIG_CRACEN_LIB_KMU=n

# Make sure oberon driver is enabled
CONFIG_PSA_CRYPTO_DRIVER_OBERON=y
# Enable CRACEN driver
CONFIG_PSA_CRYPTO_DRIVER_CRACEN=y
# Fallback to oberon driver for cipher operations (AES-modes)
CONFIG_PSA_USE_CRACEN_CIPHER_DRIVER=n
# Fallback to oberon for authenticated encryption (AES-GCM, CCM, Chachapoly)
CONFIG_PSA_USE_CRACEN_AEAD_DRIVER=n
# Fallback to oberon for hashes (SHA-*)
CONFIG_PSA_USE_CRACEN_HASH_DRIVER=n
# Fallback to oberon for MAC (CMAC, HMAC)
CONFIG_PSA_USE_CRACEN_MAC_DRIVER=n
# Fallback to oberon for ECDH
CONFIG_PSA_USE_CRACEN_KEY_AGREEMENT_DRIVER=n
# Fallback to oberon for asymmetric encryption
CONFIG_PSA_USE_CRACEN_ASYMMETRIC_DRIVER=n
# Fallback to oberon for all key management
CONFIG_PSA_USE_CRACEN_KEY_MANAGEMENT_DRIVER=n
# Fallback to oberon nfor KDFs
CONFIG_PSA_USE_CRACEN_KEY_DERIVATION_DRIVER=n
# Fallback to oberon for PAKES (EC J-PAKE, SPAKE2+)
CONFIG_PSA_USE_CRACEN_PAKE_DRIVER=n
# Fallback to oberon for signatures (ECDSA, EDDSA, RSA)
CONFIG_PSA_USE_CRACEN_ASYMMETRIC_SIGNATURE_DRIVER=n
```

## samples/matter/thermostat/Kconfig
```kconfig
#
# Copyright (c) 2023 Nordic Semiconductor
#
# SPDX-License-Identifier: LicenseRef-Nordic-5-Clause
#
mainmenu "Matter Thermostat sample application"

config THERMOSTAT_TEMPERATURE_STEP
	int "Defines a simulated temperature step. Use 0 for random"
	default 0
	help
	  A temperature step that defines differences between consecutive simulated temperature measurements. If set to 0, then the step is random.

config THERMOSTAT_SIMULATED_TEMPERATURE_MAX
	int "Maximum simulated temperature value"
	default 3000

config THERMOSTAT_SIMULATED_TEMPERATURE_MIN
	int "Minimum simulated temperature value"
	default 1500

config THERMOSTAT_SIMULATED_TEMPERATURE_CHANGE
	bool "Select to set the temperature to rise or fall"
	default y
	help
	  If set to true, the simulated temperature is rising. If set to false, the simulated temperature is falling.

# Enable Read Client functionality for all build configurations.
config CHIP_ENABLE_READ_CLIENT
	default y

# Sample configuration used for Thread networking
if NET_L2_OPENTHREAD

choice OPENTHREAD_NORDIC_LIBRARY_CONFIGURATION
	default OPENTHREAD_NORDIC_LIBRARY_MTD
endchoice

choice OPENTHREAD_DEVICE_TYPE
	default OPENTHREAD_MTD
endchoice

endif # NET_L2_OPENTHREAD

source "${ZEPHYR_BASE}/../modules/lib/matter/config/nrfconnect/chip-module/Kconfig.features"
source "${ZEPHYR_BASE}/../modules/lib/matter/config/nrfconnect/chip-module/Kconfig.defaults"
source "${ZEPHYR_BASE}/../nrf/samples/matter/common/src/Kconfig"
source "Kconfig.zephyr"
```
