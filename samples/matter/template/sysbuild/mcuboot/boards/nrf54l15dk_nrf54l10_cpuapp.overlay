/*
 * Copyright (c) 2024 Nordic Semiconductor ASA
 *
 * SPDX-License-Identifier: LicenseRef-Nordic-5-Clause
 */

#include <samples/matter/nrf54l15dk_nrf54l10_cpuapp_partitions.dtsi>

/ {
	chosen {
		zephyr,code-partition = &boot_partition;
	};
};
