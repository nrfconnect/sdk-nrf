/*
 * Copyright (c) 2025 Nordic Semiconductor ASA
 *
 * SPDX-License-Identifier: LicenseRef-Nordic-5-Clause
 */

#include <samples/matter/nrf54lm20dk_nrf54lm20a_cpuapp_internal_partitions.dtsi>

/ {
	chosen {
		zephyr,code-partition = &boot_partition;
	};
};
