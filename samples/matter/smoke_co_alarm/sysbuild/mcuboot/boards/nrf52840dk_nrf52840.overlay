/*
 * Copyright (c) 2024 Nordic Semiconductor ASA
 *
 * SPDX-License-Identifier: LicenseRef-Nordic-5-Clause
 */

#include <samples/matter/nrf52840dk_nrf52840_partitions.dtsi>

/ {
	chosen {
		zephyr,code-partition = &boot_partition;
	};
};
