/*
 * Copyright (c) 2026 Nordic Semiconductor ASA
 *
 * SPDX-License-Identifier: LicenseRef-Nordic-5-Clause
 */

#include <samples/matter/nrf54lc10_cpuapp_partitions.dtsi>

/ {
	chosen {
		zephyr,code-partition = &boot_partition;
	};
};
