/*
 * Copyright (c) 2024 Nordic Semiconductor ASA
 *
 * SPDX-License-Identifier: LicenseRef-Nordic-5-Clause
 */

/*
 * This file contains memory layout for the Radio core aligned to Matter requirements
 */

/*
 * Reduce size of the cpurad code partition and remove all redundant partitions
 */

/delete-node/ &cpuapp_rx_partitions;
/delete-node/ &cpuapp_rw_partitions;
/delete-node/ &cpurad_rx_partitions;
/delete-node/ &cpuppr_vpr;
/delete-node/ &cpuflpr_vpr;

&mram1x {
	cpurad_rx_partitions: cpurad-rx-partitions {
		compatible = "nordic,owned-partitions", "fixed-partitions";
		status = "okay";
		perm-read;
		perm-execute;
		perm-secure;
		#address-cells = < 0x1 >;
		#size-cells = < 0x1 >;
		cpurad_slot0_partition: partition@66000 {
			reg = < 0x66000 DT_SIZE_K(200) >;
		};
	};
};
