/*
 * Copyright (c) 2024 Nordic Semiconductor ASA
 *
 * SPDX-License-Identifier: LicenseRef-Nordic-5-Clause
 */

// Base path of the following includes points to the nrf/include directory.
// Include the application common configuration since Companion Image is a part of the Application core.
#include <../samples/matter/common/dts/nrf54h20/nrf54h20_cpuapp_memory_map.dtsi>
#include <../samples/matter/common/dts/nrf54h20/nrf54h20_flash_companion.dtsi>
