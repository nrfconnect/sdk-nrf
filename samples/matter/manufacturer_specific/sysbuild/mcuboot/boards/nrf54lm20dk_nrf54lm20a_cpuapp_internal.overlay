/*
 * Copyright (c) 2025 Nordic Semiconductor ASA
 *
 * SPDX-License-Identifier: LicenseRef-Nordic-5-Clause
 */

&rram_controller {
	cpuapp_rram: rram@0 {
		reg = <0x0 DT_SIZE_K(2036)>;
		ranges = <0x0 0x0 DT_SIZE_K(2036)>;
	};
};

/* Disable the external flash, as it's not needed
 * for the configuration with secondary slot residing
 * in the internal RRAM.
 */
&mx25r64 {
	status = "disabled";
};
