## samples/peripheral/radio_test/boards/nrf54ls05dk_nrf54ls05b_cpuapp.conf
```kconfig
#
# Copyright (c) 2025 Nordic Semiconductor
#
# SPDX-License-Identifier: LicenseRef-Nordic-5-Clause
#

# Enable the necessary drivers
CONFIG_NRFX_TIMER=y
```

## samples/peripheral/radio_test/boards/nrf7120dk_nrf7120_cpuapp.conf
```kconfig
#
# Copyright (c) 2026 Nordic Semiconductor
#
# SPDX-License-Identifier: LicenseRef-Nordic-5-Clause
#

# Enable the necessary drivers
CONFIG_NRFX_TIMER=y
```

## samples/peripheral/radio_test/sample.yaml
```yaml
sample:
  description: Radio Test sample
  name: Radio Test
tests:
  sample.peripheral.radio_test:
    sysbuild: true
    build_only: true
    integration_platforms:
      - nrf52dk/nrf52832
      - nrf52840dk/nrf52840
      - nrf5340dk/nrf5340/cpunet
      - nrf7002dk/nrf5340/cpunet
      - nrf54l15pdk/nrf54l15/cpuapp
      - nrf54h20dk/nrf54h20/cpurad
    platform_allow: >
      nrf52dk/nrf52832 nrf52840dk/nrf52840 nrf5340dk/nrf5340/cpunet nrf7002dk/nrf5340/cpunet
      nrf54l15pdk/nrf54l15/cpuapp nrf54h20dk/nrf54h20/cpurad
    tags: ci_build sysbuild
  sample.peripheral.radio_test.nrf5340_nrf21540:
    sysbuild: true
    build_only: true
    extra_args: SHIELD=nrf21540ek
    integration_platforms:
      - nrf5340dk/nrf5340/cpunet
    platform_allow: nrf5340dk/nrf5340/cpunet
    tags: ci_build sysbuild
  sample.peripheral.radio_test.nrf5340_usb:
    sysbuild: true
    build_only: true
    extra_args: FILE_SUFFIX=usb
    integration_platforms:
      - nrf5340dk/nrf5340/cpunet
    platform_allow: nrf5340dk/nrf5340/cpunet
    tags: ci_build sysbuild
  sample.peripheral.radio_test.nrf5340_nrf21540_usb:
    sysbuild: true
    build_only: true
    extra_args: SHIELD=nrf21540ek FILE_SUFFIX=usb
    integration_platforms:
      - nrf5340dk/nrf5340/cpunet
    platform_allow: nrf5340dk/nrf5340/cpunet
    tags: ci_build sysbuild
  sample.peripheral.radio_test.nrf5340_nrf21540.no_automatic_power:
    sysbuild: true
    build_only: true
    extra_args: SHIELD=nrf21540ek
    extra_configs:
      - CONFIG_RADIO_TEST_POWER_CONTROL_AUTOMATIC=n
    integration_platforms:
      - nrf5340dk/nrf5340/cpunet
    platform_allow: nrf5340dk/nrf5340/cpunet
    tags: ci_build sysbuild
```

## samples/peripheral/uart_cobs/boards/nrf9160dk_nrf52840.conf
```kconfig
#
# Copyright (c) 2020 Nordic Semiconductor ASA
#
# SPDX-License-Identifier: LicenseRef-BSD-5-Clause-Nordic
#

# Connect pins between nRF9160 and nRF52840 for UART
CONFIG_BOARD_NRF9160DK_INTERFACE0_MCU=y
CONFIG_BOARD_NRF9160DK_INTERFACE1_MCU=y
```

## samples/peripheral/uart_cobs/sample.yaml
```yaml
sample:
  name: UART Consistent Overhead Byte Stuffing (COBS)
  description: UART Consistent Overhead Byte Stuffing (COBS) sample
tests:
  samples.peripheral.uart_cobs:
    build_only: true
    build_on_all: true
    platform_whitelist: nrf52840dk_nrf52840 nrf9160dk_nrf9160ns nrf9160dk_nrf52840
    tags: ci_build
```

## samples/peripheral/vpr_offloading/Kconfig
```kconfig
#
# Copyright (c) 2026 Nordic Semiconductor
#
# SPDX-License-Identifier: LicenseRef-Nordic-5-Clause
#

config SAMPLE_LOCAL_TEMP_MONITOR
	bool "Local temperature monitor"

config SAMPLE_LOCAL_LED_CONTROL
	bool "Local LED control"

source "Kconfig.zephyr"
```

## samples/peripheral/vpr_offloading/boards/nrf54h20dk_nrf54h20_cpuapp.conf
```kconfig
CONFIG_PM=y
CONFIG_PM_DEVICE=y
CONFIG_PM_DEVICE_RUNTIME=y
CONFIG_SOC_NRF54H20_CPURAD_ENABLE=y
```

## samples/peripheral/vpr_offloading/sample.yaml
```yaml
sample:
  name: Remote processing on FLPR or PPR
  description: Using co-processor (FLPR or PPR) for background tasks

common:
  sysbuild: true
  harness: console
  harness_config:
    regex:
      - "^.*<inf> app: Average temperature: "
  tags:
    - ci_samples_peripheral_vpr_offloading

tests:
  sample.vpr_offloading.local:
    platform_allow: &offloading_local_platforms
      - nrf54l15dk/nrf54l15/cpuapp
      - nrf54lm20dk/nrf54lm20a/cpuapp
      - nrf54lv10dk/nrf54lv10a/cpuapp
      - nrf54h20dk/nrf54h20/cpuapp
    integration_platforms:
      - nrf54l15dk/nrf54l15/cpuapp
    extra_configs:
      - CONFIG_SAMPLE_LOCAL_TEMP_MONITOR=y
      - CONFIG_SAMPLE_LOCAL_LED_CONTROL=y
      - CONFIG_NRFX_SPIM=y
      - CONFIG_IPC_SERVICE=n
    extra_args:
      - SB_CONFIG_PARTITION_MANAGER=n

  sample.vpr_offloading.flpr:
    extra_args:
      - SB_CONFIG_PARTITION_MANAGER=n
      - SB_CONFIG_RUN_FLPRCORE=y
    platform_allow: &offloading_flpr_platforms
      - nrf54l15dk/nrf54l15/cpuapp
      - nrf54lm20dk/nrf54lm20a/cpuapp
      - nrf54lv10dk/nrf54lv10a/cpuapp
    integration_platforms:
      - nrf54l15dk/nrf54l15/cpuapp

  sample.vpr_offloading.ppr:
    extra_args:
      - SB_CONFIG_RUN_PPRCORE=y
      - vpr_offloading_SNIPPET=nordic-ppr
    platform_allow:
      - nrf54h20dk/nrf54h20/cpuapp
    integration_platforms:
      - nrf54h20dk/nrf54h20/cpuapp

  sample.vpr_offloading.local.current_measurement:
    tags:
      - ppk_power_measure
    platform_allow: *offloading_local_platforms
    integration_platforms:
      - nrf54l15dk/nrf54l15/cpuapp
    extra_configs:
      - CONFIG_SAMPLE_LOCAL_TEMP_MONITOR=y
      - CONFIG_SAMPLE_LOCAL_LED_CONTROL=y
      - CONFIG_NRFX_SPIM=y
      - CONFIG_IPC_SERVICE=n
    extra_args:
      - SB_CONFIG_PARTITION_MANAGER=n
    harness: pytest
    harness_config: &current_meas_harness_cfg
      fixture: ppk_power_measure
      pytest_root:
        - "${CUSTOM_ROOT_TEST_DIR}/test_measure_power_consumption.py::test_measure_current_vpr_offload"

  sample.vpr_offloading.flpr.current_measurement:
    tags:
      - ppk_power_measure
    platform_allow: *offloading_flpr_platforms
    integration_platforms:
      - nrf54l15dk/nrf54l15/cpuapp
    extra_args:
      - SB_CONFIG_PARTITION_MANAGER=n
      - SB_CONFIG_RUN_FLPRCORE=y
    harness: pytest
    harness_config: *current_meas_harness_cfg

  sample.vpr_offloading.ppr.current_measurement:
    tags:
      - ppk_power_measure
    platform_allow:
      - nrf54h20dk/nrf54h20/cpuapp
    integration_platforms:
      - nrf54h20dk/nrf54h20/cpuapp
    extra_args:
      - SB_CONFIG_RUN_PPRCORE=y
      - vpr_offloading_SNIPPET=nordic-ppr
    harness: pytest
    harness_config: *current_meas_harness_cfg
```

## samples/pmic/native/npm1300_fuel_gauge/sample.yaml
```yaml
# Copyright (c) 2023 Nordic Semiconductor ASA
# SPDX-License-Identifier: LicenseRef-Nordic-5-Clause
sample:
  name: nPM1300 fuel gauge

common:
  integration_platforms:
    - nrf52dk/nrf52832
    - nrf52840dk/nrf52840
    - nrf5340dk/nrf5340/cpuapp
    - nrf9160dk/nrf9160
  platform_allow: nrf52dk/nrf52832 nrf52840dk/nrf52840 nrf5340dk/nrf5340/cpuapp nrf9160dk/nrf9160
  tags: pmic

tests:
  samples.npm1300_fuel_gauge:
    sysbuild: true
    platform_allow: nrf52dk/nrf52832 nrf52840dk/nrf52840 nrf5340dk/nrf5340/cpuapp
    harness: console
    tags: sysbuild
    harness_config:
      fixture: nPM1300_setup_eng_b
      type: multi_line
      ordered: true
      regex:
        - "PMIC device ok"
        - "V: [0-9.]+, I: [0-9.-]+, T: [0-9.-]+"
        - "SoC: [0-9.]+, TTE: ([0-9.]+|nan), TTF: ([0-9.]+|nan)"
  samples.compile:
    sysbuild: true
    platform_allow: nrf9160dk/nrf9160
    harness: shield
    tags: shield sysbuild
    extra_args: SHIELD=npm1300_ek
```

## samples/pmic/native/npm1300_one_button/sample.yaml
```yaml
# Copyright (c) 2023 Nordic Semiconductor ASA
# SPDX-License-Identifier: LicenseRef-Nordic-5-Clause
sample:
  name: nPM1300 one button

common:
  integration_platforms:
    - nrf52dk/nrf52832
    - nrf52840dk/nrf52840
    - nrf5340dk/nrf5340/cpuapp
    - nrf54l15dk/nrf54l15/cpuapp
    - nrf54lm20dk/nrf54lm20a/cpuapp
    - nrf54h20dk/nrf54h20/cpuapp
    - nrf9160dk/nrf9160
  platform_allow:
    - nrf52dk/nrf52832
    - nrf52840dk/nrf52840
    - nrf5340dk/nrf5340/cpuapp
    - nrf54l15dk/nrf54l15/cpuapp
    - nrf54lm20dk/nrf54lm20a/cpuapp
    - nrf54h20dk/nrf54h20/cpuapp
    - nrf9160dk/nrf9160
  tags:
    - pmic
    - ci_samples_pmic
tests:
  sample.npm1300_one_button_compile:
    sysbuild: true
    build_only: true
    platform_allow:
      - nrf52dk/nrf52832
      - nrf52840dk/nrf52840
      - nrf5340dk/nrf5340/cpuapp
      - nrf54l15dk/nrf54l15/cpuapp
      - nrf54lm20dk/nrf54lm20a/cpuapp
      - nrf54h20dk/nrf54h20/cpuapp
      - nrf9160dk/nrf9160
    tags:
      - shield
      - sysbuild
      - ci_samples_pmic
```

## samples/pmic/native/npm13xx_fuel_gauge/sample.yaml
```yaml
# Copyright (c) 2023 Nordic Semiconductor ASA
# SPDX-License-Identifier: LicenseRef-Nordic-5-Clause
sample:
  name: Fuel gauge sample
  description: Fuel gauge sample for nPM1300 and nPM1304
common:
  integration_platforms:
    - nrf54l15dk/nrf54l15/cpuapp
    - nrf54lm20dk/nrf54lm20a/cpuapp
    - nrf54h20dk/nrf54h20/cpuapp
  platform_allow:
    - nrf52dk/nrf52832
    - nrf52840dk/nrf52840
    - nrf5340dk/nrf5340/cpuapp
    - nrf54l15dk/nrf54l15/cpuapp
    - nrf54lm20dk/nrf54lm20a/cpuapp
    - nrf54h20dk/nrf54h20/cpuapp
    - nrf9160dk/nrf9160
  tags:
    - pmic
    - ci_samples_pmic
    - sysbuild
tests:
  sample.npm1300_fuel_gauge_compile:
    sysbuild: true
    build_only: true
    extra_args:
      - EXTRA_DTC_OVERLAY_FILE=npm1300.overlay
  sample.npm1304_fuel_gauge_compile:
    sysbuild: true
    build_only: true
    extra_args:
      - EXTRA_DTC_OVERLAY_FILE=npm1304.overlay
```

## samples/pmic/native/npm2100_fuel_gauge/Kconfig
```kconfig
#
# Copyright (c) 2025 Nordic Semiconductor
#
# SPDX-License-Identifier: LicenseRef-Nordic-5-Clause
#

menu "Zephyr"
source "Kconfig.zephyr"
endmenu

menu "Sample configuration"

choice BATTERY_MODEL
	prompt "Initial battery model"
	default BATTERY_MODEL_ALKALINE_AA
	help
	  Select the initial battery model to use.
	  The battery model can be changed at runtime using shell commands.

config BATTERY_MODEL_ALKALINE_AA
	bool "Alkaline AA"
	help
	  Alkaline AA cylindrical battery.

config BATTERY_MODEL_ALKALINE_AAA
	bool "Alkaline AAA"
	help
	  Alkaline AAA cylindrical battery.

config BATTERY_MODEL_ALKALINE_2SAA
	bool "Alkaline 2SAA"
	help
	  Two Alkaline AA cylindrical batteries in series.

config BATTERY_MODEL_ALKALINE_2SAAA
	bool "Alkaline 2SAAA"
	help
	  Two Alkaline AAA cylindrical batteries in series.

config BATTERY_MODEL_ALKALINE_LR44
	bool "Alkaline LR44"
	help
	  Alkaline LR44 coin cell battery.

config BATTERY_MODEL_LITHIUM_CR2032
	bool "Lithium CR2032"
	help
	  Lithium-manganese dioxide CR2032 coin cell battery.

endchoice

endmenu
```

## samples/pmic/native/npm2100_fuel_gauge/sample.yaml
```yaml
# Copyright (c) 2025 Nordic Semiconductor ASA
# SPDX-License-Identifier: LicenseRef-Nordic-5-Clause
sample:
  name: nPM2100 fuel gauge

common:
  integration_platforms:
    - nrf52840dk/nrf52840
    - nrf5340dk/nrf5340/cpuapp
    - nrf54l15dk/nrf54l15/cpuapp
    - nrf54ls05dk/nrf54ls05a/cpuapp
    - nrf54ls05dk/nrf54ls05b/cpuapp
  platform_allow:
    - nrf52840dk/nrf52840
    - nrf5340dk/nrf5340/cpuapp
    - nrf54l15dk/nrf54l15/cpuapp
    - nrf54ls05dk/nrf54ls05a/cpuapp
    - nrf54ls05dk/nrf54ls05b/cpuapp
  tags:
    - pmic
    - ci_samples_pmic
tests:
  sample.npm2100_fuel_gauge_compile:
    sysbuild: true
    build_only: true
    tags:
      - sysbuild
      - ci_samples_pmic
```

## samples/pmic/native/npm2100_one_button/sample.yaml
```yaml
# Copyright (c) 2025 Nordic Semiconductor ASA
# SPDX-License-Identifier: LicenseRef-Nordic-5-Clause
sample:
  name: nPM2100 one button

common:
  integration_platforms:
    - nrf52840dk/nrf52840
    - nrf5340dk/nrf5340/cpuapp
    - nrf54l15dk/nrf54l15/cpuapp
  platform_allow:
    - nrf52840dk/nrf52840
    - nrf5340dk/nrf5340/cpuapp
    - nrf54l15dk/nrf54l15/cpuapp
  tags:
    - pmic
    - ci_samples_pmic

tests:
  sample.npm2100_one_button_compile:
    sysbuild: true
    build_only: true
    platform_allow:
      - nrf52840dk/nrf52840
      - nrf5340dk/nrf5340/cpuapp
      - nrf54l15dk/nrf54l15/cpuapp
    tags:
      - sysbuild
      - ci_samples_pmic
```

## samples/pmic/npm6001/Kconfig
```kconfig
#
# Copyright (c) 2022 Nordic Semiconductor ASA
#
# SPDX-License-Identifier: LicenseRef-Nordic-5-Clause
#

menu "Zephyr Kernel"
source "Kconfig.zephyr"
endmenu

menu "nPM6001 sample options"
module = APP
module-str = Sample application
source "${ZEPHYR_BASE}/subsys/logging/Kconfig.template.log_config"
endmenu
```

## samples/pmic/npm6001/boards/nrf52dk_nrf52832.conf
```kconfig
#
# Copyright (c) 2022 Nordic Semiconductor
#
# SPDX-License-Identifier: LicenseRef-Nordic-5-Clause
#

# Disable Shell
# (nRF52-DK not suitable for using COM port and external power supply simultaneously)
CONFIG_SHELL=n
```

## samples/pmic/npm6001/sample.yaml
```yaml
sample:
  description: nPM6001 sample
  name: npm6001
common:
  integration_platforms:
      - nrf52840dk_nrf52840
      - nrf52dk_nrf52832
      - nrf5340dk_nrf5340_cpuapp
      - nrf5340dk_nrf5340_cpuapp_ns
  platform_allow: nrf52840dk_nrf52840 nrf52dk_nrf52832
    nrf5340dk_nrf5340_cpuapp nrf5340dk_nrf5340_cpuapp_ns
  tags: npm6001 ci_build

tests:
  sample.app_npm6001:
    build_only: true
  sample.app_npm6001_loopback:
    build_only: false
    harness: console
    harness_config:
      ordered: false
      regex:
        - ".*nPM6001 successfully initialized..*"
      type: multi_line
    extra_args: CONFIG_TEST=y
    integration_platforms:
        - nrf52840dk_nrf52840
        - nrf5340dk_nrf5340_cpuapp
```

## samples/pmic/npmx/buck/Kconfig
```kconfig
#
# Copyright (c) 2022 Nordic Semiconductor ASA
#
# SPDX-License-Identifier: LicenseRef-Nordic-5-Clause
#

mainmenu "PMIC example: Buck"

choice
	bool "Testcase selection"
	default TESTCASE_SET_BUCK_VOLTAGE

config TESTCASE_SET_BUCK_VOLTAGE
	bool "Set output voltage of both bucks (simple)"

config TESTCASE_OUTPUT_VOLTAGE
	bool "Set output voltage of both bucks (advanced)"

config TESTCASE_RETENTION_VOLTAGE
	bool "Set retention voltage of buck 1 with selected external pin"

config TESTCASE_ENABLE_BUCKS_USING_PIN
	bool "Set enable mode of buck 1 with selected external pin"

endchoice

source "Kconfig.zephyr"
```

## samples/pmic/npmx/buck/sample.yaml
```yaml
sample:
  description: Sample for nPM1300 PMIC BUCKs
  name: nPM1300 PMIC BUCKs

common:
  integration_platforms:
    - nrf5340dk_nrf5340_cpuapp
    - nrf52840dk_nrf52840
  platform_allow: nrf5340dk_nrf5340_cpuapp nrf52840dk_nrf52840
  tags: pmic
  timeout: 30

tests:
  sample.pmic.buck.set_buck_voltage_eng_b:
    extra_args: CONFIG_TESTCASE_SET_BUCK_VOLTAGE=y
                CONFIG_NPMX_DEVICE_NPM1300_ENG_B=y
    harness: console
    harness_config:
      fixture: nPM1300_setup_eng_b
      type: multi_line
      ordered: true
      regex:
        - "PMIC device ok"
        - "Test setting BUCK voltage"
        - "Test setting BUCK voltage OK"

  sample.pmic.buck.output_voltage_eng_b:
    extra_args: CONFIG_TESTCASE_OUTPUT_VOLTAGE=y
                CONFIG_NPMX_DEVICE_NPM1300_ENG_B=y
    harness: console
    harness_config:
      fixture: nPM1300_setup_eng_b
      type: multi_line
      ordered: true
      regex:
        - "PMIC device ok"
        - "Test output voltage"
        - "Voltage BUCK1:"
        - "Test output voltage OK"

  sample.pmic.buck.retention_voltage_eng_b:
    extra_args: CONFIG_TESTCASE_RETENTION_VOLTAGE=y
                CONFIG_NPMX_DEVICE_NPM1300_ENG_B=y
    harness: console
    harness_config:
      fixture: nPM1300_setup_eng_b
      type: multi_line
      ordered: true
      regex:
        - "PMIC device ok"
        - "Test retention voltage"
        - "Test retention voltage OK"

  sample.pmic.buck.enable_bucks_using_pin_eng_b:
    extra_args: CONFIG_TESTCASE_ENABLE_BUCKS_USING_PIN=y
                CONFIG_NPMX_DEVICE_NPM1300_ENG_B=y
    harness: console
    harness_config:
      fixture: nPM1300_setup_eng_b
      type: multi_line
      ordered: true
      regex:
        - "PMIC device ok"
        - "Test enable BUCK using connected pin"
        - "Test enable BUCK using connected pin OK"
```
