/*
 * Copyright (c) 2024 Nordic Semiconductor ASA
 *
 * SPDX-License-Identifier: LicenseRef-Nordic-5-Clause
 */

&dppic020 {
	status = "okay";
	source-channels = < 0 1 >;
	sink-channels = < 2 3 >;
};
