## samples/peripheral/radio_test/Kconfig
```kconfig
#
# Copyright (c) 2020 Nordic Semiconductor
#
# SPDX-License-Identifier: LicenseRef-Nordic-5-Clause
#

mainmenu "Nordic Radio test sample"

config RADIO_TEST_USB
	bool "Radio Test shell over USB CDC ACM class"
	depends on SOC_NRF5340_CPUNET
	select EXPERIMENTAL
	help
	  Selects USB instead of UART as the Radio Test shell transport.
	  For nRF5340, the USB from application core is used as the communication interface.

config RADIO_TEST_POWER_CONTROL_AUTOMATIC
	bool "Automatic power control"
	depends on FEM
	default y
	help
	  Sets the SoC output power and front-end module gain to achieve the requested TX output power.
	  If the exact value cannot be achieved, power is set to closest value that does not exceed the limits
	  If this option is disabled, set the SoC output power and FEM gain with separate commands.

config RADIO_TEST_RX_TIMEOUT
	int "RX packet reception timeout"
	default 10
	help
	  Specifies the time in seconds that the application waits for the first packet to be
	  received in RX mode when a specified number of packets are set to be received.
	  If the timeout is reached before the first packet is received, the radio will be disabled.

config RADIO_TEST_PIN_DEBUG
	bool "Pin debug"
	depends on SOC_COMPATIBLE_NRF54LX
	select NRFX_GPIOTE
	help
	  Enables toggling of GPIO pins on radio events.
	  This can be useful for debugging to determine when the radio is being used.
	  This feature is currently only supported and tested on nRF54L Series devices.

source "Kconfig.zephyr"
```

## samples/peripheral/radio_test/boards/nrf5340dk_nrf5340_cpunet.conf
```kconfig
#
# Copyright (c) 2022 Nordic Semiconductor
#
# SPDX-License-Identifier: LicenseRef-Nordic-5-Clause
#

CONFIG_CONSOLE_HANDLER=n
CONFIG_CONSOLE=n
CONFIG_SERIAL=n
CONFIG_UART_CONSOLE=n

CONFIG_SHELL_IPC=y
CONFIG_SHELL_LOG_BACKEND=y
CONFIG_SHELL_BACKEND_SERIAL=n
CONFIG_SHELL_PROMPT_IPC="radio_test:~$ "

CONFIG_LOG=y
CONFIG_LOG_PRINTK=y

CONFIG_MBOX=y
CONFIG_IPC_SERVICE=y
CONFIG_IPC_SERVICE_BACKEND_RPMSG=y

CONFIG_HEAP_MEM_POOL_SIZE=4096

CONFIG_NCS_SAMPLE_REMOTE_SHELL_CHILD_IMAGE=y
```

## samples/peripheral/radio_test/boards/nrf54h20dk_nrf54h20_cpurad.conf
```kconfig
#
# Copyright (c) 2024 Nordic Semiconductor
#
# SPDX-License-Identifier: LicenseRef-Nordic-5-Clause
#
CONFIG_NRFX_GPPI_V1=n
```

## samples/peripheral/radio_test/boards/nrf54l15dk_nrf54l10_cpuapp.conf
```kconfig
#
# Copyright (c) 2024 Nordic Semiconductor
#
# SPDX-License-Identifier: LicenseRef-Nordic-5-Clause
#

# Disable the unsupported driver
CONFIG_NRFX_TIMER0=n

# Enable the necessary drivers
CONFIG_NRFX_TIMER10=y
```

## samples/peripheral/radio_test/boards/nrf54l15dk_nrf54l15_cpuapp.conf
```kconfig
#
# Copyright (c) 2024 Nordic Semiconductor
#
# SPDX-License-Identifier: LicenseRef-Nordic-5-Clause
#

# Disable the unsupported driver
CONFIG_NRFX_TIMER0=n

# Enable the necessary drivers
CONFIG_NRFX_TIMER10=y
CONFIG_NRFX_DPPI00=y
CONFIG_NRFX_DPPI10=y
CONFIG_NRFX_DPPI20=y
CONFIG_NRFX_DPPI30=y
CONFIG_NRFX_PPIB00=y
CONFIG_NRFX_PPIB01=y
CONFIG_NRFX_PPIB10=y
CONFIG_NRFX_PPIB11=y
CONFIG_NRFX_PPIB20=y
CONFIG_NRFX_PPIB21=y
CONFIG_NRFX_PPIB22=y
CONFIG_NRFX_PPIB30=y
```
