## samples/peripheral/802154_phy_test/boards/nrf5340dk_nrf5340_cpunet.conf
```kconfig
# Include empty image in the APP core
CONFIG_NCS_SAMPLE_EMPTY_APP_CORE_CHILD_IMAGE=y

CONFIG_NRF_RTC_TIMER_USER_CHAN_COUNT=2
```

## samples/peripheral/802154_phy_test/boards/nrf54h20dk_nrf54h20_cpurad.conf
```kconfig
#
# Copyright (c) 2024 Nordic Semiconductor
#
# SPDX-License-Identifier: LicenseRef-Nordic-5-Clause
#

CONFIG_SHELL_PROMPT_UART=">"

# currently unsupported for nRF54H20
CONFIG_PTT_CACHE_MGMT=n
CONFIG_PTT_CLK_OUT=n

CONFIG_SHELL_PROMPT_IPC=">"
CONFIG_SHELL_IPC=y
CONFIG_SHELL_LOG_BACKEND=y
CONFIG_SHELL_BACKEND_SERIAL=n

CONFIG_MBOX=y
CONFIG_IPC_SERVICE=y
CONFIG_SHELL_IPC_BACKEND_RX_RING_BUFFER_SIZE=1024

CONFIG_HEAP_MEM_POOL_SIZE=4096

# Enable application specific RPC operations
CONFIG_APP_RPC=y
```

## samples/peripheral/802154_phy_test/boards/nrf54l15dk_nrf54l15_cpuapp.conf
```kconfig
#
# Copyright (c) 2024 Nordic Semiconductor
#
# SPDX-License-Identifier: LicenseRef-Nordic-5-Clause
#

CONFIG_SHELL_PROMPT_UART=">"

# currently unsupported for nRF54L15
CONFIG_PTT_CACHE_MGMT=n

# nrfx drivers configuration:
CONFIG_NRFX_TIMER=y  # enable TIMER support
# enable DPPIC
CONFIG_NRFX_GPPI=y

# Set temperature sensor update period in ms
CONFIG_NRF_802154_TEMPERATURE_UPDATE_PERIOD=10000
```

## samples/peripheral/802154_phy_test/boards/nrf54l15pdk_nrf54l15_cpuapp.conf
```kconfig
#
# Copyright (c) 2024 Nordic Semiconductor
#
# SPDX-License-Identifier: LicenseRef-Nordic-5-Clause
#

CONFIG_SHELL_PROMPT_UART=">"

# currently unsupported for nRF54L15
CONFIG_PTT_CACHE_MGMT=n

# nrfx drivers configuration:
CONFIG_NRFX_TIMER20=y  # enable TIMER2
CONFIG_NRFX_DPPI=y  # enable DPPIC
```

## samples/peripheral/802154_phy_test/boards/nrf54lm20dk_nrf54lm20a_cpuapp.conf
```kconfig
#
# Copyright (c) 2025 Nordic Semiconductor
#
# SPDX-License-Identifier: LicenseRef-Nordic-5-Clause
#

CONFIG_SHELL_PROMPT_UART=">"

# currently unsupported for nRF54LM20
CONFIG_PTT_CACHE_MGMT=n
# nrfx drivers configuration:
CONFIG_NRFX_TIMER=y  # enable TIMER support
# enable DPPIC
CONFIG_NRFX_GPPI=y

# Set temperature sensor update period in ms
CONFIG_NRF_802154_TEMPERATURE_UPDATE_PERIOD=10000
```

## samples/peripheral/802154_phy_test/modules/app_rpc/zephyr/Kconfig
```kconfig
#
# Copyright (c) 2023 Nordic Semiconductor
#
# SPDX-License-Identifier: LicenseRef-Nordic-5-Clause
#

config APP_RPC
	bool "Enables application module features requiring interaction between cores"
	depends on SOC_NRF5340_CPUNET || SOC_NRF5340_CPUAPP || SOC_NRF54H20_CPUAPP \
		|| SOC_NRF54H20_ENGB_CPUAPP || SOC_NRF54H20_CPURAD || SOC_NRF54H20_ENGB_CPURAD
	select NRF_RPC
	select NRF_RPC_CBOR
```

## samples/peripheral/802154_phy_test/sample.yaml
```yaml
sample:
  description: IEEE 802.15.4 PHY Test Tool sample
  name: IEEE 802.15.4 PHY Test Tool
tests:
  sample.peripheral.802154_phy_test:
    sysbuild: true
    build_only: true
    integration_platforms:
      - nrf52833dk/nrf52833
      - nrf52840dk/nrf52840
      - nrf21540dk/nrf52840
      - nrf5340dk/nrf5340/cpunet
      - nrf54l15dk/nrf54l15/cpuapp
      - nrf54h20dk/nrf54h20/cpurad
    platform_allow: nrf52833dk/nrf52833 nrf52840dk/nrf52840 nrf21540dk/nrf52840
      nrf5340dk/nrf5340/cpunet nrf54l15dk/nrf54l15/cpuapp
      nrf54h20dk/nrf54h20/cpurad
    tags: ci_build ci_rs_build ci_rs_weekly sysbuild ci_samples_peripheral_802154
  sample.peripheral.802154_phy_test.ant_div_mode_auto:
    sysbuild: true
    build_only: true
    integration_platforms:
      - nrf21540dk/nrf52840
    platform_allow: nrf21540dk/nrf52840
    tags: ci_build ci_rs_build ci_rs_weekly sysbuild ci_samples_peripheral_802154
    extra_args: CONFIG_PTT_ANTENNA_DIVERSITY=y
      CONFIG_PTT_ANT_MODE_AUTO=y
  sample.peripheral.802154_phy_test.ant_div_mode_manual:
    sysbuild: true
    build_only: true
    integration_platforms:
      - nrf21540dk/nrf52840
    platform_allow: nrf21540dk/nrf52840
    tags: ci_build ci_rs_build ci_rs_weekly ci_rs_integration sysbuild ci_samples_peripheral_802154
    extra_args: CONFIG_PTT_ANTENNA_DIVERSITY=y
      CONFIG_PTT_ANT_MODE_MANUAL=y
```

## samples/peripheral/802154_phy_test/sysbuild/remote_shell/boards/nrf5340dk_nrf5340_cpuapp.conf
```kconfig
#
# Copyright (c) 2024 Nordic Semiconductor
#
# SPDX-License-Identifier: LicenseRef-Nordic-5-Clause
#

CONFIG_SOC_NRF53_CPUNET_ENABLE=y
CONFIG_NRFX_UARTE0=y
```

## samples/peripheral/802154_sniffer/Kconfig
```kconfig
source "Kconfig.zephyr"

config XIAO_BLE_ADAFRUIT_BOOTLOADER
	bool "Build UF2 image for use with Adafruit bootloader"
	default y
	depends on BOARD_XIAO_BLE
	help
	  If enabled a UF2 image will be generated for flashing with the default bootloader shipped with the Xiao BLE board. If disabled a regular firmware image will be generated that must be flashed via an extrernal debugger.
```

## samples/peripheral/802154_sniffer/boards/xiao_ble_nrf52840_nobootloader.conf
```kconfig
CONFIG_BUILD_OUTPUT_UF2=n
CONFIG_USE_DT_CODE_PARTITION=n
CONFIG_XIAO_BLE_ADAFRUIT_BOOTLOADER=n
```

## samples/peripheral/802154_sniffer/sample.yaml
```yaml
sample:
  description: IEEE 802.15.4 Sniffer sample
  name: IEEE 802.15.4 Sniffer
tests:
  sample.peripheral.802154_sniffer:
    sysbuild: true
    build_only: true
    integration_platforms:
      - nrf52840dk/nrf52840
      - nrf52840dongle/nrf52840
      - nrf5340dk/nrf5340/cpuapp
    platform_allow: nrf52840dk/nrf52840 nrf52840dongle/nrf52840 nrf5340dk/nrf5340/cpuapp
    tags: ci_build sysbuild ci_samples_peripheral_802154
```

## samples/peripheral/lpuart/boards/nrf52833dk_nrf52833.conf
```kconfig
#
# Copyright (c) 2024 Nordic Semiconductor
#
# SPDX-License-Identifier: LicenseRef-Nordic-5-Clause
#
CONFIG_UART_1_ASYNC=y
CONFIG_UART_1_INTERRUPT_DRIVEN=n
```

## samples/peripheral/lpuart/boards/nrf52dk_nrf52832.conf
```kconfig
#
# Copyright (c) 2020 Nordic Semiconductor
#
# SPDX-License-Identifier: LicenseRef-Nordic-5-Clause
#

CONFIG_UART_0_ASYNC=y
CONFIG_UART_0_INTERRUPT_DRIVEN=n
```

## samples/peripheral/lpuart/boards/nrf54l15dk_nrf54l15_cpuapp.conf
```kconfig
#
# Copyright (c) 2024 Nordic Semiconductor
#
# SPDX-License-Identifier: LicenseRef-Nordic-5-Clause
#
CONFIG_UART_21_ASYNC=y
CONFIG_UART_21_INTERRUPT_DRIVEN=n
```

## samples/peripheral/lpuart/boards/nrf9151dk_nrf9151_ns.conf
```kconfig
# Copyright (c) 2026 Nordic Semiconductor ASA
#
# SPDX-License-Identifier: LicenseRef-Nordic-5-Clause

CONFIG_TFM_PROFILE_TYPE_MINIMAL=y

CONFIG_UART_1_ASYNC=y
CONFIG_UART_1_INTERRUPT_DRIVEN=n
```

## samples/peripheral/lpuart/boards/nrf9160dk_nrf9160.conf
```kconfig
#
# Copyright (c) 2024 Nordic Semiconductor
#
# SPDX-License-Identifier: LicenseRef-Nordic-5-Clause
#
CONFIG_UART_1_ASYNC=y
CONFIG_UART_1_INTERRUPT_DRIVEN=n
CONFIG_UART_1_NRF_HW_ASYNC=y
CONFIG_UART_1_NRF_HW_ASYNC_TIMER=2
CONFIG_UART_1_NRF_ASYNC_LOW_POWER=y
CONFIG_NRFX_TIMER2=y
```

## samples/peripheral/lpuart/boards/nrf9160dk_nrf9160ns.conf
```kconfig
#
# Copyright (c) 2020 Nordic Semiconductor
#
# SPDX-License-Identifier: LicenseRef-Nordic-5-Clause
#

CONFIG_UART_1_ASYNC=y
CONFIG_UART_1_INTERRUPT_DRIVEN=n
CONFIG_UART_1_NRF_HW_ASYNC=y
CONFIG_UART_1_NRF_HW_ASYNC_TIMER=2
CONFIG_NRFX_TIMER2=y

# Setup modem to get lowest power consumption
CONFIG_NRF_MODEM_LIB=y
CONFIG_NETWORKING=y
CONFIG_NET_SOCKETS=y
CONFIG_HEAP_MEM_POOL_SIZE=1024
```

## samples/peripheral/lpuart/sample.yaml
```yaml
sample:
  description: Low Power UART sample
  name: Low Power UART

common:
  tags:
    - ci_build
    - sysbuild
    - ci_samples_peripheral_lpuart
  timeout: 30

tests:
  sample.peripheral.lpuart:
    sysbuild: true
    platform_allow:
      - nrf52dk/nrf52832
      - nrf52833dk/nrf52833
      - nrf52840dk/nrf52840
      - nrf9160dk/nrf9160/ns
      - nrf5340dk/nrf5340/cpuapp
      - nrf21540dk/nrf52840
      - nrf54l15dk/nrf54l05/cpuapp
      - nrf54l15dk/nrf54l10/cpuapp
      - nrf54l15dk/nrf54l15/cpuapp
      - nrf54lm20dk/nrf54lm20a/cpuapp
      - nrf54ls05dk/nrf54ls05b/cpuapp
      - nrf54ls05dk@0.0.0/nrf54ls05b/cpuapp
      - nrf54lv10dk/nrf54lv10a/cpuapp
    integration_platforms:
      - nrf52dk/nrf52832
      - nrf52833dk/nrf52833
      - nrf52840dk/nrf52840
      - nrf9160dk/nrf9160/ns
      - nrf5340dk/nrf5340/cpuapp
      - nrf21540dk/nrf52840
      - nrf54l15dk/nrf54l05/cpuapp
      - nrf54l15dk/nrf54l10/cpuapp
      - nrf54l15dk/nrf54l15/cpuapp
      - nrf54lm20dk/nrf54lm20a/cpuapp
      - nrf54ls05dk/nrf54ls05b/cpuapp
      - nrf54lv10dk/nrf54lv10a/cpuapp
    platform_exclude: native_sim
    tags: ppk_power_measure
    harness: pytest
    harness_config:
      fixture: gpio_loopback
      pytest_root:
        - "${CUSTOM_ROOT_TEST_DIR}/test_measure_power_consumption.py::test_measure_and_data_dump_power_consumption_lpuart"
    timeout: 90
  sample.peripheral.lpuart.debug:
    sysbuild: true
    platform_allow:
      - nrf52833dk/nrf52833
      - nrf52840dk/nrf52840
      - nrf9160dk/nrf9160/ns
      - nrf5340dk/nrf5340/cpuapp
      - nrf21540dk/nrf52840
      - nrf54l15dk/nrf54l05/cpuapp
      - nrf54l15dk/nrf54l10/cpuapp
      - nrf54l15dk/nrf54l15/cpuapp
      - nrf54lm20dk/nrf54lm20a/cpuapp
      - nrf54ls05dk/nrf54ls05b/cpuapp
      - nrf54ls05dk@0.0.0/nrf54ls05b/cpuapp
      - nrf54lv10dk/nrf54lv10a/cpuapp
    integration_platforms:
      - nrf52840dk/nrf52840
    extra_configs:
      - CONFIG_ASSERT=y
      - CONFIG_CONSOLE=y
      - CONFIG_UART_CONSOLE=y
      - CONFIG_LOG=y
      - CONFIG_NRF_SW_LPUART_LOG_LEVEL_DBG=y
    harness: console
    harness_config:
      fixture: gpio_loopback
      type: multi_line
      ordered: true
      regex:
        - ".*app: ASYNC Tx sent 5 bytes"
        - ".*app: ASYNC Received data 5 bytes"
        - ".*app: ASYNC Received data 1 bytes"
        - ".*app: ASYNC Tx sent 5 bytes"
        - ".*app: ASYNC Received data 5 bytes"
        - ".*app: ASYNC Received data 1 bytes"
        - ".*app: ASYNC Tx sent 5 bytes"
        - ".*app: ASYNC Received data 5 bytes"
  sample.peripheral.lpuart_int_driven:
    sysbuild: true
    extra_configs:
      - CONFIG_NRF_SW_LPUART_INT_DRIVEN=y
    integration_platforms:
      - nrf52dk/nrf52832
      - nrf52833dk/nrf52833
      - nrf52840dk/nrf52840
      - nrf9160dk/nrf9160/ns
      - nrf5340dk/nrf5340/cpuapp
      - nrf21540dk/nrf52840
      - nrf54l15dk/nrf54l05/cpuapp
      - nrf54l15dk/nrf54l10/cpuapp
      - nrf54l15dk/nrf54l15/cpuapp
      - nrf54lm20dk/nrf54lm20a/cpuapp
      - nrf54ls05dk/nrf54ls05b/cpuapp
      - nrf54lv10dk/nrf54lv10a/cpuapp
    platform_allow:
      - nrf52dk/nrf52832
      - nrf52833dk/nrf52833
      - nrf52840dk/nrf52840
      - nrf9160dk/nrf9160/ns
      - nrf5340dk/nrf5340/cpuapp
      - nrf21540dk/nrf52840
      - nrf54l15dk/nrf54l05/cpuapp
      - nrf54l15dk/nrf54l10/cpuapp
      - nrf54l15dk/nrf54l15/cpuapp
      - nrf54lm20dk/nrf54lm20a/cpuapp
      - nrf54ls05dk/nrf54ls05b/cpuapp
      - nrf54ls05dk@0.0.0/nrf54ls05b/cpuapp
      - nrf54lv10dk/nrf54lv10a/cpuapp
    tags: ppk_power_measure
    harness: pytest
    harness_config:
      fixture: gpio_loopback
      pytest_root:
        - "${CUSTOM_ROOT_TEST_DIR}/test_measure_power_consumption.py::test_measure_and_data_dump_power_consumption_lpuart"
    timeout: 90
  sample.peripheral.lpuart_int_driven.debug:
    sysbuild: true
    extra_configs:
      - CONFIG_NRF_SW_LPUART_INT_DRIVEN=y
      - CONFIG_ASSERT=y
      - CONFIG_CONSOLE=y
      - CONFIG_UART_CONSOLE=y
      - CONFIG_LOG=y
      - CONFIG_NRF_SW_LPUART_LOG_LEVEL_DBG=y
    integration_platforms:
      - nrf52dk/nrf52832
      - nrf52833dk/nrf52833
      - nrf52840dk/nrf52840
      - nrf9160dk/nrf9160/ns
      - nrf5340dk/nrf5340/cpuapp
      - nrf21540dk/nrf52840
      - nrf54l15dk/nrf54l05/cpuapp
      - nrf54l15dk/nrf54l10/cpuapp
      - nrf54l15dk/nrf54l15/cpuapp
      - nrf54lm20dk/nrf54lm20a/cpuapp
      - nrf54ls05dk/nrf54ls05b/cpuapp
      - nrf54lv10dk/nrf54lv10a/cpuapp
    platform_allow:
      - nrf52dk/nrf52832
      - nrf52833dk/nrf52833
      - nrf52840dk/nrf52840
      - nrf9160dk/nrf9160/ns
      - nrf5340dk/nrf5340/cpuapp
      - nrf21540dk/nrf52840
      - nrf54l15dk/nrf54l05/cpuapp
      - nrf54l15dk/nrf54l10/cpuapp
      - nrf54l15dk/nrf54l15/cpuapp
      - nrf54lm20dk/nrf54lm20a/cpuapp
      - nrf54ls05dk/nrf54ls05b/cpuapp
      - nrf54ls05dk@0.0.0/nrf54ls05b/cpuapp
      - nrf54lv10dk/nrf54lv10a/cpuapp
    harness: console
    harness_config:
      fixture: gpio_loopback
      type: multi_line
      ordered: true
      regex:
        - ".*app: IRQ Tx sent 5 bytes"
        - ".*app: IRQ Received data 5 bytes"
        - ".*app: IRQ Received data 1 bytes"
        - ".*app: IRQ Tx sent 5 bytes"
        - ".*app: IRQ Received data 5 bytes"
        - ".*app: IRQ Received data 1 bytes"
        - ".*app: IRQ Tx sent 5 bytes"
        - ".*app: IRQ Received data 5 bytes"
```

## samples/peripheral/ppi_seq_spi/Kconfig.sysbuild
```kconfig
#
# Copyright (c) 2026 Nordic Semiconductor ASA
#
# SPDX-License-Identifier: LicenseRef-Nordic-5-Clause
#

if SOC_NRF54H20_CPUAPP
choice NETCORE
endchoice
endif # SOC_NRF54H20_CPUAPP
if SUPPORT_PPRCORE
choice PPRCORE
config PPRCORE_REMOTE
	bool "Remote"
	help
	  Include remote image as the PPR core image to use.

endchoice

if !PPRCORE_NONE

config PPRCORE_IMAGE_NAME
	default "remote" if PPRCORE_REMOTE

config PPRCORE_IMAGE_PATH
	default "$(APP_DIR)/remote" if PPRCORE_REMOTE

endif # !PPRCORE_NONE

endif # SUPPORT_PPRCORE

source "share/sysbuild/Kconfig"
```

## samples/peripheral/ppi_seq_spi/sample.yaml
```yaml
sample:
  description: Sample showing PPI sequencer with SPI
  name: SPI PPI sequencer sample

common:
  tags:
    - ci_samples_peripheral_ppi

tests:
  sample.peripheral.ppi_seq_spi:
    harness: console
    harness_config:
      type: multi_line
      ordered: true
      regex:
        - "PPI Sequencer for SPI transfers .+"
        - "PPI sequence completed. Period: 1000, data received:\\d+, callback:\\d+, load:0.\\d%"
    integration_platforms:
      - nrf54h20dk/nrf54h20/cpuapp
      - nrf54l15dk/nrf54l15/cpuapp
    platform_allow:
      - nrf54h20dk/nrf54h20/cpuapp
      - nrf54l15dk/nrf54l15/cpuapp
  sample.peripheral.ppi_seq_spi.ppr:
    harness: console
    harness_config:
      type: multi_line
      ordered: true
      regex:
        - "PPI Sequencer for SPI transfers .+"
        - "PPI sequence completed. Period: 1000, data received:\\d+, callback:\\d+, load:0.\\d%"
    integration_platforms:
      - nrf54h20dk/nrf54h20/cpuapp
    platform_allow:
      - nrf54h20dk/nrf54h20/cpuapp
    extra_args:
      - SB_CONFIG_PPRCORE_REMOTE=y
      - ppi_seq_spi_CONFIG_NRFX_GPPI=y
      - ppi_seq_spi_FILE_SUFFIX=ppr
```
