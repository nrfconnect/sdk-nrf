/*
 * Copyright (c) 2026 Nordic Semiconductor ASA
 *
 * SPDX-License-Identifier: LicenseRef-Nordic-5-Clause
 */

sample_spi: &spi00 {
	compatible = "nordic,ppi-seq-spi";
	status = "okay";
	pinctrl-0 = <&spi00_default>;
	pinctrl-1 = <&spi00_sleep>;
	pinctrl-names = "default", "sleep";
	overrun-character = <0x00>;
	spi-cs-setup-delay-ns = <765>;
	cs-gpios = <&gpio2 5 GPIO_ACTIVE_LOW>;
	frequency = <DT_FREQ_M(8)>;
};
