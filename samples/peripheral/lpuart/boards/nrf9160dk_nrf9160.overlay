/* SPDX-License-Identifier: LicenseRef-Nordic-5-Clause */

&uart1 {
	rx-pin = <10>;
	tx-pin = <11>;
	/delete-property/ rts-pin;
	/delete-property/ cts-pin;

	lpuart: nrf-sw-lpuart {
		compatible = "nordic,nrf-sw-lpuart";
		status = "okay";
		label = "LPUART";
		req-pin = <12>;
		rdy-pin = <13>;
	};
};

&uart0 {
	status = "disabled";
};
