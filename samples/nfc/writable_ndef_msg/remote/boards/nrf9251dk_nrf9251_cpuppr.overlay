/*
 * Copyright (c) 2026 Nordic Semiconductor ASA
 *
 * SPDX-License-Identifier: LicenseRef-Nordic-5-Clause
 */

&nfct {
	status = "okay";
	interrupt-parent = <&cpuppr_clic>;
};

&hfxo {
	status = "okay";
};
