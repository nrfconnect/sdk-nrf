/*
 * Copyright (c) 2024 Nordic Semiconductor ASA
 *
 * SPDX-License-Identifier: LicenseRef-Nordic-5-Clause
 */

/*
 * The sample does not use Buttons 3 and 4.
 * Buttons 3 and 4 in PDK are connected to the GPIO port, which does not support interrupts.
 */

 / {
	aliases {
		/delete-property/ sw2;
		/delete-property/ sw3;
	};
	buttons {
		/delete-node/ button_2;
		/delete-node/ button_3;
	};
};
