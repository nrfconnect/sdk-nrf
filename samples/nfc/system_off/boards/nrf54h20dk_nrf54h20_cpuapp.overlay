/*
 * Copyright (c) 2025 Nordic Semiconductor ASA
 *
 * SPDX-License-Identifier: LicenseRef-Nordic-5-Clause
 */

&uart136 {
	zephyr,pm-device-runtime-auto;
	disable-rx;
};

&nfct {
	status = "okay";
	memory-regions = <&cpuapp_dma_region>;
};
