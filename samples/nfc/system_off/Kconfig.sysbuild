## samples/nfc/system_off/Kconfig.sysbuild
```kconfig
#
# Copyright (c) 2025 Nordic Semiconductor ASA
#
# SPDX-License-Identifier: LicenseRef-Nordic-5-Clause
#

source "share/sysbuild/Kconfig"

config REMOTE_CORE_BOARD
string
	default "nrf54h20dk/nrf54h20/cpurad" if $(BOARD) = "nrf54h20dk"
```

## samples/nfc/system_off/boards/nrf54lm20dk_nrf54lm20a_cpuapp.conf
```kconfig
#
# Copyright (c) 2026 Nordic Semiconductor ASA
#
# SPDX-License-Identifier: LicenseRef-Nordic-5-Clause
#

CONFIG_PM_DEVICE=y
CONFIG_PM_DEVICE_RUNTIME=y
```

## samples/nfc/system_off/sample.yaml
```yaml
sample:
  description: Wake up from system off by NFC field detect sample
  name: NFC System Off
tests:
  sample.nfc.system_off:
    sysbuild: true
    build_only: true
    integration_platforms:
      - nrf52840dk/nrf52840
      - nrf52dk/nrf52832
      - nrf5340dk/nrf5340/cpuapp
      - nrf5340dk/nrf5340/cpuapp/ns
      - nrf54l15dk/nrf54l05/cpuapp
      - nrf54l15dk/nrf54l10/cpuapp
      - nrf54l15dk/nrf54l15/cpuapp
      - nrf54lm20dk/nrf54lm20a/cpuapp
      - nrf54h20dk/nrf54h20/cpuapp
      - nrf7120pdk/nrf7120/cpuapp
    platform_allow:
      - nrf52840dk/nrf52840
      - nrf52dk/nrf52832
      - nrf5340dk/nrf5340/cpuapp
      - nrf5340dk/nrf5340/cpuapp/ns
      - nrf54l15dk/nrf54l05/cpuapp
      - nrf54l15dk/nrf54l10/cpuapp
      - nrf54l15dk/nrf54l15/cpuapp
      - nrf54lm20dk/nrf54lm20a/cpuapp
      - nrf54h20dk/nrf54h20/cpuapp
      - nrf7120pdk/nrf7120/cpuapp
    tags:
      - ci_build
      - sysbuild
      - ci_samples_nfc
```

## samples/nfc/tag_reader/sample.yaml
```yaml
sample:
  description: NFC Tag Reader sample
  name: NFC Tag Reader
tests:
  sample.nfc.tag_reader:
    sysbuild: true
    build_only: true
    integration_platforms:
      - nrf52840dk/nrf52840
      - nrf52dk/nrf52832
      - nrf5340dk/nrf5340/cpuapp
    platform_allow: nrf52840dk/nrf52840 nrf52dk/nrf52832 nrf5340dk/nrf5340/cpuapp
    tags: ci_build sysbuild
```

## samples/nfc/tnep_poller/sample.yaml
```yaml
sample:
  description: TBD
  name: TBD
tests:
  sample.nfc.tnep_poller:
    sysbuild: true
    build_only: true
    integration_platforms:
      - nrf52840dk/nrf52840
      - nrf52dk/nrf52832
      - nrf5340dk/nrf5340/cpuapp
    platform_allow: nrf52840dk/nrf52840 nrf52dk/nrf52832 nrf5340dk/nrf5340/cpuapp
    tags: ci_build sysbuild
```

## samples/nfc/tnep_tag/sample.yaml
```yaml
sample:
  description: TBD
  name: TBD
tests:
  sample.nfc.tnep_tag:
    build_only: true
    integration_platforms:
      - nrf52840dk_nrf52840
      - nrf52dk_nrf52832
      - nrf5340dk_nrf5340_cpuapp
      - nrf5340dk_nrf5340_cpuapp_ns
      - nrf54h20dk_nrf54h20_cpuapp
      - nrf54l15pdk_nrf54l15_cpuapp
    platform_allow: >
      nrf52840dk_nrf52840
      nrf52dk_nrf52832
      nrf5340dk_nrf5340_cpuapp
      nrf5340dk_nrf5340_cpuapp_ns
      nrf54h20dk_nrf54h20_cpuapp
      nrf54l15pdk_nrf54l15_cpuapp
    tags: ci_build
```

## samples/nfc/writable_ndef_msg/sample.yaml
```yaml
sample:
  description: NFC Writable NDEF Message sample
  name: NFC Writable NDEF Message
tests:
  sample.nfc.writable_ndef_msg:
    sysbuild: true
    build_only: true
    integration_platforms:
      - nrf52840dk/nrf52840
      - nrf52dk/nrf52832
      - nrf5340dk/nrf5340/cpuapp
      - nrf5340dk/nrf5340/cpuapp/ns
      - nrf54h20dk/nrf54h20/cpuapp
      - nrf54l15pdk/nrf54l15/cpuapp
    platform_allow: >
      nrf52840dk/nrf52840
      nrf52dk/nrf52832
      nrf5340dk/nrf5340/cpuapp
      nrf5340dk/nrf5340/cpuapp/ns
      nrf54h20dk/nrf54h20/cpuapp
      nrf54l15pdk/nrf54l15/cpuapp
    tags: ci_build sysbuild
```

## samples/nrf5340/empty_app_core/sample.yaml
```yaml
sample:
  description: Minimal Zephyr configuration sample that only suspends CPU.
  name: Empty firmware for application core
tests:
  sample.nrf5340.empty_app_core.build:
    sysbuild: true
    build_only: true
    integration_platforms:
      - nrf5340dk/nrf5340/cpuapp
      - nrf7002dk/nrf5340/cpuapp
    platform_allow: nrf5340dk/nrf5340/cpuapp nrf7002dk/nrf5340/cpuapp
    tags: ci_build sysbuild
```

## samples/nrf5340/empty_net_core/sample.yaml
```yaml
sample:
  description: Minimal configuration sample that works as empty netcore image.
  name: Empty firmware for network core
tests:
  sample.nrf5340.empty_net_core.build:
    sysbuild: true
    build_only: true
    integration_platforms:
      - nrf5340dk/nrf5340/cpunet
      - thingy53/nrf5340/cpunet
    platform_allow: nrf5340dk/nrf5340/cpunet thingy53/nrf5340/cpunet
    tags: ci_build sysbuild
```

## samples/nrf5340/extxip_smp_svr/Kconfig.sysbuild
```kconfig
#
# Copyright (c) 2026 Nordic Semiconductor ASA
#
# SPDX-License-Identifier: LicenseRef-Nordic-5-Clause
#

config PARTITION_MANAGER
	default n

config PM_EXTERNAL_FLASH_MCUBOOT_SECONDARY
	default y if BOARD_NRF5340DK_NRF5340_CPUAPP || BOARD_NRF5340DK_NRF5340_CPUAPP_NS || \
		     BOARD_THINGY53_NRF5340_CPUAPP

source "${ZEPHYR_BASE}/share/sysbuild/Kconfig"
```

## samples/nrf5340/extxip_smp_svr/sample.yaml
```yaml
sample:
  description: Simple Management Protocol sample
  name: smp svr
common:
  sysbuild: true
  harness: console
  harness_config:
    type: one_line
    ordered: true
    regex:
      - "<inf> smp_sample: build time:"
  platform_allow:
    - nrf5340dk/nrf5340/cpuapp
  integration_platforms:
    - nrf5340dk/nrf5340/cpuapp
tests:
  sample.mcumgr.smp_svr.ext_xip:
    platform_allow:
      - thingy53/nrf5340/cpuapp
    integration_platforms:
      - thingy53/nrf5340/cpuapp
  sample.mcumgr.smp_svr.ext_xip.no_network_core:
    platform_allow:
      - thingy53/nrf5340/cpuapp
    integration_platforms:
      - thingy53/nrf5340/cpuapp
    extra_args:
      - FILE_SUFFIX=no_network_core
  sample.mcumgr.smp_svr.ext_xip.no_network_core.directxip:
    platform_allow:
      - thingy53/nrf5340/cpuapp
    integration_platforms:
      - thingy53/nrf5340/cpuapp
    extra_args:
      - FILE_SUFFIX=no_network_core_directxip
```

## samples/nrf5340/extxip_smp_svr/sysbuild/mcuboot/boards/nrf5340dk_nrf5340_cpuapp_minimal.conf
```kconfig
#
# Copyright (c) 2021 Nordic Semiconductor ASA
#
# SPDX-License-Identifier: LicenseRef-Nordic-5-Clause
#

# CC3xx is currently not used for nrf53
CONFIG_HW_CC3XX=n
CONFIG_NRF_CC3XX_PLATFORM=n

# Required for kernel operation
CONFIG_CLOCK_CONTROL=y
CONFIG_SYS_CLOCK_EXISTS=y
```

## samples/nrf5340/multicore/Kconfig
```kconfig
#
# Copyright (c) 2022 Nordic Semiconductor ASA
#
# SPDX-License-Identifier: LicenseRef-Nordic-5-Clause
#

source "Kconfig.zephyr"

config INCLUDE_NET_CORE_IMAGE
	bool "Include net image as sub image"
	depends on SOC_NRF5340_CPUAPP
	default y if (BOARD_NRF5340DK_NRF5340_CPUAPP || BOARD_NRF5340DK_NRF5340_CPUAPP_NS)
	select PARTITION_MANAGER_ENABLED
	select BOARD_ENABLE_CPUNET
```

## samples/nrf5340/multicore/sample.yaml
```yaml
sample:
    name: Child image from source template
    description: Template of application that builds cpunet from sources
tests:
  sample.nrf5340.multicore:
    build_only: true
    platform_allow: nrf5340dk_nrf5340_cpuapp
    integration_platforms:
      - nrf5340dk_nrf5340_cpuapp
    tags: ci_build
```

## samples/nrf5340/multiprotocol_rpmsg/sample.yaml
```yaml
sample:
  description: Allows Zephyr to provide Bluetooth and IEEE 802.15.4 connectivity via
    RPMsg.
  name: Multiprotocol RPMsg
tests:
  sample.nrf5340.multiprotocol_rpmsg.build:
    sysbuild: true
    build_only: true
    integration_platforms:
      - nrf5340dk/nrf5340/cpunet
    platform_allow: nrf5340dk/nrf5340/cpunet
    tags: ci_build sysbuild
```

## samples/nrf5340/netboot/Kconfig
```kconfig
#
# Copyright (c) 2020 Nordic Semiconductor ASA
#
# SPDX-License-Identifier: LicenseRef-Nordic-5-Clause
#

menu "nRF5340 Network Core Bootloader Sample Settings"

config NETBOOT_MIN_PARTITION_SIZE
	bool "Use minimimum partition size"

config B0N_SIZE
	hex
	prompt "Size of the B0n partition."
	default 0x2510 if NETBOOT_MIN_PARTITION_SIZE
	default 0x8510
	help
		Since the locking granularity is 2kB, ensure that B0N_SIZE is
		set such that the size of the `b0n_container` is aligned to this
		size. If the minimal config is enabled the binary will be around
		5kB. Note: The provision partition is 0x2F0 bytes.

endmenu

menu "Zephyr Kernel"
source "Kconfig.zephyr"
endmenu
```

## samples/nrf5340/netboot_deprecated_pm/Kconfig
```kconfig
#
# Copyright (c) 2020 Nordic Semiconductor ASA
#
# SPDX-License-Identifier: LicenseRef-Nordic-5-Clause
#

menu "nRF5340 Network Core Bootloader Sample Settings"

config NETBOOT_MIN_PARTITION_SIZE
	bool "Use minimimum partition size"

config B0N_SIZE
	hex
	prompt "Size of the B0n partition"
	default 0x2580 if PM_PARTITION_SIZE_PROVISION=0x280 && NETBOOT_MIN_PARTITION_SIZE
	default 0x8580 if PM_PARTITION_SIZE_PROVISION=0x280
	default 0x8800
	help
		Since the locking granularity is 2kB, ensure that B0N_SIZE is
		set such that the size of the `b0n_container` is aligned to this
		size. If the minimal config is enabled the binary will be around
		5kB. Note: The provision partition is 0x280 bytes.

endmenu

menu "Zephyr Kernel"
source "Kconfig.zephyr"
endmenu
```

## samples/nrf5340/remote_shell/Kconfig
```kconfig
#
# Copyright (c) 2022 Nordic Semiconductor
#
# SPDX-License-Identifier: LicenseRef-Nordic-5-Clause
#

source "Kconfig.zephyr"

menu "Nordic Remote Shell sample"

config REMOTE_SHELL_TX_RING_BUFFER_SIZE
	int "Set TX ring buffer size"
	default 64
	help
	  If UART is utilizing DMA transfers then increasing ring buffer size
	  increases transfers length and reduces number of interrupts. It is used
	  to collect data from transport medium and passing it to remote shell.

config REMOTE_SHELL_RX_RING_BUFFER_SIZE
	int "Set RX ring buffer size"
	default 64
	help
	  RX ring buffer size, used to collect data received from remote shell and passing
	  them to chosen transport medium.

endmenu
```

## samples/nrf5340/remote_shell/sample.yaml
```yaml
sample:
  description: Remote shell sample based on IPC service shell backend.
  name: Remote IPC shell sample
tests:
  sample.nrf5340.remote_ipc_shell.empty_app_core.build:
    sysbuild: true
    build_only: true
    integration_platforms:
      - nrf5340dk/nrf5340/cpuapp
    platform_allow: nrf5340dk/nrf5340/cpuapp
    tags: ci_build sysbuild
  sample.nrf5340.remote_ipc_shell.uart.build:
    sysbuild: true
    build_only: true
    extra_args: >
      FILE_SUFFIX=uart
    integration_platforms:
      - nrf5340dk/nrf5340/cpuapp
    platform_allow: nrf5340dk/nrf5340/cpuapp
    tags: ci_build sysbuild
```

## samples/nrf54h20/empty_app_core/sample.yaml
```yaml
sample:
  description: Minimal sample used to boot radiocore
  name: Empty firmware for application core (nRF54H20)
tests:
  sample.nrf54h20.empty_app_core.build:
    build_only: true
    integration_platforms:
      - nrf54h20dk/nrf54h20/cpuapp
    platform_allow:
      - nrf54h20dk/nrf54h20/cpuapp
    tags:
      - ci_build
      - ci_samples_nrf54h20
```

## samples/nrf54h20/idle_relocated_tcm/Kconfig.sysbuild
```kconfig
#
# Copyright (c) 2025 Nordic Semiconductor ASA
#
# SPDX-License-Identifier: LicenseRef-Nordic-5-Clause
#

choice NETCORE
	default NETCORE_REMOTE

config NETCORE_REMOTE
	bool "Remote radio"
	help
	  Use remote radio.

endchoice

config NETCORE_IMAGE_NAME
	default "remote" if NETCORE_REMOTE

config NETCORE_IMAGE_PATH
	default "$(ZEPHYR_NRF_MODULE_DIR)/samples/nrf54h20/idle_relocated_tcm/remote" if NETCORE_REMOTE

source "share/sysbuild/Kconfig"
```

## samples/nrf54h20/idle_relocated_tcm/testcase.yaml
```yaml
common:
  sysbuild: true
  tags:
    - ci_build
    - ci_samples_nrf54h20
  harness_config:
    type: multi_line
    ordered: true
    regex:
      - "Multicore idle test on"
      - "Multicore idle test iteration 0"
      - "Multicore idle test iteration 1"

tests:
  benchmarks.multicore.idle_relocated_tcm.nrf54h20dk_cpuapp_cpurad.direct_xip.merged_slot:
    harness: console
    platform_allow:
      - nrf54h20dk/nrf54h20/cpuapp
    integration_platforms:
      - nrf54h20dk/nrf54h20/cpuapp
  benchmarks.multicore.idle_relocated_tcm.nrf54h20dk_cpuapp_cpurad.direct_xip.split_slot:
    harness: console
    platform_allow:
      - nrf54h20dk/nrf54h20/cpuapp
    integration_platforms:
      - nrf54h20dk/nrf54h20/cpuapp
    extra_args:
      - FILE_SUFFIX=split_slot
  benchmarks.multicore.idle_relocated_tcm.nrf54h20dk_cpuapp_cpurad.direct_xip.merged_slot.ironside_se_conf:
    harness: console
    platform_allow:
      - nrf54h20dk/nrf54h20/cpuapp
    integration_platforms:
      - nrf54h20dk/nrf54h20/cpuapp
    extra_args:
      - SB_CONFIG_NCS_MCUBOOT_LOAD_PERIPHCONF=y
      - SB_CONFIG_NCS_MCUBOOT_MPCCONF_STATIC_WRITE_PROTECTION=y
  benchmarks.multicore.idle_relocated_tcm.nrf54h20dk_cpuapp_cpurad.direct_xip.split_slot.ironside_se_conf:
    harness: console
    platform_allow:
      - nrf54h20dk/nrf54h20/cpuapp
    integration_platforms:
      - nrf54h20dk/nrf54h20/cpuapp
    extra_args:
      - FILE_SUFFIX=split_slot
      # Does not currently set SB_CONFIG_NCS_MCUBOOT_MPCCONF_STATIC_WRITE_PROTECTION=y since only
      # two images per slot are supported when using that feature.
      - SB_CONFIG_NCS_MCUBOOT_LOAD_PERIPHCONF=y
```

## samples/nrf54h20/radio_loader/testcase.yaml
```yaml
common:
  sysbuild: true
  tags:
    - ci_build
    - ci_samples_nrf54h20

tests:
  radio_loader.nrf54h20dk_cpurad:
    platform_allow:
      - nrf54h20dk/nrf54h20/cpurad
    integration_platforms:
      - nrf54h20dk/nrf54h20/cpurad
```

## samples/nrf7120/priv_unpriv_access/sample.yaml
```yaml
sample:
  description: Using zephyr to access different privileged level of peripherals
  name: test privileged unprivileged access

tests:
  sample.nrf7120.test_priv_unpriv_access:
    depends_on: gpio
    harness: ztest
    harness_config:
      fixture: gpio_loopback
    integration_platforms:
      - nrf7120dk/nrf7120/cpuapp
    platform_allow:
      - nrf7120dk/nrf7120/cpuapp
    tags:
      - ci_samples_nrf7120
      - ci_build
```
