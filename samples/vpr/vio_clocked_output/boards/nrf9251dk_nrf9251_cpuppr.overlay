/*
 * Copyright (c) 2026 Nordic Semiconductor ASA
 *
 * SPDX-License-Identifier: LicenseRef-Nordic-5-Clause
 */

/* Disable UART while not in use. */
&uart132 {
	disable-rx;
	zephyr,pm-device-runtime-auto;
};
