## CMakeLists.txt
```
# Copyright (c) 2026 Nordic Semiconductor ASA
# SPDX-License-Identifier: LicenseRef-Nordic-5-Clause

cmake_minimum_required(VERSION 3.20.0)

find_package(Zephyr REQUIRED HINTS $ENV{ZEPHYR_BASE})
project(vpr_vio_toggle)

# NORDIC SDK APP START
target_sources(app PRIVATE src/main.c)
# NORDIC SDK APP END
```

## Kconfig
```
# Copyright (c) 2026 Nordic Semiconductor ASA
# SPDX-License-Identifier: LicenseRef-Nordic-5-Clause

menu "VPR VIO sample"

config APP_VIO_PIN
	int "VIO bit index to drive"
	range 0 15
	default 0
	help
	  The VPR VIO pin number that the sample toggles. This must match the physical pin routed to
	  this VPR core in the vpr_launcher devicetree overlay.

config APP_PULSE_HIGH_CYCLES
	int "Pulse HIGH width in core cycles"
	default 4
	help
	  Total number of clock cycles the pin is held high.
	  This can be as low as 1 cycle as that is how long a pin write takes.

config APP_PULSE_LOW_CYCLES
	int "Pulse LOW width in core cycles"
	default 12
	help
	  Total number of clock cycles the pin is held low.
	  This must be at least the 4 cycles needed for the loop and pin write.

endmenu

source "Kconfig.zephyr"
```

## prj.conf
```kconfig
# Copyright (c) 2026 Nordic Semiconductor ASA
# SPDX-License-Identifier: LicenseRef-Nordic-5-Clause
```

## boards/nrf54l15dk_nrf54l15_cpuflpr.conf
```kconfig
# Copyright (c) 2026 Nordic Semiconductor ASA
# SPDX-License-Identifier: LicenseRef-Nordic-5-Clause

# VIO 9 corresponds to GPIO P2.9
CONFIG_APP_VIO_PIN=9

# @128 MHz clock this will create a 8 MHz block wave with 25% duty cycle.
CONFIG_APP_PULSE_HIGH_CYCLES=4
CONFIG_APP_PULSE_LOW_CYCLES=12
```

## boards/nrf9251dk_nrf9251_cpuflpr.conf
```kconfig
# Copyright (c) 2026 Nordic Semiconductor ASA
# SPDX-License-Identifier: LicenseRef-Nordic-5-Clause

# VIO 0 corresponds to GPIO P5.0
CONFIG_APP_VIO_PIN=1

# @256 MHz clock this will create a 16 MHz block wave with 25% duty cycle.
CONFIG_APP_PULSE_HIGH_CYCLES=4
CONFIG_APP_PULSE_LOW_CYCLES=12
```

## boards/nrf9251dk_nrf9251_cpuppr.conf
```kconfig
# Copyright (c) 2026 Nordic Semiconductor ASA
# SPDX-License-Identifier: LicenseRef-Nordic-5-Clause

# VIO 0 corresponds to GPIO P0.0 or P1.6
CONFIG_APP_VIO_PIN=0

# @16 MHz clock this will create a 1 MHz block wave with 25% duty cycle.
CONFIG_APP_PULSE_HIGH_CYCLES=4
CONFIG_APP_PULSE_LOW_CYCLES=12
```

## src/main.c
```c
/*
 * Copyright (c) 2026 Nordic Semiconductor ASA
 *
 * SPDX-License-Identifier: LicenseRef-Nordic-5-Clause
 */

#include <stdio.h>
#include <zephyr/sys/util.h>

#include <hal/nrf_vpr_csr.h>
#include <hal/nrf_vpr_csr_vio.h>
#include <hal/nrf_gpio.h>

#define VIO_MASK BIT(CONFIG_APP_VIO_PIN)

/* Run exactly N nop instructions (N core cycles) inline. */
#define MULTIPLE_NOPS(n) __asm__ volatile(".rept %c0\n\tnop\n.endr\n" : : "i"(n))

/* Fixed in-loop overhead, in core cycles.*/
#define VIO_WRITE_CYCLES     1
#define LOOP_BRANCH_CYCLES   3
#define HIGH_OVERHEAD_CYCLES (VIO_WRITE_CYCLES)
#define LOW_OVERHEAD_CYCLES  (LOOP_BRANCH_CYCLES + VIO_WRITE_CYCLES)

BUILD_ASSERT(CONFIG_APP_PULSE_HIGH_CYCLES >= HIGH_OVERHEAD_CYCLES,
	     "APP_PULSE_HIGH_CYCLES must be >= the fixed HIGH overhead");
BUILD_ASSERT(CONFIG_APP_PULSE_LOW_CYCLES >= LOW_OVERHEAD_CYCLES,
	     "APP_PULSE_LOW_CYCLES must be >= the fixed LOW overhead");

int main(void)
{
	printf("VPR VIO sample on %s: toggling VIO index %d\n", CONFIG_BOARD_TARGET,
	       CONFIG_APP_VIO_PIN);

#if NRF_GPIO_HAS_SEL
	/* On the nRF54L series the FLPR routes the pin to the VPR at runtime.
	 * On SoCs that route pins through the UICR periphconf this is done by the vpr_launcher
	 * devicetree overlay.
	 */
	nrf_gpio_pin_control_select(
		NRF_GPIO_PIN_MAP(CONFIG_APP_TX_GPIO_PORT, CONFIG_APP_TX_GPIO_PIN),
		NRF_GPIO_PIN_SEL_VPR);
#endif

	/* Configure the VIO bit as an output, starting low. */
	nrf_vpr_csr_vio_dir_set(VIO_MASK);
	nrf_vpr_csr_vio_out_set(0);

	/* Prevent any interrupts to disturb the critical timing.*/
	irq_lock();

	while (1) {
		/* High. */
		nrf_vpr_csr_vio_out_set(VIO_MASK);
		MULTIPLE_NOPS(CONFIG_APP_PULSE_HIGH_CYCLES - HIGH_OVERHEAD_CYCLES);

		/* Low. */
		nrf_vpr_csr_vio_out_set(0);
		MULTIPLE_NOPS(CONFIG_APP_PULSE_LOW_CYCLES - LOW_OVERHEAD_CYCLES);
	}

	return 0;
}
```
