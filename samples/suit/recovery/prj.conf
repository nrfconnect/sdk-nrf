## CMakeLists.txt
```
#
# Copyright (c) 2024 Nordic Semiconductor ASA
#
# SPDX-License-Identifier: LicenseRef-Nordic-5-Clause
#

cmake_minimum_required(VERSION 3.20.0)

find_package(Zephyr REQUIRED HINTS $ENV{ZEPHYR_BASE})

project(suit_recovery)

target_sources(app PRIVATE src/main.c)

# This project uses orginal sdk-zephyr C source code
target_include_directories(app PRIVATE $ENV{ZEPHYR_BASE}/samples/subsys/mgmt/mcumgr/smp_svr/src)
target_sources_ifdef(CONFIG_MCUMGR_TRANSPORT_BT app PRIVATE $ENV{ZEPHYR_BASE}/samples/subsys/mgmt/mcumgr/smp_svr/src/bluetooth.c)
```

## Kconfig
```
#
# Copyright (c) 2024 Nordic Semiconductor ASA
#
# SPDX-License-Identifier: LicenseRef-Nordic-5-Clause
#

config SUIT_RECOVERY_EXTMEM
	bool "External memory support for recovery application"
	depends on $(dt_chosen_enabled,extmem-device)
	default y
	select GPIO

if SUIT_RECOVERY_EXTMEM

choice SUIT_DFU_CANDIDATE_PROCESSING_LEVEL
	default SUIT_DFU_CANDIDATE_PROCESSING_PUSH_TO_CACHE

endchoice # SUIT_APP_ENVELOPE_PROCESSING_LEVEL

endif # SUIT_RECOVERY_EXTMEM

source "Kconfig.zephyr"
```

## sysbuild.conf
```
#
# Copyright (c) 2024 Nordic Semiconductor ASA
#
# SPDX-License-Identifier: LicenseRef-Nordic-5-Clause
#

SB_CONFIG_SUIT_ENVELOPE=y

SB_CONFIG_NETCORE_HCI_IPC=y

SB_CONFIG_SUIT_ENVELOPE_ROOT_TEMPLATE_FILENAME="app_recovery_envelope.yaml.jinja2"

# As the root envelope for the recovery firmware is directly responsible
# for the application domain image (not only for managing other manifests)
# it is more convenient to use the name "application" for the artifacts.
SB_CONFIG_SUIT_ENVELOPE_ROOT_ARTIFACT_NAME="application"
```

## prj.conf
```kconfig
#
# Copyright (c) 2024 Nordic Semiconductor ASA
#
# SPDX-License-Identifier: LicenseRef-Nordic-5-Clause
#

# Kconfigs necessary to build the application as a recovery application

CONFIG_SUIT_RECOVERY=y

# It is the main application which is responsible for flashing and generating the UICR
# configuration - the recovery application should not do it.
CONFIG_NRF_REGTOOL_GENERATE_UICR=n
CONFIG_SOC_NRF54H20_GENERATE_BICR=n

############

# Kconfigs needed to provide the recovery application functionality

# Enable mcumgr
CONFIG_NET_BUF=y
CONFIG_ZCBOR=y
CONFIG_ZCBOR_CANONICAL=y
CONFIG_MCUMGR=y
CONFIG_MCUMGR_SMP_LEGACY_RC_BEHAVIOUR=y

# Enable SUIT services
CONFIG_SUIT=y
CONFIG_MGMT_SUITFU=y
CONFIG_FLASH=y

CONFIG_MCUMGR_GRP_OS=y
CONFIG_MGMT_SUITFU_GRP_SUIT=y
CONFIG_MGMT_SUITFU_GRP_SUIT_IMAGE_FETCH=n
CONFIG_MGMT_SUITFU_GRP_IMG=n
CONFIG_MCUMGR_GRP_OS_BOOTLOADER_INFO=y
CONFIG_MCUMGR_GRP_OS_ECHO=n
CONFIG_MCUMGR_GRP_OS_INFO=n

##################
# Bluetooth config

CONFIG_BT=y
CONFIG_BT_PERIPHERAL=y

# Allow for large Bluetooth data packets.
CONFIG_BT_L2CAP_TX_MTU=498
CONFIG_BT_BUF_ACL_RX_SIZE=502
CONFIG_BT_BUF_ACL_TX_SIZE=502

# Enable the Bluetooth mcumgr transport (unauthenticated).
CONFIG_MCUMGR_TRANSPORT_BT=y
CONFIG_MCUMGR_TRANSPORT_BT_PERM_RW=y
CONFIG_MCUMGR_TRANSPORT_BT_CONN_PARAM_CONTROL=y

# Disable SMP over UART
CONFIG_MCUMGR_TRANSPORT_UART=n

# Enable the mcumgr Packet Reassembly feature over Bluetooth and its configuration dependencies.
# MCUmgr buffer size is optimized to fit one SMP packet divided into five Bluetooth Write Commands,
# transmitted with the maximum possible MTU value: 498 bytes.
CONFIG_MCUMGR_TRANSPORT_BT_REASSEMBLY=y
CONFIG_MCUMGR_TRANSPORT_NETBUF_SIZE=2475
CONFIG_MCUMGR_TRANSPORT_WORKQUEUE_STACK_SIZE=4096

CONFIG_BT_DEVICE_NAME="SUIT Recovery"

########

# Disable unneeded drivers, peripherals and features to optimize for size
CONFIG_SIZE_OPTIMIZATIONS=y

# Enable LTO
CONFIG_LTO=y
CONFIG_ISR_TABLES_LOCAL_DECLARATION=y

CONFIG_I2C=n
CONFIG_WATCHDOG=n
CONFIG_SPI=n
CONFIG_GPIO=n
CONFIG_SERIAL=n

CONFIG_FPU=n

CONFIG_BOOT_BANNER=n
CONFIG_NCS_BOOT_BANNER=n
CONFIG_BOOT_DELAY=0

CONFIG_CONSOLE=n
CONFIG_UART_CONSOLE=n
CONFIG_STDOUT_CONSOLE=n
CONFIG_PRINTK=n
CONFIG_EARLY_CONSOLE=n

CONFIG_SOC_FLASH_NRF_RADIO_SYNC_RPC_HOST=y

CONFIG_ARM_MPU=n

CONFIG_TIMESLICING=n
CONFIG_COMMON_LIBC_MALLOC=y
CONFIG_LOG=n
CONFIG_ASSERT=n

CONFIG_BT_HCI_ACL_FLOW_CONTROL=n
CONFIG_BT_HCI_VS=n

CONFIG_BT_DEBUG_NONE=y
CONFIG_BT_ASSERT=n
CONFIG_BT_DATA_LEN_UPDATE=n
CONFIG_BT_PHY_UPDATE=n
CONFIG_BT_GATT_CACHING=n

CONFIG_BT_GATT_ENFORCE_SUBSCRIPTION=n
CONFIG_BT_GATT_READ_MULTIPLE=n
CONFIG_BT_GATT_READ_MULT_VAR_LEN=n
CONFIG_BT_GAP_AUTO_UPDATE_CONN_PARAMS=n

CONFIG_BT_CTLR_PRIVACY=n
CONFIG_BT_CTLR_PHY_2M=n

CONFIG_MBEDTLS_PSA_CRYPTO_LEGACY_RNG=y
```

## boards/nrf54h20dk_nrf54h20_cpuapp.overlay
```dts
/*
 * Copyright (c) 2024 Nordic Semiconductor ASA
 *
 * SPDX-License-Identifier: LicenseRef-Nordic-5-Clause
 */

 / {
	chosen {
		zephyr,code-partition = &cpuapp_recovery_partition;
		nrf,tz-secure-image = &cpuapp_recovery_partition;
	};
};

&cpusec_cpuapp_ipc {
    status = "okay";
};

&cpusec_bellboard {
    status = "okay";
};

/ {
    chosen {
        zephyr,bt-hci-ipc = &ipc0;
    };
};
```

## src/main.c
```c
/*
 * Copyright (c) 2024 Nordic Semiconductor ASA
 *
 * SPDX-License-Identifier: LicenseRef-Nordic-5-Clause
 */

#include <zephyr/kernel.h>
#include <zephyr/sys/printk.h>
#include <nrfs_mram.h>
#include <zephyr/logging/log.h>
#include "common.h"

LOG_MODULE_REGISTER(app);

int main(void)
{
	if (IS_ENABLED(CONFIG_MCUMGR_TRANSPORT_BT)) {
		nrfs_err_t err = nrfs_mram_init(NULL);

		if (err != NRFS_SUCCESS) {
			printk("Unable to initialize MRAM latency service: %d\r\n", err);
		} else {
			err = nrfs_mram_set_latency(MRAM_LATENCY_NOT_ALLOWED, NULL);
			if (err != NRFS_SUCCESS) {
				printk("Unable to disable MRAM auto poweroff: %d\r\n", err);
			}
		}

		start_smp_bluetooth_adverts();
	}

	return 0;
}
```
