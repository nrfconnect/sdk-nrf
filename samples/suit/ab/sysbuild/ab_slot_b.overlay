/*
 * Copyright (c) 2025 Nordic Semiconductor ASA
 *
 * SPDX-License-Identifier: LicenseRef-Nordic-5-Clause
 */

/ {
	aliases {
		suit-active-code-partition = &cpuapp_slot_b_partition;
		suit-inactive-code-partition = &cpuapp_slot_a_partition;
	};

	chosen {
		zephyr,code-partition = &cpuapp_slot_b_partition;
	};
};
