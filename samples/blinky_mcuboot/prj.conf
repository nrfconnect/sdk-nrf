## CMakeLists.txt
```
#
# Copyright (c) 2022 Nordic Semiconductor ASA
#
# SPDX-License-Identifier: LicenseRef-Nordic-5-Clause
#

cmake_minimum_required(VERSION 3.20.0)

find_package(Zephyr REQUIRED HINTS $ENV{ZEPHYR_BASE})
project(app)

target_sources(app PRIVATE src/main.c)
```

## Kconfig
```
#
# Copyright (c) 2022 Nordic Semiconductor ASA
#
# SPDX-License-Identifier: LicenseRef-Nordic-5-Clause
#

source "Kconfig.zephyr"

config INCLUDE_NET_CORE_IMAGE
	bool "Include net image as sub image"
	depends on SOC_NRF5340_CPUAPP
	default y if (BOARD_NRF5340DK_NRF5340_CPUAPP || BOARD_NRF5340DK_NRF5340_CPUAPPNS)
	select BOARD_ENABLE_CPUNET
	select NCS_INCLUDE_BLINKY_CHILD_IMAGE
```

## sample.yaml
```
sample:
  description: Zigbee Blinky sample for upgrading nrf5340 APP+NET 
  name: Zigbee Blinky mcuboot
tests:
  sample.zigbee.shell:
    build_only: true
    sysbuild: false
    integration_platforms:
      - nrf5340dk/nrf5340/cpuapp
      - nrf5340dk/nrf5340/cpuapp/ns
    platform_allow: nrf5340dk/nrf5340/cpuapp nrf5340dk/nrf5340/cpuapp/ns
    tags: ci_build
```

## prj.conf
```kconfig
CONFIG_PRINTK=y
CONFIG_GPIO=y

CONFIG_BOOTLOADER_MCUBOOT=y
CONFIG_MCUBOOT_IMAGE_VERSION="9.9.9"
```

## nrf5340dk_nrf5340_cpuapp.overlay
```dts
/*
 * Copyright (c) 2022 Nordic Semiconductor ASA
 *
 * SPDX-License-Identifier: LicenseRef-Nordic-5-Clause
 */

 / {
	led_gpio_fwd: nrf-gpio-forwarder {
			compatible = "nordic,nrf-gpio-forwarder";
			net-led-gpio-if {
				gpios = <&gpio0 28 0>;
			};
		};
};
```

## src/main.c
```c
/*
 * Copyright (c) 2016 Intel Corporation
 *
 * SPDX-License-Identifier: Apache-2.0
 */

#include <zephyr.h>
#include <drivers/gpio.h>

/* 1000 msec = 1 sec */
#define SLEEP_TIME_MS   1000

/* The devicetree node identifier for the "led0" alias. */
#define LED1_NODE DT_ALIAS(led1)

#if IS_ENABLED(CONFIG_NCS_INCLUDE_BLINKY_CHILD_IMAGE)
#pragma message "We have NCS_INCLUDE_BLINKY_CHILD_IMAGE"
#endif

#if IS_ENABLED(CONFIG_NCS_INCLUDE_RPMSG_CHILD_IMAGE)
#pragma message "We have NCS_INCLUDE_RPMSG_CHILD_IMAGE"
#endif

#if IS_ENABLED(CONFIG_NCS_SAMPLE_BLINKY_CHILD_IMAGE)
#pragma message "We have NCS_SAMPLE_BLINKY_CHILD_IMAGE"
#endif

/*
 * A build error on this line means your board is unsupported.
 * See the sample documentation for information on how to fix this.
 */
static const struct gpio_dt_spec led = GPIO_DT_SPEC_GET(LED1_NODE, gpios);

void main(void)
{
	int ret;

	printk("Hello world from %s\n", CONFIG_BOARD);

	if (!device_is_ready(led.port)) {
		return;
	}

	ret = gpio_pin_configure_dt(&led, GPIO_OUTPUT_ACTIVE);
	if (ret < 0) {
		return;
	}

	while (1) {
		ret = gpio_pin_toggle_dt(&led);
		if (ret < 0) {
			return;
		}
		k_msleep(SLEEP_TIME_MS);
	}
}
```
