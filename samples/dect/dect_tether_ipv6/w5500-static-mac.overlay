/*
 * Copyright (c) 2026 Nordic Semiconductor ASA
 *
 * SPDX-License-Identifier: LicenseRef-Nordic-5-Clause
 */

/*
 * Arceli W5500 with fixed Ethernet MAC (alternative to w5500.overlay).
 *
 * Build: same as the Arceli Ethernet build but use this overlay instead:
 *   -DEXTRA_DTC_OVERLAY_FILE=w5500-static-mac.overlay
 *
 * MAC below is locally administered unicast (U/L bit set). Replace all six octets
 * per unit if several boards share one broadcast domain.
 */

&eth_w5500_arceli_eth_w5500 {
	local-mac-address = [f6 ce 36 04 73 b1];
	/* spi-max-frequency = <24000000>; */
};
