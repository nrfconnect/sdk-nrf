## CMakeLists.txt
```
# Copyright (c) 2025 Nordic Semiconductor ASA
# SPDX-License-Identifier: LicenseRef-Nordic-5-Clause

cmake_minimum_required(VERSION 3.20.0)

find_package(Zephyr REQUIRED HINTS $ENV{ZEPHYR_BASE})
project(secondary)

target_sources(app PRIVATE src/main.c)
```

## prj.conf
```kconfig
#
# Copyright (c) 2025 Nordic Semiconductor ASA
#
# SPDX-License-Identifier: LicenseRef-Nordic-5-Clause
#

CONFIG_IS_IRONSIDE_SE_SECONDARY_IMAGE=y

# Use the devicetree chosen code-partition to determine flash load offset
CONFIG_USE_DT_CODE_PARTITION=y

CONFIG_FLASH=y

# NB: app.overlay sets zephyr,code-partition to secondary_partition
```

## app.overlay
```dts
/*
 * Copyright (c) 2025 Nordic Semiconductor ASA
 *
 * SPDX-License-Identifier: LicenseRef-Nordic-5-Clause
 */

#include "../sysbuild/nrf54h20dk_nrf54h20_memory_map.dtsi"

/ {
	chosen {
		zephyr,code-partition = &secondary_partition;
	};
};
```

## boards/nrf54h20dk_nrf54h20_cpuapp.overlay
```dts
/*
 * Copyright (c) 2025 Nordic Semiconductor ASA
 *
 * SPDX-License-Identifier: LicenseRef-Nordic-5-Clause
 */

#include "../../boards/nrf54h20dk_nrf54h20_cpuapp.overlay"

/ {
	chosen {
		zephyr,code-partition = &secondary_partition;
	};
};
```

## src/main.c
```c
/*
 * Copyright (c) 2025 Nordic Semiconductor ASA.
 *
 * SPDX-License-Identifier: LicenseRef-Nordic-5-Clause
 */

#include <zephyr/kernel.h>
#include <zephyr/sys/printk.h>
#include <zephyr/drivers/flash.h>
#include <zephyr/storage/flash_map.h>
#include <zephyr/arch/cpu.h>
#include <ironside/se/boot_report.h>

#define MRAM_WRITE_BLOCK_SIZE 16
#define ERASE_OFFSET                                                                               \
	(PARTITION_OFFSET(protectedmem_partition) + PARTITION_SIZE(protectedmem_partition) -       \
	 MRAM_WRITE_BLOCK_SIZE)

int main(void)
{
	printk("Secondary: Secondary firmware booted\n");

	const struct ironside_se_boot_report *const report = IRONSIDE_SE_BOOT_REPORT;

	if (report->init_context.boot_reason == IRONSIDE_SE_BOOT_REASON_BOOTERROR) {
		if (report->init_context.trigger_init_status.boot_error ==
		    IRONSIDE_SE_BOOT_ERROR_UICR_PROTECTEDMEM_INTEGRITY_FAILED) {
			printk("Secondary: Booted because of PROTECTEDMEM failure\n");
		} else {
			printk("Secondary: Booted because of unexpected boot error: 0x%x\n",
			       report->init_context.trigger_init_status.boot_error);
		}
	} else {
		printk("Secondary: Booted because of unexpected reason: 0x%x\n",
		       report->init_context.boot_reason);
	}

	printk("Secondary: Reverting test pattern write to protected memory...\n");

	const struct device *flash_dev = PARTITION_DEVICE(protectedmem_partition);
	int rc = flash_erase(flash_dev, ERASE_OFFSET, MRAM_WRITE_BLOCK_SIZE);

	if (rc) {
		printk("Secondary: flash_erase failed: %d\n", rc);
		return rc;
	}

	printk("Secondary: Rebooting after 1s. Primary firmware should boot again since the "
	       "corruption was fixed.\n");

	k_msleep(1000);
	NVIC_SystemReset();

	CODE_UNREACHABLE;

	return 0;
}
```
