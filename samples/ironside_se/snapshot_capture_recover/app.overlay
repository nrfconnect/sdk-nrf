/*
 * Copyright (c) 2026 Nordic Semiconductor ASA
 * SPDX-License-Identifier: LicenseRef-Nordic-5-Clause
 *
 * Partition layout: periphconf is placed right after cpuapp_boot_partition.
 * cpuapp_slot0 is moved to start after periphconf and reduced by 8 KB so the
 * end of the original slot layout is unchanged (hole left where periphconf was).
 */

/delete-node/ &cpuapp_slot0_partition;
/delete-node/ &periphconf_partition;

&mram1x {
	partitions {
		/* cpuapp_boot_partition is at 0x30000, size 64 KB → ends at 0x40000 */
		periphconf_partition: partition@40000 {
			reg = <0x40000 DT_SIZE_K(8)>;
		};

		/* Start after periphconf, reduced by 8 KB so end stays at 0x92000 */
		cpuapp_slot0_partition: partition@42000 {
			reg = <0x42000 DT_SIZE_K(320)>;
		};
	};
};
