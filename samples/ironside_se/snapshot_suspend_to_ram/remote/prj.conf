## CMakeLists.txt
```
#
# Copyright (c) 2026 Nordic Semiconductor ASA
#
# SPDX-License-Identifier: LicenseRef-Nordic-5-Clause
#

cmake_minimum_required(VERSION 3.20.0)

find_package(Zephyr REQUIRED HINTS $ENV{ZEPHYR_BASE})
project(remote)

target_sources(app PRIVATE src/main.c)
```

## prj.conf
```kconfig
# Copyright (c) 2026 Nordic Semiconductor ASA
#
# SPDX-License-Identifier: LicenseRef-Nordic-5-Clause
#
# Empty idle image for the radio core. Mirrors the remote configuration of the
# multicore idle benchmark (s2ram scenario) so the radio core reaches low power.

CONFIG_PM=y
CONFIG_PM_DEVICE=y
CONFIG_PM_DEVICE_RUNTIME_ASYNC=n
CONFIG_POWEROFF=y

CONFIG_CONSOLE=n
CONFIG_UART_CONSOLE=n
CONFIG_SERIAL=n
CONFIG_GPIO=n
CONFIG_BOOT_BANNER=n
CONFIG_NCS_BOOT_BANNER=n
```

## src/main.c
```c
/*
 * Copyright (c) 2026 Nordic Semiconductor ASA
 *
 * SPDX-License-Identifier: LicenseRef-Nordic-5-Clause
 */

#include <zephyr/kernel.h>

/*
 * Idle image for the radio core. It mostly sleeps so the core stays idle,
 * which lets the whole SoC reach low power while the application core is idle.
 *
 * A dedicated image is used instead of the standard empty net-core image
 * (SB_CONFIG_NETCORE_EMPTY, whose main() returns and never runs again) so the
 * core wakes periodically. The periodic wake-up acts as a liveness signal,
 * showing the radio core is still alive rather than hung.
 */
int main(void)
{
	while (1) {
		k_sleep(K_SECONDS(2));
	}

	return 0;
}
```
