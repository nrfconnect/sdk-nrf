## sample.yaml
```
sample:
  name: Secondary Boot Sample
  description: |
    Sample demonstrating secondary application image boot on nRF54H20DK.
    The primary image prints hello world, calls stub functions for UICR
    update and secure domain service to boot the secondary image. The
    secondary image prints its own hello world message.

common:
  sysbuild: true
  harness: console
  harness_config:
    type: multi_line
    regex:
      - "=== Hello World from Primary Image ==="
      - "=== Hello World from Secondary Image ==="

tests:
  samples.secondary_boot.nrf54h20dk:
    tags:
      - sysbuild
      - ci_samples_secondary_boot
    platform_allow:
      - nrf54h20dk/nrf54h20/cpuapp
    integration_platforms:
      - nrf54h20dk/nrf54h20/cpuapp
```

## sysbuild.conf
```
# Copyright (c) 2025 Nordic Semiconductor ASA
# SPDX-License-Identifier: LicenseRef-Nordic-5-Clause

# Select secondary boot image with UICR generation
SB_CONFIG_SECONDARY_BOOT_GEN_UICR=y
```

## prj.conf
```kconfig
#
# Copyright (c) 2025 Nordic Semiconductor ASA
#
# SPDX-License-Identifier: LicenseRef-Nordic-5-Clause
#

# Enable console and UART
CONFIG_CONSOLE=y
CONFIG_UART_CONSOLE=y

# Enable printk
CONFIG_PRINTK=y
```

## src/main.c
```c
/*
 * Copyright (c) 2025 Nordic Semiconductor ASA.
 *
 * SPDX-License-Identifier: LicenseRef-Nordic-5-Clause
 */

#include <zephyr/kernel.h>
#include <zephyr/sys/printk.h>
#include <ironside/se/api.h>
#include <string.h>

int main(void)
{
	int err;

	printk("=== Hello World from Primary Image ===\n");

	printk("Booting secondary image\n");
	err = ironside_se_bootmode_secondary_reboot(NULL, 0);
	if (err != 0) {
		printk("Secondary image boot failed: %d\n", err);
		return err;
	}

	while (1) {
		printk("FAILURE: Primary should not be running - secondary boot failed\n");
		k_msleep(1000);
	}

	return 0;
}
```
