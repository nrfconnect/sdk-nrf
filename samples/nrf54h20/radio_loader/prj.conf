## CMakeLists.txt
```
#
# Copyright (c) 2025 Nordic Semiconductor ASA
#
# SPDX-License-Identifier: LicenseRef-Nordic-5-Clause
#

cmake_minimum_required(VERSION 3.20.0)

find_package(Zephyr REQUIRED HINTS $ENV{ZEPHYR_BASE})

project(radio_loader)

target_sources(app PRIVATE src/main.c)
```

## prj.conf
```kconfig
#
# Copyright (c) 2025 Nordic Semiconductor ASA
#
# SPDX-License-Identifier: LicenseRef-Nordic-5-Clause
#

# ==============================================================================
# Optimized minimal configuration for radio_loader
# ==============================================================================
# This loader only runs SYS_INIT(load_and_jump_to_firmware, EARLY, 0) which:
#   1. Copies firmware from MRAM to TCM using memcpy()
#   2. Jumps to the loaded firmware's reset handler
# No Zephyr services, threading, or drivers are needed.
#
# Memory footprint target: < 4 KB

# ==============================================================================
# Power Management
# ==============================================================================
CONFIG_PM=n
CONFIG_PM_DEVICE=n

# ==============================================================================
# Kernel - Threading Disabled
# ==============================================================================
# We never reach main() or start the scheduler, so disable all threading
CONFIG_MULTITHREADING=n
CONFIG_MAIN_STACK_SIZE=512
CONFIG_THREAD_STACK_INFO=n

# Disable kernel features that require threading/scheduler
CONFIG_EVENTS=n
CONFIG_POLL=n
CONFIG_TIMESLICING=n

# ==============================================================================
# Console, Debug, and Logging
# ==============================================================================
# No console output needed - loader jumps immediately to firmware
CONFIG_CONSOLE=n
CONFIG_UART_CONSOLE=n
CONFIG_SERIAL=n
CONFIG_PRINTK=n
CONFIG_EARLY_CONSOLE=n
CONFIG_LOG=n

# Banners and debug features
CONFIG_NCS_BOOT_BANNER=n
CONFIG_BOOT_BANNER=n
CONFIG_ERRNO=n

# ==============================================================================
# Device Drivers
# ==============================================================================
# No peripheral drivers needed - we only use memcpy and jump
CONFIG_GPIO=n
CONFIG_PINCTRL=n
CONFIG_I2C=n
CONFIG_SPI=n
CONFIG_WATCHDOG=n

# ==============================================================================
# Interrupt Management
# ==============================================================================
CONFIG_DYNAMIC_INTERRUPTS=n
CONFIG_IRQ_OFFLOAD=n
CONFIG_GEN_IRQ_VECTOR_TABLE=n
CONFIG_GEN_ISR_TABLES=n
CONFIG_GEN_SW_ISR_TABLE=n

# ==============================================================================
# Hardware Protection
# ==============================================================================
CONFIG_HW_STACK_PROTECTION=n
CONFIG_ARM_MPU=n

# ==============================================================================
# Security and Crypto
# ==============================================================================
# No crypto needed for simple memory copy operation
CONFIG_PSA_CRYPTO=n

# ==============================================================================
# Memory Optimization
# ==============================================================================
CONFIG_HEAP_MEM_POOL_SIZE=0
CONFIG_SYS_HEAP_RUNTIME_STATS=n

# Use nano printf for minimal footprint (only used if PRINTK somehow gets enabled)
CONFIG_CBPRINTF_NANO=y
```

## app.overlay
```dts
/*
 * Copyright (c) 2025 Nordic Semiconductor ASA
 *
 * SPDX-License-Identifier: LicenseRef-Nordic-5-Clause
 */

/* Use existing node as source partition for demo purposes. */
&cpuapp_slot0_partition {
	reg = <0x52000 DT_SIZE_K(128)>;
};

/* Mock the node labels to satisfy the build */
cpurad_slot2_partition: &cpuapp_slot0_partition {};

cpurad_slot3_partition: &cpuapp_slot0_partition {};
```

## src/main.c
```c
/*
 * Copyright (c) 2025 Nordic Semiconductor ASA
 *
 * SPDX-License-Identifier: LicenseRef-Nordic-5-Clause
 */

#include <zephyr/kernel.h>

#define PARTITION_ADDRESS(label) DT_REG_ADDR(DT_NODELABEL(label))
#define PARTITION_SIZE(label)    DT_REG_SIZE(DT_NODELABEL(label))

#ifdef CONFIG_USE_DT_CODE_PARTITION
#define FLASH_LOAD_ADDRESS DT_REG_ADDR(DT_CHOSEN(zephyr_code_partition))
#elif defined(CONFIG_FLASH_LOAD_OFFSET)
#define FLASH_LOAD_ADDRESS (CONFIG_FLASH_BASE_ADDRESS + CONFIG_FLASH_LOAD_OFFSET)
#endif

#define PARTITION_IS_RUNNING_APP_PARTITION(label)                                                  \
	(DT_REG_ADDR(DT_NODELABEL(label)) <= FLASH_LOAD_ADDRESS &&                                 \
	 DT_REG_ADDR(DT_NODELABEL(label)) + DT_REG_SIZE(DT_NODELABEL(label)) > FLASH_LOAD_ADDRESS)

/* Used to determine the running slot of the radio loader. */
#define RADIO_LOADER_PRIMARY_SLOT	cpurad_slot0_partition
#define RADIO_LOADER_SECONDARY_SLOT	cpurad_slot1_partition

/* Used to determine the loaded firmware source address from NVM and size. */
#define LOADED_FW_PRIMARY_SLOT		cpurad_slot2_partition
#define LOADED_FW_SECONDARY_SLOT	cpurad_slot3_partition

/* Used to determine the running slot of the radio core. */
#define RUNNING_FW_SLOT			cpurad_ram0
#define RUNNING_FW_SLOT_NODE		DT_NODELABEL(RUNNING_FW_SLOT)
#define RUNNING_FW_SLOT_ADDR		DT_REG_ADDR(RUNNING_FW_SLOT_NODE)
#define RUNNING_FW_SLOT_SIZE		DT_REG_SIZE(RUNNING_FW_SLOT_NODE)

BUILD_ASSERT(DT_NODE_EXISTS(DT_NODELABEL(RADIO_LOADER_PRIMARY_SLOT)),
			    "Missing nodelabel: cpurad_slot0_partition");
BUILD_ASSERT(DT_NODE_EXISTS(DT_NODELABEL(RADIO_LOADER_SECONDARY_SLOT)),
			    "Missing nodelabel: cpurad_slot1_partition");

BUILD_ASSERT(DT_NODE_EXISTS(DT_NODELABEL(LOADED_FW_PRIMARY_SLOT)),
			    "Missing nodelabel: cpurad_slot2_partition");
BUILD_ASSERT(DT_NODE_EXISTS(DT_NODELABEL(LOADED_FW_SECONDARY_SLOT)),
			    "Missing nodelabel: cpurad_slot3_partition");
BUILD_ASSERT((PARTITION_SIZE(LOADED_FW_PRIMARY_SLOT) ==
	     PARTITION_SIZE(LOADED_FW_SECONDARY_SLOT)),
	     "LOADED_FW_PRIMARY_SLOT and LOADED_FW_SECONDARY_SLOT sizes are not equal");

BUILD_ASSERT(DT_NODE_EXISTS(DT_NODELABEL(RUNNING_FW_SLOT)),
			    "Missing nodelabel: cpurad_ram0");
BUILD_ASSERT((PARTITION_SIZE(LOADED_FW_PRIMARY_SLOT) <= RUNNING_FW_SLOT_SIZE),
	     "LOADED_FW_PRIMARY_SLOT size exceeds RUNNING_FW_SLOT size");
BUILD_ASSERT((PARTITION_SIZE(LOADED_FW_SECONDARY_SLOT) <= RUNNING_FW_SLOT_SIZE),
	     "LOADED_FW_SECONDARY_SLOT size exceeds RUNNING_FW_SLOT size");

/**
 * @brief Copy firmware from MRAM to TCM and jump to it
 *
 * This function runs as SYS_INIT(EARLY, 0) before main() and the scheduler.
 * It copies the firmware from MRAM to TCM for optimal performance, then
 * transfers execution to the loaded firmware's reset handler.
 *
 * This function never returns - execution transfers to the loaded firmware.
 *
 * @return 0 on success (never reached), -1 on failure (never reached)
 */
static int load_and_jump_to_firmware(void)
{
	/* Get the loaded firmware source address from NVM and size */
	void *loaded_fw_nvm_addr = NULL;
	size_t loaded_fw_nvm_size = 0;

	/* Get the loaded firmware destination address from RAM and size */
	void *loaded_fw_ram_addr = (void *)(RUNNING_FW_SLOT_ADDR);

	if (PARTITION_IS_RUNNING_APP_PARTITION(RADIO_LOADER_PRIMARY_SLOT)) {
		loaded_fw_nvm_addr = (void *)(PARTITION_ADDRESS(LOADED_FW_PRIMARY_SLOT));
		loaded_fw_nvm_size = (size_t)(PARTITION_SIZE(LOADED_FW_PRIMARY_SLOT));
	} else {
		loaded_fw_nvm_addr = (void *)(PARTITION_ADDRESS(LOADED_FW_SECONDARY_SLOT));
		loaded_fw_nvm_size = (size_t)(PARTITION_SIZE(LOADED_FW_SECONDARY_SLOT));
	}

	/* Copy firmware from MRAM to TCM */
	memcpy(loaded_fw_ram_addr, loaded_fw_nvm_addr, loaded_fw_nvm_size);

	/* Extract reset handler from ARM Cortex-M vector table (entry 1) */
	uint32_t *vector_table =
		(uint32_t *)((uint8_t *)loaded_fw_ram_addr + CONFIG_ROM_START_OFFSET);
	typedef void reset_handler_t(void);
	reset_handler_t *reset_handler = (reset_handler_t *)(vector_table[1]);

	/* Jump to loaded firmware - this never returns */
	reset_handler();

	/* Should never reach here */
	return -1;
}

SYS_INIT(load_and_jump_to_firmware, EARLY, 0);

/**
 * @brief Main function - should never be reached
 *
 * If we reach main(), the firmware load and jump failed.
 * This indicates a critical error in the loader.
 */
int main(void)
{
#ifdef CONFIG_PRINTK
	printk("ERROR: Firmware jump failed!\n");
#endif
	while (1) {
		/* Hang here if jump fails */
	}
	return -1;
}
```
