/*
 * Copyright (c) 2025 Nordic Semiconductor ASA
 *
 * SPDX-License-Identifier: LicenseRef-Nordic-5-Clause
 */

#include "../boards/memory_map_split_slot.overlay"

/ {
	chosen {
		zephyr,code-partition = &boot_partition;
	};
};
