/*
 * Copyright (c) 2025 Nordic Semiconductor ASA
 *
 * SPDX-License-Identifier: LicenseRef-Nordic-5-Clause
 */

#include "../../../boards/memory_map.overlay"

/{
	chosen {
		zephyr,code-partition = &cpurad_ram0;
		zephyr,sram = &cpurad_data_ram;
		fw-to-relocate = &cpurad_loaded_fw;
	};
};

&cpurad_ram0 {
	compatible = "mmio-sram";
	/delete-property/ reg;
	reg = < 0x23000000 0x20000 >;
	ranges = < 0x0 0x23000000 0x20000 >;
};
