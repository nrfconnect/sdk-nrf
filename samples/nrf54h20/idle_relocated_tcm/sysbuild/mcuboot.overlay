/*
 * Copyright (c) 2025 Nordic Semiconductor ASA
 *
 * SPDX-License-Identifier: LicenseRef-Nordic-5-Clause
 */

#include "../common/memory_map.dtsi"

/ {
	chosen {
		zephyr,code-partition = &boot_partition;
	};
};
