/*
 * Copyright (c) 2025 Nordic Semiconductor ASA
 *
 * SPDX-License-Identifier: LicenseRef-Nordic-5-Clause
 */

#include "../../../boards/memory_map.overlay"

/{
	chosen {
		zephyr,code-partition = &cpurad_loader_partition;
		zephyr,sram = &cpurad_data_ram;
		zephyr,loaded-fw-src = &cpurad_loaded_fw;
		zephyr,loaded-fw-dst = &cpurad_ram0;
	};
};

&cpurad_ram0 {
	compatible = "mmio-sram";
	/delete-property/ reg;
	reg = < 0x23000000 0x20000 >;
	ranges = < 0x0 0x23000000 0x20000 >;
};

secondary_app_partition: &cpurad_loader_partition_slot1 {};
