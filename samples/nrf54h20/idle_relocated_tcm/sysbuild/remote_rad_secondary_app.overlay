/*
 * Copyright (c) 2025 Nordic Semiconductor ASA
 *
 * SPDX-License-Identifier: LicenseRef-Nordic-5-Clause
 */

#include "../boards/memory_map.overlay"

/{
	chosen {
		fw-to-relocate = &cpurad_loaded_fw_slot1;
	};
};

&cpurad_ram0 {
	compatible = "mmio-sram";
	/delete-property/ reg;
	reg = < 0x23000000 0x20000 >;
	ranges = < 0x0 0x23000000 0x20000 >;
};

secondary_app_partition: &cpurad_ram0 {};
