## sample.yaml
```
sample:
common:
    tags: tfm regression
    platform_allow: nrf5340pdk_nrf5340_cpuappns nrf9160dk_nrf9160ns
    harness: console
    harness_config:
      type: multi_line
      regex:
        - "\\*\\*\\* Non-secure test suites summary \\*\\*\\*"
        - ".*TFM_PS_TEST_1XXX.*PASSED"
        - ".*TFM_ITS_TEST_1XXX.*PASSED"
        - ".*TFM_CRYPTO_TEST_6XXX.*PASSED"
        - ".*TFM_PLATFORM_TEST_2XXX.*PASSED"
        - ".*TFM_ATTEST_TEST_2XXX.*PASSED"
        - ".*TFM_QCBOR_TEST_7XXX.*PASSED"
        - ".*TFM_T_COSE_TEST_8XXX.*PASSED"
        - ".*TFM_IPC_TEST_1XXX.*PASSED"
sample:
  name: "TFM PSA Test"

tests:
  sample.tfm.regression_test:
    timeout: 200
  sample.tfm.regression_test.ipc:
    timeout: 200
    tags: ipc
    extra_args: CONFIG_TFM_IPC=y
  sample.tfm.regression_test.ipc.level2:
    timeout: 200
    tags: level_2
    extra_args: CONFIG_TFM_IPC=y CONFIG_TFM_ISOLATION_LEVEL=2
```

## prj.conf
```kconfig
CONFIG_BUILD_WITH_TFM=y
CONFIG_TFM_REGRESSION=y
CONFIG_TFM_NATIVE_NS=y
```

## app.overlay
```dts
/*
 * Copyright (c) 2020 Nordic Semiconductor ASA
 *
 * SPDX-License-Identifier: LicenseRef-BSD-5-Clause-Nordic
 */

&uart1 {
	status = "disabled";
};
```

## src/main.c
```c
/*
 * Copyright (c) 2012-2014 Wind River Systems, Inc.
 *
 * SPDX-License-Identifier: Apache-2.0
 */

#include <zephyr.h>

void main(void)
{
	/* This code should not run, but rather be replaced with TF-M's native
	   NS app. */
	CODE_UNREACHABLE;
}
```
