/*
 * Copyright (c) 2024 Nordic Semiconductor
 * SPDX-License-Identifier: LicenseRef-Nordic-5-Clause
 */

/* enable PPR peripheral, so application will launch it */
&cpuppr_vpr {
	status = "okay";
};

/* enable RAM30/31, used by PPR */
&cpuppr_ram3x_region {
	status = "okay";
};

/* mark uart135 as reserved, used by PPR */
&uart135 {
	status = "reserved";
};
