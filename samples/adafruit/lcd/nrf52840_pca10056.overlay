/*
 * Copyright (c) 2018 - 2019 Nordic Semiconductor ASA
 *
 * SPDX-License-Identifier: LicenseRef-BSD-5-Clause-Nordic
 */

&spi0 {
	status = "ok";
	sck-pin = <47>;
	mosi-pin = <45>;
	miso-pin = <46>;
};

&i2c1 {
	status = "ok";
	sda-pin = <26>;
	scl-pin = <27>;
};
