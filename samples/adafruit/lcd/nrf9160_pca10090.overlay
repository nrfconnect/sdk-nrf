/*
 * Copyright (c) 2018 - 2019 Nordic Semiconductor ASA
 *
 * SPDX-License-Identifier: LicenseRef-BSD-5-Clause-Nordic
 */

&spi0 {
	status = "ok";
	sck-pin = <13>;
	mosi-pin = <11>;
	miso-pin = <12>;
};

&i2c1 {
	status = "ok";
	sda-pin = <30>;
	scl-pin = <31>;
};
