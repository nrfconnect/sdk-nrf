## CMakeLists.txt
```
#
# Copyright (c) 2024 Nordic Semiconductor ASA
#
# SPDX-License-Identifier: LicenseRef-Nordic-5-Clause
#

cmake_minimum_required(VERSION 3.13.1)

find_package(Zephyr REQUIRED HINTS $ENV{ZEPHYR_BASE})
project(ssf_client_sample)

# NORDIC SDK APP START
target_sources(app PRIVATE src/main.c)
# NORDIC SDK APP END
```

## Kconfig
```
#
# Copyright (c) 2024 Nordic Semiconductor ASA
#
# SPDX-License-Identifier: LicenseRef-Nordic-5-Clause
#

menuconfig SSF_CLIENT_SAMPLE
	bool "SDFW Service Framework Client Sample"
	help
	   "Enable sample-specific configurations."

if SSF_CLIENT_SAMPLE

config ENABLE_ECHO_REQUEST
	bool "Enable SSF dummy request service(s)"
	depends on SSF_ECHO_SERVICE_ENABLED
	default y

config ENABLE_RESET_EVT_SUBSCRIBE_REQUEST
	bool "Enable the reset event subscription service"
	depends on SSF_RESET_EVT_SERVICE_ENABLED
	default y

module = SSF_CLIENT_SAMPLE
module-str = SSF Client Sample
source "${ZEPHYR_BASE}/subsys/logging/Kconfig.template.log_config"

endif # SSF_CLIENT_SAMPLE

source "Kconfig.zephyr"
```

## Kconfig.sysbuild
```
#
# Copyright (c) 2024 Nordic Semiconductor
#
# SPDX-License-Identifier: LicenseRef-Nordic-5-Clause
#

source "${ZEPHYR_BASE}/share/sysbuild/Kconfig"

config BUILD_ALSO_FOR_RADIO_CORE
	bool "Build also for the radio CPU"

config RADIO_BOARD_TARGET_CPUCLUSTER
	string
	depends on BUILD_ALSO_FOR_RADIO_CORE
	default "cpurad" if SOC_NRF54H20_CPUAPP || SOC_NRF9280_CPUAPP
```

## sample.yaml
```
sample:
  name: SSF Client Sample
  description: |
    Sample demonstrating how to build application with sdfw service framework
    enabled and how to request services from secure domain.

common:
  build_only: true
  tags:

    - ci_build
    - ci_samples_sdfw
tests:
  samples.sdfw.ssf_client:
    sysbuild: true
    tags:
      - sysbuild
      - ci_samples_sdfw
    platform_allow:
      - nrf54h20dk/nrf54h20/cpuapp
      - nrf54h20dk/nrf54h20/cpurad
      - nrf9280pdk/nrf9280/cpuapp
      - nrf9280pdk/nrf9280/cpurad
    integration_platforms:
      - nrf54h20dk/nrf54h20/cpuapp
      - nrf54h20dk/nrf54h20/cpurad
      - nrf9280pdk/nrf9280/cpuapp
      - nrf9280pdk/nrf9280/cpurad
  samples.sdfw.ssf_client.logging.uart:
    sysbuild: true
    tags:
      - sysbuild
      - ci_samples_sdfw
    platform_allow:
      - nrf54h20dk/nrf54h20/cpuapp
      - nrf54h20dk/nrf54h20/cpurad
      - nrf9280pdk/nrf9280/cpuapp
      - nrf9280pdk/nrf9280/cpurad
    integration_platforms:
      - nrf54h20dk/nrf54h20/cpuapp
      - nrf54h20dk/nrf54h20/cpurad
      - nrf9280pdk/nrf9280/cpuapp
      - nrf9280pdk/nrf9280/cpurad
    extra_args: EXTRA_CONF_FILE=uart_logging.conf
```

## prj.conf
```kconfig
CONFIG_SSF_CLIENT_SAMPLE=y
```

## boards/nrf54h20dk_nrf54h20_cpurad.overlay
```dts
/*
 * Copyright (c) 2024 Nordic Semiconductor ASA
 *
 * SPDX-License-Identifier: LicenseRef-Nordic-5-Clause
 */

&cpusec_cpurad_ipc {
	status = "okay";
};

&cpurad_ram0x_region {
	status = "okay";
};

&cpusec_bellboard {
	status = "okay";
};
```

## src/main.c
```c
/*
 * Copyright (c) 2024 Nordic Semiconductor ASA.
 *
 * SPDX-License-Identifier: LicenseRef-Nordic-5-Clause
 */

#include <sdfw/sdfw_services/echo_service.h>
#include <sdfw/sdfw_services/reset_evt_service.h>

#include <zephyr/logging/log.h>
LOG_MODULE_REGISTER(ssf_client_sample, CONFIG_SSF_CLIENT_SAMPLE_LOG_LEVEL);

static void echo_request(void)
{
	int err;
	char req_str[] = "Hello " CONFIG_BOARD;
	char rsp_str[sizeof(req_str) + 1];

	LOG_INF("Calling ssf_echo, str: \"%s\"", req_str);

	err = ssf_echo(req_str, rsp_str, sizeof(rsp_str));
	if (err != 0) {
		LOG_ERR("ssf_echo failed");
	} else {
		LOG_INF("ssf_echo response: %s", rsp_str);
	}
}

static int reset_evt_callback(uint32_t domains, uint32_t delay_ms, void *user_data)
{
	LOG_INF("reset_evt: domains 0x%x will reset in %d ms", domains, delay_ms);

	return 0;
}

static void reset_evt_subscribe(void)
{
	int err;

	err = ssf_reset_evt_subscribe(reset_evt_callback, NULL);
	if (err != 0) {
		LOG_ERR("Unable to subscribe to reset_evt, err: %d", err);
		return;
	}
}

int main(void)
{
	LOG_INF("ssf client sample (%s)", CONFIG_BOARD);

	if (IS_ENABLED(CONFIG_ENABLE_ECHO_REQUEST)) {
		echo_request();
	}

	if (IS_ENABLED(CONFIG_ENABLE_RESET_EVT_SUBSCRIBE_REQUEST)) {
		reset_evt_subscribe();
	}

	return 0;
}
```
