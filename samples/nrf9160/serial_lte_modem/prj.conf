## CMakeLists.txt
```
#
# Copyright (c) 2019 Nordic Semiconductor
#
# SPDX-License-Identifier: LicenseRef-BSD-5-Clause-Nordic
#

cmake_minimum_required(VERSION 3.8.2)

# This sample runs as a non-secure application on nRF91. Therefore, it
# requires the secure_partition_manager that prepares the required
# peripherals to be available for the application.
#
# Configure the SPM image to enable the peripherals that this sample
# needs.
set(spm_CONF_FILE
  prj.conf
  ${CMAKE_CURRENT_LIST_DIR}/child_secure_partition_manager.conf
  )
include($ENV{ZEPHYR_BASE}/../nrf/cmake/boilerplate.cmake)
find_package(Zephyr REQUIRED HINTS $ENV{ZEPHYR_BASE})
project(serial_lte_modem)

target_sources(app PRIVATE src/main.c)
target_sources(app PRIVATE src/slm_util.c)
target_sources(app PRIVATE src/slm_at_host.c)
target_sources(app PRIVATE src/slm_at_tcpip.c)
target_sources(app PRIVATE src/slm_at_icmp.c)
target_sources(app PRIVATE src/slm_at_gps.c)
target_sources(app PRIVATE src/slm_at_mqtt.c)
target_sources(app PRIVATE src/slm_at_ftp.c)

add_subdirectory(src/tcpip_proxy)

zephyr_include_directories(src)
```

## Kconfig
```
#
# Copyright (c) 2019 Nordic Semiconductor
#
# SPDX-License-Identifier: LicenseRef-BSD-5-Clause-Nordic
#

source "Kconfig.zephyr"

menu "Nordic Serial LTE Modem"

config SLM_AT_MODE
	bool "Serial LTE Modem by raw AT mode"
	default y
	select AT_CMD
	select AT_NOTIF
	select AT_CMD_PARSER
	select MODEM_INFO
	select MQTT_LIB
	select MQTT_LIB_TLS
	select FTP_CLIENT

config SLM_AT_MAX_PARAM
	int "Max number of parameters in AT command"
	default 8

#
# Inter-Connect
#
choice
	prompt "UART for Interconnect"
	default SLM_CONNECT_UART_0
	help
		Sets the UART to use for interconnect
		-  UART 0
		-  UART 2
	config SLM_CONNECT_UART_0
		bool "UART 0"
	  select UART_0_NRF_HW_ASYNC
	config SLM_CONNECT_UART_2
		bool "UART 2"
	  select UART_2_NRF_UARTE
	  select UART_2_NRF_HW_ASYNC
	  select UART_2_NRF_FLOW_CONTROL
endchoice

choice
	prompt "Termination Mode"
	default SLM_CR_LF_TERMINATION
	help
		Sets the termination ending from the serial terminal
		Levels are:
		-  NULL Termination
		-  CR Termination
		-  LF Termination
		-  CR+LF Termination
	config SLM_NULL_TERMINATION
		bool "NULL Termination"
	config SLM_CR_TERMINATION
		bool "CR Termination"
	config SLM_LF_TERMINATION
		bool "LF Termination"
	config SLM_CR_LF_TERMINATION
		bool "CR+LF Termination"
endchoice

config SLM_AT_HOST_TERMINATION
	int
	default 0 if SLM_NULL_TERMINATION
	default 1 if SLM_CR_TERMINATION
	default 2 if SLM_LF_TERMINATION
	default 3 if SLM_CR_LF_TERMINATION

#
# GPIO wakeup
#
config SLM_GPIO_WAKEUP
	bool "Support of GPIO wakeup"
	help
	  Enable GPIO wakeup on nRF9160 side

config SLM_INTERFACE_PIN
	int "Interface GPIO to wake up or exit idle"
	default 6 if SLM_CONNECT_UART_0
	default 31 if SLM_CONNECT_UART_2

#
# A-GPS
#
config SLM_SUPL_SERVER
	string "SUPL server"
	default "supl.google.com"

config SLM_SUPL_PORT
	int "SUPL server port"
	default 7276

#
# FTP
#
config SLM_FTP_SERVER_PORT
	int "FTP service port on remote host"
	default 21

config SLM_FTP_USER_ANONYMOUS
	string "FTP client login user Anonymous"
	default "anonymous"
	help
	  Define the user name for anonymous login.

config SLM_FTP_PASSWORD_ANONYMOUS
	string "FTP client login password for user Anonymous"
	default "anonymous@example.com"
	help
	  Define the password for anonymous login.

rsource "src/tcpip_proxy/Kconfig"

module = SLM
module-str = serial modem
source "${ZEPHYR_BASE}/subsys/logging/Kconfig.template.log_config"

endmenu
```

## sample.yaml
```
sample:
  name: serial lte modem sample
tests:
  test_build:
    build_only: true
    build_on_all: true
    platform_whitelist: nrf9160dk_nrf9160ns
    tags: ci_build
```

## prj.conf
```kconfig
#
# Copyright (c) 2019 Nordic Semiconductor ASA
#
# SPDX-License-Identifier: LicenseRef-BSD-5-Clause-Nordic
#
# General config
CONFIG_LOG=y
CONFIG_LOG_DEFAULT_LEVEL=3
CONFIG_STACK_SENTINEL=y
CONFIG_NEWLIB_LIBC=y
CONFIG_NEWLIB_LIBC_FLOAT_PRINTF=y

# Segger RTT
CONFIG_USE_SEGGER_RTT=y
CONFIG_RTT_CONSOLE=y
CONFIG_UART_CONSOLE=n
CONFIG_LOG_BACKEND_RTT=y
CONFIG_LOG_BACKEND_UART=n

# Network
CONFIG_NETWORKING=y
CONFIG_NET_SOCKETS=y
CONFIG_NET_NATIVE=n

# BSD library
CONFIG_BSD_LIBRARY=y
# Enable below for modem trace
#CONFIG_BSD_LIBRARY_TRACE_ENABLED=y

# Use GPIO
CONFIG_GPIO=y
CONFIG_GPIO_NRFX=y
CONFIG_GPIO_NRF_P0=y

# UART interface
CONFIG_SERIAL=y
CONFIG_UART_ASYNC_API=y
CONFIG_NRFX_TIMER2=y

# LTE link control
CONFIG_LTE_LINK_CONTROL=y
CONFIG_LTE_AUTO_INIT_AND_CONNECT=n

# Stacks and heaps
CONFIG_MAIN_STACK_SIZE=4096
CONFIG_HEAP_MEM_POOL_SIZE=16384
CONFIG_SYSTEM_WORKQUEUE_STACK_SIZE=8192

# AT_CMD
# Enable AT_CMD debug for details
#CONFIG_AT_CMD_LOG_LEVEL_DBG=y

# Device power management
CONFIG_DEVICE_POWER_MANAGEMENT=y

# Enable SUPL client support
#CONFIG_SUPL_CLIENT_LIB=y

# Application-specific
CONFIG_SLM_LOG_LEVEL_INF=y
# Enable GPIO wakeup if sleep is expected
#CONFIG_SLM_GPIO_WAKEUP=y
# Use UART_0 (when working with PC terminal)
CONFIG_UART_0_NRF_HW_ASYNC_TIMER=2
# Use UART_2 (when working with external MCU)
#CONFIG_SLM_CONNECT_UART_2=y
#CONFIG_UART_2_NRF_HW_ASYNC_TIMER=2
# Use optional TCP/TLS Proxy
#CONFIG_SLM_TCP_PROXY=y
# Use optional UDP/DTLS Proxy
#CONFIG_SLM_UDP_PROXY=y
```

## child_secure_partition_manager.conf
```kconfig
#
# Copyright (c) 2019 Nordic Semiconductor ASA
#
# SPDX-License-Identifier: LicenseRef-BSD-5-Clause-Nordic
#

# Set UARTE2 as non-secure, used for serial modem protocol
CONFIG_SPM_NRF_UARTE2_NS=y

# Set REGULATORS as non-secure, used for sleep/wakeup
CONFIG_SPM_NRF_REGULATORS_NS=y

# Enable below for power saving
CONFIG_SERIAL=n
CONFIG_CONSOLE=n
CONFIG_UART_CONSOLE=n
CONFIG_LOG=n
CONFIG_LOG_BACKEND_UART=n
```

## overlay-rtt.conf
```kconfig
#
# Copyright (c) 2019 Nordic Semiconductor ASA
#
# SPDX-License-Identifier: LicenseRef-BSD-5-Clause-Nordic
#

# Segger RTT
CONFIG_USE_SEGGER_RTT=y
CONFIG_RTT_CONSOLE=y
CONFIG_UART_CONSOLE=n
CONFIG_LOG_BACKEND_RTT=y
CONFIG_LOG_BACKEND_UART=n
```

## nrf9160_pca10090ns.overlay
```dts
&uart2 {
	current-speed = <115200>;
	status = "okay";
	tx-pin = <10>;
	rx-pin = <11>;
	rts-pin = <12>;
	cts-pin = <13>;
};
```

## src/main.c
```c
/*
 * Copyright (c) 2019 Nordic Semiconductor ASA
 *
 * SPDX-License-Identifier: LicenseRef-BSD-5-Clause-Nordic
 */
#include <logging/log.h>

#include <zephyr.h>
#include <stdio.h>
#include <drivers/uart.h>
#include <drivers/gpio.h>
#include <string.h>
#include <bsd.h>
#include <modem/lte_lc.h>
#include <hal/nrf_gpio.h>
#include <hal/nrf_power.h>
#include <hal/nrf_regulators.h>
#include <modem/modem_info.h>
#include "slm_at_host.h"

LOG_MODULE_REGISTER(app, CONFIG_SLM_LOG_LEVEL);

#define SLM_WQ_STACK_SIZE	KB(2)
#define SLM_WQ_PRIORITY		K_LOWEST_APPLICATION_THREAD_PRIO
static K_THREAD_STACK_DEFINE(slm_wq_stack_area, SLM_WQ_STACK_SIZE);

static struct device *gpio_dev;
static struct gpio_callback gpio_cb;
static struct k_work exit_idle_work;

/* global variable used across different files */
struct at_param_list at_param_list;
struct modem_param_info modem_param;
char rsp_buf[CONFIG_AT_CMD_RESPONSE_MAX_LEN];
struct k_work_q slm_work_q;

/**@brief Recoverable BSD library error. */
void bsd_recoverable_error_handler(uint32_t err)
{
	LOG_ERR("bsdlib recoverable error: %u", err);
}

static void exit_idle(struct k_work *work)
{
	int err;

	LOG_INF("Exit Idle");
	gpio_pin_interrupt_configure(gpio_dev, CONFIG_SLM_INTERFACE_PIN,
				     GPIO_INT_DISABLE);
	gpio_remove_callback(gpio_dev, &gpio_cb);
	/* Do the same as nrf_gpio_cfg_default() */
	gpio_pin_configure(gpio_dev, CONFIG_SLM_INTERFACE_PIN, GPIO_INPUT);
	/* Restart SLM services */
	err = slm_at_host_init();
	if (err) {
		LOG_ERR("Failed to init at_host: %d", err);
	}
}

static void gpio_callback(struct device *dev,
		     struct gpio_callback *gpio_cb, u32_t pins)
{
	k_work_submit_to_queue(&slm_work_q, &exit_idle_work);
}

void enter_idle(void)
{
	int err;

	gpio_dev = device_get_binding(DT_LABEL(DT_NODELABEL(gpio0)));
	if (gpio_dev == NULL) {
		LOG_ERR("GPIO_0 bind error");
		return;
	}
	err = gpio_pin_configure(gpio_dev, CONFIG_SLM_INTERFACE_PIN,
				GPIO_INPUT | GPIO_PULL_UP);
	if (err) {
		LOG_ERR("GPIO_0 config error: %d", err);
		return;
	}
	gpio_init_callback(&gpio_cb, gpio_callback,
			BIT(CONFIG_SLM_INTERFACE_PIN));
	err = gpio_add_callback(gpio_dev, &gpio_cb);
	if (err) {
		LOG_ERR("GPIO_0 add callback error: %d", err);
		return;
	}
	err = gpio_pin_interrupt_configure(gpio_dev, CONFIG_SLM_INTERFACE_PIN,
					   GPIO_INT_LEVEL_LOW);
	if (err) {
		LOG_ERR("GPIO_0 enable callback error: %d", err);
	}
}

void enter_sleep(void)
{
#if defined(CONFIG_SLM_GPIO_WAKEUP)
	/*
	 * Due to errata 4, Always configure PIN_CNF[n].INPUT before
	 *  PIN_CNF[n].SENSE.
	 */
	nrf_gpio_cfg_input(CONFIG_SLM_INTERFACE_PIN,
		NRF_GPIO_PIN_PULLUP);
	nrf_gpio_cfg_sense_set(CONFIG_SLM_INTERFACE_PIN,
		NRF_GPIO_PIN_SENSE_LOW);
#endif	/* CONFIG_SLM_GPIO_WAKEUP */

	/*
	 * The LTE modem also needs to be stopped by issuing a command
	 * through the modem API, before entering System OFF mode.
	 * Once the command is issued, one should wait for the modem
	 * to respond that it actually has stopped as there may be a
	 * delay until modem is disconnected from the network.
	 * Refer to https://infocenter.nordicsemi.com/topic/ps_nrf9160/
	 * pmu.html?cp=2_0_0_4_0_0_1#system_off_mode
	 */
	lte_lc_power_off();
	bsd_shutdown();
	nrf_regulators_system_off(NRF_REGULATORS_NS);
}

void start_execute(void)
{
	int err;

	LOG_INF("Serial LTE Modem");

	err = modem_info_init();
	if (err) {
		LOG_ERR("Modem info could not be established: %d", err);
		return;
	}

	modem_info_params_init(&modem_param);

	/* Initialize AT Parser */
	err = at_params_list_init(&at_param_list, CONFIG_SLM_AT_MAX_PARAM);
	if (err) {
		LOG_ERR("Failed to init AT Parser: %d", err);
		return;
	}

	err = slm_at_host_init();
	if (err) {
		LOG_ERR("Failed to init at_host: %d", err);
		return;
	}

	k_work_q_start(&slm_work_q, slm_wq_stack_area,
		K_THREAD_STACK_SIZEOF(slm_wq_stack_area), SLM_WQ_PRIORITY);
	k_work_init(&exit_idle_work, exit_idle);
}

#if defined(CONFIG_SLM_GPIO_WAKEUP)
void main(void)
{
	u32_t rr = nrf_power_resetreas_get(NRF_POWER_NS);

	LOG_DBG("RR: 0x%08x", rr);
	if (rr & NRF_POWER_RESETREAS_OFF_MASK) {
		nrf_power_resetreas_clear(NRF_POWER_NS, 0x70017);
		start_execute();
	} else {
		LOG_INF("Sleep");
		enter_sleep();
	}
}
#else
void main(void)
{
	start_execute();
}
#endif	/* CONFIG_SLM_GPIO_WAKEUP */
```

## src/slm_at_ftp.c
```c
/*
 * Copyright (c) 2020 Nordic Semiconductor ASA
 *
 * SPDX-License-Identifier: LicenseRef-BSD-5-Clause-Nordic
 */
#include <logging/log.h>
#include <zephyr.h>
#include <stdio.h>
#include <string.h>
#include <net/tls_credentials.h>
#include <net/net_ip.h>
#include <net/ftp_client.h>
#include "slm_util.h"
#include "slm_at_host.h"
#include "slm_at_ftp.h"

LOG_MODULE_REGISTER(ftp, CONFIG_SLM_LOG_LEVEL);

#define INVALID_SEC_TAG		-1
#define FTP_MAX_HOSTNAME	64
#define FTP_MAX_USERNAME	32
#define FTP_MAX_PASSWORD	32
#define FTP_MAX_OPTION		32
#define FTP_MAX_FILEPATH	128

#define AT_FTP_STR		"AT#XFTP"

/*
 * Known limitation in this version
 */

/**@brief Socketopt operations. */
enum slm_ftp_operation {
	/* FTP Session Management */
	FTP_OP_CLOSE,
	FTP_OP_OPEN,
	FTP_OP_STATUS,
	FTP_OP_ASCII,
	FTP_OP_BINARY,
	FTP_OP_CLEAR,
	/* FTP Directory Operation */
	FTP_OP_PWD,
	FTP_OP_LS,
	FTP_OP_CD,
	FTP_OP_MKDIR,
	FTP_OP_RMDIR,
	/* FTP File Operation */
	FTP_OP_RENAME,
	FTP_OP_DELETE,
	FTP_OP_GET,
	FTP_OP_PUT,
	FTP_OP_MAX
};

typedef int (*ftp_op_handler_t) (void);

typedef struct ftp_op_list {
	u8_t op_code;
	char *op_str;
	ftp_op_handler_t handler;
} ftp_op_list_t;

/** forward declaration of cmd handlers **/
static int do_ftp_open(void);
static int do_ftp_status(void);
static int do_ftp_ascii(void);
static int do_ftp_binary(void);
static int do_ftp_close(void);

static int do_ftp_pwd(void);
static int do_ftp_ls(void);
static int do_ftp_cd(void);
static int do_ftp_mkdir(void);
static int do_ftp_rmdir(void);

static int do_ftp_rename(void);
static int do_ftp_delete(void);
static int do_ftp_get(void);
static int do_ftp_put(void);

/**@brief SLM AT Command list type. */
static ftp_op_list_t ftp_op_list[FTP_OP_MAX] = {
	{FTP_OP_CLOSE, "close", do_ftp_close},
	{FTP_OP_OPEN, "open", do_ftp_open},
	{FTP_OP_STATUS, "status", do_ftp_status},
	{FTP_OP_ASCII, "ascii", do_ftp_ascii},
	{FTP_OP_BINARY, "binary", do_ftp_binary},
	{FTP_OP_PWD, "pwd", do_ftp_pwd},
	{FTP_OP_CD, "cd", do_ftp_cd},
	{FTP_OP_LS, "ls", do_ftp_ls},
	{FTP_OP_MKDIR, "mkdir", do_ftp_mkdir},
	{FTP_OP_RMDIR, "rmdir", do_ftp_rmdir},
	{FTP_OP_RENAME, "rename", do_ftp_rename},
	{FTP_OP_DELETE, "delete", do_ftp_delete},
	{FTP_OP_GET, "get", do_ftp_get},
	{FTP_OP_PUT, "put", do_ftp_put},
};

/* global functions defined in different files */
void rsp_send(const u8_t *str, size_t len);

/* global variable defined in different files */
extern struct at_param_list at_param_list;
extern char rsp_buf[CONFIG_AT_CMD_RESPONSE_MAX_LEN];
extern struct k_work_q slm_work_q;

void ftp_ctrl_callback(const u8_t *msg, u16_t len)
{
	rsp_send((u8_t *)msg, len);
}

void ftp_data_callback(const u8_t *msg, u16_t len)
{
	if (slm_util_hex_check((u8_t *)msg, len)) {
		int ret;
		int size = len * 2;

		ret = slm_util_htoa(msg, len, rsp_buf, size);
		if (ret > 0) {
			rsp_send(rsp_buf, ret);
		} else {
			LOG_WRN("hex convert error: %d", ret);
		}
	} else {
		rsp_send((u8_t *)msg, len);
	}
}

/* AT#XFTP="open",<username>,<password>,<hostname>[,<port>[,<sec_tag>]] */
/* similar to ftp://<user>:<password>@<host>:<port> */
static int do_ftp_open(void)
{
	int ret = 0;
	char username[FTP_MAX_USERNAME];
	int sz_username = FTP_MAX_USERNAME;
	char password[FTP_MAX_PASSWORD];
	int sz_password = FTP_MAX_PASSWORD;
	char hostname[FTP_MAX_HOSTNAME];
	int sz_hostname = FTP_MAX_HOSTNAME;
	u16_t port = CONFIG_SLM_FTP_SERVER_PORT;
	sec_tag_t sec_tag = INVALID_SEC_TAG;
	int param_count;

	/* Parse AT command */
	param_count = at_params_valid_count_get(&at_param_list);
	if (param_count < 5) {
		return -EINVAL;
	}
	memset(username, 0x00, sz_username); /* Important for optional params*/
	ret = at_params_string_get(&at_param_list, 2, username, &sz_username);
	if (ret || strlen(username) == 0) {
		memcpy(username, CONFIG_SLM_FTP_USER_ANONYMOUS,
			sizeof(CONFIG_SLM_FTP_USER_ANONYMOUS) - 1);
		memcpy(password, CONFIG_SLM_FTP_PASSWORD_ANONYMOUS,
			sizeof(CONFIG_SLM_FTP_PASSWORD_ANONYMOUS) - 1);
	} else {
		username[sz_username] = '\0';
		ret = at_params_string_get(&at_param_list, 3, password,
					&sz_password);
		if (ret) {
			return -EINVAL;
		}
		password[sz_password] = '\0';
	}
	ret = at_params_string_get(&at_param_list, 4, hostname, &sz_hostname);
	if (ret) {
		return ret;
	}
	hostname[sz_hostname] = '\0';
	if (param_count > 5) {
		ret = at_params_short_get(&at_param_list, 5, &port);
		if (ret) {
			return ret;
		}
	}
	if (param_count > 6) {
		ret = at_params_int_get(&at_param_list, 6, &sec_tag);
		if (ret) {
			return ret;
		}
	}

	/* FTP open */
	ret = ftp_open(hostname, port, sec_tag);
	if (ret != FTP_CODE_200) {
		return -ENETUNREACH;
	}

	/* FTP login */
	ret = ftp_login(username, password);
	if (ret != FTP_CODE_230) {
		return -EACCES;
	}

	return 0;
}

/* AT#XFTP="close" */
static int do_ftp_close(void)
{
	int ret = ftp_close();

	return (ret == FTP_CODE_221) ? 0 : -1;
}

/* AT#XFTP="status" */
static int do_ftp_status(void)
{
	int ret = ftp_status();

	return (ret == FTP_CODE_211) ? 0 : -1;
}

/* AT#XFTP="ascii" */
static int do_ftp_ascii(void)
{
	int ret = ftp_type(FTP_TYPE_ASCII);

	return (ret == FTP_CODE_200) ? 0 : -1;
}

/* AT#XFTP="binary" */
static int do_ftp_binary(void)
{
	int ret = ftp_type(FTP_TYPE_BINARY);

	return (ret == FTP_CODE_200) ? 0 : -1;
}

/* AT#XFTP="pwd" */
static int do_ftp_pwd(void)
{
	int ret = ftp_pwd();

	return (ret == FTP_CODE_257) ? 0 : -1;
}

/* AT#XFTP="ls"[,<options>[,<folder>]] */
static int do_ftp_ls(void)
{
	int ret;
	char options[FTP_MAX_OPTION];
	int sz_options = FTP_MAX_OPTION;
	char target[FTP_MAX_FILEPATH];
	int sz_target = FTP_MAX_FILEPATH;
	int param_count;

	memset(options, 0x00, sz_options);
	memset(target, 0x00, sz_target);
	/* Parse AT command */
	param_count = at_params_valid_count_get(&at_param_list);
	if (param_count > 2) {
		ret = at_params_string_get(&at_param_list, 2,
				options, &sz_options);
		if (ret) {
			return ret;
		}
		options[sz_options] = '\0';
	}
	if (param_count > 3) {
		ret = at_params_string_get(&at_param_list, 3,
				target, &sz_target);
		if (ret) {
			return ret;
		}
		target[sz_target] = '\0';
	}

	ret = ftp_list(options, target);
	return (ret == FTP_CODE_226) ? 0 : -1;
}

/* AT#XFTP="cd",<folder> */
static int do_ftp_cd(void)
{
	int ret;
	char folder[FTP_MAX_FILEPATH];
	int sz_folder = FTP_MAX_FILEPATH;
	int param_count;

	/* Parse AT command */
	param_count = at_params_valid_count_get(&at_param_list);
	if (param_count < 3) {
		return -EINVAL;
	}
	ret = at_params_string_get(&at_param_list, 2, folder, &sz_folder);
	if (ret) {
		return ret;
	}
	folder[sz_folder] = '\0';

	ret = ftp_cwd(folder);
	return (ret == FTP_CODE_250) ? 0 : -1;
}

/* AT#XFTP="mkdir",<folder> */
static int do_ftp_mkdir(void)
{
	int ret;
	char folder[FTP_MAX_FILEPATH];
	int sz_folder = FTP_MAX_FILEPATH;
	int param_count;

	/* Parse AT command */
	param_count = at_params_valid_count_get(&at_param_list);
	if (param_count < 3) {
		return -EINVAL;
	}
	ret = at_params_string_get(&at_param_list, 2, folder, &sz_folder);
	if (ret) {
		return ret;
	}
	folder[sz_folder] = '\0';

	ret = ftp_mkd(folder);
	return (ret == FTP_CODE_257) ? 0 : -1;
}

/* AT#XFTP="rmdir",<folder> */
static int do_ftp_rmdir(void)
{
	int ret;
	char folder[FTP_MAX_FILEPATH];
	int sz_folder = FTP_MAX_FILEPATH;
	int param_count;

	/* Parse AT command */
	param_count = at_params_valid_count_get(&at_param_list);
	if (param_count < 3) {
		return -EINVAL;
	}
	ret = at_params_string_get(&at_param_list, 2, folder, &sz_folder);
	if (ret) {
		return ret;
	}
	folder[sz_folder] = '\0';

	ret = ftp_rmd(folder);
	return (ret == FTP_CODE_250) ? 0 : -1;
}

/* AT#XFTP="rename",<file_old>,<file_new> */
static int do_ftp_rename(void)
{
	int ret;
	char file_old[FTP_MAX_FILEPATH];
	int sz_file_old = FTP_MAX_FILEPATH;
	char file_new[FTP_MAX_FILEPATH];
	int sz_file_new = FTP_MAX_FILEPATH;
	int param_count;

	/* Parse AT command */
	param_count = at_params_valid_count_get(&at_param_list);
	if (param_count < 4) {
		return -EINVAL;
	}
	ret = at_params_string_get(&at_param_list, 2, file_old, &sz_file_old);
	if (ret) {
		return ret;
	}
	file_old[sz_file_old] = '\0';
	ret = at_params_string_get(&at_param_list, 3, file_new, &sz_file_new);
	if (ret) {
		return ret;
	}
	file_new[sz_file_new] = '\0';

	ret = ftp_rename(file_old, file_new);
	return (ret == FTP_CODE_250) ? 0 : -1;
}

/* AT#XFTP="delete",<file> */
static int do_ftp_delete(void)
{
	int ret;
	char file[FTP_MAX_FILEPATH];
	int sz_file = 128;
	int param_count;

	/* Parse AT command */
	param_count = at_params_valid_count_get(&at_param_list);
	if (param_count < 3) {
		return -EINVAL;
	}
	ret = at_params_string_get(&at_param_list, 2, file, &sz_file);
	if (ret) {
		return ret;
	}
	file[sz_file] = '\0';

	ret = ftp_delete(file);
	return (ret == FTP_CODE_250) ? 0 : -1;
}

/* AT#XFTP="get",<file> */
static int do_ftp_get(void)
{
	int ret;
	char file[FTP_MAX_FILEPATH];
	int sz_file = FTP_MAX_FILEPATH;
	int param_count;

	/* Parse AT command */
	param_count = at_params_valid_count_get(&at_param_list);
	if (param_count < 3) {
		return -EINVAL;
	}
	ret = at_params_string_get(&at_param_list, 2, file, &sz_file);
	if (ret) {
		return ret;
	}
	file[sz_file] = '\0';

	ret = ftp_get(file);
	return (ret == FTP_CODE_226) ? 0 : -1;
}

/* AT#XFTP="put",<file>[<datatype>,<data>] */
static int do_ftp_put(void)
{
	int ret;
	char file[FTP_MAX_FILEPATH];
	int sz_file = FTP_MAX_FILEPATH;
	int param_count;

	/* Parse AT command */
	param_count = at_params_valid_count_get(&at_param_list);
	if (param_count < 3) {
		return -EINVAL;
	}
	ret = at_params_string_get(&at_param_list, 2, file, &sz_file);
	if (ret) {
		return ret;
	}
	file[sz_file] = '\0';

	if (param_count > 4) {
		u16_t type;
		char data[NET_IPV4_MTU];
		int size;

		ret = at_params_short_get(&at_param_list, 3, &type);
		if (ret) {
			return ret;
		}
		size = NET_IPV4_MTU;
		ret = at_params_string_get(&at_param_list, 4, data, &size);
		if (ret) {
			return ret;
		}
		if (type == DATATYPE_HEXADECIMAL) {
			u8_t data_hex[size / 2];

			ret = slm_util_atoh(data, size, data_hex, size / 2);
			if (ret > 0) {
				ret = ftp_put(file, data_hex, ret);
			}
		} else {
			ret = ftp_put(file, data, size);
		}
	} else {
		ret = ftp_put(file, NULL, 0);
	}

	return (ret == FTP_CODE_226) ? 0 : -1;
}

/**@brief API to handle FTP AT command
 */
int slm_at_ftp_parse(const char *at_cmd)
{
	int ret = -ENOTSUP;
	char op_str[16];
	int size = 16;

	if (slm_util_cmd_casecmp(at_cmd, AT_FTP_STR)) {
		ret = at_parser_params_from_str(at_cmd, NULL, &at_param_list);
		if (ret) {
			LOG_ERR("Failed to parse AT command %d", ret);
			return -EINVAL;
		}
		if (at_parser_cmd_type_get(at_cmd) != AT_CMD_TYPE_SET_COMMAND) {
			return -EINVAL;
		}
		if (at_params_valid_count_get(&at_param_list) < 2) {
			return -EINVAL;
		}
		ret = at_params_string_get(&at_param_list, 1, op_str, &size);
		if (ret) {
			return ret;
		}
		op_str[size] = '\0';
		ret = -EINVAL;
		for (int i = 0; i < FTP_OP_MAX; i++) {
			if (slm_util_casecmp(op_str,
				ftp_op_list[i].op_str)) {
				ret = ftp_op_list[i].handler();
				break;
			}
		}
	}

	return ret;
}

/**@brief API to list FTP AT commands
 */
void slm_at_ftp_clac(void)
{
	sprintf(rsp_buf, "%s\r\n", AT_FTP_STR);
	rsp_send(rsp_buf, strlen(rsp_buf));
}

/**@brief API to initialize FTP AT commands handler
 */
int slm_at_ftp_init(void)
{
	return ftp_init(ftp_ctrl_callback, ftp_data_callback);
}

/**@brief API to uninitialize FTP AT commands handler
 */
int slm_at_ftp_uninit(void)
{
	return ftp_uninit();
}
```

## src/slm_at_ftp.h
```c
/*
 * Copyright (c) 2019 Nordic Semiconductor ASA
 *
 * SPDX-License-Identifier: LicenseRef-BSD-5-Clause-Nordic
 */

#ifndef SLM_AT_FTP_
#define SLM_AT_FTP_

/**@file slm_at_tcpip.h
 *
 * @brief Vendor-specific AT command for FTP service.
 * @{
 */

#include <zephyr/types.h>
#include <modem/at_cmd.h>

/**
 * @brief FTP AT command parser.
 *
 * @param at_cmd AT command string.
 *
 * @retval 0 If the operation was successful.
 *           Otherwise, a (negative) error code is returned.
 */
int slm_at_ftp_parse(const char *at_cmd);

/**
 * @brief List FTP AT commands.
 *
 */
void slm_at_ftp_clac(void);

/**
 * @brief Initialize FTP AT command parser.
 *
 * @retval 0 If the operation was successful.
 *           Otherwise, a (negative) error code is returned.
 */
int slm_at_ftp_init(void);

/**
 * @brief Uninitialize FTP AT command parser.
 *
 * @retval 0 If the operation was successful.
 *           Otherwise, a (negative) error code is returned.
 */
int slm_at_ftp_uninit(void);
/** @} */

#endif /* SLM_AT_FTP_ */
```

## src/slm_at_gps.c
```c
/*
 * Copyright (c) 2019 Nordic Semiconductor ASA
 *
 * SPDX-License-Identifier: LicenseRef-BSD-5-Clause-Nordic
 */
#include <logging/log.h>

#include <zephyr.h>
#include <stdio.h>
#include <nrf_socket.h>
#include "slm_util.h"
#include "slm_at_host.h"
#include "slm_at_gps.h"
#ifdef CONFIG_SUPL_CLIENT_LIB
#include <net/socket.h>
#include <supl_os_client.h>
#include <supl_session.h>
#endif

LOG_MODULE_REGISTER(gps, CONFIG_SLM_LOG_LEVEL);

#define IS_FIX(_flag)       (_flag & NRF_GNSS_PVT_FLAG_FIX_VALID_BIT)
#define IS_UNHEALTHY(_flag) (_flag & NRF_GNSS_SV_FLAG_UNHEALTHY)

#define INVALID_SOCKET	-1

/**@brief List of supported AT commands. */
enum slm_gps_mode {
	GPS_MODE_STANDALONE,
	GPS_MODE_PSM,
	GPS_MODE_EDRX,
	GPS_MODE_AGPS
};

#define AT_GPS	"AT#XGPS"

static struct gps_client {
	int sock; /* Socket descriptor. */
	u16_t mask; /* NMEA mask */
	bool running; /* GPS running status */
	bool has_fix; /* At least one fix is got */
} client;

static nrf_gnss_data_frame_t gps_data;

#define THREAD_STACK_SIZE	KB(1)
#define THREAD_PRIORITY		K_LOWEST_APPLICATION_THREAD_PRIO

static struct k_thread gps_thread;
static k_tid_t gps_thread_id;
static K_THREAD_STACK_DEFINE(gps_thread_stack, THREAD_STACK_SIZE);
static u64_t ttft_start;

/* global functions defined in different files */
void rsp_send(const u8_t *str, size_t len);

/* global variable defined in different files */
extern struct at_param_list at_param_list;
extern char rsp_buf[CONFIG_AT_CMD_RESPONSE_MAX_LEN];
extern struct k_work_q slm_work_q;

#ifdef CONFIG_SUPL_CLIENT_LIB
static int supl_fd;
int connect_supl_server(void)
{
	int ret;
	struct sockaddr_in server;
	struct addrinfo *res;
	struct addrinfo hints = {
		.ai_family = AF_INET,
		.ai_socktype = SOCK_STREAM,
		.ai_protocol = IPPROTO_TCP,
		/* Either a valid,
		 * NULL-terminated access point name or NULL.
		 */
		.ai_canonname = NULL,
	};

	ret = socket(AF_INET, SOCK_STREAM, IPPROTO_TCP);
	if (ret < 0) {
		LOG_ERR("socket() error: %d", -errno);
		return -errno;
	}

	supl_fd = ret;
	ret = getaddrinfo(CONFIG_SLM_SUPL_SERVER, NULL, &hints, &res);
	if (ret || res == NULL) {
		LOG_ERR("getaddrinfo() error: %d", ret);
		close(supl_fd);
		return ret;
	}
	server.sin_family = AF_INET;
	server.sin_port = htons(CONFIG_SLM_SUPL_PORT);
	server.sin_addr.s_addr =
		((struct sockaddr_in *)res->ai_addr)->sin_addr.s_addr;
	ret = connect(supl_fd, (struct sockaddr *)&server,
		sizeof(struct sockaddr_in));
	if (ret) {
		LOG_ERR("connect() error: %d", -errno);
		close(supl_fd);
		ret = -errno;
	}

	freeaddrinfo(res);
	return ret;
}

ssize_t supl_write(const void *buff, size_t nbytes, void *user_data)
{
	ARG_UNUSED(user_data);
	return send(supl_fd, buff, nbytes, 0);
}

int supl_logger(int level, const char *fmt, ...)
{
	char buffer[256] = { 0 };
	va_list args;

	va_start(args, fmt);
	int ret = vsnprintk(buffer, sizeof(buffer), fmt, args);

	va_end(args);

	if (ret < 0) {
		LOG_ERR("[SUPL] Encoding error");
		return ret;
	} else if ((size_t)ret >= sizeof(buffer)) {
		LOG_WRN("[SUPL] Too long message");
	}

	LOG_DBG("[SUPL] %s", log_strdup(buffer));

	return ret;
}

ssize_t supl_read(void *p_buff, size_t nbytes, void *user_data)
{
	ARG_UNUSED(user_data);
	ssize_t rc = recv(supl_fd, p_buff, nbytes, 0);

	if (rc < 0 && (errno == ETIMEDOUT)) {
		return 0;
	}

	return rc;
}

int supl_inject(void *agps, size_t agps_size, nrf_gnss_agps_data_type_t type,
	     void *user_data)
{
	int ret;

	ARG_UNUSED(user_data);

	ret = nrf_sendto(client.sock, agps, agps_size, 0, &type, sizeof(type));
	if (ret) {
		LOG_ERR("Inject error, type: %d (err: %d)", type, errno);
		return ret;
	}

	LOG_INF("Injected AGPS data, flags: %d, size: %d", type, agps_size);
	return 0;
}

void supl_handler(struct k_work *work)
{
	int ret;
	nrf_gnss_delete_mask_t delete_mask = 0;

	ARG_UNUSED(work);

	/* suspend GPS */
	ret = nrf_setsockopt(client.sock, NRF_SOL_GNSS, NRF_SO_GNSS_STOP,
			&delete_mask, sizeof(delete_mask));
	if (ret) {
		LOG_ERR("Failed to suspend GPS (err: %d)", -errno);
		return;
	}
	k_thread_suspend(gps_thread_id);
	sprintf(rsp_buf, "GPS suspended\r\n");
	rsp_send(rsp_buf, strlen(rsp_buf));

	/* SUPL injection */
	ret = connect_supl_server();
	if (ret == 0) {
		LOG_DBG("SUPL session start");
		supl_session(&gps_data.agps);
		LOG_DBG("SUPL session done");
		close(supl_fd);
	}
	sprintf(rsp_buf, "SUPL injection done\r\n");
	rsp_send(rsp_buf, strlen(rsp_buf));

	/* Resume GPS */
	k_thread_resume(gps_thread_id);
	ret = nrf_setsockopt(client.sock, NRF_SOL_GNSS, NRF_SO_GNSS_START,
			&delete_mask, sizeof(delete_mask));
	if (ret) {
		LOG_ERR("Failed to resume GPS (err: %d)", -errno);
	} else {
		ttft_start = k_uptime_get();
		sprintf(rsp_buf, "GPS resumed\r\n");
		rsp_send(rsp_buf, strlen(rsp_buf));
	}
}

K_WORK_DEFINE(supl_work, supl_handler);

#endif /* CONFIG_SUPL_CLIENT_LIB */

static void gps_satellite_stats(void)
{
	static u8_t last_tracked;
	u8_t tracked = 0;
	u8_t in_fix = 0;
	u8_t unhealthy = 0;

	if (gps_data.data_id != NRF_GNSS_PVT_DATA_ID || client.has_fix) {
		return;
	}

	for (int i = 0; i < NRF_GNSS_MAX_SATELLITES; ++i) {
		if ((gps_data.pvt.sv[i].sv > 0) &&
		    (gps_data.pvt.sv[i].sv < 33)) {
			LOG_DBG("GPS tracking: %d", gps_data.pvt.sv[i].sv);
			tracked++;
			if (IS_FIX(gps_data.pvt.sv[i].flags)) {
				in_fix++;
			}
			if (IS_UNHEALTHY(gps_data.pvt.sv[i].flags)) {
				unhealthy++;
			}
		}
	}

	if (last_tracked != tracked) {
		sprintf(rsp_buf, "#XGPSS: track %d use %d unhealthy %d\r\n",
			tracked, in_fix, unhealthy);
		rsp_send(rsp_buf, strlen(rsp_buf));
		last_tracked = tracked;
	}
}

static void gps_pvt_notify(void)
{
	sprintf(rsp_buf, "#XGPSP: long %f lat %f\r\n",
		gps_data.pvt.longitude,
		gps_data.pvt.latitude);
	rsp_send(rsp_buf, strlen(rsp_buf));
	sprintf(rsp_buf, "#XGPSP: %04u-%02u-%02u %02u:%02u:%02u\r\n",
		gps_data.pvt.datetime.year,
		gps_data.pvt.datetime.month,
		gps_data.pvt.datetime.day,
		gps_data.pvt.datetime.hour,
		gps_data.pvt.datetime.minute,
		gps_data.pvt.datetime.seconds);
	rsp_send(rsp_buf, strlen(rsp_buf));
}

static void gps_thread_fn(void *arg1, void *arg2, void *arg3)
{
	ARG_UNUSED(arg1);
	ARG_UNUSED(arg2);
	ARG_UNUSED(arg3);

	while (true) {
		if (nrf_recv(client.sock, &gps_data, sizeof(gps_data), 0)
			<= 0) {
			LOG_ERR("GPS nrf_recv(): %d", -errno);
			sprintf(rsp_buf, "#XGPS: %d\r\n", -errno);
			rsp_send(rsp_buf, strlen(rsp_buf));
			nrf_close(client.sock);
			client.running = false;
			break;
		}
		gps_satellite_stats();
		switch (gps_data.data_id) {
		case NRF_GNSS_PVT_DATA_ID:
			if (IS_FIX(gps_data.pvt.flags)) {
				gps_pvt_notify();
				if (!client.has_fix) {
					u64_t now = k_uptime_get();

					sprintf(rsp_buf, "#XGPSP: TTFF %ds\r\n",
						(int)(now - ttft_start)/1000);
					rsp_send(rsp_buf, strlen(rsp_buf));
					client.has_fix = true;
				}
			}
			break;
		case NRF_GNSS_NMEA_DATA_ID:
			if (client.has_fix) {
				rsp_send(gps_data.nmea,
					strlen(gps_data.nmea));
			}
			break;

		case NRF_GNSS_AGPS_DATA_ID:
#ifdef CONFIG_SUPL_CLIENT_LIB
			LOG_INF("New AGPS data requested, flags 0x%08x",
			       gps_data.agps.data_flags);
			k_work_submit_to_queue(&slm_work_q, &supl_work);
#endif
			break;

		default:
			break;
		}
	}
}

static int do_gps_start(void)
{
	int ret = -EINVAL;

	nrf_gnss_fix_retry_t    fix_retry    = 0; /* unlimited retry period */
	nrf_gnss_fix_interval_t fix_interval = 1; /* 1s delay between fixes */
	nrf_gnss_delete_mask_t  delete_mask  = 0;
	nrf_gnss_nmea_mask_t    nmea_mask = (nrf_gnss_nmea_mask_t)client.mask;

	client.sock = nrf_socket(NRF_AF_LOCAL, NRF_SOCK_DGRAM, NRF_PROTO_GNSS);
	if (client.sock < 0) {
		LOG_ERR("Could not init socket (err: %d)", -errno);
		goto error;
	}
	ret = nrf_setsockopt(client.sock, NRF_SOL_GNSS, NRF_SO_GNSS_FIX_RETRY,
			&fix_retry, sizeof(fix_retry));
	if (ret) {
		LOG_ERR("Failed to set fix retry value (err: %d)", -errno);
		goto error;
	}
	ret = nrf_setsockopt(client.sock, NRF_SOL_GNSS,
		NRF_SO_GNSS_FIX_INTERVAL, &fix_interval, sizeof(fix_interval));
	if (ret) {
		LOG_ERR("Failed to set fix interval value (err: %d)", -errno);
		goto error;
	}
	ret = nrf_setsockopt(client.sock, NRF_SOL_GNSS, NRF_SO_GNSS_NMEA_MASK,
			&nmea_mask, sizeof(nmea_mask));
	if (ret) {
		LOG_ERR("Failed to set nmea mask (err: %d)", -errno);
		goto error;
	}
	ret = nrf_setsockopt(client.sock, NRF_SOL_GNSS, NRF_SO_GNSS_START,
			&delete_mask, sizeof(delete_mask));
	if (ret) {
		LOG_ERR("Failed to start GPS (err: %d)", -errno);
		goto error;
	}

	/* Start GPS listening thread */
	if (gps_thread_id != NULL) {
		k_thread_resume(gps_thread_id);
	} else {
		gps_thread_id = k_thread_create(&gps_thread, gps_thread_stack,
				K_THREAD_STACK_SIZEOF(gps_thread_stack),
				gps_thread_fn, NULL, NULL, NULL,
				THREAD_PRIORITY, 0, K_NO_WAIT);
	}

	client.running = true;
	LOG_DBG("GPS started");

	sprintf(rsp_buf, "#XGPS: 1,%d\r\n", client.mask);
	rsp_send(rsp_buf, strlen(rsp_buf));
	ttft_start = k_uptime_get();
	return 0;

error:
	nrf_close(client.sock);
	LOG_ERR("GPS start failed: %d", ret);
	sprintf(rsp_buf, "#XGPS: %d\r\n", ret);
	rsp_send(rsp_buf, strlen(rsp_buf));
	client.running = false;

	return -errno;
}

static int do_gps_stop(void)
{
	int ret = 0;
	nrf_gnss_delete_mask_t	delete_mask  = 0;

	if (client.sock != INVALID_SOCKET) {
		ret = nrf_setsockopt(client.sock, NRF_SOL_GNSS,
			NRF_SO_GNSS_STOP, &delete_mask, sizeof(delete_mask));
		if (ret != 0) {
			LOG_ERR("Failed to stop GPS (err: %d)", -errno);
			ret = -errno;
		} else {
			k_thread_suspend(gps_thread_id);
			nrf_close(client.sock);
			client.running = false;
			sprintf(rsp_buf, "#XGPS: 0\r\n");
			rsp_send(rsp_buf, strlen(rsp_buf));
			LOG_DBG("GPS stopped");
		}

	}

	return ret;
}

/**@brief handle AT#XGPS commands
 *  AT#XGPS=<op>[,<mask>]
 *  AT#XGPS?
 *  AT#XGPS=? TEST command not supported
 */
static int handle_at_gps(enum at_cmd_type cmd_type)
{
	int err = -EINVAL;
	u16_t op;

	switch (cmd_type) {
	case AT_CMD_TYPE_SET_COMMAND:
		if (at_params_valid_count_get(&at_param_list) < 2) {
			return -EINVAL;
		}
		err = at_params_short_get(&at_param_list, 1, &op);
		if (err < 0) {
			return err;
		}
		if (op == 1) {
			if (at_params_valid_count_get(&at_param_list) > 2) {
				err = at_params_short_get(&at_param_list, 2,
							&client.mask);
				if (err < 0) {
					return err;
				}
			}
			if (client.running) {
				LOG_WRN("GPS is running");
			} else {
				err = do_gps_start();
			}
		} else if (op == 0) {
			if (!client.running) {
				LOG_WRN("GPS is not running");
			} else {
				err = do_gps_stop();
			}
		} break;

	case AT_CMD_TYPE_READ_COMMAND:
		if (client.running) {
			sprintf(rsp_buf, "#XGPS: 1,%d\r\n", client.mask);
		} else {
			sprintf(rsp_buf, "#XGPS: 0\r\n");
		}
		rsp_send(rsp_buf, strlen(rsp_buf));
		err = 0;
		break;

	case AT_CMD_TYPE_TEST_COMMAND:
		sprintf(rsp_buf, "#XGPS: (0, 1), (bitmask)\r\n");
		rsp_send(rsp_buf, strlen(rsp_buf));
		err = 0;
		break;

	default:
		break;
	}

	return err;
}

/**@brief API to handle GPS AT commands
 */
int slm_at_gps_parse(const char *at_cmd)
{
	int ret = -ENOTSUP;

	if (slm_util_cmd_casecmp(at_cmd, AT_GPS)) {
		ret = at_parser_params_from_str(at_cmd, NULL, &at_param_list);
		if (ret < 0) {
			LOG_ERR("Failed to parse AT command %d", ret);
			return -EINVAL;
		}
		ret = handle_at_gps(at_parser_cmd_type_get(at_cmd));
	}

	return ret;
}

/**@brief API to list GPS AT commands
 */
void slm_at_gps_clac(void)
{
	sprintf(rsp_buf, "%s\r\n", AT_GPS);
	rsp_send(rsp_buf, strlen(rsp_buf));
}

/**@brief API to initialize GPS AT commands handler
 */
int slm_at_gps_init(void)
{
#ifdef CONFIG_SUPL_CLIENT_LIB
	int ret;
	static struct supl_api supl_api = {
		.read       = supl_read,
		.write      = supl_write,
		.handler    = supl_inject,
		.logger     = supl_logger,
		.counter_ms = k_uptime_get
	};

	ret = supl_init(&supl_api);
	if (ret) {
		LOG_ERR("SUPL init error: %d", ret);
		return ret;
	}
#endif

	client.sock = INVALID_SOCKET;
	client.mask =  NRF_GNSS_NMEA_GSV_MASK |
		       NRF_GNSS_NMEA_GSA_MASK |
		       NRF_GNSS_NMEA_GLL_MASK |
		       NRF_GNSS_NMEA_GGA_MASK |
		       NRF_GNSS_NMEA_RMC_MASK;
	client.running = false;
	client.has_fix = false;
	gps_thread_id = NULL;

	return 0;
}

/**@brief API to uninitialize GPS AT commands handler
 */
int slm_at_gps_uninit(void)
{
	if (gps_thread_id != NULL) {
		do_gps_stop();
		k_thread_abort(gps_thread_id);
		gps_thread_id = NULL;
	}

	return 0;
}
```

## src/slm_at_gps.h
```c
/*
 * Copyright (c) 2019 Nordic Semiconductor ASA
 *
 * SPDX-License-Identifier: LicenseRef-BSD-5-Clause-Nordic
 */

#ifndef SLM_AT_GPS_
#define SLM_AT_GPS_

/**@file slm_at_gps.h
 *
 * @brief Vendor-specific AT command for GPS service.
 * @{
 */

#include <zephyr/types.h>
#include <modem/at_cmd.h>

/**
 * @brief GPS AT command parser.
 *
 * @param at_cmd  AT command string.
 *
 * @retval 0 If the operation was successful.
 *           Otherwise, a (negative) error code is returned.
 */
int slm_at_gps_parse(const char *at_cmd);

/**
 * @brief List GPS AT commands.
 *
 */
void slm_at_gps_clac(void);

/**
 * @brief Initialize GPS AT command parser.
 *
 * @param callback Callback function to send AT response
 *
 * @retval 0 If the operation was successful.
 *           Otherwise, a (negative) error code is returned.
 */
int slm_at_gps_init(at_cmd_handler_t callback);

/**
 * @brief Uninitialize GPS AT command parser.
 *
 * @retval 0 If the operation was successful.
 *           Otherwise, a (negative) error code is returned.
 */
int slm_at_gps_uninit(void);

/** @} */

#endif /* SLM_AT_GPS_ */
```

## src/slm_at_host.c
```c
/*
 * Copyright (c) 2019 Nordic Semiconductor ASA
 *
 * SPDX-License-Identifier: LicenseRef-BSD-5-Clause-Nordic
 */

#include <zephyr.h>
#include <stdio.h>
#include <ctype.h>
#include <logging/log.h>
#include <drivers/uart.h>
#include <string.h>
#include <init.h>
#include <modem/at_cmd.h>
#include <modem/at_notif.h>

LOG_MODULE_REGISTER(at_host, CONFIG_SLM_LOG_LEVEL);

#include "slm_util.h"
#include "slm_at_host.h"
#include "slm_at_tcpip.h"
#include "slm_at_icmp.h"
#include "slm_at_gps.h"
#include "slm_at_ftp.h"
#if defined(CONFIG_SLM_TCP_PROXY)
#include "slm_at_tcp_proxy.h"
#endif
#if defined(CONFIG_SLM_UDP_PROXY)
#include "slm_at_udp_proxy.h"
#endif
#include "slm_at_mqtt.h"

#define SLM_UART_0_NAME	"UART_0"
#define SLM_UART_2_NAME	"UART_2"

#define OK_STR		"OK\r\n"
#define ERROR_STR	"ERROR\r\n"
#define FATAL_STR	"FATAL ERROR\r\n"
#define SLM_SYNC_STR	"Ready\r\n"

#define SLM_VERSION	"#XSLMVER: 1.2\r\n"
#define AT_CMD_SLMVER	"AT#XSLMVER"
#define AT_CMD_SLEEP	"AT#XSLEEP"
#define AT_CMD_CLAC	"AT#XCLAC"

#define AT_MAX_CMD_LEN	CONFIG_AT_CMD_RESPONSE_MAX_LEN
#define UART_RX_LEN	8  /* UART FIFO depth is 6 (?) */

/** @brief Termination Modes. */
enum term_modes {
	MODE_NULL_TERM, /**< Null Termination */
	MODE_CR,        /**< CR Termination */
	MODE_LF,        /**< LF Termination */
	MODE_CR_LF,     /**< CR+LF Termination */
	MODE_COUNT      /* Counter of term_modes */
};

/**@brief Shutdown modes. */
enum shutdown_modes {
	SHUTDOWN_MODE_IDLE,
	SHUTDOWN_MODE_SLEEP,
	SHUTDOWN_MODE_INVALID
};

static enum term_modes term_mode;
static struct device *uart_dev;
static u8_t at_buf[AT_MAX_CMD_LEN];
static size_t at_buf_len;
static struct k_work cmd_send_work;
static const char termination[3] = { '\0', '\r', '\n' };

static u8_t uart_rx_buf[UART_RX_LEN];
static u8_t *uart_tx_buf;
static u8_t buf_num;

static K_SEM_DEFINE(tx_done, 0, 1);

/* global functions defined in different files */
void enter_idle(void);
void enter_sleep(void);

/* global variable defined in different files */
extern struct at_param_list at_param_list;

/* forward declaration */
void slm_at_host_uninit(void);

void rsp_send(const u8_t *str, size_t len)
{
	int ret;

	k_sem_take(&tx_done, K_FOREVER);

	uart_tx_buf = k_malloc(len);
	if (uart_tx_buf == NULL) {
		LOG_WRN("No ram buffer");
		k_sem_give(&tx_done);
		return;
	}

	LOG_HEXDUMP_DBG(str, len, "TX");

	memcpy(uart_tx_buf, str, len);
	ret = uart_tx(uart_dev, uart_tx_buf, len, K_FOREVER);
	if (ret) {
		LOG_WRN("uart_tx failed: %d", ret);
		k_free(uart_tx_buf);
		k_sem_give(&tx_done);
	}
}

static void response_handler(void *context, const char *response)
{
	int len = strlen(response);

	ARG_UNUSED(context);

	/* Forward the data over UART */
	if (len > 0) {
		rsp_send(response, len);
	}
}

static void handle_at_clac(void)
{
	rsp_send(AT_CMD_SLMVER, sizeof(AT_CMD_SLMVER) - 1);
	rsp_send("\r\n", 2);
	rsp_send(AT_CMD_SLEEP, sizeof(AT_CMD_SLEEP) - 1);
	rsp_send("\r\n", 2);
	rsp_send(AT_CMD_CLAC, sizeof(AT_CMD_CLAC) - 1);
	rsp_send("\r\n", 2);
	slm_at_tcpip_clac();
#if defined(CONFIG_SLM_TCP_PROXY)
	slm_at_tcp_proxy_clac();
#endif
#if defined(CONFIG_SLM_UDP_PROXY)
	slm_at_udp_proxy_clac();
#endif
	slm_at_icmp_clac();
	slm_at_gps_clac();
	slm_at_mqtt_clac();
	slm_at_ftp_clac();
}

static int handle_at_sleep(const char *at_cmd, enum shutdown_modes *mode)
{
	int ret = -EINVAL;
	enum at_cmd_type type;
	u16_t shutdown_mode;

	ret = at_parser_params_from_str(at_cmd, NULL, &at_param_list);
	if (ret < 0) {
		LOG_ERR("Failed to parse AT command %d", ret);
		return -EINVAL;
	}

	type = at_parser_cmd_type_get(at_cmd);
	if (type == AT_CMD_TYPE_SET_COMMAND) {
		shutdown_mode = SHUTDOWN_MODE_IDLE;
		if (at_params_valid_count_get(&at_param_list) > 1) {
			ret = at_params_short_get(&at_param_list, 1,
					&shutdown_mode);
			if (ret < 0) {
				LOG_ERR("AT parameter error");
				return -EINVAL;
			}
		}
		if (shutdown_mode == SHUTDOWN_MODE_IDLE) {
			slm_at_host_uninit();
			enter_idle();
			*mode = SHUTDOWN_MODE_IDLE;
			ret = 0; /*Will send no "OK"*/
		} else if (shutdown_mode == SHUTDOWN_MODE_SLEEP) {
			slm_at_host_uninit();
			enter_sleep();
			ret = 0; /* Cannot reach here */
		} else {
			LOG_ERR("AT parameter error");
			ret = -EINVAL;
		}
	}

	if (type == AT_CMD_TYPE_TEST_COMMAND) {
		char buf[64];

		sprintf(buf, "#XSLEEP: (%d, %d)\r\n", SHUTDOWN_MODE_IDLE,
			SHUTDOWN_MODE_SLEEP);
		rsp_send(buf, strlen(buf));
		ret = 0;
	}

	return ret;
}

static void cmd_send(struct k_work *work)
{
	size_t chars;
	char str[24];
	static char buf[AT_MAX_CMD_LEN];
	enum at_cmd_state state;
	int err;

	ARG_UNUSED(work);

	/* Make sure the string is 0-terminated */
	at_buf[MIN(at_buf_len, AT_MAX_CMD_LEN - 1)] = 0;

	LOG_HEXDUMP_DBG(at_buf, at_buf_len, "RX");

	if (slm_util_cmd_casecmp(at_buf, AT_CMD_SLMVER)) {
		rsp_send(SLM_VERSION, sizeof(SLM_VERSION) - 1);
		rsp_send(OK_STR, sizeof(OK_STR) - 1);
		goto done;
	}

	if (slm_util_cmd_casecmp(at_buf, AT_CMD_CLAC)) {
		handle_at_clac();
		rsp_send(OK_STR, sizeof(OK_STR) - 1);
		goto done;
	}

	if (slm_util_cmd_casecmp(at_buf, AT_CMD_SLEEP)) {
		enum shutdown_modes mode = SHUTDOWN_MODE_INVALID;

		err = handle_at_sleep(at_buf, &mode);
		if (err) {
			rsp_send(ERROR_STR, sizeof(ERROR_STR) - 1);
			goto done;
		} else {
			if (mode == SHUTDOWN_MODE_INVALID) {
				/*Test command*/
				rsp_send(OK_STR, sizeof(OK_STR) - 1);
				goto done;
			} else {
				/*Entered IDLE*/
				return;
			}
		}
	}

	err = slm_at_tcpip_parse(at_buf);
	if (err == 0) {
		rsp_send(OK_STR, sizeof(OK_STR) - 1);
		goto done;
	} else if (err != -ENOTSUP) {
		rsp_send(ERROR_STR, sizeof(ERROR_STR) - 1);
		goto done;
	}
#if defined(CONFIG_SLM_TCP_PROXY)
	err = slm_at_tcp_proxy_parse(at_buf);
	if (err == 0) {
		rsp_send(OK_STR, sizeof(OK_STR) - 1);
		goto done;
	} else if (err != -ENOTSUP) {
		rsp_send(ERROR_STR, sizeof(ERROR_STR) - 1);
		goto done;
	}
#endif

#if defined(CONFIG_SLM_UDP_PROXY)
	err = slm_at_udp_proxy_parse(at_buf);
	if (err == 0) {
		rsp_send(OK_STR, sizeof(OK_STR) - 1);
		goto done;
	} else if (err != -ENOTSUP) {
		rsp_send(ERROR_STR, sizeof(ERROR_STR) - 1);
		goto done;
	}
#endif

	err = slm_at_icmp_parse(at_buf);
	if (err == 0) {
		goto done;
	} else if (err != -ENOTSUP) {
		rsp_send(ERROR_STR, sizeof(ERROR_STR) - 1);
		goto done;
	}

	err = slm_at_gps_parse(at_buf);
	if (err == 0) {
		rsp_send(OK_STR, sizeof(OK_STR) - 1);
		goto done;
	} else if (err != -ENOTSUP) {
		rsp_send(ERROR_STR, sizeof(ERROR_STR) - 1);
		goto done;
	}

	err = slm_at_mqtt_parse(at_buf);
	if (err == 0) {
		rsp_send(OK_STR, sizeof(OK_STR) - 1);
		goto done;
	} else if (err != -ENOTSUP) {
		rsp_send(ERROR_STR, sizeof(ERROR_STR) - 1);
		goto done;
	}

	err = slm_at_ftp_parse(at_buf);
	if (err == 0) {
		rsp_send(OK_STR, sizeof(OK_STR) - 1);
		goto done;
	} else if (err != -ENOTSUP) {
		rsp_send(ERROR_STR, sizeof(ERROR_STR) - 1);
		goto done;
	}

	err = at_cmd_write(at_buf, buf, AT_MAX_CMD_LEN, &state);
	if (err < 0) {
		LOG_ERR("AT command error: %d", err);
		state = AT_CMD_ERROR;
	}

	switch (state) {
	case AT_CMD_OK:
		rsp_send(buf, strlen(buf));
		rsp_send(OK_STR, sizeof(OK_STR) - 1);
		break;
	case AT_CMD_ERROR:
		rsp_send(ERROR_STR, sizeof(ERROR_STR) - 1);
		break;
	case AT_CMD_ERROR_CMS:
		chars = sprintf(str, "+CMS: %d\r\n", err);
		rsp_send(str, ++chars);
		break;
	case AT_CMD_ERROR_CME:
		chars = sprintf(str, "+CME: %d\r\n", err);
		rsp_send(str, ++chars);
		break;
	default:
		break;
	}

done:
	k_sleep(K_MSEC(100)); /* allow time for TX DMA */
	buf_num = 1U;
	err = uart_rx_enable(uart_dev, &uart_rx_buf[0], 1, K_FOREVER);
	if (err) {
		LOG_ERR("UART RX failed: %d", err);
		rsp_send(FATAL_STR, sizeof(FATAL_STR) - 1);
	}
}

static void uart_rx_handler(u8_t character)
{
	static bool inside_quotes;
	static size_t cmd_len;
	size_t pos;

	cmd_len += 1;
	pos = cmd_len - 1;

	/* Handle special characters. */
	switch (character) {
	case 0x08: /* Backspace. */
		/* Fall through. */
	case 0x7F: /* DEL character */
		pos = pos ? pos - 1 : 0;
		at_buf[pos] = 0;
		cmd_len = cmd_len <= 1 ? 0 : cmd_len - 2;
		break;
	case '"':
		inside_quotes = !inside_quotes;
		 /* Fall through. */
	default:
		/* Detect AT command buffer overflow or zero length */
		if (cmd_len > AT_MAX_CMD_LEN) {
			LOG_ERR("Buffer overflow, dropping '%c'\n", character);
			cmd_len = AT_MAX_CMD_LEN;
			return;
		} else if (cmd_len < 1) {
			LOG_ERR("Invalid AT command length: %d", cmd_len);
			cmd_len = 0;
			return;
		}

		at_buf[pos] = character;
		break;
	}

	if (inside_quotes) {
		return;
	}

	/* Check if the character marks line termination. */
	switch (term_mode) {
	case MODE_NULL_TERM:
		/* Fall through. */
	case MODE_CR:
		if (character == termination[term_mode]) {
			goto send;
		}
		break;
	case MODE_LF:
		if ((at_buf[pos - 1]) &&
			character == termination[term_mode]) {
			goto send;
		}
		break;
	case MODE_CR_LF:
		if ((at_buf[pos - 1] == '\r') && (character == '\n')) {
			goto send;
		}
		break;
	default:
		LOG_ERR("Invalid termination mode: %d", term_mode);
		break;
	}

	return;
send:
	uart_rx_disable(uart_dev);
	k_work_submit(&cmd_send_work);
	at_buf_len = cmd_len;
	cmd_len = 0;
}

static void uart_callback(struct uart_event *evt, void *user_data)
{
	int err;

	ARG_UNUSED(user_data);

	switch (evt->type) {
	case UART_TX_DONE:
		k_free(uart_tx_buf);
		k_sem_give(&tx_done);
		break;
	case UART_TX_ABORTED:
		k_free(uart_tx_buf);
		k_sem_give(&tx_done);
		LOG_INF("TX_ABORTED");
		break;
	case UART_RX_RDY:
		uart_rx_handler(evt->data.rx.buf[0]);
		break;
	case UART_RX_BUF_REQUEST:
		err = uart_rx_buf_rsp(uart_dev, &uart_rx_buf[buf_num], 1);
		if (err) {
			LOG_WRN("UART RX buf rsp: %d", err);
		}
		buf_num++;
		buf_num %= UART_RX_LEN;
		break;
	case UART_RX_BUF_RELEASED:
		break;
	case UART_RX_STOPPED:
		LOG_WRN("RX_STOPPED (%d)", evt->data.rx_stop.reason);
		break;
	case UART_RX_DISABLED:
		LOG_DBG("RX_DISABLED");
		break;
	default:
		break;
	}
}

int slm_at_host_init(void)
{
	char *uart_dev_name;
	int err;
	enum term_modes mode = CONFIG_SLM_AT_HOST_TERMINATION;
	u32_t start_time;

	/* Choosing the termination mode */
	if (mode < MODE_COUNT) {
		term_mode = mode;
	} else {
		return -EINVAL;
	}

	/* Choose which UART to use */
#if defined(CONFIG_SLM_CONNECT_UART_0)
		uart_dev_name = SLM_UART_0_NAME;
#elif defined(CONFIG_SLM_CONNECT_UART_2)
		uart_dev_name = SLM_UART_2_NAME;
#else
	LOG_ERR("Unsupported UART instance");
	return -EINVAL;
#endif
	/* Initialize the UART module */
	uart_dev = device_get_binding(uart_dev_name);
	if (uart_dev == NULL) {
		LOG_ERR("Cannot bind %s\n", uart_dev_name);
		return -EINVAL;
	}
	/* Wait for the UART line to become valid */
	start_time = k_uptime_get_32();
	do {
		err = uart_err_check(uart_dev);
		if (err) {
			if (k_uptime_get_32() - start_time > K_MSEC(500)) {
				LOG_ERR("UART check failed: %d. "
					"UART initialization timed out.", err);
				return -EIO;
			}
		}
	} while (err);
	/* Register async handling callback */
	err = uart_callback_set(uart_dev, uart_callback, NULL);
	if (err) {
		LOG_ERR("Cannot set callback: %d", err);
		return -EFAULT;
	}
	/* Power on UART module */
	device_set_power_state(uart_dev, DEVICE_PM_ACTIVE_STATE,
				NULL, NULL);
	buf_num = 1U;
	err = uart_rx_enable(uart_dev, &uart_rx_buf[0], 1, K_FOREVER);
	if (err) {
		LOG_ERR("Cannot enable rx: %d", err);
		return -EFAULT;
	}

	err = at_notif_register_handler(NULL, response_handler);
	if (err) {
		LOG_ERR("Can't register handler err=%d", err);
		return err;
	}

	err = slm_at_tcpip_init();
	if (err) {
		LOG_ERR("TCPIP could not be initialized: %d", err);
		return -EFAULT;
	}
#if defined(CONFIG_SLM_TCP_PROXY)
	err = slm_at_tcp_proxy_init();
	if (err) {
		LOG_ERR("TCP Server could not be initialized: %d", err);
		return -EFAULT;
	}
#endif
#if defined(CONFIG_SLM_UDP_PROXY)
	err = slm_at_udp_proxy_init();
	if (err) {
		LOG_ERR("UDP Server could not be initialized: %d", err);
		return -EFAULT;
	}
#endif
	err = slm_at_icmp_init();
	if (err) {
		LOG_ERR("ICMP could not be initialized: %d", err);
		return -EFAULT;
	}
	err = slm_at_gps_init();
	if (err) {
		LOG_ERR("GPS could not be initialized: %d", err);
		return -EFAULT;
	}
	err = slm_at_mqtt_init();
	if (err) {
		LOG_ERR("MQTT could not be initialized: %d", err);
		return -EFAULT;
	}

	err = slm_at_ftp_init();
	if (err) {
		LOG_ERR("FTP could not be initialized: %d", err);
		return -EFAULT;
	}

	k_work_init(&cmd_send_work, cmd_send);
	k_sem_give(&tx_done);
	rsp_send(SLM_SYNC_STR, sizeof(SLM_SYNC_STR)-1);

	LOG_DBG("at_host init done");
	return err;
}

void slm_at_host_uninit(void)
{
	int err;

	err = slm_at_tcpip_uninit();
	if (err) {
		LOG_WRN("TCPIP could not be uninitialized: %d", err);
	}
#if defined(CONFIG_SLM_TCP_PROXY)
	err = slm_at_tcp_proxy_uninit();
	if (err) {
		LOG_WRN("TCP Server could not be uninitialized: %d", err);
	}
#endif
#if defined(CONFIG_SLM_UDP_PROXY)
	err = slm_at_udp_proxy_uninit();
	if (err) {
		LOG_WRN("UDP Server could not be uninitialized: %d", err);
	}
#endif
	err = slm_at_icmp_uninit();
	if (err) {
		LOG_WRN("ICMP could not be uninitialized: %d", err);
	}
	err = slm_at_gps_uninit();
	if (err) {
		LOG_WRN("GPS could not be uninitialized: %d", err);
	}
	err = slm_at_mqtt_uninit();
	if (err) {
		LOG_WRN("MQTT could not be uninitialized: %d", err);
	}
	err = slm_at_ftp_uninit();
	if (err) {
		LOG_WRN("FTP could not be uninitialized: %d", err);
	}
	err = at_notif_deregister_handler(NULL, response_handler);
	if (err) {
		LOG_WRN("Can't deregister handler: %d", err);
	}

	/* Power off UART module */
	uart_rx_disable(uart_dev);
	k_sleep(K_MSEC(100));
	err = device_set_power_state(uart_dev, DEVICE_PM_OFF_STATE,
				NULL, NULL);
	if (err) {
		LOG_WRN("Can't power off uart: %d", err);
	}

	LOG_DBG("at_host uninit done");
}
```
