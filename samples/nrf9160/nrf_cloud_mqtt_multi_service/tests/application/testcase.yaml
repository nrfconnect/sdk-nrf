## samples/nrf9160/serial_lte_modem/Kconfig
```kconfig
#
# Copyright (c) 2019 Nordic Semiconductor
#
# SPDX-License-Identifier: LicenseRef-BSD-5-Clause-Nordic
#

source "Kconfig.zephyr"

menu "Nordic Serial LTE Modem"

config SLM_AT_MODE
	bool "Serial LTE Modem by raw AT mode"
	default y
	select AT_CMD
	select AT_NOTIF
	select AT_CMD_PARSER
	select MODEM_INFO
	select MQTT_LIB
	select MQTT_LIB_TLS
	select FTP_CLIENT

config SLM_AT_MAX_PARAM
	int "Max number of parameters in AT command"
	default 8

#
# Inter-Connect
#
choice
	prompt "UART for Interconnect"
	default SLM_CONNECT_UART_0
	help
		Sets the UART to use for interconnect
		-  UART 0
		-  UART 2
	config SLM_CONNECT_UART_0
		bool "UART 0"
	  select UART_0_NRF_HW_ASYNC
	config SLM_CONNECT_UART_2
		bool "UART 2"
	  select UART_2_NRF_UARTE
	  select UART_2_NRF_HW_ASYNC
	  select UART_2_NRF_FLOW_CONTROL
endchoice

choice
	prompt "Termination Mode"
	default SLM_CR_LF_TERMINATION
	help
		Sets the termination ending from the serial terminal
		Levels are:
		-  NULL Termination
		-  CR Termination
		-  LF Termination
		-  CR+LF Termination
	config SLM_NULL_TERMINATION
		bool "NULL Termination"
	config SLM_CR_TERMINATION
		bool "CR Termination"
	config SLM_LF_TERMINATION
		bool "LF Termination"
	config SLM_CR_LF_TERMINATION
		bool "CR+LF Termination"
endchoice

config SLM_AT_HOST_TERMINATION
	int
	default 0 if SLM_NULL_TERMINATION
	default 1 if SLM_CR_TERMINATION
	default 2 if SLM_LF_TERMINATION
	default 3 if SLM_CR_LF_TERMINATION

#
# GPIO wakeup
#
config SLM_GPIO_WAKEUP
	bool "Support of GPIO wakeup"
	help
	  Enable GPIO wakeup on nRF9160 side

config SLM_INTERFACE_PIN
	int "Interface GPIO to wake up or exit idle"
	default 6 if SLM_CONNECT_UART_0
	default 31 if SLM_CONNECT_UART_2

#
# A-GPS
#
config SLM_SUPL_SERVER
	string "SUPL server"
	default "supl.google.com"

config SLM_SUPL_PORT
	int "SUPL server port"
	default 7276

#
# FTP
#
config SLM_FTP_SERVER_PORT
	int "FTP service port on remote host"
	default 21

config SLM_FTP_USER_ANONYMOUS
	string "FTP client login user Anonymous"
	default "anonymous"
	help
	  Define the user name for anonymous login.

config SLM_FTP_PASSWORD_ANONYMOUS
	string "FTP client login password for user Anonymous"
	default "anonymous@example.com"
	help
	  Define the password for anonymous login.

rsource "src/tcpip_proxy/Kconfig"

module = SLM
module-str = serial modem
source "${ZEPHYR_BASE}/subsys/logging/Kconfig.template.log_config"

endmenu
```

## samples/nrf9160/slm_shell/boards/nrf52840dk_nrf52840.conf
```kconfig
#
# Copyright (c) 2023 Nordic Semiconductor ASA
#
# SPDX-License-Identifier: LicenseRef-Nordic-5-Clause
#

# Configuration file for nRF52840DK.
# This file is merged with prj.conf in the application folder, and options
# set here will take precedence if they are present in both files.

CONFIG_NRFX_UARTE1=y
CONFIG_UART_1_INTERRUPT_DRIVEN=n
CONFIG_UART_1_ASYNC=y
CONFIG_UART_1_NRF_HW_ASYNC=y
CONFIG_UART_1_NRF_HW_ASYNC_TIMER=2
CONFIG_MODEM_SLM_WAKEUP_PIN=11
CONFIG_MODEM_SLM_INDICATE_PIN=13
```

## samples/nrf9160/slm_shell/boards/nrf7002dk_nrf5340_cpuapp.conf
```kconfig
#
# Copyright (c) 2023 Nordic Semiconductor ASA
#
# SPDX-License-Identifier: LicenseRef-Nordic-5-Clause
#

# Configuration file for nRF7002DK.
# This file is merged with prj.conf in the application folder, and options
# set here will take precedence if they are present in both files.

CONFIG_NRFX_UARTE2=y
CONFIG_UART_2_INTERRUPT_DRIVEN=n
CONFIG_UART_2_ASYNC=y
CONFIG_UART_2_NRF_HW_ASYNC=y
CONFIG_UART_2_NRF_HW_ASYNC_TIMER=2
CONFIG_MODEM_SLM_WAKEUP_PIN=30
CONFIG_MODEM_SLM_INDICATE_PIN=31
```

## samples/nrf9160/sms/Kconfig
```kconfig
#
# Copyright (c) 2021 Nordic Semiconductor ASA
#
# SPDX-License-Identifier: LicenseRef-Nordic-5-Clause
#

menu "SMS Sample Settings"

config SMS_SEND_PHONE_NUMBER
	string "Phone number, including country code, where the SMS message is sent"
	default ""

endmenu

menu "Zephyr Kernel"
source "Kconfig.zephyr"
endmenu
```

## samples/nrf9160/sms/sample.yaml
```yaml
sample:
  name: sms Sample
tests:
  sample.nrf9160.sms:
    build_only: true
    integration_platforms:
      - nrf9160dk_nrf9160_ns
    platform_allow: nrf9160dk_nrf9160_ns
    tags: ci_build
```

## samples/nrf9160/spm/sample.yaml
```yaml
sample:
  name: spm Sample
tests:
  samples.nrf9160.spm:
    build_only: true
    build_on_all: true
    platform_whitelist: nrf9160dk_nrf9160
    tags: ci_build
```
