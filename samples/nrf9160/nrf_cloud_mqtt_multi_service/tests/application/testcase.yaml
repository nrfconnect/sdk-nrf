## samples/nrf9160/nrf_cloud_mqtt_multi_service/tests/application/testcase.yaml
```yaml
tests:
  sample.nrf9160.nrf_cloud_mqtt_multi_service.application:
    platform_allow: nrf9160dk_nrf9160_ns thingy91_nrf9160_ns native_posix qemu_cortex_m3
```

## samples/nrf9160/nrf_cloud_rest_agps/Kconfig
```kconfig
#
# Copyright (c) 2021 Nordic Semiconductor ASA
#
# SPDX-License-Identifier: LicenseRef-Nordic-5-Clause
#

menu "nRF Cloud REST A-GPS API Sample"

config REST_RETRY_WAIT_TIME_MIN
	int "Wait time, in minutes, before retrying (rebooting)"
	default 5

config REST_TERM_CONTROL
	bool "Use terminal control sequences to improve readability"

config REST_NMEA
	bool "Log NMEA sentences, not just PVT reports"

config REST_API_TOKEN
	string "API token which can be used instead of a JWT"

config REST_ENABLE_LED
	select DK_LIBRARY
	bool "Turn on LED when connected to network"
	default y

config REST_BUTTON_EVT_NUM
	int "Button number to use for device interactions"
	default 1

if REST_ENABLE_LED
config REST_LED_NUM
	int "LED number to use"
	default 0
endif

config REST_DO_JITP
	bool "Ask to perform just-in-time provisioning on startup"

config LTE_POWER_SAVING_MODE
	bool "Request Power Saving Mode (PSM) from cellular network"

config SAMPLE_AT_MAGPIO
	string "AT%XMAGPIO command"
	default "AT\%XMAGPIO=1,0,0,1,1,1574,1577" if BOARD_NRF9160DK_NRF9160_NS
	default "AT\%XMAGPIO=1,1,1,7,1,746,803,2,698,748,2,1710,2200,3,824,894,4,880,960,5,791,849,7,1565,1586" if BOARD_THINGY91_NRF9160_NS
	help
	  Defines what is the AT%XMAGPIO command to be sent to GPS module. Leave
	  empty if this command should not be sent.

config SAMPLE_AT_COEX0
	string "AT%XCOEX0 command"
	default "AT\%XCOEX0=1,1,1565,1586" if (BOARD_NRF9160DK_NRF9160_NS || BOARD_THINGY91_NRF9160_NS) && GPS_SAMPLE_ANTENNA_ONBOARD
	default "AT\%XCOEX0" if (BOARD_NRF9160DK_NRF9160_NS || BOARD_THINGY91_NRF9160_NS) && GPS_SAMPLE_ANTENNA_EXTERNAL
	help
	  Defines what is the AT%XCOEX0 command to be sent to GPS module. Leave
	  empty if this command should not be sent.

config LTE_POWER_SAVING_MODE
	bool "Request Power Saving Mode (PSM) from cellular network"

config SAMPLE_AT_MAGPIO
	string "AT%XMAGPIO command"
	default "AT\%XMAGPIO=1,0,0,1,1,1574,1577" if BOARD_NRF9160DK_NRF9160_NS
	default "AT\%XMAGPIO=1,1,1,7,1,746,803,2,698,748,2,1710,2200,3,824,894,4,880,960,5,791,849,7,1565,1586" if BOARD_THINGY91_NRF9160_NS
	help
	  Defines what is the AT%XMAGPIO command to be sent to GPS module. Leave
	  empty if this command should not be sent.

config SAMPLE_AT_COEX0
	string "AT%XCOEX0 command"
	default "AT\%XCOEX0=1,1,1565,1586" if (BOARD_NRF9160DK_NRF9160_NS || BOARD_THINGY91_NRF9160_NS) && GPS_SAMPLE_ANTENNA_ONBOARD
	default "AT\%XCOEX0" if (BOARD_NRF9160DK_NRF9160_NS || BOARD_THINGY91_NRF9160_NS) && GPS_SAMPLE_ANTENNA_EXTERNAL
	help
	  Defines what is the AT%XCOEX0 command to be sent to GPS module. Leave
	  empty if this command should not be sent.

config GNSS_FIX_RETRY
	int "GNSS fix retry period in seconds"
	default 120
	help
	  Fix retry parameter controls the maximum time the GNSS receiver is allowed to run while
	  trying to produce a valid PVT estimate. If the fix retry time is non-zero, the GNSS
	  receiver is turned off after the fix retry time is up regardless of whether a valid PVT
	  estimate was produced or not. If fix retry parameter is set to zero, the GNSS receiver
	  is allowed to run indefinitely until a valid PVT estimate is produced.

config GNSS_FIX_INTERVAL
	int "GNSS fix interval in seconds"
	default 240
	help
	  Single fix navigation mode is engaged by setting the fix interval to 0.
	  Continuous navigation mode is engaged by setting fix interval to 1.
	  Periodic navigation mode is engaged by setting the fix interval to value 10...65535.

endmenu

menu "Zephyr Kernel"
source "Kconfig.zephyr"
endmenu

module = NRF_CLOUD_REST_AGPS_SAMPLE
module-str = nRF Cloud Rest A-GPS Sample
source "${ZEPHYR_BASE}/subsys/logging/Kconfig.template.log_config"
```

## samples/nrf9160/nrf_cloud_rest_agps/sample.yaml
```yaml
sample:
  name: nRF Cloud REST API
tests:
  samples.nrf9160.nrf_cloud_rest_agps:
    build_only: true
    build_on_all: true
    platform_allow: nrf9160dk_nrf9160_ns
    tags: ci_build
    integration_platforms:
      - nrf9160dk_nrf9160_ns
```

## samples/nrf9160/nrf_cloud_rest_cell_pos/Kconfig
```kconfig
#
# Copyright (c) 2022 Nordic Semiconductor ASA
#
# SPDX-License-Identifier: LicenseRef-Nordic-5-Clause
#

menu "nRF Cloud REST Cellular Positioning Sample"

config REST_CELL_POS_DO_JITP
	bool "Ask to perform just-in-time provisioning (JITP) via REST on startup"
	help
	  If a device has JITP certificates and has not yet been provisioned to
	  nRF Cloud, enable this option and press the configured button when
	  prompted after the sample starts.

endmenu

menu "Zephyr Kernel"
source "Kconfig.zephyr"
endmenu

module = NRF_CLOUD_REST_CELL_POS_SAMPLE
module-str = nRF Cloud REST Cellular Positioning Sample
source "${ZEPHYR_BASE}/subsys/logging/Kconfig.template.log_config"
```

## samples/nrf9160/nrf_cloud_rest_cell_pos/sample.yaml
```yaml
sample:
  name: nRF Cloud REST Cellular Positioning
tests:
  sample.nrf9160.nrf_cloud_rest_cell_pos:
    build_only: true
    integration_platforms:
      - nrf9160dk_nrf9160_ns
    platform_allow: nrf9160dk_nrf9160_ns
    tags: ci_build
```

## samples/nrf9160/nrf_cloud_rest_device_message/sample.yaml
```yaml
sample:
  name: nRF Cloud REST Device message
tests:
  samples.nrf9160.nrf_cloud_rest_device_message:
    build_only: true
    platform_allow: nrf9160dk_nrf9160_ns
    integration_platforms:
      - nrf9160dk_nrf9160_ns
    tags: ci_build
```

## samples/nrf9160/nrf_cloud_rest_device_message_tol2/Kconfig
```kconfig
#
# Copyright (c) 2022 Nordic Semiconductor ASA
#
# SPDX-License-Identifier: LicenseRef-Nordic-5-Clause
#

menu "nRF Cloud REST Device Message Sample"

config REST_DEVICE_MESSAGE_SAMPLE_VERSION
	string "The sample's version string"
	default "1.0.0"

endmenu

menu "Zephyr Kernel"
source "Kconfig.zephyr"
endmenu

module = NRF_CLOUD_REST_DEVICE_MESSAGE_SAMPLE
module-str = nRF Cloud Rest Sample
source "${ZEPHYR_BASE}/subsys/logging/Kconfig.template.log_config"
```

## samples/nrf9160/nrf_cloud_rest_fota/Kconfig
```kconfig
#
# Copyright (c) 2021 Nordic Semiconductor ASA
#
# SPDX-License-Identifier: LicenseRef-Nordic-5-Clause
#

menu "nRF Cloud REST FOTA Sample"

config REST_FOTA_SAMPLE_VERSION
	string "The sample's version string"
	default "1.0.0"

config REST_FOTA_JOB_CHECK_RATE_MIN
	int "Rate (minutes) at which this sample will check for FOTA updates"
	default 15

config REST_FOTA_DL_TIMEOUT_MIN
	int "The time (minutes) allotted for a FOTA download to complete"
	default 15
	help
	  If the FOTA download does not complete in the allotted time,
	  the download will be cancelled and the job status will be
	  set as failed.

config REST_FOTA_ENABLE_LED
	depends on DK_LIBRARY
	bool "Turn on LED when connected to network"
	default y

config REST_FOTA_USE_NRF_CLOUD_SETTINGS_AREA
	bool "Use the same settings area as the nRF Cloud FOTA library"
	default y
	help
	  Using the same settings area as the nRF Cloud FOTA library will
	  allow this sample to perform application-FOTA updates to applications
	  built with CONFIG_NRF_CLOUD_FOTA enabled.

config REST_FOTA_SETTINGS_NAME
	depends on !REST_FOTA_USE_NRF_CLOUD_SETTINGS_AREA
	string "Settings identifier for the REST FOTA sample"
	default "rest_fota_sample"
	help
	  The root settings identifier for this application.
	  For application-FOTA, this value should also be found in your target application
	  so that the FOTA status can be properly reported to nRF Cloud.

config REST_FOTA_SETTINGS_KEY_PENDING_JOB
	depends on !REST_FOTA_USE_NRF_CLOUD_SETTINGS_AREA
	string "Settings item key for pending FOTA job info"
	default "pending_job"
	help
	  The settings item key where pending FOTA job info will be stored.
	  For application-FOTA, this value should also be found in your target application
	  so that the FOTA status can be properly reported to nRF Cloud.

if REST_FOTA_ENABLE_LED
config REST_FOTA_LED_NUM
	int "LED number to use"
	default 0
endif

config REST_FOTA_BUTTON_EVT_NUM
	int "Button number to use for device interactions"
	default 1

config REST_FOTA_DO_JITP
	bool "Ask to perform just-in-time provisioning (JITP) via REST on startup"
	help
	  If a device has JITP certificates and has not yet been provisioned to
	  nRF Cloud, enable this option and press the configured button when
	  prompted after the sample starts.

endmenu

menu "Zephyr Kernel"
source "Kconfig.zephyr"
endmenu

module = NRF_CLOUD_REST_FOTA_SAMPLE
module-str = nRF Cloud Rest FOTA Sample
source "${ZEPHYR_BASE}/subsys/logging/Kconfig.template.log_config"
```

## samples/nrf9160/nrf_cloud_rest_fota/sample.yaml
```yaml
sample:
  name: nRF Cloud REST FOTA
tests:
  sample.nrf9160.nrf_cloud_rest_fota:
    build_only: true
    integration_platforms:
      - nrf9160dk_nrf9160_ns
    platform_allow: nrf9160dk_nrf9160_ns
    tags: ci_build
```

## samples/nrf9160/nrf_provisioning/sample.yaml
```yaml
sample:
  name: nRF Device Provisioning
tests:
  sample.nrf9160.nrf_provisioning:
    build_only: true
    integration_platforms:
      - nrf9160dk_nrf9160_ns
    platform_allow: nrf9160dk_nrf9160_ns
```

## samples/nrf9160/nrfx/rtc/Kconfig
```kconfig
mainmenu "NRFX Timed signal"

config FORCE_NRFX_MODULES
	bool "Test to force nrfx enabled"
	select NRFX_RTC
	default y

source "$ZEPHYR_BASE/Kconfig.zephyr"
```

## samples/nrf9160/nrfx_timed_signal/Kconfig
```kconfig
mainmenu "NRFX Timed signal"

config FORCE_NRFX_MODULES
	bool "Test to force nrfx enabled"
	select NRFX_TIMER
	select NRFX_DPPI
	select NRFX_GPIOTE
	default y

source "$ZEPHYR_BASE/Kconfig.zephyr"
```

## samples/nrf9160/pdn/sample.yaml
```yaml
sample:
  name: pdn sample
tests:
  samples.nrf9160.pdn:
    build_only: true
    platform_allow: nrf9160dk_nrf9160ns
    integration_platforms:
      - nrf9160dk_nrf9160ns
    tags: ci_build
```

## samples/nrf9160/pdn_client/Kconfig
```kconfig
#
# Copyright (c) 2020 Nordic Semiconductor ASA
#
# SPDX-License-Identifier: LicenseRef-BSD-5-Clause-Nordic
#

menu "PDN client sample"

config PDN_SAMPLE_APN
	string "Access Point NAme (APN)"
	default "my.app.custom.apn"

endmenu

menu "Zephyr Kernel"
source "Kconfig.zephyr"
endmenu
```

## samples/nrf9160/pdn_client/sample.yaml
```yaml
sample:
  name: pdn_client Sample
tests:
  test_build:
    build_only: true
    build_on_all: true
    platform_whitelist: nrf9160_pca10090ns
    tags: ci_build
```

## samples/nrf9160/pdn_management/Kconfig
```kconfig
#
# Copyright (c) 2019 Nordic Semiconductor ASA
#
# SPDX-License-Identifier: LicenseRef-BSD-5-Clause-Nordic
#

menu "Application sample"

config POWER_OPTIMIZATION_ENABLE
	bool "Enable power optimization"
	default y
	select LTE_EDRX_REQ


endmenu

menu "Zephyr Kernel"
source "$ZEPHYR_BASE/Kconfig.zephyr"
endmenu
```

## samples/nrf9160/secure_boot/Kconfig
```kconfig
#
# Copyright (c) 2018 Nordic Semiconductor ASA
#
# SPDX-License-Identifier: LicenseRef-BSD-5-Clause-Nordic
#

menu "Secure Boot"

	config SB_BOOT_SILENTLY
		bool "Boot silently"
		default n

	config SB_NRF_CLOCK_NS
		bool "Clock control is Non-Secure"
		default y

	config SB_NRF_RTC1_NS
		bool "RTC1 is Non-Secure"
		default y

	config SB_NRF_IPC_NS
		bool "IPC is Non-Secure"
		default y

	config SB_NRF_NVMC_NS
		bool "NVMC is Non-Secure"
		default y

	config SB_NRF_VMC_NS
		bool "VMC is Non-Secure"
		default y

	config SB_NRF_P0_NS
		bool "GPIO is Non-Secure"
		default y

	config SB_NRF_GPIOTE1_NS
		bool "GPIOTE1 IRQ available in Non-Secure domain"
		default y

	config SB_NRF_UARTE1_NS
		bool "UARTE1 is Non-Secure"
		default y

	config SB_NRF_UARTE2_NS
		bool "UARTE2 is Non-Secure"
		default n

	config SB_NRF_EGU1_NS
		bool "EGU1 is Non-Secure"
		default y

	config SB_NRF_EGU2_NS
		bool "EGU2 is Non-Secure"
		default y

	config SB_NRF_FPU_NS
		bool "FPU is Non-Secure"
		default y

	config SB_NRF_TWIM2_NS
		bool "TWIM2 is Non-Secure"
		default y

	config SB_NRF_SPIM3_NS
		bool "SPIM3 is Non-Secure"
		default y

	config SB_NRF_TIMER0_NS
		bool "TIMER0 is Non-Secure"
		default y

	config SB_NRF_TIMER1_NS
		bool "TIMER1 is Non-Secure"
		default y

	config SB_NRF_TIMER2_NS
		bool "TIMER2 is Non-Secure"
		default y

endmenu

menu "Zephyr Kernel"
source "$ZEPHYR_BASE/Kconfig.zephyr"
endmenu
```

## samples/nrf9160/secure_services/sample.yaml
```yaml
sample:
  name: secure services
tests:
  samples.nrf9160.secure_services.default:
    platform_allow: nrf9160dk_nrf9160ns
    tags: ci_build
    harness: console
    harness_config:
      type: multi_line
      ordered: true
      regex:
        - "Secure Services example."
        - "Generate 16 strings of 144 random bytes, read MCUboot header or validate S0 if present, sleep, then reboot."
        - "Random number len 144: 0x[0-9a-f]{288}"
        - "Random number len 144: 0x[0-9a-f]{288}"
        - "Random number len 144: 0x[0-9a-f]{288}"
        - "Random number len 144: 0x[0-9a-f]{288}"
        - "Random number len 144: 0x[0-9a-f]{288}"
        - "Random number len 144: 0x[0-9a-f]{288}"
        - "Random number len 144: 0x[0-9a-f]{288}"
        - "Random number len 144: 0x[0-9a-f]{288}"
        - "Random number len 144: 0x[0-9a-f]{288}"
        - "Random number len 144: 0x[0-9a-f]{288}"
        - "Random number len 144: 0x[0-9a-f]{288}"
        - "Random number len 144: 0x[0-9a-f]{288}"
        - "Random number len 144: 0x[0-9a-f]{288}"
        - "Random number len 144: 0x[0-9a-f]{288}"
        - "Random number len 144: 0x[0-9a-f]{288}"
        - "Random number len 144: 0x[0-9a-f]{288}"
        - "App FW version: 1"
        - "CONFIG_SPM_SERVICE_PREVALIDATE is disabled or bootloader is not present."
        - "FICR.INFO.PART = 0x00009120"
        - "FICR.INFO.VARIANT ..0x210. = 0x41414142"
        - "Reboot in 5 seconds."
        - "Secure Services example."

  samples.nrf9160.secure_services.bootloaders:
    platform_allow: nrf9160dk_nrf9160ns
    extra_args: CONFIG_BOOTLOADER_MCUBOOT=y CONFIG_SECURE_BOOT=y CONFIG_SPM_SERVICE_PREVALIDATE=y mcuboot_CONFIG_EXT_API_PROVIDE_EXT_API_ENABLED=y CONFIG_SPM_SERVICE_S0_ACTIVE=y
    harness: console
    harness_config:
      type: multi_line
      ordered: true
      regex:
        - "Secure Services example."
        - "Generate 16 strings of 144 random bytes, read MCUboot header or validate S0 if present, sleep, then reboot."
        - "Random number len 144: 0x[0-9a-f]{288}"
        - "Random number len 144: 0x[0-9a-f]{288}"
        - "Random number len 144: 0x[0-9a-f]{288}"
        - "Random number len 144: 0x[0-9a-f]{288}"
        - "Random number len 144: 0x[0-9a-f]{288}"
        - "Random number len 144: 0x[0-9a-f]{288}"
        - "Random number len 144: 0x[0-9a-f]{288}"
        - "Random number len 144: 0x[0-9a-f]{288}"
        - "Random number len 144: 0x[0-9a-f]{288}"
        - "Random number len 144: 0x[0-9a-f]{288}"
        - "Random number len 144: 0x[0-9a-f]{288}"
        - "Random number len 144: 0x[0-9a-f]{288}"
        - "Random number len 144: 0x[0-9a-f]{288}"
        - "Random number len 144: 0x[0-9a-f]{288}"
        - "Random number len 144: 0x[0-9a-f]{288}"
        - "Random number len 144: 0x[0-9a-f]{288}"
        - "App FW version: 1"
        - "Read 512 bytes from address 0x28000 .MCUboot header for current image.."
        - "S0 .0x8200. valid. True"
        - "FICR.INFO.PART = 0x00009120"
        - "FICR.INFO.VARIANT ..0x210. = 0x41414142"
        - "Reboot in 5 seconds."
        - "Secure Services example."

  samples.nrf9160.secure_services.b0_mcuboot:
    platform_allow: nrf9160dk_nrf9160ns
    extra_args: OVERLAY_CONFIG="b0_mcuboot_overlay.conf"
    build_only: true
    build_on_all: true
    tags: ci_build
```
