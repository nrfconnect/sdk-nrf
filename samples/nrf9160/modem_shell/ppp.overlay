/*
 * Copyright (c) 2021 Nordic Semiconductor ASA
 *
 * SPDX-License-Identifier: LicenseRef-Nordic-5-Clause
 */
&uart0 {
	compatible = "nordic,nrf-uarte";
	status = "okay";
	hw-flow-control;
};

/* Enable uart1. Note: cannot be used with T-FM.
 * See: https://github.com/zephyrproject-rtos/zephyr/commit/0856e4ba518d32576ed1800a4b70a33617196474
 */
&uart1 {
	status = "okay";
};

/ {
	chosen {
		zephyr,ppp-uart = &uart0;
		zephyr,console = &uart1;
		zephyr,shell-uart = &uart1;
	};
};
