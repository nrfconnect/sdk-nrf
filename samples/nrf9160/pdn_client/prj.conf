## CMakeLists.txt
```
#
# Copyright (c) 2020 Nordic Semiconductor
#
# SPDX-License-Identifier: LicenseRef-BSD-5-Clause-Nordic
#

cmake_minimum_required(VERSION 3.8.2)

include($ENV{ZEPHYR_BASE}/../nrf/cmake/boilerplate.cmake)
include($ENV{ZEPHYR_BASE}/cmake/app/boilerplate.cmake NO_POLICY_SCOPE)
project(pdn_client)

# NORDIC SDK APP START
target_sources(app PRIVATE src/pdn_client.c)
# NORDIC SDK APP END
```

## Kconfig
```
#
# Copyright (c) 2020 Nordic Semiconductor ASA
#
# SPDX-License-Identifier: LicenseRef-BSD-5-Clause-Nordic
#

menu "PDN client sample"

config PDN_SAMPLE_APN
	string "Access Point NAme (APN)"
	default "my.app.custom.apn"

endmenu

menu "Zephyr Kernel"
source "Kconfig.zephyr"
endmenu
```

## sample.yaml
```
sample:
  name: pdn_client Sample
tests:
  test_build:
    build_only: true
    build_on_all: true
    platform_whitelist: nrf9160_pca10090ns
    tags: ci_build
```

## prj.conf
```kconfig
#
# Copyright (c) 2019 Nordic Semiconductor ASA
#
# SPDX-License-Identifier: LicenseRef-BSD-5-Clause-Nordic
#
# General config
CONFIG_ASSERT=y

# Network
CONFIG_NETWORKING=y
CONFIG_NET_NATIVE=n
CONFIG_NET_SOCKETS=y
CONFIG_NET_SOCKETS_OFFLOAD=y

# BSD library
CONFIG_BSD_LIBRARY=y

# AT libraries
CONFIG_AT_CMD=y
CONFIG_AT_NOTIF=y

# LTE link control
CONFIG_LTE_LINK_CONTROL=y
CONFIG_LTE_AUTO_INIT_AND_CONNECT=n

# PDN library
CONFIG_PDN=y

# Stacks and heaps
CONFIG_MAIN_STACK_SIZE=3072
CONFIG_HEAP_MEM_POOL_SIZE=2048
```

## src/pdn_client.c
```c
/*
 * Copyright (c) 2020 Nordic Semiconductor ASA
 *
 * SPDX-License-Identifier: LicenseRef-BSD-5-Clause-Nordic
 */

#include <zephyr.h>
#include <stdio.h>
#include <string.h>
#include <pdn.h>
#include <net/bsdlib.h>
#include <at_cmd.h>
#include <at_notif.h>
#include <lte_lc.h>

/**@brief Configures modem to provide LTE link. Blocks until link is
 * successfully established.
 */
static void modem_configure(void)
{
	int err;

	if (IS_ENABLED(CONFIG_LTE_AUTO_INIT_AND_CONNECT)) {
		/* Do nothing, modem is already turned on
		 * and connected.
		 */
	} else {
		printk("LTE Link Connecting ...\n");
		err = lte_lc_init_and_connect();
		__ASSERT(err == 0, "LTE link could not be established.");
		printk("LTE Link Connected!\n");
	}
}

void main(void)
{
	int error;
	const char *const address = CONFIG_PDN_SAMPLE_APN;

	printk("The PDN client sample started\n");

	modem_configure();

	printk("Connecting to APN '%s'... ", address);

	const int pdn_handle = pdn_connect(address, PDN_INET_IPV4V6);

	if (pdn_handle < 0) {
		printk("FAIL! Error: %d\n", pdn_handle);
		return;
	}

	printk("OK\nActivating the PDN... ");

	error = pdn_activate(pdn_handle);
	if (error < 0) {
		printk("FAIL! Error=%d\n", error);

		printk("Try to activate default PDN... ");

		error = pdn_activate(0);
		if (error < 0) {
			printk("FAIL! Error=%d\n", error);
			return;
		}
	}

	printk("OK\nPDN state=%d and ID=%d\n", pdn_state_get(pdn_handle),
	       pdn_id_get(pdn_handle));

	printk("Deactivate and disconnect the PDN... ");
	pdn_disconnect(pdn_handle);

	printk("OK\nSample completed, exiting...\n");
}
```
