#include <nrf9160dk_nrf52840_reset_on_if5.dtsi>

/ {
	chosen {
		zephyr,bt-uart=&lpuart;
	};
};

&uart2 {
	current-speed = <1000000>;
	status = "okay";
	tx-pin = <18>; /* <&interface_to_nrf52840 1 0>; */
	rx-pin = <17>; /* <&interface_to_nrf52840 0 0>; */
	/delete-property/ rts-pin;
	/delete-property/ cts-pin;
	/delete-property/ hw-flow-control;

	lpuart: nrf-sw-lpuart {
		compatible = "nordic,nrf-sw-lpuart";
		status = "okay";
		label = "LPUART";
		req-pin = <21>; /* <&interface_to_nrf52840 3 0>; */
		rdy-pin = <19>; /* <&interface_to_nrf52840 2 0>; */
	};
};
