## samples/nrf9160/agps/Kconfig
```kconfig
#
# Copyright (c) 2020 Nordic Semiconductor ASA
#
# SPDX-License-Identifier: LicenseRef-Nordic-5-Clause
#

menu "A-GPS Sample Settings"

config CLOUD_MESSAGE
	string "Custom message published periodically to cloud"
	default "{\"state\":{\"reported\":{\"message\":\"Hello Internet of Things!\"}}}"

config LTE_POWER_SAVING_MODE
	bool "Request Power Saving Mode (PSM) from cellular network"

if NRF_CLOUD_PGPS
config PGPS_STORE_LOCATION
	bool "Store location when GPS fix occurs"
	help
	  For semi-stationary applications, the first fix after reset will
	  be faster using predicted GPS if the last known location is provided
	  to the modem.
endif

endmenu

menu "Zephyr Kernel"
source "Kconfig.zephyr"
endmenu

module = AGPS_SAMPLE
module-str = A-GPS sample
source "${ZEPHYR_BASE}/subsys/logging/Kconfig.template.log_config"
```

## samples/nrf9160/agps/sample.yaml
```yaml
sample:
  name: A-GPS sample
tests:
  samples.nrf9160.agps:
    build_only: true
    platform_allow: nrf9160dk_nrf9160_ns thingy91_nrf9160ns
    integration_platforms:
      - nrf9160dk_nrf9160_ns
      - thingy91_nrf9160ns
    tags: ci_build
```

## samples/nrf9160/asset_tracker/Kconfig
```kconfig
#
# Copyright (c) 2018 Nordic Semiconductor ASA
#
# SPDX-License-Identifier: LicenseRef-BSD-5-Clause-Nordic
#

menu "Application sample"

config POWER_OPTIMIZATION_ENABLE
	bool "Enable power optimization"
	default y
	select LTE_EDRX_REQ

config GPS_SIM_TRIGGER_TIMER_MSEC
	int
	default 120000 if POWER_OPTIMIZATION_ENABLE
	default 2000

config MQTT_KEEPALIVE
	int
	default 1000 if POWER_OPTIMIZATION_ENABLE
	default 120
choice
	prompt "GPS device"
	default GPS_USE_SIM
	help
		Select from which device GPS data will be fetched.

config GPS_USE_SIM
	bool "Use GPS simulator"
	select GPS_SIM
	select GPS_SIM_TRIGGER
	help
		Use simulated GPS data.

config GPS_USE_EXTERNAL
	bool "User provided GPS device"
	help
		Provide a GPS device that location data will be fetched from and
		sent to nRF Cloud

endchoice

if GPS_USE_SIM

config GPS_DEV_NAME
	string
	default GPS_SIM_DEV_NAME

config GPS_TRIGGER
	bool
	default GPS_SIM_TRIGGER

endif

if GPS_USE_EXTERNAL
config GPS_DEV_NAME
	string "GPS device name"
	help
		GPS device from which location data will be fetched and sent
		to nRF Cloud.

endif

choice
	prompt "Accelerometer device"
	default ACCEL_USE_SIM
	help
		Select which device will provide accelerometer data.

config ACCEL_USE_SIM
	bool "Use simulated accelerometer data"
	select SENSOR
	select SENSOR_SIM
	select SENSOR_SIM_TRIGGER
	select SENSOR_SIM_STATIC_VALUES
	help
		Use sensor simulator to generate accelerometer data for
		flip detection data sent to nRF Cloud.

config ACCEL_USE_EXTERNAL
	bool "User provided accelerometer device"
	help
		The user will provide an accelerometer device that will
		be used for flip detection.

endchoice

if ACCEL_USE_SIM
config ACCEL_DEV_NAME
	string
	default SENSOR_SIM_DEV_NAME

config ACCEL_TRIGGER
	bool
	default SENSOR_SIM_TRIGGER
endif

if ACCEL_USE_EXTERNAL

config ACCEL_DEV_NAME
	string "Accelerometer device name"
	help
		Device from which accelerometer data will be fetched and used
		for orientation detection and sent to nRF Cloud.

endif

choice
	prompt "nRF Cloud user association"
	default CLOUD_UA_BUTTONS
	help
		Select which method to use for nRF Cloud user association
		input.

config CLOUD_UA_BUTTONS
	bool "Use buttons and switches"
	help
		Use buttons and switches on the development kit to provide
		user association input.

config CLOUD_UA_CONSOLE
	bool "Use console input"
	help
		Use console to enter nRF Cloud user association input.
		Allowed input is as follows:
		'b1' = Button 1
		'b2' = Button 2
		's1' = Switch 1
		's2' = Switch 2

endchoice
endmenu

menu "Zephyr Kernel"
source "$ZEPHYR_BASE/Kconfig.zephyr"
endmenu
```

## samples/nrf9160/at_client/sample.yaml
```yaml
sample:
  name: at_client Sample
tests:
  sample.nrf9160.at_client:
    build_only: true
    integration_platforms:
      - nrf9160dk_nrf9160_ns
    platform_allow: nrf9160dk_nrf9160_ns
    tags: ci_build
```

## samples/nrf9160/at_host/sample.yaml
```yaml
sample:
  name: at_host sample
tests:
  samples.nrf9160.at_host:
    build_only: true
    build_on_all: true
    platform_allow: nrf9160dk_nrf9160ns
    tags: ci_build
```

## samples/nrf9160/at_monitor/sample.yaml
```yaml
sample:
  name: AT monitor sample
tests:
  samples.nrf9160.at_monitor:
    build_only: true
    platform_allow: nrf9160dk_nrf9160_ns
    integration_platforms:
      - nrf9160dk_nrf9160_ns
    tags: ci_build
```

## samples/nrf9160/aws_fota/Kconfig
```kconfig
#
# Copyright (c) 2019 Nordic Semiconductor ASA
#
# SPDX-License-Identifier: LicenseRef-Nordic-5-Clause
#

menu "MQTT FOTA Sample Settings"

config APP_VERSION
	string "Application version"
	default "v1.0.0"

config  CERT_SEC_TAG
	int "Security tag for TLS credentials"
	default 12345678
	help
	  Security tag where the certificates for the AWS IoT MQTT broker
	  are stored.

config USE_CUSTOM_CLIENT_ID
	bool "Custom MQTT client ID"

config CLIENT_ID
	depends on USE_CUSTOM_CLIENT_ID
	string "Client ID"
	default "your_client_id"

config MQTT_BROKER_HOSTNAME
	string "AWS IoT MQTT broker hostname"
	default "your_aws_mqtt_broker_hostname.amazonaws.com"
	help
	  Address to your AWS IoT MQTT broker.

config MQTT_BROKER_PORT
	int "AWS IoT MQTT broker port"
	default 8883

config CLIENT_ID_PREFIX
	depends on !USE_CUSTOM_CLIENT_ID
	string "Prefix used when constructing the MQTT client ID from the IMEI"
	default "nrf-"
	help
	  Generates an MQTT client ID based on the prefix and IMEI from the
	  device.

config MQTT_MESSAGE_BUFFER_SIZE
	int "MQTT message buffer size"
	default 128

config MQTT_PAYLOAD_BUFFER_SIZE
	int "MQTT payload buffer size"
	default 128

endmenu

menu "Zephyr Kernel"
source "Kconfig.zephyr"
endmenu
```

## samples/nrf9160/aws_fota/sample.yaml
```yaml
sample:
  name: AWS IoT Jobs FOTA sample
tests:
  sample.nrf9160.aws_fota:
    build_only: true
    integration_platforms:
      - nrf9160dk_nrf9160_ns
    platform_allow: nrf9160dk_nrf9160_ns
    tags: ci_build
```

## samples/nrf9160/aws_iot/Kconfig
```kconfig
#
# Copyright (c) 2020 Nordic Semiconductor ASA
#
# SPDX-License-Identifier: LicenseRef-Nordic-5-Clause
#

menu "AWS IoT Sample Settings"

config APP_VERSION
	string "Application version"
	default "v1.0.0"

config PUBLICATION_INTERVAL_SECONDS
	int "Interval in seconds that the sample will publish data"
	default 60

config CONNECTION_RETRY_TIMEOUT_SECONDS
	int "Number of seconds between each AWS IoT connection retry"
	default 30

config AWS_IOT_SAMPLE_DEVICE_ID_USE_HW_ID
	bool "Use HW ID as device ID"
	select HW_ID_LIBRARY
	help
	  Use the devices's hardware ID as device ID when connecting to AWS IOT

module = AWS_IOT_SAMPLE
module-str = AWS IoT sample
source "${ZEPHYR_BASE}/subsys/logging/Kconfig.template.log_config"

endmenu

menu "Zephyr Kernel"
source "Kconfig.zephyr"
endmenu
```

## samples/nrf9160/aws_iot/sample.yaml
```yaml
sample:
  name: AWS IoT sample
tests:
  samples.nrf9160.aws_iot:
    build_only: true
    platform_allow: nrf9160dk_nrf9160_ns thingy91_nrf9160ns
    integration_platforms:
      - nrf9160dk_nrf9160_ns
      - thingy91_nrf9160ns
    tags: ci_build
```

## samples/nrf9160/azure_fota/Kconfig
```kconfig
#
# Copyright (c) 2022 Nordic Semiconductor ASA
#
# SPDX-License-Identifier: LicenseRef-Nordic-5-Clause
#

menu "Azure FOTA sample"

menu "Zephyr Kernel"
source "Kconfig.zephyr"
endmenu

module = AZURE_FOTA_SAMPLE
module-str = Azure FOTA sample
source "${ZEPHYR_BASE}/subsys/logging/Kconfig.template.log_config"

config AZURE_FOTA_SAMPLE_DEVICE_ID_USE_HW_ID
	bool "Use HW ID as device ID"
	select HW_ID_LIBRARY
	help
	  Use the devices's hardware ID as device ID when connecting to Azure IOT Hub

endmenu
```

## samples/nrf9160/azure_fota/sample.yaml
```yaml
sample:
  name: Azure FOTA sample
tests:
  sample.nrf9160.azure_fota:
    build_only: true
    integration_platforms:
      - nrf9160dk_nrf9160_ns
    platform_allow: nrf9160dk_nrf9160_ns
    tags: ci_build
```

## samples/nrf9160/azure_iot_hub/Kconfig
```kconfig
#
# Copyright (c) 2022 Nordic Semiconductor ASA
#
# SPDX-License-Identifier: LicenseRef-Nordic-5-Clause
#

menu "Azure IoT Hub sample"

menu "Zephyr Kernel"
source "Kconfig.zephyr"
endmenu

module = AZURE_IOT_HUB_SAMPLE
module-str = Azure IoT Hub sample
source "${ZEPHYR_BASE}/subsys/logging/Kconfig.template.log_config"

config DEVICE_ID_USE_UUID
	bool "Use modem UUID as device ID"
	help
		Use the devices's modem UUID as device ID when connecting to Azure IOT hub

endmenu
```

## samples/nrf9160/azure_iot_hub/sample.yaml
```yaml
sample:
  name: Azure IoT Hub sample
tests:
  samples.nrf9160.azure_iot_hub:
    build_only: true
    platform_allow: nrf9160dk_nrf9160_ns
    integration_platforms:
      - nrf9160dk_nrf9160_ns
    tags: ci_build
```

## samples/nrf9160/ciphersuites/sample.yaml
```yaml
sample:
  name: TLS Ciphersuites sample
tests:
  samples.nrf9160.ciphersuites:
    build_only: true
    platform_allow: nrf9160dk_nrf9160_ns
    integration_platforms:
      - nrf9160dk_nrf9160_ns
    tags: ci_build
```

## samples/nrf9160/cloud_client/Kconfig
```kconfig
#
# Copyright (c) 2020 Nordic Semiconductor ASA
#
# SPDX-License-Identifier: LicenseRef-Nordic-5-Clause
#

menu "Cloud Client Sample Settings"

config CLOUD_BACKEND
	string "Selects the cloud backend to be used"
	default "NRF_CLOUD"
	help
	  Possible values are "NRF_CLOUD", "AWS_IOT", "AZURE_IOT_HUB".

config CLOUD_MESSAGE
	string "Sets the custom message published periodically to cloud"
	default "{\"state\":{\"reported\":{\"message\":\"Hello Internet of Things!\"}}}"

config CLOUD_MESSAGE_PUBLICATION_INTERVAL
	int "Sets how often the custom message should be published to cloud, in seconds"
	default 10

config CLOUD_CONNECTION_RETRY_TIMEOUT_SECONDS
	int "Sets the number of seconds between each cloud connection retry"
	default 30

choice
	prompt "Cloud Publication Trigger"
	default CLOUD_PUBLICATION_BUTTON_PRESS

config CLOUD_PUBLICATION_BUTTON_PRESS
	bool "Triggers publication to cloud upon a button press"

config CLOUD_PUBLICATION_SEQUENTIAL
	bool "Sets sequential publication to cloud set by the CONFIG_MESSAGE_PUBLICATION_INTERVAL option"

endchoice

config POWER_SAVING_MODE_ENABLE
	bool "Requests PSM from cellular network"

endmenu

module = CLOUD_CLIENT
module-str = Cloud client
source "${ZEPHYR_BASE}/subsys/logging/Kconfig.template.log_config"

menu "Zephyr Kernel"
source "Kconfig.zephyr"
endmenu
```

## samples/nrf9160/cloud_client/sample.yaml
```yaml
sample:
  name: Cloud client sample
tests:
  sample.nrf9160.cloud_client:
    build_only: true
    integration_platforms:
      - nrf9160dk_nrf9160_ns
      - thingy91_nrf9160_ns
    platform_allow: nrf9160dk_nrf9160_ns thingy91_nrf9160_ns
    tags: ci_build
  sample.nrf9160.cloud_client.aws:
    build_only: true
    extra_configs:
      - CONFIG_CLOUD_BACKEND="AWS_IOT"
      - CONFIG_AWS_IOT=y
      - CONFIG_AWS_IOT_SEC_TAG=1234
      - CONFIG_AWS_IOT_CLIENT_ID_STATIC="dummy-id"
      - CONFIG_AWS_IOT_BROKER_HOST_NAME="dummy-host.net"
      - CONFIG_AWS_IOT_TOPIC_UPDATE_DELTA_SUBSCRIBE=y
    integration_platforms:
      - nrf9160dk_nrf9160_ns
      - thingy91_nrf9160_ns
    platform_allow: nrf9160dk_nrf9160_ns thingy91_nrf9160_ns
    tags: ci_build
  sample.nrf9160.cloud_client.azure:
    build_only: true
    extra_configs:
      - CONFIG_CLOUD_BACKEND="AZURE_IOT_HUB"
      - CONFIG_AZURE_IOT_HUB_HOSTNAME="dummy-host.net"
      - CONFIG_AZURE_IOT_HUB_DEVICE_ID="dummy-id"
      - CONFIG_AZURE_IOT_HUB_SEC_TAG=1234
      - CONFIG_AZURE_IOT_HUB=y
    integration_platforms:
      - nrf9160dk_nrf9160_ns
      - thingy91_nrf9160_ns
    platform_allow: nrf9160dk_nrf9160_ns thingy91_nrf9160_ns
    tags: ci_build
```

## samples/nrf9160/coap_client/Kconfig
```kconfig
#
# Copyright (c) 2019 Nordic Semiconductor ASA
#
# SPDX-License-Identifier: LicenseRef-Nordic-5-Clause
#

menu "nRF CoAP client sample"

config COAP_RESOURCE
	string "CoAP resource - defaults to Californium observable resource"
	default "obs"

config COAP_SERVER_HOSTNAME
	string "CoAP server hostname"
	default "californium.eclipseprojects.io"

config COAP_SERVER_PORT
	int "CoAP server port"
	default 5683

endmenu

menu "Zephyr Kernel"
source "Kconfig.zephyr"
endmenu
```

## samples/nrf9160/coap_client/boards/qemu_x86.conf
```kconfig
#
# Copyright (c) 2019 Nordic Semiconductor ASA
#
# SPDX-License-Identifier: LicenseRef-Nordic-5-Clause
#
# General config
CONFIG_TEST_RANDOM_GENERATOR=y
CONFIG_NEWLIB_LIBC=n

# Networking config
CONFIG_NET_IPV4=y
CONFIG_NET_NATIVE=y
CONFIG_NET_SOCKETS_OFFLOAD=n
CONFIG_NET_UDP=y

CONFIG_DNS_RESOLVER=y
CONFIG_DNS_SERVER_IP_ADDRESSES=y
CONFIG_DNS_SERVER1="8.8.8.8"

# Network address config
CONFIG_NET_CONFIG_SETTINGS=y
CONFIG_NET_CONFIG_NEED_IPV4=y
CONFIG_NET_CONFIG_MY_IPV4_ADDR="192.0.2.1"
CONFIG_NET_CONFIG_PEER_IPV4_ADDR="192.0.2.2"
CONFIG_NET_CONFIG_MY_IPV4_GW="192.0.2.2"

# Main thread
CONFIG_MINIMAL_LIBC=y
CONFIG_MINIMAL_LIBC_MALLOC=y
CONFIG_COMMON_LIBC_MALLOC_ARENA_SIZE=2048

# LTE link control
CONFIG_LTE_LINK_CONTROL=n

# Modem library
CONFIG_NRF_MODEM_LIB=n

# AT Host
CONFIG_AT_HOST_LIBRARY=n
```

## samples/nrf9160/coap_client/sample.yaml
```yaml
sample:
  name: nRF CoAP client sample
tests:
  sample.nrf9160.coap_client:
    build_only: true
    integration_platforms:
      - nrf9160dk_nrf9160_ns
    platform_allow: nrf9160dk_nrf9160_ns
    tags: ci_build
```

## samples/nrf9160/download/Kconfig
```kconfig
menu "Download sample"

config SAMPLE_SECURE_SOCKET
	bool "Use TLS/DTLS"

if SAMPLE_SECURE_SOCKET
config SAMPLE_SEC_TAG
	int "Security tag"
	default 42

config SAMPLE_CERT_FILE
	string "Certificate file name"
	default "../cert/file-example.pem"
endif

choice SAMPLE_FILE
	prompt "Test file"

config SAMPLE_FILE_HTTP
	bool "HTTP test file"
	depends on !SAMPLE_SECURE_SOCKET
config SAMPLE_FILE_HTTPS
	bool "HTTPS test file"
	depends on SAMPLE_SECURE_SOCKET
config SAMPLE_FILE_CUSTOM
	bool "Custom test file"

endchoice

config SAMPLE_FILE_URL
	string "URL of resource to download" if SAMPLE_FILE_CUSTOM
	default "http://speedtest.ftp.otenet.gr/files/test100k.db" if SAMPLE_FILE_HTTP
	default "https://file-examples-com.github.io/uploads/2017/10/file_example_JPG_100kB.jpg" if SAMPLE_FILE_HTTPS

config SAMPLE_COMPUTE_HASH
	bool "Compute sha256 hash"
	select MBEDTLS

config SAMPLE_COMPARE_HASH
	bool "Compare hash"
	depends on SAMPLE_COMPUTE_HASH

config SAMPLE_SHA256_HASH
	string "sha256 hash"
	depends on SAMPLE_COMPARE_HASH
	default "f627ca4c2c322f15db26152df306bd4f983f0146409b81a4341b9b340c365a16" if SAMPLE_FILE_HTTP
	default "88aeb1f4467bd1e50cf624de972fbf3f40801632fedb64aaa7b1a8a9ef786fc6" if SAMPLE_FILE_HTTPS

endmenu

menu "Zephyr Kernel"
source "Kconfig.zephyr"
endmenu
```

## samples/nrf9160/download/sample.yaml
```yaml
sample:
  name: Download sample
tests:
  samples.nrf9160.download_client:
    build_only: true
    platform_allow: nrf9160dk_nrf9160_ns
    integration_platforms:
      - nrf9160dk_nrf9160_ns
    tags: ci_build
    extra_configs:
      - CONFIG_SHELL=y
      - CONFIG_COAP=y
      - CONFIG_DOWNLOAD_CLIENT_SHELL=y
  samples.nrf9160.download.tfm:
    build_only: true
    platform_allow: nrf9160dk_nrf9160_ns
    integration_platforms:
      - nrf9160dk_nrf9160_ns
    tags: ci_build
    extra_args: OVERLAY_CONFIG="overlay-tfm.conf"
```

## samples/nrf9160/fmfu_smp_svr/sample.yaml
```yaml
sample:
  description: Full modem firmware update Simple Management Protocol sample
  name: Full modem serial update sample
tests:
  samples.nrf9160.fmfu_smp_svr:
    build_only: true
    platform_allow: nrf9160dk_nrf9160_ns
    integration_platforms:
      - nrf9160dk_nrf9160_ns
    tags: ci_build
```
