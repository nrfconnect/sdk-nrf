/* Copyright (c) 2020 Nordic Semiconductor ASA
 *
 * SPDX-License-Identifier: LicenseRef-BSD-5-Clause-Nordic
 */

&uart0 {
	/*
	 * Only TX is used in this sample, so delete the RX pin assignment
	 * to prevent UART receiver from being enabled and consuming power.
	 */
	/delete-property/ rx-pin;
};
&uart1 {
	status = "disabled";
};
&uart2 {
	status = "disabled";
};
&uart3 {
	status = "disabled";
};
