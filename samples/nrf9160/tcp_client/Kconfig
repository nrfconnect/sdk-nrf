## samples/nrf9160/tcp_client/Kconfig
```kconfig
#
# Copyright (c) 2020 Nordic Semiconductor ASA
#
# SPDX-License-Identifier: LicenseRef-BSD-5-Clause-Nordic
#

menu "TCP Sample Settings"

config TCP_DATA_UPLOAD_SIZE_BYTES
	int "Number of bytes transmitted to the server"
	default 10

config TCP_DATA_UPLOAD_FREQUENCY_SECONDS
	int "How often data is transmitted to the server"
	default 900

config TCP_SERVER_ADDRESS_STATIC
	string "TCP server IP address"
	default "8.8.8.8"

config TCP_SERVER_PORT
	int "TCP server port number"
	default "2469"

config TCP_PSM_ENABLE
	bool "Enable LTE Power Saving Mode"
	default y

config TCP_EDRX_ENABLE
	bool "Enable LTE enhanced Discontinuous Reception"
	default y

config TCP_RAI_ENABLE
	bool "Enable LTE Release Assistance Indication"
	default y

endmenu

module = TCP
module-str = TCP sample
source "${ZEPHYR_BASE}/subsys/logging/Kconfig.template.log_config"

menu "Zephyr Kernel"
source "Kconfig.zephyr"
endmenu
```

## samples/nrf9160/udp/Kconfig
```kconfig
#
# Copyright (c) 2020 Nordic Semiconductor ASA
#
# SPDX-License-Identifier: LicenseRef-Nordic-5-Clause
#

menu "UDP Sample Settings"

config UDP_DATA_UPLOAD_SIZE_BYTES
	int "Number of bytes transmitted to the server"
	default 10

config UDP_DATA_UPLOAD_FREQUENCY_SECONDS
	int "How often data is transmitted to the server"
	default 900

config UDP_SERVER_ADDRESS_STATIC
	string "UDP server IP address"
	default "8.8.8.8"

config UDP_SERVER_PORT
	int "UDP server port number"
	default "2469"

config UDP_PSM_ENABLE
	bool "Enable LTE Power Saving Mode"
	default y

config UDP_EDRX_ENABLE
	bool "Enable LTE enhanced Discontinuous Reception"

config UDP_RAI_ENABLE
	bool "Enable LTE Release Assistance Indication"

endmenu

module = UDP
module-str = UDP sample
source "${ZEPHYR_BASE}/subsys/logging/Kconfig.template.log_config"

menu "Zephyr Kernel"
source "Kconfig.zephyr"
endmenu
```

## samples/nrf9160/udp/boards/qemu_x86.conf
```kconfig
#
# Copyright (c) 2020 Nordic Semiconductor ASA
#
# SPDX-License-Identifier: LicenseRef-Nordic-5-Clause
#

# General config
CONFIG_SERIAL=y
CONFIG_NCS_SAMPLES_DEFAULTS=n

# Networking config
CONFIG_NET_NATIVE=y
CONFIG_NET_IPV4=y
CONFIG_NET_TCP=y
CONFIG_NET_SOCKETS_POSIX_NAMES=y
CONFIG_NET_SOCKETS_OFFLOAD=n

# LTE link control
CONFIG_LTE_LINK_CONTROL=n

# Modem library
CONFIG_NRF_MODEM_LIB=n

# LTE parameters
CONFIG_LTE_NETWORK_MODE_LTE_M=n
CONFIG_UDP_PSM_ENABLE=n
CONFIG_UDP_EDRX_ENABLE=n
CONFIG_UDP_RAI_ENABLE=n

# Network address config
CONFIG_NET_CONFIG_SETTINGS=y
CONFIG_NET_CONFIG_NEED_IPV4=y
CONFIG_NET_CONFIG_MY_IPV4_ADDR="192.0.2.1"
CONFIG_NET_CONFIG_MY_IPV4_GW="192.0.2.2"

# Network DNS config
CONFIG_DNS_RESOLVER=y
CONFIG_DNS_SERVER_IP_ADDRESSES=y
CONFIG_DNS_SERVER1="8.8.8.8"
```

## samples/nrf9160/udp_gps/Kconfig
```kconfig
menu "GPS"

choice
	prompt "GPS device"
	default GPS_USE_SIM
	help
		Select from which device GPS data will be fetched.

config GPS_USE_SIM
	bool "Use GPS simulator"
	select GPS_SIM
	select GPS_SIM_TRIGGER
	help
		Use simulated GPS data.

config GPS_USE_EXTERNAL
	bool "User provided GPS device"
	help
		Provide a GPS device that location data will be fetched from and
		sent to nRF Cloud

endchoice

rsource "src/gps_controller/Kconfig"

config GPS_DEV_NAME
	string "GPS device name"
	default GPS_SIM_DEV_NAME if GPS_USE_SIM
	help
		GPS device from which location data will be fetched and sent
		to nRF Cloud.

config GPS_TRIGGER
	bool
	default GPS_SIM_TRIGGER if GPS_USE_SIM

config GPS_SIM_TRIGGER_TIMER_MSEC
	int
	default 120000 if POWER_OPTIMIZATION_ENABLE
	default 2000

endmenu	# GPS

menu "Zephyr Kernel"
source "$ZEPHYR_BASE/Kconfig.zephyr"
endmenu
```

## samples/nrf93m1dk/modem_bypass/Kconfig
```kconfig
#
# Copyright (c) 2026 Nordic Semiconductor
#
# SPDX-License-Identifier: LicenseRef-Nordic-5-Clause
#

source "Kconfig.zephyr"
```

## samples/nrf93m1dk/modem_bypass/sample.yaml
```yaml
sample:
  name: nRF93M1 DK modem bypass
  description: |
    Sample that puts the nRF93M1 modem UART in bypass mode, forwarding it to
    the USB CDC-ACM VCOM port for direct AT command access from a host PC.
tests:
  sample.nrf93m1dk.modem_bypass:
    sysbuild: true
    build_only: true
    integration_platforms:
      - nrf93m1dk/nrf54l15/cpuapp
    platform_allow:
      - nrf93m1dk/nrf54l15/cpuapp
    tags:
      - ci_build
      - ci_samples_nrf93m1dk
```

## samples/nrf93m1dk/ppp_shell/boards/nrf93m1dk_nrf54l15_cpuapp.conf
```kconfig
#
# Copyright (c) 2026 Nordic Semiconductor ASA
#
# SPDX-License-Identifier: LicenseRef-Nordic-5-Clause
#

# Use UART async API with PM_RUNTIME.
CONFIG_UART_INTERRUPT_DRIVEN=n
CONFIG_UART_ASYNC_API=y
CONFIG_SHELL_BACKEND_SERIAL_API_ASYNC=y
CONFIG_MODEM_BACKEND_UART_ASYNC_HWFC=y
CONFIG_MODEM_BACKEND_UART_ASYNC_RECEIVE_IDLE_TIMEOUT_MS=1

CONFIG_MODEM_CMUX_MTU=127
CONFIG_MODEM_CMUX_WORK_BUFFER_SIZE_EXTRA=532
CONFIG_MODEM_CELLULAR_UART_BUFFER_SIZES=532
CONFIG_MODEM_CMUX_MSC_FC_THRESHOLD=32
```

## samples/nrf_compress/mcuboot_update/Kconfig
```kconfig
#
# Copyright (c) 2024 Nordic Semiconductor
#
# SPDX-License-Identifier: LicenseRef-Nordic-5-Clause
#

config OUTPUT_BOOT_MESSAGE
	bool "Output message on boot"
	help
	  Will output a dummy message on boot, this is to allow for generating a different image
	  that can be used to test the compressed firmware update.

source "Kconfig.zephyr"
```

## samples/nrf_compress/mcuboot_update/Kconfig.sysbuild
```kconfig
#
# Copyright (c) 2025 Nordic Semiconductor
#
# SPDX-License-Identifier: LicenseRef-Nordic-5-Clause
#

config PARTITION_MANAGER
	default n if SOC_SERIES_NRF52 || SOC_NRF54L15 || SOC_NRF54LM20A || SOC_NRF54LV10A

source "share/sysbuild/Kconfig"
```

## samples/nrf_compress/mcuboot_update/sample.yaml
```yaml
common:
  sysbuild: true
  tags:
    - sysbuild
    - ci_samples_nrf_compress
  harness: console
  harness_config:
    type: multi_line
    ordered: true
    regex:
      - "Starting bootloader"
      - "Jumping to the first image slot"
      - "smp_bt_sample: Advertising successfully started"
  timeout: 15
tests:
  nrf_compress.mcuboot_update:
    platform_allow:
      - nrf52840dk/nrf52840
      - nrf5340dk/nrf5340/cpuapp
      - nrf54h20dk/nrf54h20/cpuapp
      - nrf54l15dk/nrf54l15/cpuapp
      - nrf54lm20dk/nrf54lm20a/cpuapp
      - nrf54lv10dk/nrf54lv10a/cpuapp
    integration_platforms:
      - nrf52840dk/nrf52840
      - nrf5340dk/nrf5340/cpuapp
      - nrf54l15dk/nrf54l15/cpuapp
      - nrf54lm20dk/nrf54lm20a/cpuapp
      - nrf54lv10dk/nrf54lv10a/cpuapp
```

## samples/nrf_compress/mcuboot_update/sysbuild/mcuboot/boards/nrf54lm20dk_nrf54lm20a_cpuapp.conf
```kconfig
#
# Copyright (c) 2025 Nordic Semiconductor ASA
#
# SPDX-License-Identifier: LicenseRef-Nordic-5-Clause
#

# Ensure that the SPI NOR driver is disabled by default
CONFIG_SPI_NOR=n

# TODO: below are not yet supported and need fixing
CONFIG_FPROTECT=n

CONFIG_BOOT_WATCHDOG_FEED=n
```

## samples/nrf_desktop/Kconfig
```kconfig
#
# Copyright (c) 2018 Nordic Semiconductor ASA
#
# SPDX-License-Identifier: LicenseRef-BSD-5-Clause-Nordic
#

menu "nRF52 Desktop"
rsource "src/hw_interface/Kconfig"
rsource "src/modules/Kconfig"
rsource "src/services/Kconfig"
endmenu

menu "Zephyr Kernel"
source "$ZEPHYR_BASE/Kconfig.zephyr"
endmenu
```

## samples/nrf_desktop/configuration/Kconfig
```kconfig
#
# Copyright (c) 2018 Nordic Semiconductor
#
# SPDX-License-Identifier: LicenseRef-BSD-5-Clause-Nordic
#

menu "Project options"

if BOOTLOADER_MCUBOOT

config DESKTOP_SIGNATURE_KEY_FILE
	bool "Specify signature key file"
	help
	  If enabled project will use signature key file specified in the
	  path. If disabled project will use default key file from MCUboot
	  directory.

config DESKTOP_SIGNATURE_KEY_FILE_PATH
	string "Signature key file"
	depends on DESKTOP_SIGNATURE_KEY_FILE
	help
	  Path to signature key file used for signed image generation.

endif

endmenu
```

## samples/nrf_desktop/sample.yaml
```yaml
sample:
  description: nRF52 Desktop
  name: BLE HID device reference design
tests:
  test:
    build_only: true
    build_on_all: true
    platform_whitelist: nrf52840_pca20041 nrf52840_pca10056 nrf52840_pca10059
    tags: bluetooth ci_build
  test_zrelease:
    build_only: true
    build_on_all: true
    platform_whitelist: nrf52840_pca20041 nrf52840_pca10056 nrf52840_pca10059
    tags: bluetooth ci_build
    extra_args: "CMAKE_BUILD_TYPE=ZRelease"
```

## samples/nrf_desktop/src/hw_interface/Kconfig
```kconfig
#
# Copyright (c) 2018 Nordic Semiconductor
#
# SPDX-License-Identifier: LicenseRef-BSD-5-Clause-Nordic
#

menu "Hardware interface modules"

comment "Motion configuration"

choice
	prompt "Select motion interface"
	default DESKTOP_MOTION_NONE

config DESKTOP_MOTION_NONE
	bool "Disable motion"

config DESKTOP_MOTION_OPTICAL_ENABLE
	bool "Motion from optical sensor"

config DESKTOP_MOTION_BUTTONS_ENABLE
	bool "Motion from buttons"

config DESKTOP_MOTION_SIMULATED_ENABLE
	bool "Simulated motion"
	depends on SHELL

endchoice

config DESKTOP_MOTION_SIMULATED_EDGE_TIME
	int "Time for transition between two points in a trajectory [ms]"
	depends on DESKTOP_MOTION_SIMULATED_ENABLE
	range 8 1000000
	default 16
	help
	  Must be power of two (calculations speedup).

config DESKTOP_MOTION_SIMULATED_SCALE_FACTOR
	int "Scale factor for given shape"
	depends on DESKTOP_MOTION_SIMULATED_ENABLE
	range 1 5
	default 2

config DESKTOP_SPI_FREQ_HZ
	int "SPI clock frequency for communication with the optical sensor"
	depends on DESKTOP_MOTION_OPTICAL_ENABLE
	default 1800000
	range 500000 2500000

config DESKTOP_OPTICAL_DEFAULT_CPI
	int "Default CPI resolution of the mouse optical sensor"
	depends on DESKTOP_MOTION_OPTICAL_ENABLE
	default 1600
	range 100 12000
	help
	  This value is set on firmware start. It can be changed in runtime
	  using the configuration channel.

config DESKTOP_OPTICAL_RUN_DOWNSHIFT_TIME_MS
	int "Default run downshift time of the mouse optical sensor"
	depends on DESKTOP_MOTION_OPTICAL_ENABLE
	default 500
	range 10 2550
	help
	  Time after which sensor goes from "Run" to "Rest 1" mode.
	  This value is set on firmware start. It can be changed in runtime
	  using the configuration channel.

config DESKTOP_OPTICAL_REST1_DOWNSHIFT_TIME_MS
	int "Default Rest 1 downshift time of the mouse optical sensor"
	depends on DESKTOP_MOTION_OPTICAL_ENABLE
	default 9220
	range 320 81600
	help
	  Time after which sensor goes from "Rest 1" to "Rest 2" mode.
	  This value is set on firmware start. It can be changed in runtime
	  using the configuration channel.

config DESKTOP_OPTICAL_REST2_DOWNSHIFT_TIME_MS
	int "Default Rest 2 downshift time of the mouse optical sensor"
	depends on DESKTOP_MOTION_OPTICAL_ENABLE
	default 150000
	range 3200 816000
	help
	  Time after which sensor goes from "Rest 2" to "Rest 3" mode.
	  This value is set on firmware start. It can be changed in runtime
	  using the configuration channel.

comment "Buttons configuration"

choice
	prompt "Select buttons interface"
	default DESKTOP_BUTTONS_NONE

config DESKTOP_BUTTONS_NONE
	bool "Disable buttons"

config DESKTOP_BUTTONS_ENABLE
	bool "Buttons scanned from key matrix or directly connected GPIO"

endchoice

config DESKTOP_BUTTONS_SCAN_INTERVAL
	int "Buttons scan interval in ms"
	depends on DESKTOP_BUTTONS_ENABLE
	default 15
	help
	  Interval at which key matrix is scanned.

config DESKTOP_BUTTONS_DEBOUNCE_INTERVAL
	int "Interval before first button scan in ms"
	depends on DESKTOP_BUTTONS_ENABLE
	default 1
	help
	  Interval before first scan. Introduced for debouncing reasons.

config DESKTOP_BUTTONS_POLARITY_INVERSED
	bool "Inverse buttons polarity"
	depends on DESKTOP_BUTTONS_ENABLE
	help
	  When this option is enabled, button is pressed when the GPIO state
	  is low.

comment "Wheel configuration"
	depends on HAS_DTS_QDEC

config DESKTOP_WHEEL_ENABLE
	bool "Enable wheel hardware interface"
	depends on HAS_DTS_QDEC

config DESKTOP_WHEEL_SENSOR_VALUE_DIVIDER
	int "Wheel sensor value divider"
	depends on DESKTOP_WHEEL_ENABLE
	range 1 2048
	default 1
	help
	  A value obtained from the wheel sensor will be divided
	  by provided argument before being processed further.

config DESKTOP_WHEEL_INVERT_AXIS
	bool "Invert wheel axis"
	depends on DESKTOP_WHEEL_ENABLE
	help
	  Switch the orientation of the wheel sensor.

comment "LED configuration"

config DESKTOP_LED_ENABLE
	bool "Enable LED hardware interface"

config DESKTOP_LED_COUNT
	int "Number of LEDs in use"
	depends on DESKTOP_LED_ENABLE
	default 0

config DESKTOP_LED_COLOR_COUNT
	int "Number of color channels per diode"
	depends on DESKTOP_LED_ENABLE
	default 3

config DESKTOP_LED_BRIGHTNESS_MAX
	int "Maximum value for LED brightness"
	depends on DESKTOP_LED_ENABLE
	default 255

comment "Battery charger configuration"

choice
	prompt "Select battery charging interface"
	default DESKTOP_BATTERY_NONE

config DESKTOP_BATTERY_NONE
	bool "No battery charging"

config DESKTOP_BATTERY_DISCRETE
	bool "Discrete battery charger"

endchoice

config DESKTOP_BATTERY_MIN_LEVEL
	int "Minimum battery voltage [mV] that corresponds to 0% level"
	depends on DESKTOP_BATTERY_DISCRETE
	default 3100

config DESKTOP_BATTERY_MAX_LEVEL
	int "Maximum battery voltage [mV] that corresponds to 100% level"
	depends on DESKTOP_BATTERY_DISCRETE
	default 4180

config DESKTOP_BATTERY_VOLTAGE_DIVIDER_UPPER
	int "Upper resistor in battery measurement voltage divider [kOhm]"
	depends on DESKTOP_BATTERY_DISCRETE
	default 1500
	help
	  Output voltage is measured on the lower resistor.

config DESKTOP_BATTERY_VOLTAGE_DIVIDER_LOWER
	int "Lower resistor in battery measurement voltage divider [kOhm]"
	depends on DESKTOP_BATTERY_DISCRETE
	default 180
	help
	  Output voltage is measured on the lower resistor.

config DESKTOP_BATTERY_POLL_INTERVAL_MS
	int "Time between the subsequent battery measurements [ms]"
	depends on DESKTOP_BATTERY_DISCRETE
	default 10000
	range 500 120000

config DESKTOP_BATTERY_CHARGE_ENABLE_PIN
	int "Battery charging enable pin"
	depends on DESKTOP_BATTERY_DISCRETE
	help
	  A pin which enables battery charging.

config DESKTOP_BATTERY_MONITOR_ENABLE_PIN
	int "Battery monitoring enable pin"
	depends on DESKTOP_BATTERY_DISCRETE
	help
	  A pin which enables the battery measurement circuit.

config DESKTOP_BATTERY_CSO_PIN
	int "Charging status pin"
	depends on DESKTOP_BATTERY_DISCRETE
	help
	  A pin number to which CSO output is connected.

choice
	prompt "Select CSO pin pull"
	default DESKTOP_BATTERY_CSO_PULL_NONE

config DESKTOP_BATTERY_CSO_PULL_NONE
	bool "Disable CSO pin pull"

config DESKTOP_BATTERY_CSO_PULL_UP
	bool "Enable CPO pin pull up"

config DESKTOP_BATTERY_CSO_PULL_DOWN
	bool "Enable CSO pin pull down"

endchoice

config DESKTOP_BATTERY_CSO_FREQ
	int "CSO switching frequency (in Hz) on error state"
	depends on DESKTOP_BATTERY_DISCRETE
	default 1000
	help
	  A frequency with which CSO pin switches state when charging
	  error occurs.

comment "Log level configuration"

module = DESKTOP_BOARD
module-str = board module
source "subsys/logging/Kconfig.template.log_config"

if !DESKTOP_MOTION_NONE
module = DESKTOP_MOTION
module-str = motion module
source "subsys/logging/Kconfig.template.log_config"
endif

if !DESKTOP_BUTTONS_NONE
module = DESKTOP_BUTTONS
module-str = buttons module
source "subsys/logging/Kconfig.template.log_config"
endif

if DESKTOP_WHEEL_ENABLE
module = DESKTOP_WHEEL
module-str = wheel module
source "subsys/logging/Kconfig.template.log_config"
endif

if DESKTOP_LED_ENABLE
module = DESKTOP_LED
module-str = LED module
source "subsys/logging/Kconfig.template.log_config"
endif

if !DESKTOP_BATTERY_NONE
module = DESKTOP_BATTERY
module-str = battery module
source "subsys/logging/Kconfig.template.log_config"
endif

endmenu
```
