## samples/nrf_desktop/src/modules/Kconfig
```kconfig
#
# Copyright (c) 2018 Nordic Semiconductor
#
# SPDX-License-Identifier: LicenseRef-BSD-5-Clause-Nordic
#

rsource "Kconfig.power_manager"
rsource "Kconfig.hid_state"
rsource "Kconfig.led_state"
rsource "Kconfig.usb_state"
rsource "Kconfig.shell"
rsource "Kconfig.ble"
rsource "Kconfig.config_channel"
rsource "Kconfig.fn_keys"
```

## samples/nrf_desktop/src/modules/Kconfig.ble
```kconfig
#
# Copyright (c) 2018 Nordic Semiconductor
#
# SPDX-License-Identifier: LicenseRef-BSD-5-Clause-Nordic
#

menu "BLE"

comment "BLE State"

config DESKTOP_BLE_BOND_REMOVAL
	bool "Enable bond removal by pressing a button during startup"
	default n
	depends on !DESKTOP_BUTTONS_NONE
	help
	  Let user remove all bonded Bluetooth peers by holding down a button
	  during the device boot.

if DESKTOP_BLE_BOND_REMOVAL

config DESKTOP_BLE_BOND_REMOVAL_BUTTON
	hex "Key ID of button used to remove bonds when held during startup"
	range 0x0000 0xffff
	help
	  Button which should be held during device startup in order to
	  unpair all bonded Bluetooth peers.
endif

if !DESKTOP_BLE_BOND_REMOVAL

config DESKTOP_BLE_BOND_REMOVAL_BUTTON
	hex
	default 0x0000

endif

module = DESKTOP_BLE_STATE
module-str = BLE state
source "subsys/logging/Kconfig.template.log_config"

module = DESKTOP_BLE_BOND
module-str = BLE bonds
source "subsys/logging/Kconfig.template.log_config"

comment "BLE Advertising"

config DESKTOP_BLE_ADVERTISING_ENABLE
	bool "Enable BLE advertising"
	depends on BT_PERIPHERAL
	help
	  Make device discoverable via BLE.

config DESKTOP_BLE_DIRECT_ADV_AVAILABLE
	bool
	default y if BT_PERIPHERAL
	default y if BT_CENTRAL && BT_SCAN_WITH_IDENTITY

config DESKTOP_BLE_DIRECT_ADV
	bool "Advertise to bonded peer directly"
	depends on DESKTOP_BLE_ADVERTISING_ENABLE
	depends on DESKTOP_BLE_DIRECT_ADV_AVAILABLE
	help
	  Device will use direct advertising if bonded.

config DESKTOP_BLE_FAST_ADV
	bool "Enable period of fast advertising"
	depends on DESKTOP_BLE_ADVERTISING_ENABLE
	help
	  Device will initially advertise with shorter interval.

config DESKTOP_BLE_SWIFT_PAIR
	bool "Enable Swift Pair feature"
	depends on DESKTOP_BLE_ADVERTISING_ENABLE
	depends on DESKTOP_BLE_FAST_ADV
	help
	  Enable quick pairing with Microsoft Swift Pair.

config DESKTOP_BLE_FAST_ADV_TIMEOUT
	int "Time of initial fastest advertising"
	default 30
	depends on DESKTOP_BLE_FAST_ADV
	help
	  Device will initially advertise with shorter interval to enable
	  quickest discovery by Swift Pair hosts. After this time it will shift
	  to normal cadence advertising.

config DESKTOP_BLE_SWIFT_PAIR_GRACE_PERIOD
	int "No Swift Pair timegap before suspend"
	default 30
	depends on DESKTOP_POWER_MANAGER_ENABLE
	depends on DESKTOP_BLE_SWIFT_PAIR
	help
	  To ensure users will not try to connect to a device which is no longer
	  available, Swift Pair vendor section will be removed before exiting
	  from advertising mode.

if DESKTOP_BLE_ADVERTISING_ENABLE

module = DESKTOP_BLE_ADV
module-str = BLE advertising
source "subsys/logging/Kconfig.template.log_config"

endif


comment "BLE Scanning"

config DESKTOP_BLE_SCANNING_ENABLE
	bool "Enable BLE scanning"
	default n
	depends on BT_CENTRAL
	help
	  Enable device to scan for peripheral devices.

if DESKTOP_BLE_SCANNING_ENABLE

module = DESKTOP_BLE_SCANNING
module-str = BLE scanning
source "subsys/logging/Kconfig.template.log_config"

endif

config DESKTOP_BLE_SHORT_NAME
	string "Short device name used for advertising and as a scan filter"
	default ""
	help
	  Name of the device to which central shall connect to. Used also to
	  determine shortened device name for advertising.

endmenu
```

## samples/nrf_desktop/src/modules/Kconfig.config_channel
```kconfig
#
# Copyright (c) 2018 Nordic Semiconductor
#
# SPDX-License-Identifier: LicenseRef-BSD-5-Clause-Nordic
#

menu "User configuration channel"

config DESKTOP_CONFIG_CHANNEL_ENABLE
	bool "Enable user configuration channel"
	help
	  Enables user to change firmware parameters at runtime over the
	  configuration channel.

if SETTINGS

module = DESKTOP_CONFIG
module-str = Config channel
source "subsys/logging/Kconfig.template.log_config"

endif

endmenu
```

## samples/nrf_desktop/src/modules/Kconfig.hid_state
```kconfig
#
# Copyright (c) 2018 Nordic Semiconductor
#
# SPDX-License-Identifier: LicenseRef-BSD-5-Clause-Nordic
#

menu "HID State"

config DESKTOP_REPORT_DESC
	string "HID report descriptor"
	default ""
	help
	  This option specifies a path to the HID report descriptor file.

config DESKTOP_HID_STATE_ENABLE
	bool
	default y if DESKTOP_WHEEL_ENABLE || !DESKTOP_MOTION_NONE || !DESKTOP_BUTTONS_NONE
	help
	  HID events processing module.

if DESKTOP_HID_STATE_ENABLE

config DESKTOP_HID_REPORT_EXPIRATION
	int "HID report expiration [ms]"
	default 500
	help
	  Define the time after which a HID report expires
	  and is not sent again.

config DESKTOP_HID_STATE_ITEM_COUNT
	int "HID state item count"
	default 10
	range 1 255

config DESKTOP_HID_EVENT_QUEUE_SIZE
	int "HID event queue size"
	default 12
	range 2 255

config DESKTOP_LOG_HID_STATE_LEVEL
	int "HID state log level"
	depends on LOG
	default 2
	range 0 4
	help
	  Sets log level for HID state.
	  Levels are:
	  - 0 OFF, do not write
	  - 1 ERROR, only write LOG_ERR
	  - 2 WARNING, write LOG_WRN in addition to previous level
	  - 3 INFO, write LOG_INF in addition to previous levels
	  - 4 DEBUG, write LOG_DBG in addition to previous levels

endif

endmenu
```

## samples/nrf_desktop/src/modules/Kconfig.led_state
```kconfig
#
# Copyright (c) 2018 Nordic Semiconductor
#
# SPDX-License-Identifier: LicenseRef-BSD-5-Clause-Nordic
#

if DESKTOP_LED_ENABLE

menu "LED state"

module = DESKTOP_LED_STATE
module-str = LED state
source "subsys/logging/Kconfig.template.log_config"

endmenu

endif
```

## samples/nrf_desktop/src/modules/Kconfig.power_manager
```kconfig
#
# Copyright (c) 2018 Nordic Semiconductor
#
# SPDX-License-Identifier: LicenseRef-BSD-5-Clause-Nordic
#

menu "Power manager"

config DESKTOP_POWER_MANAGER_ENABLE
	bool "Enable power management"
	depends on HAS_SYS_POWER_STATE_DEEP_SLEEP_1
	select DEVICE_POWER_MANAGEMENT
	select SYS_POWER_DEEP_SLEEP_STATES
	help
	  Enable power management, which will put the device to low-power mode
	  if it is idle.

if DESKTOP_POWER_MANAGER_ENABLE

config DESKTOP_POWER_MANAGER_TIMEOUT
	int "Power down timeout [s]"
	default 120
	help
	  Time in seconds after which the device will enter low-power mode.

module = DESKTOP_POWER_MANAGER
module-str = power manager
source "subsys/logging/Kconfig.template.log_config"

endif

endmenu
```

## samples/nrf_desktop/src/modules/Kconfig.usb_state
```kconfig
#
# Copyright (c) 2018 Nordic Semiconductor
#
# SPDX-License-Identifier: LicenseRef-BSD-5-Clause-Nordic
#

if USB_DEVICE_HID

menu "USB state"

config DESKTOP_USB_ENABLE
	bool "Enable USB module"
	default n
	help
	  Enables USB module.

config DESKTOP_LOG_USB_STATE_LEVEL
	int "USB state log level"
	depends on LOG
	depends on DESKTOP_USB_ENABLE
	default 2
	range 0 4
	help
	  Sets log level for USB state.
	  Levels are:
	  - 0 OFF, do not write
	  - 1 ERROR, only write LOG_ERR
	  - 2 WARNING, write LOG_WRN in addition to previous level
	  - 3 INFO, write LOG_INF in addition to previous levels
	  - 4 DEBUG, write LOG_DBG in addition to previous levels

endmenu

endif
```

## samples/nrf_desktop/src/services/Kconfig
```kconfig
#
# Copyright (c) 2018 Nordic Semiconductor
#
# SPDX-License-Identifier: LicenseRef-BSD-5-Clause-Nordic
#

menu "BLE Services"

config DESKTOP_HID_MOUSE
	bool "Mouse HID device"
	help
	  This option controls if target is visible as mouse HID device.

config DESKTOP_HID_KEYBOARD
	bool "Keyboard HID device"
	help
	  This option controls if target is visible as keyboard HID device.

config DESKTOP_HID_MPLAYER
	bool "Media player HID device"
	help
	  This option controls if target is visible as media player HID device.

config DESKTOP_BAS_ENABLE
	bool
	default n
	help
	  This option enables battery service.

config DESKTOP_HIDS_ENABLE
	bool
	default n
	help
	  This option enables HID over GATT service.

config DESKTOP_HID_PERIPHERAL
	bool
	default y
	depends on BT_PERIPHERAL
	depends on (DESKTOP_HID_MOUSE || DESKTOP_HID_KEYBOARD || DESKTOP_HID_MPLAYER)
	select BT_GATT_HIDS
	select NRF_BT_DIS
	select DESKTOP_BAS_ENABLE
	select DESKTOP_HIDS_ENABLE
	help
	  This option selects required options if device is HID peripheral.

config DESKTOP_LOG_BAS_LEVEL
	int "Battery Service log level"
	depends on LOG
	depends on DESKTOP_BAS_ENABLE
	default 2
	range 0 4
	help
	  Sets log level for Battery Service.
	  Levels are:
	  - 0 OFF, do not write
	  - 1 ERROR, only write LOG_ERR
	  - 2 WARNING, write LOG_WRN in addition to previous level
	  - 3 INFO, write LOG_INF in addition to previous levels
	  - 4 DEBUG, write LOG_DBG in addition to previous levels

config DESKTOP_LOG_HIDS_LEVEL
	int "HID over GATT Service log level"
	depends on LOG
	depends on DESKTOP_HIDS_ENABLE
	default 2
	range 0 4
	help
	  Sets log level for HID over GATT Service.
	  Levels are:
	  - 0 OFF, do not write
	  - 1 ERROR, only write LOG_ERR
	  - 2 WARNING, write LOG_WRN in addition to previous level
	  - 3 INFO, write LOG_INF in addition to previous levels
	  - 4 DEBUG, write LOG_DBG in addition to previous levels

endmenu
```

## samples/nrf_profiler/sample.yaml
```yaml
sample:
  description: Sample showing Profiler usage
  name: Profiler sample
tests:
  sample.nrf_profiler:
    sysbuild: true
    build_only: true
    integration_platforms:
      - nrf52dk/nrf52832
      - nrf52840dk/nrf52840
      - nrf5340dk/nrf5340/cpuapp/ns
      - nrf9160dk/nrf9160/ns
      - nrf21540dk/nrf52840
    platform_allow:
      - nrf52dk/nrf52832
      - nrf52840dk/nrf52840
      - nrf5340dk/nrf5340/cpuapp/ns
      - nrf9160dk/nrf9160/ns
      - nrf21540dk/nrf52840
    platform_exclude: native_posix qemu_x86 qemu_cortex_m3
    tags: ci_build sysbuild
```

## samples/nrf_rpc/entropy_nrf53/Kconfig.sysbuild
```kconfig
#
# Copyright (c) 2025 Nordic Semiconductor
#
# SPDX-License-Identifier: LicenseRef-Nordic-5-Clause
#

config PARTITION_MANAGER
	default n if !BOARD_IS_NON_SECURE

if SUPPORT_NETCORE

config SUPPORT_NETCORE_REMOTE
	bool
	default y

config NRF_DEFAULT_REMOTE
	bool
	default y

choice NETCORE
	default NETCORE_REMOTE if NRF_DEFAULT_REMOTE && NETCORE_REMOTE_BOARD_TARGET_CPUCLUSTER != ""
	depends on !EXTERNAL_CONFIGURED_NETCORE

config NETCORE_REMOTE
	bool "remote"
	depends on SUPPORT_NETCORE_REMOTE

endchoice

if !NETCORE_NONE

config NETCORE_IMAGE_NAME
	default "remote" if NETCORE_REMOTE

config NETCORE_IMAGE_PATH
	default "$(APP_DIR)/remote" if NETCORE_REMOTE

endif # !NETCORE_NONE

endif # SUPPORT_NETCORE

source "share/sysbuild/Kconfig"
```
