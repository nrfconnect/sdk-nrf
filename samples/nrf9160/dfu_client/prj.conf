## prj.conf
```kconfig
# General config
CONFIG_NEWLIB_LIBC=y
CONFIG_TEST_RANDOM_GENERATOR=y
CONFIG_ASSERT=y
CONFIG_REBOOT=y

# Trusted execution
CONFIG_TRUSTED_EXECUTION_NONSECURE=y

# Network
CONFIG_NETWORKING=y
CONFIG_NET_SOCKETS=y
CONFIG_NET_SOCKETS_OFFLOAD=y

# LTE link control
CONFIG_LTE_LINK_CONTROL=y
CONFIG_LTE_AUTO_INIT_AND_CONNECT=y

# BSD library
CONFIG_BSD_LIBRARY=y

# Library for buttons and LEDs
CONFIG_DK_LIBRARY=y
CONFIG_DK_LIBRARY_INVERT_LEDS=n

# Console
CONFIG_CONSOLE_SUBSYS=y
CONFIG_CONSOLE_HANDLER=y
CONFIG_CONSOLE_GETCHAR=y

# Main thread
CONFIG_MAIN_THREAD_PRIORITY=7

# Heap and stacks
CONFIG_HEAP_MEM_POOL_SIZE=16384
CONFIG_MAIN_STACK_SIZE=8192
CONFIG_MPU_STACK_GUARD=y

CONFIG_DEBUG=y

# Enable HTTP and HTTP DFU libs
CONFIG_NRF_HTTP_CLIENT=y
CONFIG_NRF_HTTP_DFU_CLIENT=y
CONFIG_NRF_DFU_HTTP_MAX_RESPONSE_SIZE=2048

# Enable Log, with debug messages and in place processing
CONFIG_LOG=y
CONFIG_LOG_DEFAULT_LEVEL=1
CONFIG_LOG_IMMEDIATE=y
CONFIG_LOG_PRINTK=y
CONFIG_LOG_BUFFER_SIZE=4096
```

## src/main.c
```c
/*
 * Copyright (c) 2019 Nordic Semiconductor ASA
 *
 * SPDX-License-Identifier: LicenseRef-BSD-5-Clause-Nordic
 */

#include <stdint.h>
#include <stdbool.h>
#include <stddef.h>
#include <string.h>
#include <stdio.h>
#include <zephyr.h>

#include "bsd.h"
#include "lte_lc.h"
#include "nrf_socket.h"
#include "dfu_client.h"

#include <logging/log.h>
LOG_MODULE_REGISTER(app);


static int app_dfu_client_event_handler(struct dfu_client_object *const dfu, enum dfu_client_evt event,
				  u32_t status);


static struct dfu_client_object dfu = {
	.host = "s3.amazonaws.com",
	.resource = "/nordic-firmware-files/f81197c5-0353-4ac2-a961-3b2ce867329d",
	.callback = app_dfu_client_event_handler
};


/**@brief Recoverable BSD library error. */
void bsd_recoverable_error_handler(uint32_t err)
{
	LOG_ERR("bsd_recoverable_error_handler = %lu\n", err);

	// Read the fault register for details.
	volatile uint32_t fault_reason = *((volatile uint32_t *)0x4002A614);
	__ASSERT(false, "bsd_recoverable_error_handler, reason %lu, reset application\n", fault_reason);
}

/**@brief Irrecoverable BSD library error. */
void bsd_irrecoverable_error_handler(uint32_t err)
{
	LOG_ERR("bsd_irrecoverable_error_handler = %lu\n", err);

	// Read the fault register for details.
	volatile uint32_t fault_reason = *((volatile uint32_t *)0x4002A614);
	__ASSERT(false, "bsd_recoverable_error_handler, reason %lu, reset application\n", fault_reason);
}


/**@brief Initialize modem DFU. */
static void app_dfu_init(void)
{
	int retval = dfu_client_init(&dfu);
   __ASSERT(retval == 0, "dfu_init() failed, err %d", retval);
}


/**@brief Start transfer of the new firmware patch. */
static void app_dfu_transfer_start(void)
{

	int retval = dfu_client_connect(&dfu);
	__ASSERT(retval == 0, "dfu_client_connect() failed, err %d", retval);

	retval = dfu_client_download(&dfu);
	__ASSERT(retval != -1, "dfu_client_download() failed, err %d", retval);
}

static int app_dfu_client_event_handler(struct dfu_client_object *const dfu,
				  enum dfu_client_evt event,
				  u32_t error)
{
	LOG_INF("app_dfu_client_event_handler(), status %d, firmware size %d, downloaded %d\n",
		dfu->status, dfu->firmware_size, dfu->download_size);

	switch (event) {
	case DFU_CLIENT_EVT_DOWNLOAD_INIT: {
		LOG_INF("Download started");
		break;
	}
	case DFU_CLIENT_EVT_DOWNLOAD_FRAG: {
		LOG_INF("Download fragment, size %d", dfu->fragment_size );
		break;
	}
	case DFU_CLIENT_EVT_DOWNLOAD_DONE: {
		LOG_INF("Download completed");
		break;
	}
	case DFU_CLIENT_EVT_ERROR: {
		LOG_ERR("DFU error");

		__ASSERT(false, "Something went wrong, please restart the application\n");
		break;
	}
	default:
		break;
	}

	return 0;
}



int main(void)
{
	LOG_INF("Requesting DFU init");

	app_dfu_init();

	LOG_INF("Requesting DFU start");

	app_dfu_transfer_start();

	while (true) {
        if(dfu.status == DFU_CLIENT_STATUS_DOWNLOAD_COMPLETE) {
            LOG_ERR("Download complete. Nothing more to do.");
            break;
        }
        k_yield();
		dfu_client_process(&dfu);
	}
	dfu_client_disconnect(&dfu);

	return 0;
}
```
