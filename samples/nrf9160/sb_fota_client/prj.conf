## CMakeLists.txt
```
#
# Copyright (c) 2018 Nordic Semiconductor
#
# SPDX-License-Identifier: LicenseRef-BSD-5-Clause-Nordic
#

cmake_minimum_required(VERSION 3.8.2)

find_package(Zephyr REQUIRED HINTS $ENV{ZEPHYR_BASE})
project(app)

# NORDIC SDK APP START
target_sources(app PRIVATE src/main.c)
zephyr_library_sources_ifdef(CONFIG_SHELL src/ping.c)
zephyr_library_sources_ifdef(CONFIG_SHELL src/shell.c)
# NORDIC SDK APP END
```

## prj.conf
```kconfig
#
# Copyright (c) 2020 Nordic Semiconductor ASA
#
# SPDX-License-Identifier: LicenseRef-BSD-5-Clause-Nordic
#

# General config
CONFIG_ASSERT=y
CONFIG_REBOOT=y
CONFIG_BASE64=y
CONFIG_NEWLIB_LIBC=y
CONFIG_FPU=y

# Heap pool
CONFIG_HEAP_MEM_POOL_SIZE=16384
CONFIG_SYSTEM_WORKQUEUE_STACK_SIZE=8192
CONFIG_MAIN_STACK_SIZE=2048

# Modem library
CONFIG_NRF_MODEM_LIB=y
CONFIG_NRF_MODEM_LIB_SYS_INIT=y
CONFIG_MODEM_INFO=y

# Network
CONFIG_NETWORKING=y
CONFIG_NET_NATIVE=n
CONFIG_NET_SOCKETS=y
CONFIG_NET_SOCKETS_OFFLOAD=y

# Shell
CONFIG_SHELL=y
CONFIG_SHELL_WILDCARD=n

# Network
CONFIG_NETWORKING=y
CONFIG_NET_NATIVE=n
CONFIG_NET_SOCKETS=y
CONFIG_NET_SOCKETS_OFFLOAD=y

# LTE link control
CONFIG_LTE_LINK_CONTROL=y
CONFIG_LTE_AUTO_INIT_AND_CONNECT=y
CONFIG_LTE_EDRX_REQ_VALUE_LTE_M="0101"
CONFIG_LTE_EDRX_REQ_VALUE_NBIOT="0101"
CONFIG_LTE_PSM_REQ_RAT="00100001"
CONFIG_LTE_PSM_REQ_RPTAU="00000001"

# Settings
CONFIG_FLASH=y
CONFIG_FLASH_PAGE_LAYOUT=y
CONFIG_FLASH_MAP=y
CONFIG_NVS=y
CONFIG_SETTINGS=y
CONFIG_MPU_ALLOW_FLASH_WRITE=y
CONFIG_NVS_LOG_LEVEL_OFF=y

# HTTP Client
CONFIG_HTTP_CLIENT=y

# FOTA download
CONFIG_FOTA_DOWNLOAD=y
# Retries are handled by Modem FOTA library, disable FOTA download socket retries
CONFIG_FOTA_SOCKET_RETRIES=0
CONFIG_DOWNLOAD_CLIENT=y
CONFIG_DFU_TARGET=y

# Modem FOTA
CONFIG_SB_FOTA=y

# Logging
CONFIG_LOG=y
CONFIG_SB_FOTA_LOG_LEVEL_DBG=y
CONFIG_DOWNLOAD_CLIENT_LOG_LEVEL_INF=y
CONFIG_FOTA_DOWNLOAD_LOG_LEVEL_INF=y
CONFIG_DFU_TARGET_LOG_LEVEL_INF=y
CONFIG_NVS_LOG_LEVEL_OFF=y

# Network settings
#CONFIG_PDN=y
#CONFIG_PDN_SYS_INIT=y
#CONFIG_PDN_DEFAULTS_OVERRIDE=y
#CONFIG_PDN_DEFAULT_APN="apn"
#CONFIG_PDN_DEFAULT_FAM_IPV4=y
#CONFIG_PDN_DEFAULT_AUTH_PAP=y
#CONFIG_PDN_DEFAULT_USERNAME="user"
#CONFIG_PDN_DEFAULT_PASSWORD="password"
```

## src/main.c
```c
/*
 * Copyright (c) 2020 Nordic Semiconductor ASA
 *
 * SPDX-License-Identifier: LicenseRef-BSD-5-Clause-Nordic
 */

#include <stdio.h>
#include <string.h>
#include <zephyr.h>
#include <power/reboot.h>
#include <nrf_modem.h>
#include <modem/nrf_modem_lib.h>
#include <modem/lte_lc.h>
#include <modem/at_cmd.h>
#include <modem/at_notif.h>
#include <sb_fota.h>
#include <nrf9160.h>
#include <hal/nrf_gpio.h>

/* For Nordic devices (for example the nRF9160 DK) the device ID is format
 * "nrf-<IMEI>".
 */
#define DEV_ID_PREFIX "nrf-"
#define IMEI_LEN (15)
#define DEV_ID_BUFF_SIZE (sizeof(DEV_ID_PREFIX) + IMEI_LEN + 2)

void ping_init(void);

static void modem_fota_callback(enum sb_fota_event e)
{
	switch(e) {
	case FOTA_EVENT_DOWNLOADING:
		printk("Modem FOTA library: Checking for update\n");
		break;
	case FOTA_EVENT_IDLE:
		printk("Modem FOTA library: Idle\n");
		break;
	case FOTA_EVENT_MODEM_SHUTDOWN:
		printk("Modem FOTA library: Update downloaded. Modem will be updated.\n");
		break;
	case FOTA_EVENT_REBOOT_PENDING:
		printk("Modem FOTA library: Modem updated, need to reboot\n");
		sys_reboot(SYS_REBOOT_COLD);
		break;
	}
}

static void modem_trace_enable(void)
{
	/* GPIO configurations for trace and debug */
	#define CS_PIN_CFG_TRACE_CLK	21 //GPIO_OUT_PIN21_Pos
	#define CS_PIN_CFG_TRACE_DATA0	22 //GPIO_OUT_PIN22_Pos
	#define CS_PIN_CFG_TRACE_DATA1	23 //GPIO_OUT_PIN23_Pos
	#define CS_PIN_CFG_TRACE_DATA2	24 //GPIO_OUT_PIN24_Pos
	#define CS_PIN_CFG_TRACE_DATA3	25 //GPIO_OUT_PIN25_Pos

	// Configure outputs.
	// CS_PIN_CFG_TRACE_CLK
	NRF_P0_NS->PIN_CNF[CS_PIN_CFG_TRACE_CLK] = (GPIO_PIN_CNF_DRIVE_H0H1 << GPIO_PIN_CNF_DRIVE_Pos) |
		(GPIO_PIN_CNF_INPUT_Disconnect << GPIO_PIN_CNF_INPUT_Pos);

	// CS_PIN_CFG_TRACE_DATA0
	NRF_P0_NS->PIN_CNF[CS_PIN_CFG_TRACE_DATA0] = (GPIO_PIN_CNF_DRIVE_H0H1 << GPIO_PIN_CNF_DRIVE_Pos) |
		(GPIO_PIN_CNF_INPUT_Disconnect << GPIO_PIN_CNF_INPUT_Pos);

	// CS_PIN_CFG_TRACE_DATA1
	NRF_P0_NS->PIN_CNF[CS_PIN_CFG_TRACE_DATA1] = (GPIO_PIN_CNF_DRIVE_H0H1 << GPIO_PIN_CNF_DRIVE_Pos) |
		(GPIO_PIN_CNF_INPUT_Disconnect << GPIO_PIN_CNF_INPUT_Pos);

	// CS_PIN_CFG_TRACE_DATA2
	NRF_P0_NS->PIN_CNF[CS_PIN_CFG_TRACE_DATA2] = (GPIO_PIN_CNF_DRIVE_H0H1 << GPIO_PIN_CNF_DRIVE_Pos) |
		(GPIO_PIN_CNF_INPUT_Disconnect << GPIO_PIN_CNF_INPUT_Pos);

	// CS_PIN_CFG_TRACE_DATA3
	NRF_P0_NS->PIN_CNF[CS_PIN_CFG_TRACE_DATA3] = (GPIO_PIN_CNF_DRIVE_H0H1 << GPIO_PIN_CNF_DRIVE_Pos) |
		(GPIO_PIN_CNF_INPUT_Disconnect << GPIO_PIN_CNF_INPUT_Pos);

	NRF_P0_NS->DIR = 0xFFFFFFFF;
}

void main(void)
{
	int err;

	modem_trace_enable();

	printk("Modem FOTA client started\n");

	err = nrf_modem_lib_get_init_ret();

	switch (err) {
	case MODEM_DFU_RESULT_OK:
		printk("Modem firmware update successful!\n");
		printk("Modem will run the new firmware after reboot\n");
		sys_reboot(SYS_REBOOT_WARM);
		break;
	case MODEM_DFU_RESULT_UUID_ERROR:
	case MODEM_DFU_RESULT_AUTH_ERROR:
		printk("Modem firmware update failed!\n");
		printk("Modem will run non-updated firmware on reboot.\n");
		sys_reboot(SYS_REBOOT_WARM);
		break;
	case MODEM_DFU_RESULT_HARDWARE_ERROR:
	case MODEM_DFU_RESULT_INTERNAL_ERROR:
		printk("Modem firmware update failed!\n");
		printk("Fatal error.\n");
		sys_reboot(SYS_REBOOT_WARM);
		break;
	case -1:
		printk("Could not initialize bsdlib.\n");
		printk("Fatal error.\n");
		return;
	default:
		break;
	}

#if defined(CONFIG_SHELL)
	ping_init();
#endif

	if (sb_fota_init(&modem_fota_callback) != 0) {
		printk("Failed to initialize modem FOTA\n");
		return;
	}

	k_sleep(K_FOREVER);
}
```

## src/ping.c
```c
/*
 * Copyright (c) 2020 Nordic Semiconductor ASA
 *
 * SPDX-License-Identifier: LicenseRef-BSD-5-Clause-Nordic
 */
#include <zephyr.h>
#include <stdio.h>
#include <string.h>
#include <net/socket.h>
#include <nrf_socket.h>

#define INVALID_SOCKET		-1
#define ICMP_MAX_URL		128
#define ICMP_MAX_LEN		512

#define ICMP			0x01
#define ICMP_ECHO_REQ		0x08
#define ICMP_ECHO_REP		0x00
#define IP_PROTOCOL_POS		0x09

#define PING_WORK_QUEUE_STACK_SIZE 2048
#define PING_WORK_QUEUE_PRIORITY 5

K_THREAD_STACK_DEFINE(ping_work_q_stack_area, PING_WORK_QUEUE_STACK_SIZE);

/**@ ICMP Ping command arguments */
static struct ping_argv_t {
	struct addrinfo *src;
	struct addrinfo *dest;
	int len;
	int waitms;
	int count;
	int interval;
} ping_argv;

static struct k_work_q my_work_q;
static struct k_work my_work;

static inline void setip(uint8_t *buffer, uint32_t ipaddr)
{
	buffer[0] = ipaddr & 0xFF;
	buffer[1] = (ipaddr >> 8) & 0xFF;
	buffer[2] = (ipaddr >> 16) & 0xFF;
	buffer[3] = ipaddr >> 24;
}

static uint16_t check_ics(const uint8_t *buffer, int len)
{
	const uint32_t *ptr32 = (const uint32_t *)buffer;
	uint32_t hcs = 0;
	const uint16_t *ptr16;

	for (int i = len / 4; i > 0; i--) {
		uint32_t s = *ptr32++;

		hcs += s;
		if (hcs < s) {
			hcs++;
		}
	}

	ptr16 = (const uint16_t *)ptr32;

	if (len & 2) {
		uint16_t s = *ptr16++;

		hcs += s;
		if (hcs < s) {
			hcs++;
		}
	}

	if (len & 1) {
		const uint8_t *ptr8 = (const uint8_t *)ptr16;
		uint8_t s = *ptr8;

		hcs += s;
		if (hcs < s) {
			hcs++;
		}
	}

	while (hcs > 0xFFFF) {
		hcs = (hcs & 0xFFFF) + (hcs >> 16);
	}

	return ~hcs;    /* One's complement */
}

static void calc_ics(uint8_t *buffer, int len, int hcs_pos)
{
	uint16_t *ptr_hcs = (uint16_t *)(buffer + hcs_pos);
	*ptr_hcs = 0;   /* Clear checksum before calculation */
	uint16_t hcs;

	hcs = check_ics(buffer, len);
	*ptr_hcs = hcs;
}

static uint32_t send_ping_wait_reply(void)
{
	static uint8_t seqnr;
	uint16_t total_length;
	uint8_t ip_buf[NET_IPV4_MTU];
	uint8_t *data = NULL;
	static int64_t start_t, delta_t;
	const uint8_t header_len = 20;
	int pllen, len;
	const uint16_t icmp_hdr_len = 8;
	struct sockaddr_in *sa;
	struct nrf_pollfd fds[1];
	int fd;
	int ret;
	int hcs;
	int plseqnr;

	/* Generate IPv4 ICMP EchoReq */
	total_length = ping_argv.len + header_len + icmp_hdr_len;
	memset(ip_buf, 0x00, header_len);

	/* IPv4 header */
	ip_buf[0] = (4 << 4) + (header_len / 4); /* Version & header length */
	ip_buf[1] = 0x00;                        /* Type of service */
	ip_buf[2] = total_length >> 8;           /* Total length */
	ip_buf[3] = total_length & 0xFF;         /* Total length */
	ip_buf[4] = 0x00;                        /* Identification */
	ip_buf[5] = 0x00;                        /* Identification */
	ip_buf[6] = 0x00;                        /* Flags & fragment offset */
	ip_buf[7] = 0x00;                        /* Flags & fragment offset */
	ip_buf[8] = 64;                          /* TTL */
	ip_buf[9] = ICMP;                        /* Protocol */
	/* ip_buf[10..11] = ICS, calculated later */

	sa = (struct sockaddr_in *)ping_argv.src->ai_addr;
	setip(ip_buf+12, sa->sin_addr.s_addr);     /* Source */
	sa = (struct sockaddr_in *)ping_argv.dest->ai_addr;
	setip(ip_buf+16, sa->sin_addr.s_addr);     /* Destination */

	calc_ics(ip_buf, header_len, 10);

	/* ICMP header */
	data = ip_buf + header_len;
	data[0] = ICMP_ECHO_REQ;                 /* Type (echo req) */
	data[1] = 0x00;                          /* Code */
	/* data[2..3] = checksum, calculated later */
	data[4] = 0x00;                         /* Identifier */
	data[5] = 0x00;                         /* Identifier */
	data[6] = seqnr >> 8;                   /* seqnr */
	data[7] = ++seqnr;                      /* seqr */

	/* Payload */
	for (int i = 8; i < total_length - header_len; i++) {
		data[i] = (i + seqnr) % 10 + '0';
	}

	/* ICMP CRC */
	calc_ics(data, total_length - header_len, 2);

	/* Send the ping */
	errno = 0;
	delta_t = 0;
	start_t = k_uptime_get();

	fd = nrf_socket(NRF_AF_PACKET, NRF_SOCK_RAW, 0);
	if (fd < 0) {
		printk("socket() failed: (%d)\n", -errno);
		return (uint32_t)delta_t;
	}

	ret = nrf_send(fd, ip_buf, total_length, 0);
	if (ret <= 0) {
		printk("nrf_send() failed: (%d)\n", -errno);
		goto close_end;
	}

	fds[0].fd = fd;
	fds[0].events = NRF_POLLIN;
	ret = nrf_poll(fds, 1, ping_argv.waitms);
	if (ret <= 0) {
		printk("nrf_poll() failed: (%d) (%d)\n", -errno, ret);
		goto close_end;
	}

	/* receive response */
	do {
		len = nrf_recv(fd, ip_buf, NET_IPV4_MTU, 0);
		if (len <= 0) {
			printk("nrf_recv() failed: (%d) (%d)\n", -errno, len);
			goto close_end;
		}
		if (len < header_len) {
			/* Data length error, ignore silently */
			printk("nrf_recv() wrong data (%d)\n", len);
			continue;
		}
		if (ip_buf[IP_PROTOCOL_POS] != ICMP) {
			/* Not ipv4 echo reply, ignore silently */
			continue;
		}
		break;
	} while (1);

	delta_t = k_uptime_delta(&start_t);

	/* Check ICMP HCS */
	hcs = check_ics(data, len - header_len);
	if (hcs != 0) {
		printk("HCS error %d\n", hcs);
		delta_t = 0;
		goto close_end;
	}
	/* Payload length */
	pllen = (ip_buf[2] << 8) + ip_buf[3];

	/* Check seqnr and length */
	plseqnr = data[7];
	if (plseqnr != seqnr) {
		printk("error sequence numbers %d %d\n", plseqnr, seqnr);
		delta_t = 0;
		goto close_end;
	}
	if (pllen != len) {
		printk("error length %d %d\n", pllen, len);
		delta_t = 0;
		goto close_end;
	}

	/* Result */
	printk("PING: %dms\n", (uint32_t)delta_t);

close_end:
	(void)nrf_close(fd);
	return (uint32_t)delta_t;
}

void ping_task(struct k_work *item)
{
	struct addrinfo *si = ping_argv.src;
	struct addrinfo *di = ping_argv.dest;
	uint32_t sum = 0;
	uint32_t count = 0;

	ARG_UNUSED(item);

	for (int i = 0; i < ping_argv.count; i++) {
		uint32_t ping_t = send_ping_wait_reply();

		if (ping_t > 0)  {
			count++;
			sum += ping_t;
		}
		k_sleep(K_MSEC(ping_argv.interval));
	}

	if (count > 0) {
		uint32_t avg = (sum + count/2) / count;
		printk("PING: average %dms\n", avg);
	}

	freeaddrinfo(si);
	freeaddrinfo(di);
}

int ping(const char *local, const char *remote, int count)
{
	int st;
	struct addrinfo *res;
	int addr_len;

	/* Check network connection status by checking local IP address */
	addr_len = strlen(local);
	if (addr_len == 0) {
		printk("LTE not connected yet\n");
		return -1;
	}
	st = getaddrinfo(local, NULL, NULL, &res);
	if (st != 0) {
		printk("getaddrinfo(src) error: %d\n", st);
		return -st;
	}
	ping_argv.src = res;

	/* Get destination */
	res = NULL;
	st = getaddrinfo(remote, NULL, NULL, &res);
	if (st != 0) {
		printk("getaddrinfo(dest) error: %d\n", st);
		freeaddrinfo(ping_argv.src);
		return -st;
	}
	ping_argv.dest = res;

	if (ping_argv.src->ai_family != ping_argv.dest->ai_family) {
		printk("Source/Destination address family error\n");
		freeaddrinfo(ping_argv.dest);
		freeaddrinfo(ping_argv.src);
		return -1;
	}

	ping_argv.len = 32;		/* default 32 bytes */
	if (IS_ENABLED(CONFIG_LTE_NETWORK_MODE_NBIOT) ||
	    IS_ENABLED(CONFIG_LTE_NETWORK_MODE_NBIOT_GPS)) {
		ping_argv.waitms = 30000;	/* NB-IoT default 30 seconds */
	} else {
		ping_argv.waitms = 5000;	/* M1 default 5 seconds */
	}
	ping_argv.interval = 1000;	/* default 1s */
	ping_argv.count = 1;		/* default 1, adjustable */
	if (count > 0) {
		ping_argv.count = count;
	}

	k_work_submit_to_queue(&my_work_q, &my_work);

	return 0;
}

void ping_init(void)
{
	k_work_queue_start(&my_work_q,
			   ping_work_q_stack_area,
			   K_THREAD_STACK_SIZEOF(ping_work_q_stack_area),
			   PING_WORK_QUEUE_PRIORITY,
			   NULL);
	k_work_init(&my_work, ping_task);
}
```

## src/shell.c
```c
/*
 * Copyright (c) 2020 Nordic Semiconductor ASA
 *
 * SPDX-License-Identifier: LicenseRef-BSD-5-Clause-Nordic
 */

#include <shell/shell.h>
#include <modem/at_cmd.h>
#include <net/socket.h>
#include <modem/lte_lc.h>
#include <sb_fota.h>

#define DEFAULT_DATA_SEND_INTERVAL 10

static int fd = -1;
static struct addrinfo *addrinfo_res;
static const char dummy_data[] = "01234567890123456789012345678901"
				 "01234567890123456789012345678901"
				 "01234567890123456789012345678901"
				 "01234567890123456789012345678901"
				 "01234567890123456789012345678901"
				 "01234567890123456789012345678901"
				 "01234567890123456789012345678901"
				 "01234567890123456789012345678901";
static char response_buf[CONFIG_AT_CMD_RESPONSE_MAX_LEN];

int ping(const char *local, const char *remote, int count);

static void udp_socket_open(void)
{
	int err;
	struct addrinfo hints = {
		.ai_family = AF_INET,
		.ai_socktype = SOCK_DGRAM,
	};

	/* Use dummy destination address and port */
	err = getaddrinfo("192.168.123.45", NULL, &hints, &addrinfo_res);
	if (err) {
		printk("getaddrinfo() failed, err %d\n", errno);
	}

	((struct sockaddr_in *)addrinfo_res->ai_addr)->sin_port = htons(61234);

	fd = socket(AF_INET, SOCK_DGRAM, IPPROTO_UDP);
}

void data_send_work_handler(struct k_work *work)
{
	sendto(fd, dummy_data, sizeof(dummy_data) - 1, 0,
	       addrinfo_res->ai_addr, sizeof(struct sockaddr_in));
}

K_WORK_DEFINE(data_send_work, data_send_work_handler);

void data_send_timer_handler(struct k_timer *dummy)
{
	k_work_submit(&data_send_work);
}

K_TIMER_DEFINE(data_send_timer, data_send_timer_handler, NULL);

#define FOTA_APP_BUILD_VERSION "1.1"
static int app_cmd_ver(const struct shell *shell, size_t argc, char **argv)
{
	ARG_UNUSED(argc);
	ARG_UNUSED(argv);

	int i;

	response_buf[0] = '\0';
	at_cmd_write("AT+CGMR", response_buf, sizeof(response_buf), NULL);
	i = 0;
	while (response_buf[i] != '\0') {
		if (response_buf[i] == '\r' || response_buf[i] == '\n') {
			response_buf[i] = '\0';
			break;
		}
		i++;
	}

	shell_print(shell, "App FW version:\t\t%s", FOTA_APP_BUILD_VERSION);
	shell_print(shell, "Modem FW version:\t%s", response_buf);
#if CONFIG_LTE_NETWORK_MODE_NBIOT
	shell_print(shell, "System mode:\t\tCat.NB");
#else
	shell_print(shell, "System mode:\t\tCat.M");
#endif

	return 0;
}

static int app_cmd_clock(const struct shell *shell, size_t argc, char **argv)
{
	ARG_UNUSED(argc);

	int err;
	err = sb_fota_set_clock(argv[1]);
	if (err) {
		shell_error(shell, "clock: invalid time string");
		return -EINVAL;
	}

	return 0;
}

static int app_cmd_at(const struct shell *shell, size_t argc, char **argv)
{
	ARG_UNUSED(argc);

	int err;
	err = at_cmd_write(argv[1], response_buf, sizeof(response_buf), NULL);
	if (err) {
		shell_error(shell, "ERROR");
		return -EINVAL;
	}

	shell_print(shell, "%sOK", response_buf);

	return 0;
}

static int app_cmd_ping(const struct shell *shell, size_t argc, char **argv)
{
	int err;
	char ipv4[16];
	char *tmp1, *tmp2;
	int count = 1;

	err = at_cmd_write("AT+CGPADDR", response_buf, sizeof(response_buf), NULL);
	if (err) {
		shell_error(shell, "AT ERROR");
		return -EINVAL;
	}

	/* parse +CGPADDR: 0,"10.145.192.136" */
	tmp1 = strstr(response_buf, "\"");
	if (tmp1 == NULL) {
		shell_error(shell, "AT ERROR");
		return -EINVAL;
	}
	tmp1++;
	tmp2 = strstr(tmp1, "\"");
	if (tmp2 == NULL) {
		shell_error(shell, "AT ERROR");
		return -EINVAL;
	}

	memset(ipv4, 0x00, 16);
	strncpy(ipv4, (const char *)tmp1, (size_t)(tmp2 - tmp1));
	if (argc > 2) {
		count = strtoul(argv[2], NULL, 10);
	}
	ping(ipv4, argv[1], count);

	return 0;
}

static int app_cmd_data_start(const struct shell *shell, size_t argc, char **argv)
{
	int period = 0;

	if (fd < 0) {
		udp_socket_open();
	}

	if (fd >= 0) {
		if (argc > 1) {
			period = atoi(argv[1]);
		}
		if (period < 1) {
			period = DEFAULT_DATA_SEND_INTERVAL;
		}
		shell_print(shell, "start: sending periodic data every %d seconds",
			    period);
		k_timer_start(&data_send_timer,
			      K_NO_WAIT, K_SECONDS(period));
	} else {
		shell_error(shell, "start: socket not open");
		return -EINVAL;
	}

	return 0;
}

static int app_cmd_data_stop(const struct shell *shell, size_t argc, char **argv)
{
	ARG_UNUSED(argc);
	ARG_UNUSED(argv);

	if (k_timer_remaining_get(&data_send_timer) > 0) {
		k_timer_stop(&data_send_timer);
		shell_print(shell, "stop: periodic data stopped");
	} else {
		shell_error(shell, "stop: periodic data not started");
		return -ENOEXEC;
	}

	return 0;
}

static int app_cmd_edrx_enable(const struct shell *shell, size_t argc, char **argv)
{
	ARG_UNUSED(argc);
	ARG_UNUSED(argv);

	int ret = lte_lc_edrx_req(true);
	if (ret) {
		shell_print(shell, "Failed to enable eDRX");
	}

	return ret;
}

static int app_cmd_edrx_disable(const struct shell *shell, size_t argc, char **argv)
{
	ARG_UNUSED(argc);
	ARG_UNUSED(argv);

	int ret = lte_lc_edrx_req(false);
	if (ret) {
		shell_print(shell, "Failed to disable eDRX");
	}

	return ret;
}

static int app_cmd_psm_enable(const struct shell *shell, size_t argc, char **argv)
{
	ARG_UNUSED(argc);
	ARG_UNUSED(argv);

	int ret = lte_lc_psm_req(true);
	if (ret) {
		shell_print(shell, "Failed to enable PSM");
	}

	return ret;
}

static int app_cmd_psm_disable(const struct shell *shell, size_t argc, char **argv)
{
	ARG_UNUSED(argc);
	ARG_UNUSED(argv);

	int ret = lte_lc_psm_req(false);
	if (ret) {
		shell_print(shell, "Failed to disable PSM");
	}

	return ret;
}

SHELL_STATIC_SUBCMD_SET_CREATE(app_data_cmds,
	SHELL_CMD(start, NULL, "'app data start [interval in seconds]' starts "
		               "periodic UDP data sending. The default "
		               "interval is 10 seconds.", app_cmd_data_start),
	SHELL_CMD(stop, NULL, "Stop periodic UDP data sending.",
		  app_cmd_data_stop),
	SHELL_SUBCMD_SET_END
);

SHELL_STATIC_SUBCMD_SET_CREATE(app_edrx_cmds,
	SHELL_CMD(enable, NULL, "'app edrx enable' enable eDRX",
		  app_cmd_edrx_enable),
	SHELL_CMD(disable, NULL, "'app edrx disable' disable eDRX",
		  app_cmd_edrx_disable),
	SHELL_SUBCMD_SET_END
);

SHELL_STATIC_SUBCMD_SET_CREATE(app_psm_cmds,
	SHELL_CMD(enable, NULL, "'app psm enable' enable PSM",
		  app_cmd_psm_enable),
	SHELL_CMD(disable, NULL, "'app psm disable' disable PSM",
		  app_cmd_psm_disable),
	SHELL_SUBCMD_SET_END
);

SHELL_STATIC_SUBCMD_SET_CREATE(app_cmds,
	SHELL_CMD_ARG(ver, NULL, "Firmware version.", app_cmd_ver, 1, 0),
	SHELL_CMD_ARG(clock, NULL, "'app clock <yy/MM/dd,hh:mm:ss-/+zz>' sets "
				   "modem clock (see modem AT command "
				   "specification for AT+CCLK for detailed "
				   "format description)", app_cmd_clock, 2, 0),
	SHELL_CMD_ARG(at, NULL, "Execute an AT command.", app_cmd_at, 2, 0),
	SHELL_CMD_ARG(ping, NULL, "Ping remote host by 'ping <ip> [count]'.",
		      app_cmd_ping, 2, 1),
	SHELL_CMD(data, &app_data_cmds, "Send periodic UDP data over default "
					"APN.", NULL),
	SHELL_CMD(edrx, &app_edrx_cmds, "Enable or disable eDRX.", NULL),
	SHELL_CMD(psm, &app_psm_cmds, "Enable or disable PSM.", NULL),
	SHELL_SUBCMD_SET_END
);

SHELL_CMD_REGISTER(app, &app_cmds,
		   "Commands for controlling the FOTA sample application",
		   NULL);
```
