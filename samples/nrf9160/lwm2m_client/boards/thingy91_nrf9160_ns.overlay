/*
 * Copyright (c) 2022 Nordic Semiconductor ASA
 *
 * SPDX-License-Identifier: LicenseRef-Nordic-5-Clause
 */

/ {
	buzzer: buzzer {
		compatible = "pwm-buzzer";
		pwms = <&pwm1 0 PWM_MSEC(20) PWM_POLARITY_NORMAL>;
	};
};
