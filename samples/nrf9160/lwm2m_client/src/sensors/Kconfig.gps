## samples/nrf9160/modem_shell/sample.yaml
```yaml
sample:
  name: modem_shell Sample
tests:
  sample.nrf9160.modem_shell:
    build_only: true
    integration_platforms:
      - nrf9160dk_nrf9160_ns
    platform_allow: nrf9160dk_nrf9160_ns nrf9161dk_nrf9161_ns
    tags: ci_build
  sample.nrf9160.modem_shell_debug:
    build_only: true
    extra_args: OVERLAY_CONFIG=overlay-debug.conf
    integration_platforms:
      - nrf9160dk_nrf9160_ns
    platform_allow: nrf9160dk_nrf9160_ns nrf9161dk_nrf9161_ns
    tags: ci_build
  sample.nrf9160.modem_shell.cloud_mqtt_only:
    build_only: true
    extra_args: OVERLAY_CONFIG=overlay-cloud_mqtt.conf
    integration_platforms:
      - nrf9160dk_nrf9160_ns
    platform_allow: nrf9160dk_nrf9160_ns nrf9161dk_nrf9161_ns
    tags: ci_build
  sample.nrf9160.modem_shell.cloud_mqtt_rest:
    build_only: true
    extra_args: CONFIG_MOSH_CLOUD_MQTT=y CONFIG_MOSH_CLOUD_REST=y
    integration_platforms:
      - nrf9160dk_nrf9160_ns
    platform_allow: nrf9160dk_nrf9160_ns nrf9161dk_nrf9161_ns
    tags: ci_build
  sample.nrf9160.modem_shell.non_offloading_ip:
    build_only: true
    extra_args: OVERLAY_CONFIG=overlay-non-offloading.conf
    integration_platforms:
      - nrf9160dk_nrf9160_ns
    platform_allow: nrf9160dk_nrf9160_ns nrf9161dk_nrf9161_ns
    tags: ci_build
  sample.nrf9160.modem_shell.nrf7002ek_wifi:
    build_only: true
    integration_platforms:
      - nrf9160dk_nrf9160_ns
    platform_allow: nrf9160dk_nrf9160_ns nrf9161dk_nrf9161_ns
    extra_args: SHIELD=nrf7002ek OVERLAY_CONFIG=overlay-nrf7002ek-wifi-scan-only.conf
                DTC_OVERLAY_FILE="nrf9160dk_with_nrf7002ek.overlay"
    tags: ci_build
  sample.nrf9160.modem_shell.nrf7000ek_wifi:
    build_only: true
    integration_platforms:
      - nrf9160dk_nrf9160_ns
    platform_allow: nrf9160dk_nrf9160_ns nrf9161dk_nrf9161_ns
    extra_args: SHIELD=nrf7002ek_nrf7000 OVERLAY_CONFIG=overlay-nrf7002ek-wifi-scan-only.conf
                DTC_OVERLAY_FILE="nrf9160dk_with_nrf7002ek.overlay" CONFIG_WPA_SUPP=n
    tags: ci_build
  sample.nrf9160.modem_shell.nrf7001ek_wifi:
    build_only: true
    integration_platforms:
      - nrf9160dk_nrf9160_ns
    platform_allow: nrf9160dk_nrf9160_ns nrf9161dk_nrf9161_ns
    extra_args: SHIELD=nrf7002ek_nrf7001 OVERLAY_CONFIG=overlay-nrf7002ek-wifi-scan-only.conf
                DTC_OVERLAY_FILE="nrf9160dk_with_nrf7002ek.overlay"
    tags: ci_build
  sample.nrf9160.modem_shell.nrf7002ek_wifi-debug:
    build_only: true
    integration_platforms:
      - nrf9160dk_nrf9160_ns
    platform_allow: nrf9160dk_nrf9160_ns nrf9161dk_nrf9161_ns
    extra_args: SHIELD=nrf7002ek
                OVERLAY_CONFIG="overlay-nrf7002ek-wifi-scan-only.conf;overlay-debug.conf"
                DTC_OVERLAY_FILE="nrf9160dk_with_nrf7002ek.overlay"
    tags: ci_build
  sample.nrf9160.modem_shell.esp_wifi:
    build_only: true
    extra_args: OVERLAY_CONFIG=overlay-esp-wifi.conf DTC_OVERLAY_FILE="esp_8266_nrf9160ns.overlay"
    integration_platforms:
      - nrf9160dk_nrf9160_ns
    platform_allow: nrf9160dk_nrf9160_ns nrf9161dk_nrf9161_ns
    tags: ci_build
  sample.nrf9160.modem_shell.fota:
    build_only: true
    extra_args: OVERLAY_CONFIG=overlay-app_fota.conf
    integration_platforms:
      - nrf9160dk_nrf9160_ns
    platform_allow: nrf9160dk_nrf9160_ns nrf9161dk_nrf9161_ns
    tags: ci_build
  sample.nrf9160.modem_shell.carrier:
    build_only: true
    extra_args: OVERLAY_CONFIG=overlay-carrier.conf
    integration_platforms:
      - nrf9160dk_nrf9160_ns
    platform_allow: nrf9160dk_nrf9160_ns nrf9161dk_nrf9161_ns
    tags: ci_build
  sample.nrf9160.modem_shell.lwm2m:
    build_only: true
    extra_configs:
      - CONFIG_MOSH_LWM2M_PSK="000102030405060708090a0b0c0d0e0f"
    extra_args: OVERLAY_CONFIG=overlay-lwm2m.conf
    integration_platforms:
      - nrf9160dk_nrf9160_ns
    platform_allow: nrf9160dk_nrf9160_ns nrf9161dk_nrf9161_ns
    tags: ci_build
  sample.nrf9160.modem_shell.lwm2m_bootstrap:
    build_only: true
    extra_configs:
      - CONFIG_MOSH_LWM2M_PSK="000102030405060708090a0b0c0d0e0f"
    extra_args: OVERLAY_CONFIG="overlay-lwm2m.conf;overlay-lwm2m_bootstrap.conf"
    integration_platforms:
      - nrf9160dk_nrf9160_ns
    platform_allow: nrf9160dk_nrf9160_ns nrf9161dk_nrf9161_ns
    tags: ci_build
  sample.nrf9160.modem_shell.lwm2m_pgps:
    build_only: true
    extra_configs:
      - CONFIG_MOSH_LWM2M_PSK="000102030405060708090a0b0c0d0e0f"
    extra_args: OVERLAY_CONFIG="overlay-lwm2m.conf;overlay-lwm2m_pgps.conf;overlay-pgps.conf"
    integration_platforms:
      - nrf9160dk_nrf9160_ns
    platform_allow: nrf9160dk_nrf9160_ns nrf9161dk_nrf9161_ns
    tags: ci_build
  sample.nrf9160.modem_shell.pgps:
    build_only: true
    extra_args: OVERLAY_CONFIG=overlay-pgps.conf
    integration_platforms:
      - nrf9160dk_nrf9160_ns
    platform_allow: nrf9160dk_nrf9160_ns nrf9161dk_nrf9161_ns
    tags: ci_build
  sample.nrf9160.modem_shell.location_service_ext:
    build_only: true
    extra_configs:
      - CONFIG_LOCATION_SERVICE_EXTERNAL=y
    extra_args: OVERLAY_CONFIG=overlay-cloud_mqtt.conf
    integration_platforms:
      - nrf9160dk_nrf9160_ns
    platform_allow: nrf9160dk_nrf9160_ns nrf9161dk_nrf9161_ns
    tags: ci_build
  sample.nrf9160.modem_shell.location_service_ext_pgps_nrf7002ek_wifi:
    build_only: true
    extra_configs:
      - CONFIG_LOCATION_SERVICE_EXTERNAL=y
      - CONFIG_NRF_CLOUD_PGPS_TRANSPORT_NONE=y
    extra_args: SHIELD=nrf7002ek
                OVERLAY_CONFIG="overlay-cloud_mqtt.conf;overlay-pgps.conf;overlay-nrf7002ek-wifi-scan-only.conf"
                DTC_OVERLAY_FILE="nrf9160dk_with_nrf7002ek.overlay"
    integration_platforms:
      - nrf9160dk_nrf9160_ns
    platform_allow: nrf9160dk_nrf9160_ns nrf9161dk_nrf9161_ns
    tags: ci_build
  sample.nrf9160.modem_shell.ppp:
    build_only: true
    extra_args: OVERLAY_CONFIG=overlay-ppp.conf DTC_OVERLAY_FILE="ppp.overlay"
    integration_platforms:
      - nrf9160dk_nrf9160_ns
    platform_allow: nrf9160dk_nrf9160_ns nrf9161dk_nrf9161_ns
    tags: ci_build
  sample.nrf9160.modem_shell.bt:
    build_only: true
    extra_args: OVERLAY_CONFIG=overlay-bt.conf DTC_OVERLAY_FILE="bt.overlay"
    integration_platforms:
      - nrf9160dk_nrf9160_ns
    platform_allow: nrf9160dk_nrf9160_ns nrf9161dk_nrf9161_ns
    tags: ci_build
  sample.nrf9160.modem_shell.rtt:
    build_only: true
    extra_args: OVERLAY_CONFIG=overlay-rtt.conf
    integration_platforms:
      - nrf9160dk_nrf9160_ns
    platform_allow: nrf9160dk_nrf9160_ns nrf9161dk_nrf9161_ns
    tags: ci_build
  sample.nrf9160.modem_shell.thingy91:
    build_only: true
    integration_platforms:
      - thingy91_nrf9160_ns
    platform_allow: thingy91_nrf9160_ns
    tags: ci_build
  sample.nrf9160.modem_shell.memfault_modem_trace:
    build_only: true
    integration_platforms:
      - nrf9160dk_nrf9160_ns
    platform_allow: nrf9160dk_nrf9160_ns
    extra_args: OVERLAY_CONFIG="overlay-modem-trace.conf;overlay-memfault.conf"
                DTC_OVERLAY_FILE="nrf9160dk_ext_flash.overlay"
    extra_configs:
      - CONFIG_MEMFAULT_NCS_PROJECT_KEY="0123456789abcdef0123456789abcdef"
    tags: ci_build
  sample.nrf9160.modem_shell.memfault_modem_trace_ram:
    build_only: true
    integration_platforms:
      - nrf9160dk_nrf9160_ns
    platform_allow: nrf9160dk_nrf9160_ns nrf9161dk_nrf9161_ns
    extra_args: OVERLAY_CONFIG="overlay-modem-trace-ram.conf;overlay-memfault.conf"
    extra_configs:
      - CONFIG_MEMFAULT_NCS_PROJECT_KEY="0123456789abcdef0123456789abcdef"
    tags: ci_build

  # Configurations for different location method combinations
  sample.nrf9160.modem_shell.location_gnss_wifi_no_cellular:
    build_only: true
    integration_platforms:
      - nrf9160dk_nrf9160_ns
    platform_allow: nrf9160dk_nrf9160_ns nrf9161dk_nrf9161_ns
    extra_configs:
      - CONFIG_LOCATION_METHOD_GNSS=y
      - CONFIG_LOCATION_METHOD_CELLULAR=n
      - CONFIG_LOCATION_METHOD_WIFI=y
    extra_args: SHIELD=nrf7002ek OVERLAY_CONFIG=overlay-nrf7002ek-wifi-scan-only.conf
                DTC_OVERLAY_FILE="nrf9160dk_with_nrf7002ek.overlay"
    tags: ci_build
  sample.nrf9160.modem_shell.location_wifi_cellular_no_gnss:
    build_only: true
    integration_platforms:
      - nrf9160dk_nrf9160_ns
    platform_allow: nrf9160dk_nrf9160_ns nrf9161dk_nrf9161_ns
    extra_configs:
      - CONFIG_LOCATION_METHOD_GNSS=n
      - CONFIG_LOCATION_METHOD_CELLULAR=y
      - CONFIG_LOCATION_METHOD_WIFI=y
    extra_args: SHIELD=nrf7002ek OVERLAY_CONFIG=overlay-nrf7002ek-wifi-scan-only.conf
                DTC_OVERLAY_FILE="nrf9160dk_with_nrf7002ek.overlay"
    tags: ci_build
  sample.nrf9160.modem_shell.location_wifi_no_cellular_no_gnss:
    build_only: true
    integration_platforms:
      - nrf9160dk_nrf9160_ns
    platform_allow: nrf9160dk_nrf9160_ns nrf9161dk_nrf9161_ns
    extra_configs:
      - CONFIG_LOCATION_METHOD_GNSS=n
      - CONFIG_LOCATION_METHOD_CELLULAR=n
      - CONFIG_LOCATION_METHOD_WIFI=y
    extra_args: SHIELD=nrf7002ek OVERLAY_CONFIG=overlay-nrf7002ek-wifi-scan-only.conf
                DTC_OVERLAY_FILE="nrf9160dk_with_nrf7002ek.overlay"
    tags: ci_build
  sample.nrf9160.modem_shell.location_gnss_no_wifi_no_cellular:
    build_only: true
    integration_platforms:
      - nrf9160dk_nrf9160_ns
    platform_allow: nrf9160dk_nrf9160_ns nrf9161dk_nrf9161_ns
    extra_configs:
      - CONFIG_LOCATION_METHOD_GNSS=y
      - CONFIG_LOCATION_METHOD_CELLULAR=n
      - CONFIG_LOCATION_METHOD_WIFI=n
    tags: ci_build
  sample.nrf9160.modem_shell.location_cellular_no_wifi_no_gnss:
    build_only: true
    integration_platforms:
      - nrf9160dk_nrf9160_ns
    platform_allow: nrf9160dk_nrf9160_ns nrf9161dk_nrf9161_ns
    extra_configs:
      - CONFIG_LOCATION_METHOD_GNSS=n
      - CONFIG_LOCATION_METHOD_CELLULAR=y
      - CONFIG_LOCATION_METHOD_WIFI=n
    tags: ci_build

  # Configurations with modem UART traces to make sure they fit into image.
  # Basic UART trace configuration is tested in sample.nrf9160.modem_shell.integration_config.
  sample.nrf9160.modem_shell.non_offloading_ip_modem_uart_trace:
    build_only: true
    extra_args: OVERLAY_CONFIG=overlay-non-offloading.conf CONFIG_NRF_MODEM_LIB_TRACE=y
    integration_platforms:
      - nrf9160dk_nrf9160_ns
    platform_allow: nrf9160dk_nrf9160_ns nrf9161dk_nrf9161_ns
    tags: ci_build
  sample.nrf9160.modem_shell.thingy91_modem_uart_trace:
    build_only: true
    extra_args: CONFIG_NRF_MODEM_LIB_TRACE=y
    integration_platforms:
      - thingy91_nrf9160_ns
    platform_allow: thingy91_nrf9160_ns
    tags: ci_build

  # Configuration which will be used by the CI integration job to verify PRs
  sample.nrf9160.modem_shell.integration_config:
    build_only: true
    extra_configs:
      - CONFIG_LTE_NETWORK_MODE_LTE_M=y
      - CONFIG_MODEM_ANTENNA_GNSS_EXTERNAL=y
      - CONFIG_NRF_MODEM_LIB_TRACE=y
    integration_platforms:
      - nrf9160dk_nrf9160_ns
    platform_allow: nrf9160dk_nrf9160_ns nrf9161dk_nrf9161_ns
    tags: ci_build
```

## samples/nrf9160/modem_trace_backend/Kconfig
```kconfig
#
# Copyright (c) 2022 Nordic Semiconductor
#
# SPDX-License-Identifier: LicenseRef-Nordic-5-Clause
#

menu "Modem trace backend sample"

endmenu

rsource "Kconfig.trace_print_stats"

menu "Zephyr Kernel"
source "Kconfig.zephyr"
endmenu
```

## samples/nrf9160/modem_trace_flash/Kconfig
```kconfig
#
# Copyright (c) 2022 Nordic Semiconductor
#
# SPDX-License-Identifier: LicenseRef-Nordic-5-Clause
#

menu "Modem trace flash backend sample"

config MODEM_TRACE_FLASH_SAMPLE_UART
	bool
	default $(dt_chosen_enabled,$(DT_CHOSEN_NORDIC_MODEM_TRACE_UART))

endmenu

module = MODEM_TRACE_FLASH_SAMPLE
module-str = Modem trace flash backend
source "${ZEPHYR_BASE}/subsys/logging/Kconfig.template.log_config"

menu "Zephyr Kernel"
source "Kconfig.zephyr"
endmenu
```

## samples/nrf9160/modem_trace_flash/Kconfig.trace_flash
```kconfig
#
# Copyright (c) 2022 Nordic Semiconductor
#
# SPDX-License-Identifier: LicenseRef-Nordic-5-Clause
#

module = MODEM_TRACE_FLASH_BACKEND
module-str = Modem trace flash backend
source "${ZEPHYR_BASE}/subsys/logging/Kconfig.template.log_config"

if NRF_MODEM_LIB_TRACE

# Add NRF_MODEM_LIB_TRACE_BACKEND_FLASH to the trace backend choices.
choice NRF_MODEM_LIB_TRACE_BACKEND

config NRF_MODEM_LIB_TRACE_BACKEND_FLASH
	bool "Stream modem traces to flash"
	help
	  Configure nrf_modem_lib modem traces to use the flash backend in this sample.

endchoice # NRF_MODEM_LIB_TRACE_BACKEND

if NRF_MODEM_LIB_TRACE_BACKEND_FLASH

config PM_PARTITION_SIZE_MODEM_TRACE
	hex "External flash space reserved for modem traces"
	default 0x800000
	help
	  Flash space set aside for modem traces in the external flash.
endif # NRF_MODEM_LIB_TRACE_BACKEND_FLASH

endif # NRF_MODEM_LIB_TRACE_ENABLED
```

## samples/nrf9160/modem_trace_flash/Kconfig.trace_storage
```kconfig
#
# Copyright (c) 2022 Nordic Semiconductor
#
# SPDX-License-Identifier: LicenseRef-Nordic-5-Clause
#

module = MODEM_TRACE_STORAGE
module-str = Modem trace storage
source "${ZEPHYR_BASE}/subsys/logging/Kconfig.template.log_config"
```

## samples/nrf9160/modem_trace_flash/boards/nrf9160dk_nrf9160_ns.conf
```kconfig
#
# Copyright (c) 2022 Nordic Semiconductor ASA
#
# SPDX-License-Identifier: LicenseRef-Nordic-5-Clause
#

CONFIG_SPI=y
CONFIG_SPI_NOR=y
CONFIG_SPI_NOR_SFDP_DEVICETREE=y

CONFIG_PM_OVERRIDE_EXTERNAL_DRIVER_CHECK=y
CONFIG_PM_PARTITION_SIZE_MODEM_TRACE=0x100000
```

## samples/nrf9160/modem_trace_flash/sample.yaml
```yaml
sample:
  name: Modem trace flash
tests:
  sample.nrf9160.modem_trace_flash:
    build_only: true
    integration_platforms:
      - nrf9160dk_nrf9160_ns
    platform_allow: nrf9160dk_nrf9160_ns
    tags: ci_build
```

## samples/nrf9160/mqtt_simple/Kconfig
```kconfig
#
# Copyright (c) 2020 Nordic Semiconductor ASA
#
# SPDX-License-Identifier: LicenseRef-Nordic-5-Clause
#

menu "MQTT simple sample"
config MQTT_PUB_TOPIC
	string "MQTT publish topic"
	default "my/publish/topic"

config MQTT_SUB_TOPIC
	string "MQTT subscribe topic"
	default "my/subscribe/topic"

config MQTT_CLIENT_ID
	string "MQTT Client ID"
	default "my-client-id"

config MQTT_BROKER_HOSTNAME
	string "MQTT broker hostname"
	default "mqtt.eclipseprojects.io"

config MQTT_BROKER_PORT
	int "MQTT broker port"
	default 1883

config MQTT_MESSAGE_BUFFER_SIZE
	int "MQTT message buffer size"
	default 128

config MQTT_PAYLOAD_BUFFER_SIZE
	int "MQTT payload buffer size"
	default 128

config BUTTON_EVENT_PUBLISH_MSG
	string "The message to publish on a button event"
	default "Hello from nRF91 MQTT Simple Sample"

config BUTTON_EVENT_BTN_NUM
	int "The button number"
	default 1

config MQTT_RECONNECT_DELAY_S
	int "Seconds to delay before attempting to reconnect to the broker."
	default 60

config LTE_CONNECT_RETRY_DELAY_S
	int "Seconds to delay before attempting to retry LTE connection."
	default 120

config MQTT_TLS_SEC_TAG
	int "TLS credentials security tag"
	default 24

config MQTT_TLS_SESSION_CACHING
	bool "Enable TLS session caching"

config MQTT_TLS_PEER_VERIFY
	int "Set peer verification level"
	default 2
	help
		Set to 0 for VERIFY_NONE, 1 for VERIFY_OPTIONAL, and 2 for
		VERIFY_REQUIRED.

endmenu

menu "Zephyr Kernel"
source "Kconfig.zephyr"
endmenu

module = MQTT_SIMPLE
module-str = MQTT Simple
source "${ZEPHYR_BASE}/subsys/logging/Kconfig.template.log_config"
```

## samples/nrf9160/mqtt_simple/sample.yaml
```yaml
sample:
  name: mqtt simple sample
tests:
  sample.nrf9160.mqtt_simple:
    build_only: true
    integration_platforms:
      - nrf9160dk_nrf9160_ns
    platform_allow: nrf9160dk_nrf9160_ns
    tags: ci_build
```
