## samples/nrf9160/multicell_location/Kconfig
```kconfig
#
# Copyright (c) 2021 Nordic Semiconductor ASA
#
# SPDX-License-Identifier: LicenseRef-Nordic-5-Clause
#

menu "Multicell location sample"

config MULTICELL_LOCATION_SAMPLE_REQUEST_PERIODIC
	bool "Request location periodically"
	help
	  Request cell measurements and location periodically.

config MULTICELL_LOCATION_SAMPLE_REQUEST_PERIODIC_INTERVAL
	int "Periodic search interval [sec]"
	default 60
	depends on MULTICELL_LOCATION_SAMPLE_REQUEST_PERIODIC
	help
	  Interval for periodic cell measurements and location requests.

config MULTICELL_LOCATION_SAMPLE_REQUEST_BUTTON
	bool "Request location pressing button 1"
	default y
	help
	  Request cell measurements and location when button 1 is pressed.

config MULTICELL_LOCATION_SAMPLE_REQUEST_CELL_CHANGE
	bool "Request location on cell change"
	help
	  Request cell measurements and location when the current LTE cell
	  changes. This can be useful when testing on a moving device.

config MULTICELL_LOCATION_SAMPLE_PRINT_DATA
	bool "Print multicell data"
	default y
	help
	  Prints cell data when it's reported from the link controller.

config MULTICELL_LOCATION_SAMPLE_PSM
	bool "Request PSM from the network"
	help
	  Request PSM from the LTE network.

config MULTICELL_LOCATION_SAMPLE_EDRX
	bool "Request eDRX from the network"
	help
	  Request eDRX from the LTE network.

module = MULTICELL_LOCATION_SAMPLE
module-str = Multicell location sample
source "${ZEPHYR_BASE}/subsys/logging/Kconfig.template.log_config"

endmenu

menu "Zephyr Kernel"
source "Kconfig.zephyr"
endmenu
```

## samples/nrf9160/multicell_location/sample.yaml
```yaml
sample:
  name: Multicell location sample
tests:
  sample.nrf9160.multicell_location:
    build_only: true
    extra_configs:
      - CONFIG_MULTICELL_LOCATION_SERVICE_HERE=y
      - CONFIG_MULTICELL_LOCATION_HERE_API_KEY="dummy-key"
    integration_platforms:
      - nrf9160dk_nrf9160_ns
      - thingy91_nrf9160_ns
    platform_allow: nrf9160dk_nrf9160_ns thingy91_nrf9160_ns
    tags: ci_build
```

## samples/nrf9160/nidd/Kconfig
```kconfig
#
# Copyright (c) 2022 Nordic Semiconductor ASA
#
# SPDX-License-Identifier: LicenseRef-Nordic-5-Clause
#

menu "NIDD Sample Settings"

config NIDD_APN
	string "APN used for NIDD connection"
	default ""

config NIDD_ALLOC_NEW_CID
	bool "Allocate new context identifier for NIDD connection"
	default n

config NIDD_PAYLOAD
	string "Payload for NIDD transmission"
	default "Hello, World!"

endmenu

module = NIDD
module-str = NIDD sample

menu "Zephyr Kernel"
source "Kconfig.zephyr"
endmenu
```

## samples/nrf9160/nidd/sample.yaml
```yaml
sample:
  name: NIDD sample
tests:
  samples.nrf9160.nidd:
    build_only: true
    platform_allow: nrf9160dk_nrf9160_ns thingy91_nrf9160_ns
    integration_platforms:
      - nrf9160dk_nrf9160_ns
      - thingy91_nrf9160_ns
    tags: ci_build
```

## samples/nrf9160/nrf_cloud_agps/Kconfig
```kconfig
#
# Copyright (c) 2020 Nordic Semiconductor ASA
#
# SPDX-License-Identifier: LicenseRef-BSD-5-Clause-Nordic
#

menu "nRF Cloud A-GPS Sample Settings"

config CLOUD_MESSAGE
	string "Custom message published periodically to cloud"
	default "{\"state\":{\"reported\":{\"message\":\"Hello Internet of Things!\"}}}"

config LTE_POWER_SAVING_MODE
	bool "Request Power Saving Mode (PSM) from cellular network"

endmenu

menu "Zephyr Kernel"
source "Kconfig.zephyr"
endmenu

module = NRF_CLOUD_AGPS_SAMPLE
module-str = nRF Cloud A-GPS sample
source "${ZEPHYR_BASE}/subsys/logging/Kconfig.template.log_config"
```

## samples/nrf9160/nrf_cloud_agps/sample.yaml
```yaml
sample:
  name: nRF Cloud A-GPS sample
tests:
  samples.nrf9160.nrf_cloud_agps:
    build_only: true
    build_on_all: true
    platform_whitelist: nrf9160dk_nrf9160ns thingy91_nrf9160ns
    tags: ci_build
```

## samples/nrf9160/nrf_cloud_mqtt_multi_service/Kconfig
```kconfig
#
# Copyright (c) 2022 Nordic Semiconductor ASA
#
# SPDX-License-Identifier: LicenseRef-Nordic-5-Clause
#

menu "MQTT Multi Service Sample Settings"

config POWER_SAVING_MODE_ENABLE
	bool "Enable Power Saving Mode (PSM)"
	help
	  Enable to request Power Saving Mode from cellular network.

config LTE_INIT_RETRY_TIMEOUT_SECONDS
	int "LTE initialization retry timeout (seconds)"
	default 30
	help
	  Sets the number of seconds between each LTE modem initialization
	  retry.

config CLOUD_CONNECTION_RETRY_TIMEOUT_SECONDS
	int "Cloud connection retry timeout (seconds)"
	default 30
	help
	  If connecting to nRF Cloud takes longer than this timeout, it will be
	  reattempted.

config CLOUD_CONNECTION_REESTABLISH_DELAY_SECONDS
	int "Cloud connection reestablishment delay (seconds)"
	default 5
	help
	  After the connection to nRF Cloud has been reset, wait this amount of
	  time before attempting to connect again.

config CLOUD_READY_TIMEOUT_SECONDS
	int "Cloud readiness timeout (seconds)"
	default 600
	help
	  If the connection to nRF Cloud does not become ready within this
	  timeout, the sample will reset its connection and try again.

config DATE_TIME_ESTABLISHMENT_TIMEOUT_SECONDS
	int "Modem date and time establishment timeout (seconds)"
	default 300
	help
	  The sample will wait this many seconds for the modem to determine the
	  current date and time before giving up and moving on.

config APPLICATION_THREAD_STACK_SIZE
	int "Application Thread Stack Size (bytes)"
	default 2048
	help
	  Sets the stack size (in bytes) for the application thread of the
	  sample.

config CONNECTION_THREAD_STACK_SIZE
	int "Connection Thread Stack Size (bytes)"
	default 2048
	help
	  Sets the stack size (in bytes) for the connection thread of the
	  sample.

config MESSAGE_THREAD_STACK_SIZE
	int "Message Queue Thread Stack Size (bytes)"
	default 2048
	help
	  Sets the stack size (in bytes) for the message queue processing
	  thread of the sample.

config MAX_OUTGOING_MESSAGES
	int "Outgoing message maximum"
	default 64
	help
	  Sets the maximum number of device messages which may be enqueued
	  before further messages are dropped.

config MAX_CONSECUTIVE_SEND_FAILURES
	int "Max outgoing consecutive send failures"
	default 5
	help
	  Sets the maximum number of device messages which may fail to send
	  before a connection reset and cooldown is triggered.

config CONSECUTIVE_SEND_FAILURE_COOLDOWN_SECONDS
	int "Cooldown after max consecutive send failures exceeded"
	default 10
	help
	  If a connection reset is triggered by too many failed device
	  messages, the sample will wait this long (in seconds) before trying
	  again.

config SENSOR_SAMPLE_INTERVAL_SECONDS
	int "Sensor sampling interval (seconds)"
	default 60
	help
	  Sets the time to wait between each sensor sample.

config LOCATION_TRACKING_SAMPLE_INTERVAL_SECONDS
	int "Location sampling interval (seconds)"
	default 60
	help
	  Sets the location sampling interval in seconds.

config LOCATION_TRACKING_GNSS
	bool "Use GNSS method for location tracking"
	default y
	depends on LOCATION_METHOD_GNSS
	help
	  Disable both this and LOCATION_TRACKING_CELLULAR to completely disable location tracking.

config LOCATION_TRACKING_CELLULAR
	bool "Use cellular method for location tracking"
	default y
	depends on LOCATION_METHOD_CELLULAR
	help
	  Disable both this and LOCATION_TRACKING_GNSS to completely disable location tracking.

config TEMP_DATA_USE_SENSOR
	bool "Use genuine temperature data"
	depends on BOARD_THINGY91_NRF9160_NS
	default y if BOARD_THINGY91_NRF9160_NS
	select SENSOR
	select BME680
	help
	  Sets whether to take genuine temperature measurements from a
	  connected BME680 sensor, or just simulate sensor data.

config TEMP_TRACKING
	bool "Track temperature"
	default y
	help
	  Sets whether to take temperature measurements.

choice GNSS_ANTENNA
	default GNSS_ANTENNA_ONBOARD
	prompt "Select which antenna to use for GNSS"

config GNSS_ANTENNA_ONBOARD
	bool "Use onboard antenna"

config GNSS_ANTENNA_EXTERNAL
	bool "Use external antenna"

endchoice

config GNSS_AT_MAGPIO
	string "AT%XMAGPIO command"
	default "AT\%XMAGPIO=1,0,0,1,1,1574,1577" if BOARD_NRF9160DK_NRF9160_NS
	default "AT\%XMAGPIO=1,1,1,7,1,746,803,2,698,748,2,1710,2200,3,824,894,4,880,960,5,791,849,7,1565,1586" if BOARD_THINGY91_NRF9160_NS
	help
	  AT%XMAGPIO command to be sent to GNSS module.

config GNSS_AT_COEX0
	string "AT%XCOEX0 command"
	default "AT\%XCOEX0=1,1,1565,1586" if (BOARD_NRF9160DK_NRF9160_NS || BOARD_THINGY91_NRF9160_NS) && GNSS_ANTENNA_ONBOARD
	default "AT\%XCOEX0" if (BOARD_NRF9160DK_NRF9160_NS || BOARD_THINGY91_NRF9160_NS) && GNSS_ANTENNA_EXTERNAL
	help
	  AT%XCOEX0 command to be sent to GNSS module.

config GNSS_FIX_TIMEOUT_SECONDS
	int "GNSS Fix timeout"
	default 40
	help
	  On each location sample, try for this long to achieve a GNSS fix
	  before falling back to cellular positioning.
	  Set this to 20 or so seconds below the sensor sample interval so
	  that there is time left over to perform cellular positioning.
	  Otherwise, location samples may occur at a longer interval than
	  requested.

config TEST_COUNTER
	bool "Sets whether the test counter is enabled"

endmenu

module = MQTT_MULTI_SERVICE
module-str = MQTT Multi Service
source "${ZEPHYR_BASE}/subsys/logging/Kconfig.template.log_config"

menu "Zephyr Kernel"
source "Kconfig.zephyr"
endmenu
```

## samples/nrf9160/nrf_cloud_mqtt_multi_service/child_image/mcuboot/boards/nrf9160dk_nrf9160.conf
```kconfig
#
# Copyright (c) 2023 Nordic Semiconductor ASA
#
# SPDX-License-Identifier: LicenseRef-Nordic-5-Clause
#

CONFIG_SPI=y
CONFIG_SPI_NOR=y
CONFIG_SPI_NOR_FLASH_LAYOUT_PAGE_SIZE=4096
CONFIG_SPI_NRFX_RAM_BUFFER_SIZE=32

CONFIG_PM_OVERRIDE_EXTERNAL_DRIVER_CHECK=y

CONFIG_FPROTECT=y

# Enabling SPI increases the MCUBoot image size so that it does not fit in the default
# partition size (0xC000). The minimum required size is 0xD000
CONFIG_PM_PARTITION_SIZE_MCUBOOT=0xD000
```

## samples/nrf9160/nrf_cloud_mqtt_multi_service/sample.yaml
```yaml
sample:
  name: nRF Cloud MQTT Multi Service Sample
tests:
  sample.nrf9160.nrf_cloud_mqtt_multi_service:
    build_only: true
    platform_allow: nrf9160dk_nrf9160_ns thingy91_nrf9160_ns
    integration_platforms:
      - nrf9160dk_nrf9160_ns
      - thingy91_nrf9160_ns
    tags: ci_build
```
