## samples/nrf9160/lwm2m_client/src/sensors/Kconfig.gps
```kconfig
#
# Copyright (c) 2021 Nordic Semiconductor ASA
#
# SPDX-License-Identifier: LicenseRef-Nordic-5-Clause
#

config GPS
	bool
	help
	  Enable GPS

if GPS
choice
	prompt "GPS device"
	default GPS_USE_EXTERNAL
	help
	  Select from which device GPS data will be fetched.

config GPS_USE_EXTERNAL
	bool "Use NRF9160 GPS driver"
	select NRF9160_GPS
	help
	  Provide a GPS device that location data will be fetched from and sent to the LWM2M server.

config GPS_USE_SIM
	bool "Use GPS simulator"
	select GPS_SIM
	select GPS_SIM_TRIGGER
	help
	  Use simulated GPS data.
endchoice # GPS device

if GPS_USE_SIM
config GPS_DEV_NAME
	string
	default GPS_SIM_DEV_NAME

config GPS_TRIGGER
	bool
	default GPS_SIM_TRIGGER
endif # GPS_USE_SIM

if GPS_USE_EXTERNAL
config GPS_DEV_NAME
	string "GPS device name"
	default "NRF9160_GPS"
	help
	  GPS device from which location data will be fetched and sent to nRF Cloud.
endif # GPS_USE_EXTERNAL

config GPS_SEARCH_INTERVAL_TIME
	int "GPS search interval [s]"
	default 300
	help
	  Length of time between GPS searches in seconds.

config GPS_SEARCH_TIMEOUT_TIME
	int "GPS search timeout [s]"
	default 150
	help
	  Length of time the GPS can spend looking for a fix in seconds.
	  In areas with poor connection, this should be increased.

config GPS_PRIORITY_ON_FIRST_FIX
	bool "Give GPS priority when looking for first fix"
	default n
	help
	  Gives the GPS priority while it is performing its first search.
	  Enabling this will make it significantly easier for the GPS module to find a position, but
	  will also affect performance for the rest of the app.
	  Subsequent fixes are much quicker and therefore no priority is needed.

endif #GPS
```

## samples/nrf9160/lwm2m_client/src/ui/Kconfig
```kconfig
#
# Copyright (c) 2019 Nordic Semiconductor ASA
#
# SPDX-License-Identifier: LicenseRef-Nordic-5-Clause
#

config UI_LED
	bool
	help
	  Enable LEDs.

config UI_BUZZER
	bool
	select PWM
	help
	  If enabled, a buzzer will be controllable with PWM.


config UI_INPUT
	bool
	select DK_LIBRARY
	help
	  Enable switches and buttons.


config UI_SENSE_LED
	bool "UI Sense LED module"
	help
	  Enables the sense LEDs available on the Thingy:91.
```

## samples/nrf9160/memfault/sample.yaml
```yaml
sample:
  name: Memfault sample
tests:
  sample.nrf9160.memfault:
    build_only: true
    extra_configs:
      - CONFIG_MEMFAULT_NCS_PROJECT_KEY="dummy-key"
    integration_platforms:
      - nrf9160dk_nrf9160_ns
      - thingy91_nrf9160_ns
    platform_allow: nrf9160dk_nrf9160_ns thingy91_nrf9160_ns
    tags: ci_build
  sample.nrf9160.memfault.etb:
    build_only: true
    extra_configs:
      - CONFIG_MEMFAULT_NCS_PROJECT_KEY="dummy-key"
    extra_args: OVERLAY_CONFIG=overlay-etb.conf
    integration_platforms:
      - nrf9160dk_nrf9160_ns
      - thingy91_nrf9160_ns
    platform_allow: nrf9160dk_nrf9160_ns thingy91_nrf9160_ns
    tags: ci_build
```

## samples/nrf9160/modem_callbacks/sample.yaml
```yaml
sample:
  name: modem callbacks
tests:
  sample.nrf9160.modem_callbacks:
    build_only: true
    integration_platforms:
      - nrf9160dk_nrf9160_ns
    platform_allow: nrf9160dk_nrf9160_ns
    tags: ci_build
```

## samples/nrf9160/modem_shell/Kconfig
```kconfig
#
# Copyright (c) 2020 Nordic Semiconductor ASA
#
# SPDX-License-Identifier: LicenseRef-Nordic-5-Clause
#

source "Kconfig.zephyr"

menu "Nordic Modem Shell config"

config MOSH_IPERF3
	bool "iPerf3"
	default y
	select NRF_IPERF3

config NRF_IPERF3_PROMPTLESS
	bool
	default y

config MOSH_SOCK
	bool "Socket tool"
	default y
	help
	  Socket tool with TCP, UDP, RAW, IPv4, IPv6 and packet socket support.

config MOSH_PING
	bool "ICMP ping"
	default y
	help
	  Ping is a tool for testing the reachability of a host on an IP network.

config MOSH_LINK
	bool "Link control"
	depends on LTE_LINK_CONTROL
	depends on MODEM_INFO
	depends on SETTINGS
	default y
	help
	  Link control changes and queries the state of the LTE connection.

config MOSH_CURL
	bool "cURL"
	default y
	select NRF_CURL

config NRF_CURL_PROMPTLESS
	bool
	default y

config MOSH_GNSS
	bool "GNSS"
	default y
	help
	  GNSS feature for searching the location of the device.

config MOSH_PPP
	bool "PPP"
	help
	  Point-to-Point Protocol for enabling dial-up access to the Internet.

config MOSH_SMS
	bool "SMS"
	default y
	help
	  SMS tool for sending and receiving SMS messages.

config MOSH_LOCATION
	bool "Location"
	default y
	select LOCATION
	help
	  Tool for location queries via location library.

config MOSH_FOTA
	bool "FOTA"
	default y
	help
	  FOTA for performing software updates over-the-air for both modem and application side.

config MOSH_REST
	bool "REST client"
	default y
	select REST_CLIENT
	help
	  REST client for sending and receiving simple REST requests/responses.

config MOSH_CLOUD
	bool "MQTT connection to nRFCloud"
	select NRF_CLOUD_MQTT
	select NRF_CLOUD_CELL_POS if MULTICELL_LOCATION_SERVICE_NRF_CLOUD
	help
	  MQTT connection to nRFCloud.

config MOSH_PRINT_BUFFER_SIZE
	int "Buffer size used when printing modem shell output"
	default 1024
	help
	  If the printed string exceeds this buffer, an error message is printed first and
	  then the requested string cut into the length of this buffer.

if MOSH_IPERF3
menu "MoSH iperf3 command selections"

config MOSH_WORKER_THREADS
	bool "Possibility to run iperf3 instances in separate threads"
	default y

endmenu
endif #MOSH_IPERF3

if MOSH_LINK
menu "MoSH link control selections"

config MOSH_LINK_SETT_NORMAL_MODE_AT_CMD_STR_LEN
	int "Link settings AT command length"
	default 127
	help
	  String length for custom AT commands stored into settings to be used
	  when going to normal mode.

endmenu
endif #MOSH_LINK

choice MOSH_GNSS_API
	bool "GNSS API"
	depends on MOSH_GNSS
	default MOSH_GNSS_INTERFACE
	help
	  Used GNSS API type.

config MOSH_GNSS_INTERFACE
	bool "GNSS interface"

config MOSH_GNSS_GPS_DRIVER
	bool "GPS driver"

endchoice

choice MOSH_GNSS_ANTENNA
	depends on MOSH_GNSS
	default MOSH_GNSS_ANTENNA_ONBOARD
	prompt "Select which antenna to use for GNSS"
config MOSH_GNSS_ANTENNA_ONBOARD
	bool "Use onboard antenna"
config MOSH_GNSS_ANTENNA_EXTERNAL
	bool "Use external antenna"

endchoice

config MOSH_AT_MAGPIO
	string
	default "AT\%XMAGPIO=1,0,0,1,1,1574,1577" if BOARD_NRF9160DK_NRF9160_NS
	default "AT\%XMAGPIO=1,1,1,7,1,746,803,2,698,748,2,1710,2200,3,824,894,4,880,960,5,791,849,7,1565,1586" if BOARD_THINGY91_NRF9160_NS
	help
	  Defines what is the AT%XMAGPIO command to be sent to GNSS module. Leave
	  empty if this command should not be sent.

config MOSH_AT_COEX0
	string
	default "AT\%XCOEX0=1,1,1565,1586" if (BOARD_NRF9160DK_NRF9160_NS || BOARD_THINGY91_NRF9160_NS) && MOSH_GNSS_ANTENNA_ONBOARD
	default "AT\%XCOEX0" if (BOARD_NRF9160DK_NRF9160_NS || BOARD_THINGY91_NRF9160_NS) && MOSH_GNSS_ANTENNA_EXTERNAL
	help
	  Defines what is the AT%XCOEX0 command to be sent to GNSS module. Leave
	  empty if this command should not be sent.

endmenu # Modem Shell
```

## samples/nrf9160/modem_shell/boards/thingy91_nrf9160_ns.conf
```kconfig
#
# Copyright (c) 2021 Nordic Semiconductor ASA
#
# SPDX-License-Identifier: LicenseRef-Nordic-5-Clause
#

# Configuration file for Thingy:91.
# This file is merged with prj.conf in the application folder, and options
# set here will take precedence if they are present in both files.

# Disabling some of the features by default to fit MOSH into the flash
CONFIG_MOSH_CURL=n
CONFIG_MOSH_REST=n
CONFIG_MOSH_SMS=n
CONFIG_MOSH_IPERF3=n
CONFIG_MOSH_WORKER_THREADS=n

# MCUBOOT
CONFIG_BOOTLOADER_MCUBOOT=y
CONFIG_IMG_MANAGER=y
CONFIG_MCUBOOT_IMG_MANAGER=y
CONFIG_IMG_ERASE_PROGRESSIVELY=y
```

## samples/nrf9160/modem_shell/boards/thingy91_nrf9160ns.conf
```kconfig
#
# Copyright (c) 2021 Nordic Semiconductor ASA
#
# SPDX-License-Identifier: LicenseRef-Nordic-5-Clause
#

# Configuration file for Thingy:91.
# This file is merged with prj.conf in the application folder, and options
# set here will take precedence if they are present in both files.

# Disabling CURL by default to fit MOSH into the flash
CONFIG_MOSH_CURL=n

# For APP FOTA
CONFIG_BOOTLOADER_MCUBOOT=y
CONFIG_IMG_MANAGER=y
CONFIG_IMG_ERASE_PROGRESSIVELY=y
```
