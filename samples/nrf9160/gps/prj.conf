## CMakeLists.txt
```
#
# Copyright (c) 2019 Nordic Semiconductor
#
# SPDX-License-Identifier: LicenseRef-Nordic-5-Clause
#

cmake_minimum_required(VERSION 3.20.0)

find_package(Zephyr REQUIRED HINTS $ENV{ZEPHYR_BASE})
project(gps_socket_sample)

zephyr_library_sources(src/main.c)

zephyr_library_sources_ifdef(
  CONFIG_SUPL_CLIENT_LIB
  src/supl_support.c
)
```

## Kconfig
```
#
# Copyright (c) 2020 Nordic Semiconductor ASA
#
# SPDX-License-Identifier: LicenseRef-Nordic-5-Clause
#

menu "GPS sample"

config GPS_SAMPLE_NMEA_ONLY
	bool "Output only NMEA strings"
	help
	  Outputs only NMEA strings from the GPS.

choice GPS_SAMPLE_ANTENNA
	default GPS_SAMPLE_ANTENNA_ONBOARD
	prompt "Select which antenna to use for GPS"

config GPS_SAMPLE_ANTENNA_ONBOARD
	bool "Use onboard antenna"

config GPS_SAMPLE_ANTENNA_EXTERNAL
	bool "Use external antenna"

endchoice

config GPS_SAMPLE_AT_MAGPIO
	string "AT%XMAGPIO command"
	default "AT\%XMAGPIO=1,0,0,1,1,1574,1577" if BOARD_NRF9160DK_NRF9160_NS
	default "AT\%XMAGPIO=1,1,1,7,1,746,803,2,698,748,2,1710,2200,3,824,894,4,880,960,5,791,849,7,1565,1586" if BOARD_THINGY91_NRF9160NS
	help
	  Defines what is the AT%XMAGPIO command to be sent to GPS module. Leave
	  empty if this command should not be sent.

config GPS_SAMPLE_AT_COEX0
	string "AT%XCOEX0 command"
	default "AT\%XCOEX0=1,1,1565,1586" if (BOARD_NRF9160DK_NRF9160_NS || BOARD_THINGY91_NRF9160NS) && GPS_SAMPLE_ANTENNA_ONBOARD
	default "AT\%XCOEX0" if (BOARD_NRF9160DK_NRF9160_NS || BOARD_THINGY91_NRF9160NS) && GPS_SAMPLE_ANTENNA_EXTERNAL
	help
	  Defines what is the AT%XCOEX0 command to be sent to GPS module. Leave
	  empty if this command should not be sent.

endmenu

menu "Zephyr Kernel"
source "Kconfig.zephyr"
endmenu
```

## sample.yaml
```
sample:
  name: GPS sample
tests:
  samples.nrf9160.gps:
    build_only: true
    platform_allow: nrf9160dk_nrf9160_ns
    integration_platforms:
      - nrf9160dk_nrf9160_ns
    tags: ci_build
```

## prj.conf
```kconfig
#
# Copyright (c) 2019 Nordic Semiconductor ASA
#
# SPDX-License-Identifier: LicenseRef-Nordic-5-Clause
#

CONFIG_FPU=y
CONFIG_NRF_MODEM_LIB=y
CONFIG_STDOUT_CONSOLE=y
CONFIG_UART_INTERRUPT_DRIVEN=y
CONFIG_NEWLIB_LIBC=y
CONFIG_NEWLIB_LIBC_FLOAT_PRINTF=y
CONFIG_AT_CMD=y

# To use SUPL client library for assisted GPS, enable the options below
CONFIG_SUPL_CLIENT_LIB=n
CONFIG_LTE_LINK_CONTROL=n
CONFIG_LTE_NETWORK_MODE_LTE_M_GPS=n

# Auto-connect should be left off as we want the application to control LTE
CONFIG_LTE_AUTO_INIT_AND_CONNECT=n

# Networking
CONFIG_NETWORKING=y
CONFIG_NET_SOCKETS_OFFLOAD=y
CONFIG_NET_SOCKETS=y
CONFIG_NET_SOCKETS_POSIX_NAMES=y
CONFIG_NET_SOCKETS_SOCKOPT_TLS=y

# Disable native network stack to save some memory
CONFIG_NET_NATIVE=n

# Main thread
CONFIG_HEAP_MEM_POOL_SIZE=2048
CONFIG_MAIN_STACK_SIZE=4096
CONFIG_SYSTEM_WORKQUEUE_STACK_SIZE=1536

# Application
CONFIG_GPS_SAMPLE_NMEA_ONLY=n
#CONFIG_GPS_SAMPLE_ANTENNA_EXTERNAL=y
```

## src/main.c
```c
/*
 * Copyright (c) 2019 Nordic Semiconductor ASA
 *
 * SPDX-License-Identifier: LicenseRef-Nordic-5-Clause
 */

#include <zephyr.h>
#include <nrf_modem_gnss.h>
#include <string.h>
#include <modem/at_cmd.h>
#include <modem/lte_lc.h>

#ifdef CONFIG_SUPL_CLIENT_LIB
#include <supl_os_client.h>
#include <supl_session.h>
#include "supl_support.h"
#endif

#define AT_XSYSTEMMODE      "AT\%XSYSTEMMODE=0,0,1,0"
#define AT_ACTIVATE_GPS     "AT+CFUN=31"

#define AT_CMD_SIZE(x) (sizeof(x) - 1)

static const char update_indicator[] = {'\\', '|', '/', '-'};
static const char *const at_commands[] = {
#if !defined(CONFIG_SUPL_CLIENT_LIB)
	AT_XSYSTEMMODE,
#endif
	CONFIG_GPS_SAMPLE_AT_MAGPIO,
	CONFIG_GPS_SAMPLE_AT_COEX0,
	AT_ACTIVATE_GPS
};

static struct nrf_modem_gnss_pvt_data_frame last_pvt;
static volatile bool gnss_blocked;

#ifdef CONFIG_SUPL_CLIENT_LIB
static struct nrf_modem_gnss_agps_data_frame last_agps;
static struct k_work_q agps_work_q;
static struct k_work get_agps_data_work;

#define AGPS_WORKQ_THREAD_STACK_SIZE 2048
#define AGPS_WORKQ_THREAD_PRIORITY   5

K_THREAD_STACK_DEFINE(agps_workq_stack_area, AGPS_WORKQ_THREAD_STACK_SIZE);
#endif

K_MSGQ_DEFINE(nmea_queue, sizeof(struct nrf_modem_gnss_nmea_data_frame *), 10, 4);
K_SEM_DEFINE(pvt_data_sem, 0, 1);
K_SEM_DEFINE(lte_ready, 0, 1);

struct k_poll_event events[2] = {
	K_POLL_EVENT_STATIC_INITIALIZER(K_POLL_TYPE_SEM_AVAILABLE,
					K_POLL_MODE_NOTIFY_ONLY,
					&pvt_data_sem, 0),
	K_POLL_EVENT_STATIC_INITIALIZER(K_POLL_TYPE_MSGQ_DATA_AVAILABLE,
					K_POLL_MODE_NOTIFY_ONLY,
					&nmea_queue, 0),
};

void nrf_modem_recoverable_error_handler(uint32_t error)
{
	printk("Modem library recoverable error: %u\n", error);
}

static int setup_modem(void)
{
	for (int i = 0; i < ARRAY_SIZE(at_commands); i++) {
		if (at_commands[i][0] == '\0') {
			continue;
		}

		if (at_cmd_write(at_commands[i], NULL, 0, NULL) != 0) {
			return -1;
		}
	}

	return 0;
}

#ifdef CONFIG_SUPL_CLIENT_LIB
BUILD_ASSERT(IS_ENABLED(CONFIG_LTE_NETWORK_MODE_LTE_M_GPS) ||
	     IS_ENABLED(CONFIG_LTE_NETWORK_MODE_NBIOT_GPS) ||
	     IS_ENABLED(CONFIG_LTE_NETWORK_MODE_LTE_M_NBIOT_GPS),
	     "To use SUPL and GPS, CONFIG_LTE_NETWORK_MODE_LTE_M_GPS, "
	     "CONFIG_LTE_NETWORK_MODE_NBIOT_GPS or "
	     "CONFIG_LTE_NETWORK_MODE_LTE_M_NBIOT_GPS must be enabled");

static void lte_handler(const struct lte_lc_evt *const evt)
{
	switch (evt->type) {
	case LTE_LC_EVT_NW_REG_STATUS:
		if ((evt->nw_reg_status == LTE_LC_NW_REG_REGISTERED_HOME) ||
		    (evt->nw_reg_status == LTE_LC_NW_REG_REGISTERED_ROAMING)) {
			printk("Connected to LTE network\n");
			k_sem_give(&lte_ready);
		}
		break;
	default:
		break;
	}
}

static int activate_lte(bool activate)
{
	int err;

	if (activate) {
		err = lte_lc_func_mode_set(LTE_LC_FUNC_MODE_ACTIVATE_LTE);
		if (err) {
			printk("Failed to activate LTE, error: %d\n", err);
			return -1;
		}

		printk("LTE activated\n");
		k_sem_take(&lte_ready, K_FOREVER);
	} else {
		err = lte_lc_func_mode_set(LTE_LC_FUNC_MODE_DEACTIVATE_LTE);
		if (err) {
			printk("Failed to deactivate LTE, error: %d\n", err);
			return -1;
		}

		printk("LTE deactivated\n");
	}

	return 0;
}

static void get_agps_data(struct k_work *item)
{
	ARG_UNUSED(item);

	printk("\033[1;1H");
	printk("\033[2J");
	printk("New A-GPS data requested, contacting SUPL server, flags %d\n",
			last_agps.data_flags);

	activate_lte(true);

	/* Wait for a while, because with IPv4v6 PDN the IPv6 activation takes a bit more time. */
	k_sleep(K_SECONDS(1));

	if (open_supl_socket() == 0) {
		printk("Starting SUPL session\n");
		supl_session(&last_agps);
		printk("Done\n");
		close_supl_socket();
	}
	activate_lte(false);
}

static int inject_agps_type(void *agps, size_t agps_size, uint16_t type, void *user_data)
{
	ARG_UNUSED(user_data);

	int retval = nrf_modem_gnss_agps_write(agps, agps_size, type);

	if (retval != 0) {
		printk("Failed to write A-GPS data, type: %d (errno: %d)\n", type, errno);
		return -1;
	}

	printk("Injected A-GPS data, type: %d, size: %d\n", type, agps_size);

	return 0;
}
#endif

static void gnss_event_handler(int event)
{
	int retval;
	struct nrf_modem_gnss_nmea_data_frame *nmea_data;

	switch (event) {
	case NRF_MODEM_GNSS_EVT_PVT:
		retval = nrf_modem_gnss_read(&last_pvt, sizeof(last_pvt), NRF_MODEM_GNSS_DATA_PVT);
		if (retval == 0) {
			k_sem_give(&pvt_data_sem);
		}
		break;

	case NRF_MODEM_GNSS_EVT_NMEA:
		nmea_data = k_malloc(sizeof(struct nrf_modem_gnss_nmea_data_frame));
		if (nmea_data == NULL) {
			printk("Failed to allocate memory for NMEA\n");
			break;
		}

		retval = nrf_modem_gnss_read(nmea_data,
					     sizeof(struct nrf_modem_gnss_nmea_data_frame),
					     NRF_MODEM_GNSS_DATA_NMEA);
		if (retval == 0) {
			retval = k_msgq_put(&nmea_queue, &nmea_data, K_NO_WAIT);
		}

		if (retval != 0) {
			k_free(nmea_data);
		}
		break;

	case NRF_MODEM_GNSS_EVT_AGPS_REQ:
#ifdef CONFIG_SUPL_CLIENT_LIB
		retval = nrf_modem_gnss_read(&last_agps,
					     sizeof(last_agps),
					     NRF_MODEM_GNSS_DATA_AGPS_REQ);
		if (retval == 0) {
			if (last_agps.sv_mask_ephe == 0 &&
			    last_agps.sv_mask_alm == 0 &&
			    last_agps.data_flags == NRF_MODEM_GNSS_AGPS_INTEGRITY_REQUEST) {
				/* Skip request because only integrity data is requested and
				 * Google SUPL server doesn't provide that.
				 */
				break;
			}
			k_work_submit_to_queue(&agps_work_q, &get_agps_data_work);
		}
#endif
		break;

	case NRF_MODEM_GNSS_EVT_BLOCKED:
		gnss_blocked = true;
		break;

	case NRF_MODEM_GNSS_EVT_UNBLOCKED:
		gnss_blocked = false;
		break;

	default:
		break;
	}
}

static int init_app(void)
{
#ifdef CONFIG_SUPL_CLIENT_LIB
	if (lte_lc_init()) {
		printk("Failed to initialize LTE link controller\n");
		return -1;
	}

	lte_lc_register_handler(lte_handler);

	static struct supl_api supl_api = {
		.read       = supl_read,
		.write      = supl_write,
		.handler    = inject_agps_type,
		.logger     = supl_logger,
		.counter_ms = k_uptime_get
	};

	k_work_queue_start(
		&agps_work_q,
		agps_workq_stack_area,
		K_THREAD_STACK_SIZEOF(agps_workq_stack_area),
		AGPS_WORKQ_THREAD_PRIORITY,
		NULL);

	k_work_init(&get_agps_data_work, get_agps_data);

	if (supl_init(&supl_api) != 0) {
		printk("Failed to initialize SUPL library\n");
		return -1;
	}
#endif /* CONFIG_SUPL_CLIENT_LIB */

	if (setup_modem() != 0) {
		printk("Failed to initialize modem\n");
		return -1;
	}

	/* Initialize and configure GNSS */
	if (nrf_modem_gnss_init() != 0) {
		printk("Failed to initialize GNSS interface\n");
		return -1;
	}

	if (nrf_modem_gnss_event_handler_set(gnss_event_handler) != 0) {
		printk("Failed to set GNSS event handler\n");
		return -1;
	}

	if (nrf_modem_gnss_nmea_mask_set(NRF_MODEM_GNSS_NMEA_RMC_MASK |
					 NRF_MODEM_GNSS_NMEA_GGA_MASK |
					 NRF_MODEM_GNSS_NMEA_GLL_MASK |
					 NRF_MODEM_GNSS_NMEA_GSA_MASK |
					 NRF_MODEM_GNSS_NMEA_GSV_MASK) != 0) {
		printk("Failed to set GNSS NMEA mask\n");
		return -1;
	}

	if (nrf_modem_gnss_fix_retry_set(0) != 0) {
		printk("Failed to set GNSS fix retry\n");
		return -1;
	}

	if (nrf_modem_gnss_fix_interval_set(1) != 0) {
		printk("Failed to set GNSS fix interval\n");
		return -1;
	}

	if (nrf_modem_gnss_start() != 0) {
		printk("Failed to start GNSS\n");
		return -1;
	}

	return 0;
}

static void print_satellite_stats(struct nrf_modem_gnss_pvt_data_frame *pvt_data)
{
	uint8_t tracked   = 0;
	uint8_t in_fix    = 0;
	uint8_t unhealthy = 0;

	for (int i = 0; i < NRF_MODEM_GNSS_MAX_SATELLITES; ++i) {
		if (pvt_data->sv[i].sv > 0) {
			tracked++;

			if (pvt_data->sv[i].flags & NRF_MODEM_GNSS_SV_FLAG_USED_IN_FIX) {
				in_fix++;
			}

			if (pvt_data->sv[i].flags & NRF_MODEM_GNSS_SV_FLAG_UNHEALTHY) {
				unhealthy++;
			}
		}
	}

	printk("Tracking: %d Using: %d Unhealthy: %d\n", tracked, in_fix, unhealthy);
}

static void print_fix_data(struct nrf_modem_gnss_pvt_data_frame *pvt_data)
{
	printk("Latitude:   %.06f\n", pvt_data->latitude);
	printk("Longitude:  %.06f\n", pvt_data->longitude);
	printk("Altitude:   %.01f m\n", pvt_data->altitude);
	printk("Accuracy:   %.01f m\n", pvt_data->accuracy);
	printk("Speed:      %.01f m/s\n", pvt_data->speed);
	printk("Heading:    %.01f deg\n", pvt_data->heading);
	printk("Date:       %02u-%02u-%02u\n", pvt_data->datetime.year,
					       pvt_data->datetime.month,
					       pvt_data->datetime.day);
	printk("Time (UTC): %02u:%02u:%02u\n", pvt_data->datetime.hour,
					       pvt_data->datetime.minute,
					       pvt_data->datetime.seconds);
}

static bool agps_data_download_ongoing(void)
{
#ifdef CONFIG_SUPL_CLIENT_LIB
	return k_work_is_pending(&get_agps_data_work);
#else
	return false;
#endif
}

int main(void)
{
	uint8_t cnt = 0;
	uint64_t fix_timestamp = 0;
	struct nrf_modem_gnss_nmea_data_frame *nmea_data;

	printk("Starting GPS sample\n");

	if (init_app() != 0) {
		return -1;
	}

	printk("Getting GNSS data...\n");

	for (;;) {
		(void)k_poll(events, 2, K_FOREVER);

		if (events[0].state == K_POLL_STATE_SEM_AVAILABLE &&
		    k_sem_take(events[0].sem, K_NO_WAIT) == 0) {
			/* New PVT data available */

			if (!IS_ENABLED(CONFIG_GPS_SAMPLE_NMEA_ONLY) &&
			    !agps_data_download_ongoing()) {
				printk("\033[1;1H");
				printk("\033[2J");
				print_satellite_stats(&last_pvt);

				if (gnss_blocked) {
					printk("GNSS operation blocked by LTE\n");
				}
				printk("---------------------------------\n");

				if (last_pvt.flags & NRF_MODEM_GNSS_PVT_FLAG_FIX_VALID) {
					fix_timestamp = k_uptime_get();
					print_fix_data(&last_pvt);
				} else {
					printk("Seconds since last fix: %lld\n",
							(k_uptime_get() - fix_timestamp) / 1000);
					cnt++;
					printk("Searching [%c]\n", update_indicator[cnt%4]);
				}

				printk("\nNMEA strings:\n\n");
			}
		}
		if (events[1].state == K_POLL_STATE_MSGQ_DATA_AVAILABLE &&
		    k_msgq_get(events[1].msgq, &nmea_data, K_NO_WAIT) == 0) {
			/* New NMEA data available */

			if (!agps_data_download_ongoing()) {
				printk("%s", nmea_data->nmea_str);
			}
			k_free(nmea_data);
		}

		events[0].state = K_POLL_STATE_NOT_READY;
		events[1].state = K_POLL_STATE_NOT_READY;
	}

	return 0;
}
```

## src/supl_support.c
```c
/*
 * Copyright (c) 2019 Nordic Semiconductor ASA
 *
 * SPDX-License-Identifier: LicenseRef-Nordic-5-Clause
 */

#include <zephyr.h>
#include <supl_session.h>
#include <stdio.h>
#include <net/socket.h>

#define SUPL_SERVER        "supl.google.com"
#define SUPL_SERVER_PORT   "7276"

static int supl_fd = -1;

int open_supl_socket(void)
{
	int err;
	struct addrinfo *info;

	struct addrinfo hints = {
		.ai_flags = AI_NUMERICSERV,
		.ai_family = AF_UNSPEC, /* Both IPv4 and IPv6 addresses accepted. */
		.ai_socktype = SOCK_STREAM
	};

	err = getaddrinfo(SUPL_SERVER, SUPL_SERVER_PORT, &hints, &info);
	if (err) {
		printk("Failed to resolve hostname %s, error: %d\n", SUPL_SERVER, err);

		return -1;
	}

	/* Not connected. */
	err = -1;

	for (struct addrinfo *addr = info; addr != NULL; addr = addr->ai_next) {
		char ip[INET6_ADDRSTRLEN] = { 0 };
		struct sockaddr *const sa = addr->ai_addr;

		supl_fd = socket(sa->sa_family, SOCK_STREAM, IPPROTO_TCP);
		if (supl_fd < 0) {
			printk("Failed to create socket, errno %d\n", errno);
			goto cleanup;
		}

		/* The SUPL library expects a 1 second timeout for the read function. */
		struct timeval timeout = {
			.tv_sec = 1,
			.tv_usec = 0,
		};

		err = setsockopt(supl_fd, SOL_SOCKET, SO_RCVTIMEO, &timeout, sizeof(timeout));
		if (err) {
			printk("Failed to set socket timeout, errno %d\n", errno);
			goto cleanup;
		}

		inet_ntop(sa->sa_family,
			  (void *)&((struct sockaddr_in *)sa)->sin_addr,
			  ip,
			  INET6_ADDRSTRLEN);
		printk("Connecting to %s port %s\n", ip, SUPL_SERVER_PORT);

		err = connect(supl_fd, sa, addr->ai_addrlen);
		if (err) {
			close(supl_fd);
			supl_fd = -1;

			/* Try the next address. */
			printk("Connecting to server failed, errno %d\n", errno);
		} else {
			/* Connected. */
			break;
		}
	}

cleanup:
	freeaddrinfo(info);

	if (err) {
		/* Unable to connect, close socket. */
		printk("Could not connect to SUPL server\n");
		if (supl_fd > -1) {
			close(supl_fd);
			supl_fd = -1;
		}
		return -1;
	}

	return 0;
}

void close_supl_socket(void)
{
	if (close(supl_fd) < 0) {
		printk("Failed to close SUPL socket\n");
	}
}

ssize_t supl_write(const void *p_buff, size_t nbytes, void *user_data)
{
	ARG_UNUSED(user_data);
	return send(supl_fd, p_buff, nbytes, 0);
}

int supl_logger(int level, const char *fmt, ...)
{
	char buffer[256] = { 0 };
	va_list args;

	va_start(args, fmt);
	int ret = vsnprintk(buffer, sizeof(buffer), fmt, args);

	va_end(args);

	if (ret < 0) {
		printk("%s: encoding error\n", __func__);
		return ret;
	} else if ((size_t)ret >= sizeof(buffer)) {
		printk("%s: too long message,"
		       "it will be cut short\n", __func__);
	}

	printk("%s\n", buffer);

	return ret;
}

ssize_t supl_read(void *p_buff, size_t nbytes, void *user_data)
{
	ARG_UNUSED(user_data);
	ssize_t rc = recv(supl_fd, p_buff, nbytes, 0);

	if (rc < 0 && (errno == ETIMEDOUT)) {
		return 0;
	}

	return rc;
}
```

## src/supl_support.h
```c
/*
 * Copyright (c) 2019 Nordic Semiconductor ASA
 *
 * SPDX-License-Identifier: LicenseRef-Nordic-5-Clause
 */

#ifndef SUPL_SUPPORT_H_
#define SUPL_SUPPORT_H_

#ifdef __cplusplus
extern "C" {
#endif

/** This function will open an socket to the SUPL server
 *
 * @brief This function will create and open a socket to the SUPL servers
 *         that can be used by the SUPL clients read and write functions.
 *         The socket handle is available in the implementation .c file scope
 *         and a reference is therefor not passed to the function.
 *
 * @retval 0  If opening socket was successful.
 * @retval -1 If opening socket failed
 */
int open_supl_socket(void);

/** This function will close the socket previously opened
 *
 * @brief This function will close the socket previously by the
 *        open_supl_socket function.
 *
 */
void close_supl_socket(void);

/** Function used by the SUPL client library for logging
 *
 * @brief This function is the implementation for logger function
 *        used by the SUPL client library. In this example will this
 *        lines be passed unchanged to the logger in Zephyr. If logging
 *        fails a value less than 0 should be returned to let the
 *        client know.
 *
 * @retval 0  If the logging information is processed correctly
 * @retval -1 If the function failed
 */
int supl_logger(int level, const char *fmt, ...);

/** Read function for SUPL socket used by the SUPL client
 *
 * @brief As the application owns the SUPL server socket the application
 *        can let the SUPL library client read data from the SUPL server
 *        calling this function.
 *
 *
 * @param[in] p_buff    Is the buffer that the SUPL client want to put
 *                      data that are received from the server into.
 * @param[in] nbytes    Is how many bytes that the supplied buffer can take
 * @param[in] user_data Is data previously specified by the application
 *                      in the context structure.
 *
 * @retval >0 Is the number of bytes received
 * @retval <0 If some error occurred
 */
ssize_t supl_read(void *p_buff, size_t nbytes, void *user_data);

/** Write function for SUPL socket used by the SUPL client
 *
 * @brief As the application owns the SUPL server socket the application
 *        can let the SUPL library client write data to the SUPL server
 *        calling this function.
 *
 * @param[out] p_buff    Is the buffer containing the data to be written to
 *                       SUPL server
 *             nbytes    Is the number of bytes in the buffer to be written
 *                       to the SUPL server.
 *             user_data Is data previously specified by the application
 *                       in the context structure.
 *
 * @retval >0 Is the number of bytes written
 * @retval <0 If some error occurred
 */
ssize_t supl_write(const void *p_buff, size_t nbytes, void *user_data);

#ifdef __cplusplus
}
#endif

#endif /* SUPL_SUPPORT_H */
```
