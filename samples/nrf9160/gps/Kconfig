## samples/nrf9160/lwm2m_client/sample.yaml
```yaml
sample:
  name: nrf LwM2M Sample
tests:
  samples.nrf9160.lwm2m_client:
    build_only: true
    platform_allow: nrf9160dk_nrf9160_ns thingy91_nrf9160_ns
    integration_platforms:
      - nrf9160dk_nrf9160_ns
      - thingy91_nrf9160_ns
    tags: ci_build
```

## samples/nrf9160/lwm2m_client/src/modules/Kconfig
```kconfig
#
# Copyright (c) 2021 Nordic Semiconductor ASA
#
# SPDX-License-Identifier: LicenseRef-Nordic-5-Clause
#

menu "Modules"
menuconfig SENSOR_MODULE
	bool "Enable sensor module"
	help
	  Enables options for periodically reading sensor devices, and notifying the LwM2M server when
	  a sufficiently large change occurs.

if SENSOR_MODULE
menuconfig SENSOR_MODULE_ACCEL
	bool "Enable value tracking of accelerometer"
	depends on APP_ACCELEROMETER
	default y if BOARD_THINGY91_NRF9160_NS
	help
	  Enable value tracking of accelerometer values.
	  Requires enabling value tracking for X Value, Y Value and Z Value under Accelerometer object
	  on the LwM2M server.

menuconfig SENSOR_MODULE_TEMP
	bool "Enable value tracking of temperature"
	depends on APP_TEMP_SENSOR
	default y if BOARD_THINGY91_NRF9160_NS
	help
	  Enable value tracking of temperature values.
	  Requires enabling value tracking for Sensor Value under Temperature object on the LwM2M
	  server.

menuconfig SENSOR_MODULE_PRESS
	bool "Enable value tracking of pressure"
	depends on APP_PRESS_SENSOR
	default y if BOARD_THINGY91_NRF9160_NS
	help
	  Enable value tracking of pressure values.
	  Requires enabling value tracking for Sensor Value under Pressure object on the LwM2M server.

menuconfig SENSOR_MODULE_HUMID
	bool "Enable value tracking of humidity"
	depends on APP_HUMID_SENSOR
	default y if BOARD_THINGY91_NRF9160_NS
	help
	  Enable value tracking of humidity values.
	  Requires enabling value tracking for Sensor Value under Humidity object on the LwM2M server.

menuconfig SENSOR_MODULE_GAS_RES
	bool "Enable value tracking of gas resistance"
	depends on APP_GAS_RES_SENSOR
	default y if BOARD_THINGY91_NRF9160_NS
	help
	  Enable value tracking of gas resistance values.
	  Requires enabling value tracking for Sensor Value under Generic Sensor object on the LwM2M
	  server.

menuconfig SENSOR_MODULE_LIGHT
	bool "Enable value tracking of light"
	depends on APP_LIGHT_SENSOR
	default y if BOARD_THINGY91_NRF9160_NS
	help
	  Enable value tracking of light values.
	  Requires enabling value tracking for Colour under Colour object instance 0 on the LwM2M
	  server.


menuconfig SENSOR_MODULE_COLOUR
	bool "Enable value tracking of colour"
	depends on APP_LIGHT_SENSOR
	default y if BOARD_THINGY91_NRF9160_NS
	help
	  Enable value tracking of colour values.
	  Requires enabling value tracking for Colour under Colour object instance 1 on the LwM2M
	  server.

endif # SENSOR_MODULE
endmenu # Modules
```

## samples/nrf9160/lwm2m_client/src/sensors/Kconfig.accelerometer
```kconfig
#
# Copyright (c) 2021 Nordic Semiconductor ASA
#
# SPDX-License-Identifier: LicenseRef-Nordic-5-Clause
#

config ACCELEROMETER
	bool
	help
	  Enable accelerometer

if ACCELEROMETER
choice
	prompt "Select accelerometer device"
	default ACCEL_USE_EXTERNAL

config ACCEL_USE_EXTERNAL
	bool "Use the ADXL362 accelerometer"
	depends on ADXL362

config ACCEL_USE_SIM
	bool "Simulate accelerometer"
	select SENSOR_SIM
	help
	  Use sensor simulator to generate accelerometer data.
endchoice # Accelerometer device

config ACCEL_CALIBRATE_ON_STARTUP
	bool "Calibrate the accelerometer on startup"
	default y
	help
	  Calibrate the accelerometer on a flat surface to filter away static measurement offset that
	  could affect orientation detection.

if ACCEL_CALIBRATE_ON_STARTUP
config ACCEL_CALIBRATION_ITERATIONS
	int "Number of measurements per channel during calibration"
	default 5
	help
	  Number of measurements taken during calibration.
	  Higher number will give more accurate calibration, but takes longer time.
endif # ACCEL_CALIBRATE_ON_STARTUP
endif # ACCELEROMETER
```

## samples/nrf9160/lwm2m_client/src/sensors/Kconfig.env_sensor
```kconfig
#
# Copyright (c) 2021 Nordic Semiconductor ASA
#
# SPDX-License-Identifier: LicenseRef-Nordic-5-Clause
#

config ENVIRONMENT_SENSOR
	bool
	help
	  Enable the environment sensor device.

if ENVIRONMENT_SENSOR
choice
	prompt "Select environment sensor device"
	default ENV_SENSOR_USE_EXTERNAL

config ENV_SENSOR_USE_EXTERNAL
	bool "Use the BME680 environment sensor"
	depends on BME680

config ENV_SENSOR_USE_SIM
	bool "Use sensor simulator to generate data"
	select SENSOR_SIM
endchoice # Environment sensor device

if ENV_SENSOR_USE_SIM
config ENV_SENSOR_GAS_RES_SIM_BASE
	int "Base value of simulated gas resistance value"
	default 10000
	help
	  Gas resistance in Ohm that will be used as a baseline when simulating gas resistance data.

config ENV_SENSOR_GAS_RES_SIM_MAX_DIFF
	int "Max difference from base value of simulated gas resistance"
	default 1000
	help
	  Maximum difference from the base value when simulating gas resistance data.

endif # ENV_SENSOR_USE_SIM && GAS_RES_SENSOR
endif # ENVIRONMENT_SENSOR
```

## samples/nrf9160/lwm2m_client/src/sensors/Kconfig.gnss
```kconfig
#
# Copyright (c) 2021 Nordic Semiconductor ASA
#
# SPDX-License-Identifier: LicenseRef-Nordic-5-Clause
#

config GNSS
	bool
	help
	  Enable GNSS

if GNSS

config GNSS_SEARCH_INTERVAL_TIME
	int "GNSS search interval [s]"
	default 300
	help
	  Length of time between GNSS searches in seconds.

config GNSS_SEARCH_TIMEOUT_TIME
	int "GNSS search timeout [s]"
	default 150
	help
	  Length of time the GNSS can spend looking for a fix in seconds.
	  In areas with poor connection, this should be increased.

config GNSS_PRIORITY_ON_FIRST_FIX
	bool "Give GNSS priority when looking for first fix"
	help
	  Gives the GNSS priority while it is performing its first search.
	  Enabling this will make it significantly easier for the GNSS module to find a position, but
	  will also affect performance for the rest of the app.
	  Subsequent fixes are much quicker and therefore no priority is needed.

choice
	default GNSS_ANTENNA_ONBOARD
	prompt "Select which antenna to use for GNSS"

config GNSS_ANTENNA_ONBOARD
	bool "Use onboard antenna"

config GNSS_ANTENNA_EXTERNAL
	bool "Use external antenna"

endchoice

config GNSS_AT_MAGPIO
	string "AT%XMAGPIO command"
	default "AT\%XMAGPIO=1,0,0,1,1,1574,1577" if BOARD_NRF9160DK_NRF9160_NS
	default "AT\%XMAGPIO=1,1,1,7,1,746,803,2,698,748,2,1710,2200,3,824,894,4,880,960,5,791,849,7,1565,1586" if BOARD_THINGY91_NRF9160_NS
	help
	  Defines the AT%XMAGPIO command to be sent to GNSS module. Leave
	  empty if this command should not be sent.

config GNSS_AT_COEX0
	string "AT%XCOEX0 command"
	default "AT\%XCOEX0=1,1,1565,1586" if (BOARD_NRF9160DK_NRF9160_NS || BOARD_THINGY91_NRF9160_NS) && GNSS_ANTENNA_ONBOARD
	default "AT\%XCOEX0" if (BOARD_NRF9160DK_NRF9160_NS || BOARD_THINGY91_NRF9160_NS) && GNSS_ANTENNA_EXTERNAL
	help
	  Defines the AT%XCOEX0 command to be sent to GNSS module. Leave
	  empty if this command should not be sent.

endif #GNSS
```
