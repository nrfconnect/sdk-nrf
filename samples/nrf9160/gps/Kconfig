## samples/nrf9160/gps/Kconfig
```kconfig
#
# Copyright (c) 2020 Nordic Semiconductor ASA
#
# SPDX-License-Identifier: LicenseRef-Nordic-5-Clause
#

menu "GPS sample"

config GPS_SAMPLE_NMEA_ONLY
	bool "Output only NMEA strings"
	help
	  Outputs only NMEA strings from the GPS.

choice GPS_SAMPLE_ANTENNA
	default GPS_SAMPLE_ANTENNA_ONBOARD
	prompt "Select which antenna to use for GPS"

config GPS_SAMPLE_ANTENNA_ONBOARD
	bool "Use onboard antenna"

config GPS_SAMPLE_ANTENNA_EXTERNAL
	bool "Use external antenna"

endchoice

config GPS_SAMPLE_AT_MAGPIO
	string "AT%XMAGPIO command"
	default "AT\%XMAGPIO=1,0,0,1,1,1574,1577" if BOARD_NRF9160DK_NRF9160_NS
	default "AT\%XMAGPIO=1,1,1,7,1,746,803,2,698,748,2,1710,2200,3,824,894,4,880,960,5,791,849,7,1565,1586" if BOARD_THINGY91_NRF9160_NS
	help
	  Defines what is the AT%XMAGPIO command to be sent to GPS module. Leave
	  empty if this command should not be sent.

config GPS_SAMPLE_AT_COEX0
	string "AT%XCOEX0 command"
	default "AT\%XCOEX0=1,1,1565,1586" if (BOARD_NRF9160DK_NRF9160_NS || BOARD_THINGY91_NRF9160_NS) && GPS_SAMPLE_ANTENNA_ONBOARD
	default "AT\%XCOEX0" if (BOARD_NRF9160DK_NRF9160_NS || BOARD_THINGY91_NRF9160_NS) && GPS_SAMPLE_ANTENNA_EXTERNAL
	help
	  Defines what is the AT%XCOEX0 command to be sent to GPS module. Leave
	  empty if this command should not be sent.

endmenu

menu "Zephyr Kernel"
source "Kconfig.zephyr"
endmenu
```

## samples/nrf9160/gps/sample.yaml
```yaml
sample:
  name: GPS sample
tests:
  samples.nrf9160.gps:
    build_only: true
    platform_allow: nrf9160dk_nrf9160ns
    integration_platforms:
      - nrf9160dk_nrf9160ns
    tags: ci_build
```

## samples/nrf9160/http_application_update/Kconfig
```kconfig
#
# Copyright (c) 2019 Nordic Semiconductor ASA
#
# SPDX-License-Identifier: LicenseRef-BSD-5-Clause-Nordic
#

menu "HTTP application update sample"

config DOWNLOAD_HOST
	string "Download host name"

config DOWNLOAD_PORT
	int "Download host port number. Set to 0 to use default HTTP/HTTPS port."
	default 0

config DOWNLOAD_FILE
	string "The file to download"

config APPLICATION_VERSION
	int "Application version"
	default 1

config USE_HTTPS
	bool
	prompt "Use HTTPS for download"
	depends on DOWNLOAD_CLIENT_TLS

endmenu

menu "Zephyr Kernel"
source "Kconfig.zephyr"
endmenu
```

## samples/nrf9160/http_update/application_update/Kconfig
```kconfig
#
# Copyright (c) 2019 Nordic Semiconductor ASA
#
# SPDX-License-Identifier: LicenseRef-Nordic-5-Clause
#

menu "HTTP application update sample"

config DOWNLOAD_HOST
	string "Application update host name"
	help
	  Host part of URL to application update binary. For example
	  if the file is stored in http://foo.bar/update.bin the value
	  of this configuration should be 'foo.bar'

config DOWNLOAD_FILE
	string "Application update file name"
	help
	  File part of URL to application update binary. For example
	  if the file is stored in http://foo.bar/update.bin the value
	  of this configuration should be 'update.bin'


config APPLICATION_VERSION
	int "Application version"
	default 1

config USE_HTTPS
	bool
	prompt "Use HTTPS for download"

endmenu

menu "Zephyr Kernel"
source "Kconfig.zephyr"
endmenu
```

## samples/nrf9160/http_update/application_update/sample.yaml
```yaml
sample:
  name: HTTP application update sample
tests:
  samples.nrf9160.http_update.application_update:
    build_only: true
    platform_allow: nrf9160dk_nrf9160_ns
    integration_platforms:
      - nrf9160dk_nrf9160_ns
    tags: ci_build
```

## samples/nrf9160/http_update/full_modem_update/sample.yaml
```yaml
sample:
  name: HTTP full modem update sample
tests:
  samples.nrf9160.http_update.full_modem_update:
    build_only: true
    platform_allow: nrf9160dk_nrf9160_ns
    integration_platforms:
      - nrf9160dk_nrf9160_ns
    tags: ci_build
```

## samples/nrf9160/http_update/modem_delta_update/sample.yaml
```yaml
sample:
  name: HTTP modem delta update sample
tests:
  samples.nrf9160.http_update.modem_delta_update:
    build_only: true
    platform_allow: nrf9160dk_nrf9160_ns
    integration_platforms:
      - nrf9160dk_nrf9160_ns
    tags: ci_build
```

## samples/nrf9160/https_client/Kconfig
```kconfig
#
# Copyright (c) 2021 Nordic Semiconductor ASA
#
# SPDX-License-Identifier: LicenseRef-Nordic-5-Clause
#

menu "HTTPS client sample"

config SAMPLE_NATIVE_TLS
	bool "Use Zephyr mbedTLS"

endmenu

menu "Zephyr Kernel"
source "Kconfig.zephyr"
endmenu
```

## samples/nrf9160/icalendar_parser/Kconfig
```kconfig
#
# Copyright (c) 2019 Nordic Semiconductor ASA
#
# SPDX-License-Identifier: LicenseRef-BSD-5-Clause-Nordic
#

menu "Internet Calendar Parser sample"

config DOWNLOAD_HOST
	string "Calendar host to connect"

config DOWNLOAD_FILE
	string "Calendar file to download"

config DOWNLOAD_INTERVAL
	int "The interval to download calendar from server in seconds"
	default 60

config ICAL_PARSER_IPV6
	bool "Prefer IPv6 connections"
	help
	  Prefer IPv6 protocol but fallback to
	  IPv4 when the hostname can't be resolved.

config ICAL_PARSER_TLS
	bool "Download iCalendar over HTTPS"

config ICAL_SEC_TAG
	int "Security tag to provision certificate"
	default 1

config MAX_PARSED_COMPONENTS
	int "Maximum number of parsed calendar component"
	default 10

endmenu

menu "Zephyr Kernel"
source "Kconfig.zephyr"
endmenu
```

## samples/nrf9160/icalendar_parser/sample.yaml
```yaml
sample:
  name: Internet Calendar Parser sample
tests:
  test_build:
    build_only: true
    build_on_all: true
    platform_whitelist: nrf9160_pca10090ns nrf9160_pca20035ns
    tags: ci_build
```

## samples/nrf9160/location/Kconfig
```kconfig
#
# Copyright (c) 2021 Nordic Semiconductor ASA
#
# SPDX-License-Identifier: LicenseRef-Nordic-5-Clause
#

menu "Location sample"

choice LOCATION_SAMPLE_GNSS_ANTENNA
	default LOCATION_SAMPLE_GNSS_ANTENNA_ONBOARD
	prompt "Select which antenna to use for GNSS"

config LOCATION_SAMPLE_GNSS_ANTENNA_ONBOARD
	bool "Use onboard antenna"

config LOCATION_SAMPLE_GNSS_ANTENNA_EXTERNAL
	bool "Use external antenna"

endchoice

config LOCATION_SAMPLE_GNSS_AT_MAGPIO
	string "AT%XMAGPIO command"
	default "AT\%XMAGPIO=1,0,0,1,1,1574,1577" if BOARD_NRF9160DK_NRF9160_NS
	default "AT\%XMAGPIO=1,1,1,7,1,746,803,2,698,748,2,1710,2200,3,824,894,4,880,960,5,791,849,7,1565,1586" if BOARD_THINGY91_NRF9160_NS
	help
	  Defines what is the AT%XMAGPIO command to be sent to GNSS module. Leave
	  empty if this command should not be sent.

config LOCATION_SAMPLE_GNSS_AT_COEX0
	string "AT%XCOEX0 command"
	default "AT\%XCOEX0=1,1,1565,1586" if (BOARD_NRF9160DK_NRF9160_NS || BOARD_THINGY91_NRF9160_NS) && LOCATION_SAMPLE_GNSS_ANTENNA_ONBOARD
	default "AT\%XCOEX0" if (BOARD_NRF9160DK_NRF9160_NS || BOARD_THINGY91_NRF9160_NS) && LOCATION_SAMPLE_GNSS_ANTENNA_EXTERNAL
	help
	  Defines what is the AT%XCOEX0 command to be sent to GNSS module. Leave
	  empty if this command should not be sent.

endmenu

menu "Zephyr Kernel"
source "Kconfig.zephyr"
endmenu
```

## samples/nrf9160/location/sample.yaml
```yaml
sample:
  name: location Sample
tests:
  sample.nrf9160.location:
    build_only: true
    integration_platforms:
      - nrf9160dk_nrf9160_ns
    platform_allow: nrf9160dk_nrf9160_ns
    tags: ci_build
  sample.nrf9160.location.esp_wifi:
    build_only: true
    extra_args: >
      OVERLAY_CONFIG=overlay-esp-wifi.conf DTC_OVERLAY_FILE="esp_8266_nrf9160ns.overlay"
    integration_platforms:
      - nrf9160dk_nrf9160_ns
    platform_allow: nrf9160dk_nrf9160_ns
    tags: ci_build
  sample.nrf9160.location.pgps:
    build_only: true
    extra_args: OVERLAY_CONFIG=overlay-pgps.conf
    integration_platforms:
      - nrf9160dk_nrf9160_ns
    platform_allow: nrf9160dk_nrf9160_ns
    tags: ci_build
  sample.nrf9160.location.nrf7002ek_wifi:
    build_only: true
    integration_platforms:
      - nrf9160dk_nrf9160_ns
    platform_allow: nrf9160dk_nrf9160_ns
    extra_args: >
      SHIELD=nrf7002_ek OVERLAY_CONFIG=overlay-nrf7002ek-wifi-scan-only.conf
      DTC_OVERLAY_FILE="nrf9160dk_with_nrf7002ek.overlay"
    tags: ci_build
```

## samples/nrf9160/lte_ble_gateway/Kconfig
```kconfig
#
# Copyright (c) 2018 Nordic Semiconductor ASA
#
# SPDX-License-Identifier: LicenseRef-Nordic-5-Clause
#

menu "LTE BLE gateway sample"

config GNSS_SEARCH_INTERVAL
	int "Interval for starting GNSS search"
	default 240

config GNSS_SEARCH_TIMEOUT
	int "Timeout for GNSS search"
	default 120
	help
	  The GNSS will stop acquiring GNSS fix when it times out.
	  It will restart the search at the start of the next search interval.

endmenu

module=LTE_BLE_GW
module-dep=LOG
module-str= LTE BLE gateway sample
source "${ZEPHYR_BASE}/subsys/logging/Kconfig.template.log_config"

menu "Zephyr Kernel"
source "Kconfig.zephyr"
endmenu
```

## samples/nrf9160/lte_ble_gateway/boards/nrf9160dk_nrf9160_ns.conf
```kconfig
CONFIG_NRF_SW_LPUART=y
CONFIG_UART_INTERRUPT_DRIVEN=y

CONFIG_UART_2_ASYNC=y
CONFIG_UART_2_INTERRUPT_DRIVEN=n
CONFIG_UART_2_NRF_HW_ASYNC=y
CONFIG_UART_2_NRF_HW_ASYNC_TIMER=2
```

## samples/nrf9160/lte_ble_gateway/sample.yaml
```yaml
sample:
  name: LTE-BLE gateway sample
tests:
  sample.nrf9160.lte_ble_gateway:
    build_only: true
    integration_platforms:
      - nrf9160dk_nrf9160_ns
    platform_allow: nrf9160dk_nrf9160_ns
    tags: ci_build
```

## samples/nrf9160/lwm2m_carrier/sample.yaml
```yaml
sample:
  name: LwM2M carrier sample
tests:
  samples.nrf9160.lwm2m_carrier:
    build_only: true
    platform_allow: nrf9160dk_nrf9160_ns
    integration_platforms:
      - nrf9160dk_nrf9160_ns
    tags: ci_build
```

## samples/nrf9160/lwm2m_client/Kconfig
```kconfig
#
# Copyright (c) 2018 Nordic Semiconductor ASA
#
# SPDX-License-Identifier: LicenseRef-Nordic-5-Clause
#

menu "Application sample"

rsource "src/ui/Kconfig"
rsource "src/modules/Kconfig"
rsource "src/lwm2m/Kconfig"

menu "LwM2M objects"
config APP_PUSH_BUTTON
	bool "Enable button(s)"
	select UI_INPUT
	select LWM2M_IPSO_PUSH_BUTTON
	select LWM2M_APP_PUSH_BUTTON


config APP_ONOFF_SWITCH
	bool "Enable switches"
	depends on BOARD_NRF9160DK_NRF9160_NS
	select UI_INPUT
	select LWM2M_IPSO_ONOFF_SWITCH
	select LWM2M_APP_ONOFF_SWITCH


menuconfig APP_LIGHT_CONTROL
	bool "Enable LED(s)"
	select UI_LED
	select LWM2M_IPSO_LIGHT_CONTROL
	select LWM2M_APP_LIGHT_CONTROL

if APP_LIGHT_CONTROL
	rsource "src/ui/Kconfig.ui_led"
endif # APP_LIGHT_CONTROL


menuconfig APP_BUZZER
	bool "Enable buzzer"
	depends on BOARD_THINGY91_NRF9160_NS
	select UI_BUZZER
	select LWM2M_APP_BUZZER


menuconfig APP_LIGHT_SENSOR
	bool "Enable light sensor"
	select LIGHT_SENSOR
	select LWM2M_IPSO_APP_COLOUR_SENSOR
	select LWM2M_APP_LIGHT_SENSOR

if APP_LIGHT_SENSOR
	rsource "src/sensors/Kconfig.light_sensor"
	rsource "src/ipso/Kconfig.ipso_colour_sensor"
endif # APP_LIGHT_SENSOR


menuconfig APP_ENV_SENSOR
	bool "Enable environment sensors"
	select ENVIRONMENT_SENSOR
	help
	  Enables options for enabling temperature, pressure, humidity and gas resistance sensors.

if APP_ENV_SENSOR
rsource "src/sensors/Kconfig.env_sensor"

config APP_TEMP_SENSOR
	bool "Enable temperature sensor"
	select LWM2M_IPSO_TEMP_SENSOR
	select LWM2M_APP_TEMP_SENSOR

config APP_PRESS_SENSOR
	bool "Enable air pressure sensor"
	select LWM2M_IPSO_PRESSURE_SENSOR
	select LWM2M_APP_PRESS_SENSOR

config APP_HUMID_SENSOR
	bool "Enable humidity sensor"
	select LWM2M_IPSO_HUMIDITY_SENSOR
	select LWM2M_APP_HUMID_SENSOR

config APP_GAS_RES_SENSOR
	bool "Enable gas resistance sensor"
	select LWM2M_IPSO_GENERIC_SENSOR
	select LWM2M_APP_GAS_RES_SENSOR
endif # APP_ENV_SENSOR


menuconfig APP_ACCELEROMETER
	bool "Enable accelerometer"
	select ACCELEROMETER
	select LWM2M_IPSO_ACCELEROMETER
	select LWM2M_APP_ACCELEROMETER

if APP_ACCELEROMETER
	rsource "src/sensors/Kconfig.accelerometer"
endif # APP_ACCELEROMETER

menuconfig APP_GPS
	bool "Enable GPS"
	select GPS
	select LWM2M_LOCATION_OBJ_SUPPORT

if APP_GPS
	rsource "src/sensors/Kconfig.gps"

config APP_GPS_HOLD_TIME
	int "Minimum time [s] between location data notification messages"
	default 60
	help
	  The minimum time in seconds that notifications can be sent to observers of the Location data.
endif # APP_GPS
endmenu # LwM2M objects

config APP_LWM2M_PSK
	string "LwM2M pre-shared key for communication"
	default "000102030405060708090a0b0c0d0e0f"
	help
	  Pre Shared Key must be identical to the PSK registered with the device on the LwM2M server.
	  Use the hexadecimal representation.

config APP_ENDPOINT_PREFIX
	string "Prefix used in the endpoint name"
	default "urn:imei:"
	help
	  Sets the prefix of the endpoint name used when connecting to the LwM2M server.
menu "Device info"
config APP_MANUFACTURER
	string "Board manufacturer"
	default	"Nordic Semiconductor ASA"

config APP_DEVICE_TYPE
	string "Device type"
	default	"OMA-LWM2M Client"
endmenu

config APP_HOLD_TIME_RSRP
	int "Minimum time [s] between RSRP notification messages"
	default 60
	help
	  The minimum time in seconds that notifications can be sent to observers of the
	  Connectivity Monitoring data.

config APP_MCUBOOT_FLASH_BUF_SZ
	int "Size of buffer used for flash write operations during MCUboot updates"
	depends on DFU_TARGET_MCUBOOT
	default 512
	help
	  Buffer size must be aligned to the minimal flash write block size.

config APP_CUSTOM_VERSION
	string "Application version. Leave empty to use NCS version."

config APP_NEIGHBOUR_CELL_SCAN_INTERVAL
	int "Interval time [s] between neighbour cell scans"
	depends on LWM2M_CLIENT_UTILS_SIGNAL_MEAS_INFO_OBJ_SUPPORT
	default 600
	help
	  Low value on interval may reduce the performance of the system.

module = APP
module-dep = LOG
module-str = Log level for sample
source "${ZEPHYR_BASE}/subsys/logging/Kconfig.template.log_config"
endmenu # Application sample


menu "Zephyr Kernel"
source "Kconfig.zephyr"
endmenu # Zephyr Kernel
```

## samples/nrf9160/lwm2m_client/boards/nrf9160dk_nrf9160_ns.conf
```kconfig
## nRF9160DK-specific config settings ##
# App
CONFIG_APP_GNSS=y
CONFIG_APP_LIGHT_CONTROL=y
CONFIG_APP_ONOFF_SWITCH=y
CONFIG_APP_PUSH_BUTTON=y

# IPSO
CONFIG_LWM2M_IPSO_PUSH_BUTTON_INSTANCE_COUNT=2
CONFIG_LWM2M_IPSO_ONOFF_SWITCH_INSTANCE_COUNT=2
CONFIG_LWM2M_IPSO_LIGHT_CONTROL_INSTANCE_COUNT=4
CONFIG_LWM2M_IPSO_ONOFF_SWITCH_VERSION_1_1=y
CONFIG_LWM2M_IPSO_PUSH_BUTTON_VERSION_1_1=y

# Sensor module
CONFIG_SENSOR_MODULE=n

# External flash
CONFIG_SPI=y
CONFIG_SPI_NOR=y
CONFIG_STREAM_FLASH_ERASE=y
CONFIG_FLASH=y

# Modem library
CONFIG_NRF_MODEM_LIB_SYS_INIT=n

# Full modem update
CONFIG_DFU_TARGET_FULL_MODEM=y
CONFIG_FMFU_FDEV=y
CONFIG_ZCBOR=y
CONFIG_MODEM_INFO=y
CONFIG_FMFU_FDEV_SKIP_PREVALIDATION=n

# Crypto
CONFIG_OBERON_BACKEND=y
CONFIG_NORDIC_SECURITY_BACKEND=y
# Disable all non-used crypto
CONFIG_MBEDTLS_CHACHA20_C=n
CONFIG_MBEDTLS_POLY1305_C=n
CONFIG_MBEDTLS_ECP_C=n
CONFIG_MBEDTLS_RSA_C=n
CONFIG_MBEDTLS_DHM_C=n
CONFIG_MBEDTLS_SHA1_C=n
CONFIG_MBEDTLS_SHA384_C=n
CONFIG_MBEDTLS_SHA512_C=n
# This is the one we need
CONFIG_MBEDTLS_SHA256_C=y
```

## samples/nrf9160/lwm2m_client/boards/thingy91_nrf9160_ns.conf
```kconfig
## Thingy:91-specific config settings ##
# UI
CONFIG_UI_LED_USE_PWM=y
CONFIG_UI_SENSE_LED=y

# Sensors
CONFIG_BME680=y
CONFIG_ADXL362=y
CONFIG_ADXL362_ACCEL_RANGE_2G=y
CONFIG_ACCEL_CALIBRATE_ON_STARTUP=y
CONFIG_BH1749=y
CONFIG_LIGHT_SENSOR_LIGHT_MEASUREMENT_MAX_VALUE=2000
CONFIG_LIGHT_SENSOR_COLOUR_MEASUREMENT_MAX_VALUE=3000

# App LwM2M
CONFIG_APP_BUZZER=y
```

## samples/nrf9160/lwm2m_client/dts/bindings/pwm-buzzer.yaml
```yaml
# Copyright (c) 2022 Nordic Semiconductor
#
# SPDX-License-Identifier: LicenseRef-Nordic-5-Clause

description: |
    This is a representation of a buzzer controlled by a PWM signal. Example
    usage:

      buzzer {
        compatible = "pwm-buzzer";
        pwms = <&pwm0 1>;
      };

compatible: "pwm-buzzer"

include: base.yaml

properties:
    pwms:
      type: phandle-array
      required: true
```
