## CMakeLists.txt
```
#
# Copyright (c) 2020 Nordic Semiconductor
#
# SPDX-License-Identifier: LicenseRef-Nordic-5-Clause
#

cmake_minimum_required(VERSION 3.20.0)

find_package(Zephyr REQUIRED HINTS $ENV{ZEPHYR_BASE})
project(modem_delta_update)

# NORDIC SDK APP START
target_sources(app PRIVATE src/main.c)
target_sources(app PRIVATE ../common/src/update.c)
target_include_directories(app PRIVATE ../common/include)
# NORDIC SDK APP END
```

## Kconfig
```
#
# Copyright (c) 2020 Nordic Semiconductor ASA
#
# SPDX-License-Identifier: LicenseRef-Nordic-5-Clause
#

menu "HTTP modem delta update sample"

config DOWNLOAD_FILE_BASE_TO_FOTA_TEST
	string "File to update modem from base to test firmware"
	help
	  This sample uses the delta patches included in the modem firmware
	  releases. These delta patches only work for the modem firmware
	  version which they are bundled with. This option specifies the file part
	  of the URL to the delta patch from '[SUPPORTED_BASE_VERSION]' to
	  '[SUPPORTED_BASE_VERSION]-FOTA-TEST' modem firmware version.

config DOWNLOAD_FILE_FOTA_TEST_TO_BASE
	string "File to update modem from test firmware base"
	help
	  This sample uses the delta patches included in the modem firmware
	  releases. These delta patches only work for the modem firmware
	  version which they are bundled with. This option specifies the file part
	  of the URL to the delta patch from
	  '[SUPPORTED_BASE_VERSION]-FOTA-TEST' to '[SUPPORTED_BASE_VERSION]'
	   modem firmware version.

config DOWNLOAD_HOST
	string "Host part of URL to download files."

config SUPPORTED_BASE_VERSION
	string "Supported base version"
	help
	  This sample uses the delta patches included in the modem firmware
	  releases. These delta patches only work for the modem firmware
	  version which they are bundled with. This option specifies the version
	  string of the modem firmware version which the `DOWNLOAD_FILE_*`
	  options are compatible with.

config USE_HTTPS
	bool
	prompt "Use HTTPS for download"

endmenu

menu "Zephyr Kernel"
source "Kconfig.zephyr"
endmenu
```

## sample.yaml
```
sample:
  name: HTTP modem delta update sample
tests:
  sample.nrf9160.http_update.modem_delta_update:
    build_only: true
    integration_platforms:
      - nrf9160dk_nrf9160_ns
    platform_allow: nrf9160dk_nrf9160_ns
    tags: ci_build
```

## prj.conf
```kconfig
#
# Copyright (c) 2020 Nordic Semiconductor ASA
#
# SPDX-License-Identifier: LicenseRef-Nordic-5-Clause
#
# General config
CONFIG_NCS_SAMPLES_DEFAULTS=y
CONFIG_REBOOT=y
CONFIG_NEWLIB_LIBC=y

# Network
CONFIG_NETWORKING=y
CONFIG_NET_SOCKETS=y
CONFIG_NET_NATIVE=n

# LTE link control
CONFIG_LTE_LINK_CONTROL=y

# Modem library
CONFIG_NRF_MODEM_LIB=y

# Library for buttons and LEDs
CONFIG_DK_LIBRARY=y

# Shell configurations
CONFIG_SHELL=y
CONFIG_SHELL_WILDCARD=n
CONFIG_SHELL_CMD_BUFF_SIZE=128

# Heap and stacks
CONFIG_HEAP_MEM_POOL_SIZE=2048
CONFIG_MAIN_STACK_SIZE=8192

# GPIO
CONFIG_GPIO=y

# FOTA library
CONFIG_FOTA_DOWNLOAD=y

# Download client
CONFIG_DOWNLOAD_CLIENT=y
CONFIG_DOWNLOAD_CLIENT_STACK_SIZE=4096

# DFU Target
CONFIG_DFU_TARGET=y

# Modem key management
CONFIG_MODEM_KEY_MGMT=y

# Sample configuration
CONFIG_DOWNLOAD_HOST="nrfconnectsdk.s3.eu-central-1.amazonaws.com"
CONFIG_SUPPORTED_BASE_VERSION="mfw_nrf9160_1.3.4"
CONFIG_DOWNLOAD_FILE_BASE_TO_FOTA_TEST="mfw_nrf9160_update_from_1.3.4_to_1.3.4-FOTA-TEST.bin"
CONFIG_DOWNLOAD_FILE_FOTA_TEST_TO_BASE="mfw_nrf9160_update_from_1.3.4-FOTA-TEST_to_1.3.4.bin"
```

## src/main.c
```c
/*
 * Copyright (c) 2020 Nordic Semiconductor ASA
 *
 * SPDX-License-Identifier: LicenseRef-Nordic-5-Clause
 */
#include <zephyr/kernel.h>
#include <stdio.h>
#include <string.h>
#include <nrf_modem.h>
#include <modem/nrf_modem_lib.h>
#include <net/fota_download.h>
#include <nrf_modem_at.h>
#include "update.h"

#define FOTA_TEST "FOTA-TEST"

static char version[256];

static bool is_test_firmware(void)
{
	static bool version_read;
	int err;

	if (!version_read) {
		err = nrf_modem_at_cmd(version, sizeof(version), "AT+CGMR");
		if (err != 0) {
			printk("Unable to read modem version: %d\n", err);
			return false;
		}

		if (strstr(version, CONFIG_SUPPORTED_BASE_VERSION) == NULL) {
			printk("Unsupported base modem version: %s\n", version);
			printk("Supported base version (set in prj.conf): %s\n",
			       CONFIG_SUPPORTED_BASE_VERSION);
			return false;
		}

		version_read = true;
	}

	return strstr(version, FOTA_TEST) != NULL;
}

static const char *get_file(void)
{
	if (is_test_firmware()) {
		return CONFIG_DOWNLOAD_FILE_FOTA_TEST_TO_BASE;
	} else {
		return CONFIG_DOWNLOAD_FILE_BASE_TO_FOTA_TEST;
	}
}

void fota_dl_handler(const struct fota_download_evt *evt)
{
	switch (evt->id) {
	case FOTA_DOWNLOAD_EVT_ERROR:
		printk("Received error from fota_download\n");
		update_sample_stop();
		break;

	case FOTA_DOWNLOAD_EVT_FINISHED:
		update_sample_done();
		printk("Press 'Reset' button or enter 'reset' to apply new firmware\n");
		break;

	default:
		break;
	}
}

static int num_leds(void)
{
	if (is_test_firmware()) {
		return 2;
	} else {
		return 1;
	}
}

void main(void)
{
	int err;

	printk("HTTP delta modem update sample started\n");

	printk("Initializing modem library\n");

	err = nrf_modem_lib_init();
	switch (err) {
	case NRF_MODEM_DFU_RESULT_OK:
		printk("Modem firmware update successful!\n");
		printk("Modem will run the new firmware after reboot\n");
		printk("Press 'Reset' button or enter 'reset' to apply new firmware\n");
		k_thread_suspend(k_current_get());
		break;
	case NRF_MODEM_DFU_RESULT_UUID_ERROR:
	case NRF_MODEM_DFU_RESULT_AUTH_ERROR:
		printk("Modem firmware update failed\n");
		printk("Modem will run non-updated firmware on reboot.\n");
		printk("Press 'Reset' button or enter 'reset'\n");
		break;
	case NRF_MODEM_DFU_RESULT_HARDWARE_ERROR:
	case NRF_MODEM_DFU_RESULT_INTERNAL_ERROR:
		printk("Modem firmware update failed\n");
		printk("Fatal error.\n");
		break;
	case NRF_MODEM_DFU_RESULT_VOLTAGE_LOW:
		printk("Modem firmware update failed\n");
		printk("Please reboot once you have sufficient power for the DFU.\n");
		break;
	case -1:
		printk("Could not initialize momdem library.\n");
		printk("Fatal error.\n");
		return;
	default:
		break;
	}
	printk("Initialized modem library\n");

	err = fota_download_init(fota_dl_handler);
	if (err != 0) {
		printk("fota_download_init() failed, err %d\n", err);
		return;
	}

	err = update_sample_init(&(struct update_sample_init_params){
					.update_start = update_sample_start,
					.num_leds = num_leds(),
					.filename = get_file()
				});
	if (err != 0) {
		printk("update_sample_init() failed, err %d\n", err);
		return;
	}

	printk("Current modem firmware version: %s\n", version);

	printk("Press Button 1 for enter 'download' to download modem delta update\n");
}
```
