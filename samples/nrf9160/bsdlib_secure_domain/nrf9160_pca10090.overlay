/*
 * Copyright (c) 2020 Nordic Semiconductor ASA
 *
 * SPDX-License-Identifier: Apache-2.0
 */

#include <mem.h>
#define BSD_RESERVED_MEMORY_ADDRESS            0x20010000
#define BSD_RESERVED_MEMORY_SIZE               0xc020

&sram0 {
	reg = <(BSD_RESERVED_MEMORY_ADDRESS + BSD_RESERVED_MEMORY_SIZE) (DT_SIZE_K(256) - (DT_SIZE_K(64) + BSD_RESERVED_MEMORY_SIZE)) >;
};
