## CMakeLists.txt
```
# SPDX-License-Identifier: Apache-2.0

cmake_minimum_required(VERSION 3.13.1)

include($ENV{ZEPHYR_BASE}/cmake/app/boilerplate.cmake NO_POLICY_SCOPE)
project(hello_world)

target_sources(app PRIVATE src/main.c)

# Code relocation
zephyr_code_relocate(src/main.c SRAM2_TEXT)
zephyr_code_relocate(src/main.c SRAM_DATA)
zephyr_code_relocate(src/main.c SRAM2_BSS)
```

## prj.conf
```kconfig
# nothing here
CONFIG_NETWORKING=y
CONFIG_NET_SOCKETS=y
CONFIG_HEAP_MEM_POOL_SIZE=16384
CONFIG_MAIN_STACK_SIZE=16384

# BSD library
CONFIG_BSD_LIBRARY_ALLOW_SECURE=y

# Required for secure only
CONFIG_HAVE_CUSTOM_LINKER_SCRIPT=y
CONFIG_CUSTOM_LINKER_SCRIPT="../../../lib/bsdlib/linker_bsdlib_secure.ld"

# Required for using split section of RAM
CONFIG_CODE_DATA_RELOCATION=y

CONFIG_BSD_LIBRARY=y
CONFIG_BSD_LIBRARY_SYS_INIT=n

# LTE link control
CONFIG_LTE_LINK_CONTROL=y
CONFIG_LTE_AUTO_INIT_AND_CONNECT=n
```

## nrf9160_pca10090.overlay
```dts
/*
 * Copyright (c) 2020 Nordic Semiconductor ASA
 *
 * SPDX-License-Identifier: Apache-2.0
 */

#include <mem.h>
#define BSD_RESERVED_MEMORY_ADDRESS            0x20010000
#define BSD_RESERVED_MEMORY_SIZE               0xc020

&sram0 {
	reg = <(BSD_RESERVED_MEMORY_ADDRESS + BSD_RESERVED_MEMORY_SIZE) (DT_SIZE_K(256) - (DT_SIZE_K(64) + BSD_RESERVED_MEMORY_SIZE)) >;
};
```

## src/main.c
```c
/*
 * Copyright (c) 2012-2014 Wind River Systems, Inc.
 *
 * SPDX-License-Identifier: Apache-2.0
 */

#include <zephyr.h>
#include <sys/printk.h>
#include <nrf.h>
#include <bsd.h>
#include <lte_lc.h>
#include <at_cmd.h>
#include <at_notif.h>
#include <net/bsdlib.h>
#include <bsd_platform.h>
#include <devicetree.h>

static u8_t app_mem_sram2_bss[20];
static u32_t app_mem_sram_data = 10U;

void app_func(void)
{
	printk("SRAM addr range: 0x%x-%x\n", CONFIG_SRAM_BASE_ADDRESS,
			CONFIG_SRAM_BASE_ADDRESS + (CONFIG_SRAM_SIZE*1024));
	u32_t sram2_addr = CONFIG_SRAM_BASE_ADDRESS -
			   (BSD_RESERVED_MEMORY_SIZE + (64*1024));
	printk("SRAM2 addr range: 0x%x-%x\n", sram2_addr, sram2_addr+(64*1024));
	printk("Called function %s\n", __func__);
	printk("App_func from sram2_text: %p\n", &app_func);
	printk("App_mem_sram2_bss: %p\n", &app_mem_sram2_bss[0]);
	printk("App mem_sram_data: %p\n", &app_mem_sram_data);
	printk("App mem_sram_data value: %d\n", app_mem_sram_data);
}

#if defined(CONFIG_BSD_LIBRARY)
/**@brief Recoverable BSD library error. */
void bsd_recoverable_error_handler(uint32_t err)
{
	printk("bsdlib recoverable error: %u\n", err);
}
#endif /* defined(CONFIG_BSD_LIBRARY) */

static void modem_configure(void)
{
#if defined(CONFIG_LTE_LINK_CONTROL)
	BUILD_ASSERT_MSG(!IS_ENABLED(CONFIG_LTE_AUTO_INIT_AND_CONNECT),
			"This sample does not support auto init and connect");
	int err;

	err = at_notif_init();
	__ASSERT(err == 0, "AT Notify could not be initialized.");
	err = at_cmd_init();
	__ASSERT(err == 0, "AT CMD could not be established.");
	printk("LTE Link Connecting ...\n");
	err = lte_lc_init_and_connect();
	__ASSERT(err == 0, "LTE link could not be established.");
	printk("LTE Link Connected!\n");
#endif
}



void main(void)
{
	printk("Secure world BSD example! %s\n", CONFIG_BOARD);
	printk("Initializing bsdlib\n");
	int err = bsdlib_init();

	switch (err) {
	case MODEM_DFU_RESULT_OK:
		printk("Modem firmware update successful!\n");
		printk("Modem will run the new firmware after reboot\n");
		k_thread_suspend(k_current_get());
		break;
	case MODEM_DFU_RESULT_UUID_ERROR:
	case MODEM_DFU_RESULT_AUTH_ERROR:
		printk("Modem firmware update failed\n");
		printk("Modem will run non-updated firmware on reboot.\n");
		k_thread_suspend(k_current_get());
		break;
	case MODEM_DFU_RESULT_HARDWARE_ERROR:
	case MODEM_DFU_RESULT_INTERNAL_ERROR:
		printk("Modem firmware update failed\n");
		printk("Fatal error.\n");
		k_thread_suspend(k_current_get());
		break;
	case -1:
		printk("Could not initialize bsdlib.\n");
		printk("Fatal error.\n");
		k_thread_suspend(k_current_get());
		return;
	case 0:
		break;
	default:
		printk("Unexpected error.\n");
		k_thread_suspend(k_current_get());
		return;
	}
	printk("Initialized bsdlib\n");
	modem_configure();
	app_func();

	while (1) {
	}

	printk("End of sample...\n");
}
```
