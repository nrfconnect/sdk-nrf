/*
 * Copyright (c) 2024 Nordic Semiconductor ASA
 *
 * SPDX-License-Identifier: LicenseRef-Nordic-5-Clause
 */

#include "../../../config/partitions_nrf54l15dk_nrf54l15_cpuapp.overlay"

/ {
	aliases {
		mcuboot-led0 = &led0;
	};

	chosen {
		zephyr,code-partition = &boot_partition;
	};
};
