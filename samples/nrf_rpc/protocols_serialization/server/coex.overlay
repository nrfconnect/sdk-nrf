/*
 * Copyright (c) 2026 Nordic Semiconductor ASA
 *
 * SPDX-License-Identifier: LicenseRef-Nordic-5-Clause
 */

/ {
	nrf_radio_coex: software-coex {
		compatible = "nordic,software-coex";
		status = "okay";
	};
};
