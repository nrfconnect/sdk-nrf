/*
 * Copyright (c) 2024 Nordic Semiconductor ASA
 *
 * SPDX-License-Identifier: LicenseRef-Nordic-5-Clause
 */

/ {
    nrf_radio_coex: software-coex {
        status = "okay";
        compatible = "nordic,software-coex";
    };
};
