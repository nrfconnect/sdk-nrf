## samples/nrf_rpc/entropy_nrf53/cpuapp/sample.yaml
```yaml
sample:
  description: Entropy driver application core sample
  name: Entropy remote application core
tests:
  sample.nrf_rpc.entropy_cpuapp:
    sysbuild: true
    build_only: true
    integration_platforms:
      - nrf5340dk/nrf5340/cpuapp
    platform_allow: nrf5340dk/nrf5340/cpuapp
    tags: sysbuild
```

## samples/nrf_rpc/entropy_nrf53/cpunet/sample.yaml
```yaml
sample:
  description: Entropy remote network core sample
  name: Entropy remote network core
tests:
  sample.nrf_rpc.entropy_cpunet:
    sysbuild: true
    build_only: true
    integration_platforms:
      - nrf5340dk/nrf5340/cpunet
    platform_allow: nrf5340dk/nrf5340/cpunet
    tags: sysbuild
```

## samples/nrf_rpc/protocols_serialization/client/Kconfig
```kconfig
#
# Copyright (c) 2024 Nordic Semiconductor ASA
#
# SPDX-License-Identifier: LicenseRef-Nordic-5-Clause
#

menu "Protocols serialization client"

config NRF_PS_CLIENT_CRASH_DUMP_READ_BUFFER_SIZE
	int "Crash log read buffer size"
	depends on LOG_FORWARDER_RPC
	default 256
	help
	  Size of the stack buffer used for reading a single chunk of the crash
	  log from the server device.

module = NRF_PS_CLIENT
module-str = nrf_ps_client
source "$(ZEPHYR_BASE)/subsys/logging/Kconfig.template.log_config"

config NRF_PS_CLIENT_BT_TEST
	bool "BLE test service for RPC Client"
	depends on BT
	help
	 Enable BLE test service for RPC Client.

if NRF_PS_CLIENT_BT_TEST

config NRF_PS_CLIENT_BT_TEST_CHAR_MAX_DATA_SIZE
	int "Maximum size of BLE test characteristic data in bytes"
	default 4

endif # NRF_PS_CLIENT_BT_TEST

endmenu # "Protocols serialization client"

if SETTINGS

config ZMS
	default y if (SOC_FLASH_NRF_RRAM || SOC_FLASH_NRF_MRAM)

config NVS
	default y if !(SOC_FLASH_NRF_RRAM || SOC_FLASH_NRF_MRAM)

endif # SETTINGS

menu "Zephyr Kernel"
source "Kconfig.zephyr"
endmenu
```

## samples/nrf_rpc/protocols_serialization/client/sample.yaml
```yaml
sample:
  name: Protocols serialization client sample
  description: Demonstrates serialization of Bluetooth LE and OpenThread API using
    nRF RPC

common:
  sysbuild: true
  build_only: true
  platform_allow:
    - nrf52840dk/nrf52840
    - nrf54l15dk/nrf54l15/cpuapp
    - nrf54lm20dk/nrf54lm20a/cpuapp
    - nrf54lm20dk/nrf54lm20b/cpuapp
  integration_platforms:
    - nrf52840dk/nrf52840
    - nrf54l15dk/nrf54l15/cpuapp
    - nrf54lm20dk/nrf54lm20a/cpuapp
    - nrf54lm20dk/nrf54lm20b/cpuapp
  tags:
    - ci_build
    - ci_samples_nrf_rpc

tests:
  sample.nrf_rpc.protocols_serialization.client.rpc_ble:
    extra_args:
      - EXTRA_CONF_FILE=ble.conf
  sample.nrf_rpc.protocols_serialization.client.rpc_ot:
    extra_args:
      - EXTRA_CONF_FILE=openthread.conf
  sample.nrf_rpc.protocols_serialization.client.rpc:
    extra_args:
      - EXTRA_DTC_OVERLAY_FILE=coex.overlay
      - EXTRA_CONF_FILE="ble.conf;openthread.conf;verbose.conf;log_rpc.conf;coex.conf"
  sample.nrf_rpc.protocols_serialization.client.rpc_ci:
    extra_args:
      - SNIPPET="ci-shell;zperf"
      - EXTRA_DTC_OVERLAY_FILE=coex.overlay
      - EXTRA_CONF_FILE="ble.conf;openthread.conf;verbose.conf;log_rpc.conf;coex.conf"
    extra_configs:
      - CONFIG_NRF_RPC_UTILS_CRASH_GEN=y
```

## samples/nrf_rpc/protocols_serialization/server/Kconfig
```kconfig
#
# Copyright (c) 2024 Nordic Semiconductor ASA
#
# SPDX-License-Identifier: LicenseRef-Nordic-5-Clause
#

menu "Protocols serialization server"

config NRF_PS_SERVER_FATAL_ERROR_TRIGGER
	bool "Fatal error trigger"
	depends on $(dt_alias_enabled,fatal-error-trigger)
	help
	  Enables triggering a fatal error by pressing the button selected with
	  "/aliases/fatal-error-trigger" DTS property. This feature can be used
	  to generate a core dump into a flash/RRAM partition. The core dump can
	  then be retrieved by the RPC client using the "Logging over RPC"
	  library.

config NRF_PS_SERVER_RPC_ALIVE_LED
	bool "RPC alive LED"
	default y
	depends on $(dt_alias_enabled,rpc-alive-led)
	help
	  Turns on the LED selected with "/aliases/rpc-alive-led" DTS property
	  when the UART transport is alive and ready to receive nRF RPC packets.

module = NRF_PS_SERVER
module-str = nrf_ps_server
source "$(ZEPHYR_BASE)/subsys/logging/Kconfig.template.log_config"

endmenu # "Protocols serialization server"

config ZMS
	default y if (SOC_FLASH_NRF_RRAM || SOC_FLASH_NRF_MRAM)

config NVS
	default y if !(SOC_FLASH_NRF_RRAM || SOC_FLASH_NRF_MRAM)

config SHELL_BACKEND_SERIAL
	default n if NRF_RPC_UTILS_REMOTE_SHELL

if LOG

choice LOG_MODE
	default LOG_MODE_DEFERRED
endchoice

config LOG_BUFFER_SIZE
	default 8192

config LOG_FUNC_NAME_PREFIX_DBG
	default n

config LOG_BACKEND_RTT
	default n

config LOG_BACKEND_UART
	default n

endif # LOG

if LOG_BACKEND_UART_ASYNC

# Using UART async API by the logging backend significantly reduces CPU load imposed by logging.
# To make it work, the corresponding UART instance needs to be configured to use the async API
# as well, which requires disabling the default, interrupt-driven API.
# Do it for all possible UART instances for the supported nRF52 and nRF54L SoCs.

uart_num = 0
rsource "Kconfig.zephyr_console_async"

uart_num = 1
rsource "Kconfig.zephyr_console_async"

uart_num = 00
rsource "Kconfig.zephyr_console_async"

uart_num = 20
rsource "Kconfig.zephyr_console_async"

uart_num = 21
rsource "Kconfig.zephyr_console_async"

uart_num = 22
rsource "Kconfig.zephyr_console_async"

uart_num = 30
rsource "Kconfig.zephyr_console_async"

endif # LOG_BACKEND_UART_ASYNC

if SOC_NRF54L15

config BT_LONG_WQ_STACK_SIZE
	default 2048

choice TRUSTED_STORAGE_BACKEND_AEAD_KEY
	default TRUSTED_STORAGE_BACKEND_AEAD_KEY_HASH_UID if TRUSTED_STORAGE_BACKEND_AEAD
endchoice

endif # SOC_NRF54L15

menu "Zephyr Kernel"
source "Kconfig.zephyr"
endmenu
```

## samples/nrf_rpc/protocols_serialization/server/Kconfig.zephyr_console_async
```kconfig
#
# Copyright (c) 2025 Nordic Semiconductor ASA
#
# SPDX-License-Identifier: LicenseRef-Nordic-5-Clause
#

DT_CHOSEN_ZEPHYR_CONSOLE := zephyr,console

config UART_$(uart_num)_INTERRUPT_DRIVEN
	default n
	depends on $(dt_nodelabel_enabled,uart$(uart_num))
	depends on "$(dt_nodelabel_path,uart$(uart_num))" = "$(dt_chosen_path,$(DT_CHOSEN_ZEPHYR_CONSOLE))"
```

## samples/nrf_rpc/protocols_serialization/server/boards/nrf54l15dk_nrf54l15_cpuapp.conf
```kconfig
#
# Copyright (c) 2024 Nordic Semiconductor
#
# SPDX-License-Identifier: LicenseRef-Nordic-5-Clause
#
CONFIG_MAIN_STACK_SIZE=4196
CONFIG_NRF_RPC_THREAD_STACK_SIZE=6144

# USE HASH UID instead of HUK for this sample, because Partition Manager is not available
CONFIG_TRUSTED_STORAGE_BACKEND_AEAD_KEY_HASH_UID=y

# Workaround required as Zephyr L2 implies usage of NVS backend for settings.
# It should be removed once the proper fix will be applied in Zephyr.
CONFIG_NVS=n
CONFIG_ZMS=y
CONFIG_SETTINGS_ZMS=y
```

## samples/nrf_rpc/protocols_serialization/server/boards/nrf54l15pdk_nrf54l15_cpuapp.conf
```kconfig
#
# Copyright (c) 2024 Nordic Semiconductor
#
# SPDX-License-Identifier: LicenseRef-Nordic-5-Clause
#
CONFIG_MAIN_STACK_SIZE=4196
CONFIG_NRF_RPC_THREAD_STACK_SIZE=6144

# USE HASH UID instead of HUK for this sample, because Partition Manager is not available
CONFIG_TRUSTED_STORAGE_BACKEND_AEAD_KEY_HASH_UID=y
```

## samples/nrf_rpc/protocols_serialization/server/boards/nrf54lm20dk_nrf54lm20a_cpuapp.conf
```kconfig
#
# Copyright (c) 2025 Nordic Semiconductor
#
# SPDX-License-Identifier: LicenseRef-Nordic-5-Clause
#
CONFIG_MAIN_STACK_SIZE=4196
CONFIG_NRF_RPC_THREAD_STACK_SIZE=6144
```

## samples/nrf_rpc/protocols_serialization/server/sample.yaml
```yaml
sample:
  name: Protocols serialization server sample
  description: Demonstrates serialization of Bluetooth LE and OpenThread API using
    nRF RPC

common:
  sysbuild: true
  build_only: true
  platform_allow:
    - nrf52840dk/nrf52840
    - nrf54l15dk/nrf54l15/cpuapp
    - nrf54lm20dk/nrf54lm20a/cpuapp
  integration_platforms:
    - nrf52840dk/nrf52840
    - nrf54l15dk/nrf54l15/cpuapp
    - nrf54lm20dk/nrf54lm20a/cpuapp
  tags:
    - ci_build
    - ci_samples_nrf_rpc

tests:
  sample.nrf_rpc.protocols_serialization.server.rpc_ble:
    extra_args: >
      SNIPPET="ble"
  sample.nrf_rpc.protocols_serialization.server.rpc_ot:
    extra_args: >
      SNIPPET="openthread"
  sample.nrf_rpc.protocols_serialization.server.rpc:
    extra_args: >
      SNIPPET="ble;openthread;debug;coex;log_rpc"
  sample.nrf_rpc.protocols_serialization.server.rpc_ci:
    extra_args: >
      SNIPPET="ble;openthread;debug;coex;log_rpc;ci-shell"
    extra_configs:
      - CONFIG_NRF_RPC_UTILS_CRASH_GEN=y
      - CONFIG_OPENTHREAD_RPC_ERASE_SETTINGS=y
```

## samples/nrf_rpc/protocols_serialization/server/snippets/openthread/boards/nrf54l15dk_nrf54l15_cpuapp.conf
```kconfig
#
# Copyright (c) 2024 Nordic Semiconductor
#
# SPDX-License-Identifier: LicenseRef-Nordic-5-Clause
#

CONFIG_NRF5_UICR_EUI64_ENABLE=y
```

## samples/nrf_secure_immutable_bootloader/boards/nrf54l15dk_nrf54l15_cpuapp_minimal.conf
```kconfig
#
# Copyright (c) 2025 Nordic Semiconductor ASA
#
# SPDX-License-Identifier: LicenseRef-Nordic-5-Clause
#

CONFIG_GEN_IRQ_VECTOR_TABLE=y
```

## samples/nrf_secure_immutable_bootloader/sample.yaml
```yaml
sample:
  name: Bootloader Sample
tests:
  sample.nrf_secure_immutable_bootloader:
    sysbuild: true
    build_only: true
    integration_platforms:
      - nrf5340dk/nrf5340/cpuapp
      - nrf9160dk/nrf9160
      - nrf9161dk/nrf9161
      - nrf9151dk/nrf9151
      - nrf54l15dk/nrf54l15/cpuapp
      - nrf52833dk/nrf52833
      - nrf52840dk/nrf52840
      - nrf52dk/nrf52832
      - nrf21540dk/nrf52840
    platform_allow:
      - nrf5340dk/nrf5340/cpuapp
      - nrf9160dk/nrf9160
      - nrf9161dk/nrf9161
      - nrf9151dk/nrf9151
      - nrf54l15dk/nrf54l15/cpuapp
      - nrf52840dk/nrf52840
      - nrf52833dk/nrf52833
      - nrf52dk/nrf52832
      - nrf21540dk/nrf52840
    extra_args:
      - SB_CONFIG_PARTITION_MANAGER=n
    tags:
      - ci_build
      - sysbuild
      - ci_samples_bootloader
```

## samples/openthread/cli/Kconfig.sysbuild
```kconfig
#
# Copyright (c) 2024 Nordic Semiconductor ASA
#
# SPDX-License-Identifier: LicenseRef-Nordic-5-Clause
#

config PARTITION_MANAGER
	default n

config NRF_DEFAULT_IPC_RADIO
	default y if SOC_SERIES_NRF53

config NETCORE_IPC_RADIO_IEEE802154
	default y if SOC_SERIES_NRF53

source "share/sysbuild/Kconfig"
```

## samples/openthread/cli/boards/nrf52833dk_nrf52833.conf
```kconfig
#
# Copyright (c) 2020 Nordic Semiconductor
#
# SPDX-License-Identifier: LicenseRef-BSD-5-Clause-Nordic
#

# Enable VANILLA MBEDTLE BACKEND because Oberon does not yet support SHA224
# This file can be removed when SHA224 support is added to Oberon or cookies
# no longer require it for generation.
CONFIG_MBEDTLS_VANILLA_BACKEND=y
CONFIG_CHOICE_VANILLA_MBEDTLS_SHA256_C=y
```

## samples/openthread/cli/boards/nrf52840dk_nrf52840.conf
```kconfig
#
# Copyright (c) 2020 Nordic Semiconductor
#
# SPDX-License-Identifier: LicenseRef-BSD-5-Clause-Nordic
#

# Disable built-in mbedTLS library - this enables nrf_security for OpenThread
CONFIG_OPENTHREAD_MBEDTLS=n
```

## samples/openthread/cli/boards/nrf52840dongle_nrf52840.conf
```kconfig
#
# Copyright (c) 2024 Nordic Semiconductor
#
# SPDX-License-Identifier: LicenseRef-Nordic-5-Clause
#

CONFIG_SHELL_BACKEND_SERIAL_INIT_PRIORITY=51

CONFIG_USB_CDC_ACM_LOG_LEVEL_OFF=y

CONFIG_USB_DEVICE_STACK_NEXT=y
CONFIG_CDC_ACM_SERIAL_MANUFACTURER_STRING="Nordic Semiconductor ASA"
CONFIG_CDC_ACM_SERIAL_INITIALIZE_AT_BOOT=y
CONFIG_CDC_ACM_SERIAL_PRODUCT_STRING="Thread CLI"
CONFIG_CDC_ACM_SERIAL_VID=0x1915
CONFIG_CDC_ACM_SERIAL_PID=0x0000

CONFIG_UART_LINE_CTRL=y

# Enable resetting to Bootloader using GPIO
CONFIG_OPENTHREAD_PLATFORM_BOOTLOADER_MODE_GPIO=y
```

## samples/openthread/cli/boards/nrf5340dk_nrf5340_cpuapp_ns.conf
```kconfig
#
# Copyright (c) 2021 Nordic Semiconductor
#
# SPDX-License-Identifier: LicenseRef-Nordic-5-Clause
#

# Enable Trusted Firmware M
CONFIG_OPENTHREAD_NRF_SECURITY_PSA_CHOICE=y
```

## samples/openthread/cli/boards/nrf5340pdk_nrf5340_cpuapp.conf
```kconfig
# This is a workaround for missing hardware entropy support on app core
# It must be reverted when the missing part is provided
CONFIG_ENTROPY_GENERATOR=y
CONFIG_TEST_RANDOM_GENERATOR=y
CONFIG_TIMER_RANDOM_GENERATOR=y
```

## samples/openthread/cli/boards/nrf54h20dk_nrf54h20_cpuapp.conf
```kconfig
#
# Copyright (c) 2024 Nordic Semiconductor ASA
#
# SPDX-License-Identifier: LicenseRef-Nordic-5-Clause
#

# Disable Oberon PSA crypto drivers
CONFIG_PSA_CRYPTO_DRIVER_OBERON=n

# Enable PSA crypto from SSF client
CONFIG_PSA_SSF_CRYPTO_CLIENT=y
CONFIG_SSF_PSA_CRYPTO_SERVICE_ENABLED=y

# Disable Data Cache
CONFIG_DCACHE=n
```

## samples/openthread/cli/boards/nrf54l15dk_nrf54l15_cpuapp.conf
```kconfig
#
# Copyright (c) 2024 Nordic Semiconductor
#
# SPDX-License-Identifier: LicenseRef-Nordic-5-Clause
#

# Increase Main and shell stack sizes to avoid stack overflow
# while using CRACEN
CONFIG_MAIN_STACK_SIZE=6144
CONFIG_SHELL_STACK_SIZE=5120
```

## samples/openthread/cli/boards/nrf54l15dk_nrf54l15_cpuapp_ns.conf
```kconfig
#
# Copyright (c) 2024 Nordic Semiconductor
#
# SPDX-License-Identifier: LicenseRef-Nordic-5-Clause
#

# Disable the unsupported driver
CONFIG_NRFX_UARTE0=n
```

## samples/openthread/cli/boards/nrf54l15pdk_nrf54l15_cpuapp.conf
```kconfig
#
# Copyright (c) 2024 Nordic Semiconductor
#
# SPDX-License-Identifier: LicenseRef-Nordic-5-Clause
#

CONFIG_GPIO_SHELL=n

CONFIG_NRF_802154_TEMPERATURE_UPDATE=n
```

## samples/openthread/cli/boards/nrf54lm20pdk_nrf54lm20a_cpuapp.conf
```kconfig
#
# Copyright (c) 2025 Nordic Semiconductor ASA
#
# SPDX-License-Identifier: LicenseRef-Nordic-5-Clause
#

# Disable features based on IKG
CONFIG_TRUSTED_STORAGE_BACKEND_AEAD_KEY_HASH_UID=y
```
