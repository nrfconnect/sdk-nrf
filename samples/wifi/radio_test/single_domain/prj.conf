## CMakeLists.txt
```
#
# Copyright (c) 2024 Nordic Semiconductor ASA
#
# SPDX-License-Identifier: LicenseRef-Nordic-5-Clause
#

cmake_minimum_required(VERSION 3.20.0)

find_package(Zephyr REQUIRED HINTS $ENV{ZEPHYR_BASE})
project(wifi_ble_radio_test)

set(perip_rt_dir ${ZEPHYR_NRF_MODULE_DIR}/samples/peripheral/radio_test)

file(GLOB perip_rt_sources ${perip_rt_dir}/src/*.c)

# NORDIC SDK APP START
target_sources(app PRIVATE
  ${perip_rt_sources}
  src/early_shell_start.c
)
# NORDIC SDK APP END
```

## Kconfig
```
#
# Copyright (c) 2024 Nordic Semiconductor
#
# SPDX-License-Identifier: LicenseRef-Nordic-5-Clause
#

mainmenu "Nordic Wi-Fi Bluetooth LE Radio test sample"

config SAMPLE_WIFI_RADIO_TEST_WIFI_ONLY
	bool "Wi-Fi only mode"
	help
	  Enable Wi-Fi only radio test mode, excluding peripheral BLE radio test
	  sources. BLE stack support remains enabled on combo chips.

rsource "$(ZEPHYR_NRF_MODULE_DIR)/samples/peripheral/radio_test/Kconfig"
```

## sample.yaml
```
sample:
  description: Wi-Fi BLE radio test sample single domain
  name: Wi-Fi BLE radio test Single Domain
tests:
  sample.nrf70.wifi_ble_radio_test_sd:
    sysbuild: true
    build_only: true
    extra_args:
      - single_domain_SHIELD="nrf7002eb_interposer_p1;nrf7002eb"
      - single_domain_SNIPPET=nrf70-wifi
    integration_platforms:
      - nrf54l15dk/nrf54l15/cpuapp
    platform_allow:
      - nrf54l15dk/nrf54l15/cpuapp
    tags:
      - ci_build
      - sysbuild
      - ci_samples_wifi
  sample.nrf7002eb2.wifi_ble_radio_test_sd:
    sysbuild: true
    build_only: true
    extra_args:
      - single_domain_SHIELD="nrf7002eb2"
      - single_domain_SNIPPET=nrf70-wifi
      - CONFIG_NRF_WIFI_CTRL_HEAP_SIZE=51000
    integration_platforms:
      - nrf54l15dk/nrf54l15/cpuapp
    platform_allow:
      - nrf54l15dk/nrf54l15/cpuapp
    tags:
      - ci_build
      - sysbuild
      - ci_samples_wifi
  sample.54lm20dk.nrf7002eb2.wifi_ble_radio_test_sd:
    sysbuild: true
    build_only: true
    extra_args:
      - single_domain_SHIELD="nrf7002eb2"
      - CONFIG_NRFX_TIMER=y
      - CONFIG_NRFX_GPPI=y
    integration_platforms:
      - nrf54lm20dk/nrf54lm20a/cpuapp
      - nrf54lm20dk/nrf54lm20b/cpuapp
    platform_allow:
      - nrf54lm20dk/nrf54lm20a/cpuapp
      - nrf54lm20dk/nrf54lm20b/cpuapp
    tags:
      - ci_build
      - sysbuild
      - ci_samples_wifi
  sample.nrf7120.wifi_ble_radio_test_sd:
    sysbuild: true
    build_only: true
    extra_args:
      - SB_CONFIG_WIFI_NRF70=n
    integration_platforms:
      - nrf7120dk/nrf7120/cpuapp
      - nrf7120dk/nrf7120/cpuapp/ns
    platform_allow:
      - nrf7120dk/nrf7120/cpuapp
      - nrf7120dk/nrf7120/cpuapp/ns
    tags:
      - ci_build
      - sysbuild
      - ci_samples_nrf71_wifi
```

## sysbuild.conf
```
#
# Copyright (c) 2024 Nordic Semiconductor ASA
#
# SPDX-License-Identifier: LicenseRef-Nordic-5-Clause
#

SB_CONFIG_WIFI_NRF70=y
SB_CONFIG_WIFI_NRF70_RADIO_TEST=y
SB_CONFIG_PARTITION_MANAGER=n
```

## prj.conf
```kconfig
#
# Copyright (c) 2022 Nordic Semiconductor ASA
#
# SPDX-License-Identifier: LicenseRef-Nordic-5-Clause
#
CONFIG_WIFI=y

#CONFIG_INIT_STACKS=y

# Memories
CONFIG_MAIN_STACK_SIZE=5200
CONFIG_SHELL_STACK_SIZE=5200
#64K memory needed for IQ sample captures.
CONFIG_HEAP_MEM_POOL_SIZE=65536
CONFIG_HEAP_MEM_POOL_IGNORE_MIN=y


# Debugging
CONFIG_STACK_SENTINEL=y
CONFIG_DEBUG_COREDUMP=y
CONFIG_DEBUG_COREDUMP_BACKEND_LOGGING=y
CONFIG_DEBUG_COREDUMP_MEMORY_DUMP_MIN=y
CONFIG_SHELL_CMDS_RESIZE=n
#CONFIG_DEBUG=y

# Logging
CONFIG_LOG=y
CONFIG_PRINTK=y
CONFIG_SHELL=y
# With CONFIG_LOG_PRINTK=y, printk() (and the NCS boot banner, which uses
# it at SYS_INIT APPLICATION level, before main()) is routed through the
# shell's log backend. That backend starts out disabled and is only
# enabled once the shell thread itself runs shell_start() - normally left
# to happen whenever the shell thread first gets scheduled, which isn't
# guaranteed to happen before APPLICATION level on this sample's thin
# boot. Take explicit control of that instead of leaving it to the
# scheduler: disable shell autostart here and call shell_start()
# ourselves from a SYS_INIT right after the shell UART backend's own
# init, so the log backend is deterministically enabled before
# APPLICATION level runs. See src/early_shell_start.c.
CONFIG_SHELL_AUTOSTART=n
CONFIG_SHELL_GETOPT=y
CONFIG_DEVICE_SHELL=y
CONFIG_POSIX_TIMERS=y
CONFIG_DATE_SHELL=y
CONFIG_LOG_BUFFER_SIZE=4096
CONFIG_SHELL_BACKEND_SERIAL_RX_RING_BUFFER_SIZE=1024

# Peripheral radio test configuration
CONFIG_CONSOLE_HANDLER=y
CONFIG_SHELL=y

CONFIG_DYNAMIC_INTERRUPTS=y

CONFIG_NRFX_TIMER=y
CONFIG_CLOCK_CONTROL=y

CONFIG_ENTROPY_GENERATOR=y
CONFIG_PSA_CRYPTO=y

CONFIG_FEM_AL_LIB=y
CONFIG_PICOLIBC_IO_FLOAT=y
```

## wifi_only-overlay.conf
```kconfig
#
# Copyright (c) 2026 Nordic Semiconductor ASA
#
# SPDX-License-Identifier: LicenseRef-Nordic-5-Clause
#
# Wi-Fi only radio test overlay
# Disables peripheral BLE radio test and enables WiFi radio test mode
# Works on both nRF70 and nRF71

# Enable WiFi-only mode (disables peripheral BLE radio test)
CONFIG_SAMPLE_WIFI_RADIO_TEST_WIFI_ONLY=y

# Disable peripheral BLE radio test specific features
CONFIG_CONSOLE_HANDLER=n
CONFIG_FEM_AL_LIB=n
CONFIG_ENTROPY_GENERATOR=n
CONFIG_PSA_CRYPTO=n
CONFIG_NRFX_TIMER=n
CONFIG_DYNAMIC_INTERRUPTS=n
```

## wifi_only.conf
```kconfig
#
# Copyright (c) 2026 Nordic Semiconductor ASA
#
# SPDX-License-Identifier: LicenseRef-Nordic-5-Clause
#
# Wi-Fi only radio test overlay
# Disables peripheral BLE radio test and enables WiFi radio test mode
# Works on both nRF70 and nRF71

# Enable WiFi-only mode (disables peripheral BLE radio test)
CONFIG_WIFI_ONLY=y

# Disable peripheral BLE radio test specific features
CONFIG_CONSOLE_HANDLER=n
CONFIG_FEM_AL_LIB=n
CONFIG_ENTROPY_GENERATOR=n
CONFIG_PSA_CRYPTO=n
CONFIG_NRFX_TIMER=n
CONFIG_DYNAMIC_INTERRUPTS=n
```

## boards/nrf54l15dk_nrf54l15_cpuapp.conf
```kconfig
#
# Copyright (c) 2024 Nordic Semiconductor
#
# SPDX-License-Identifier: LicenseRef-Nordic-5-Clause
#

# Enable the necessary drivers
CONFIG_NRFX_TIMER=y
CONFIG_NRFX_GPPI=y

#NRF70 specific configuration
CONFIG_WIFI_NRF70=y
CONFIG_NRF70_RADIO_TEST=y
CONFIG_NRF_WIFI_CTRL_HEAP_SIZE=32768
```

## boards/nrf54lm20dk_nrf54lm20b_cpuapp.conf
```kconfig
#
# Copyright (c) 2026 Nordic Semiconductor ASA
#
# SPDX-License-Identifier: LicenseRef-Nordic-5-Clause
#

#NRF70 specific configuration
CONFIG_WIFI_NRF70=y
CONFIG_NRF70_RADIO_TEST=y
CONFIG_NRF_WIFI_CTRL_HEAP_SIZE=32768
```

## boards/nrf7120dk_nrf7120_cpuapp.conf
```kconfig
#
# Copyright (c) 2026 Nordic Semiconductor
#
# SPDX-License-Identifier: LicenseRef-Nordic-5-Clause
#

CONFIG_NRF71_WIFI=y
CONFIG_NRF71_WIFI_RADIO_TEST_MODE=y
CONFIG_NRF71_WIFI_CTRL_HEAP_SIZE=32768

# Enable the necessary drivers
CONFIG_NRFX_TIMER=y
CONFIG_NRFX_GPPI=y
```

## inc/nrf_wifi_radio_test_shell.h
```c
/*
 * Copyright (c) 2022 Nordic Semiconductor ASA
 *
 * SPDX-License-Identifier: LicenseRef-Nordic-5-Clause
 */

/* @file
 * @brief nRF Wi-Fi radio-test mode shell module
 */

#include <zephyr/kernel.h>
#include <stdio.h>
#include <stdlib.h>
#include <zephyr/shell/shell.h>
#include <zephyr/init.h>
#include <ctype.h>
#include <host_rpu_sys_if.h>
#include <fmac_structs.h>
#include <zephyr/drivers/wifi/nrf_wifi/bus/rpu_hw_if.h>

struct nrf_wifi_ctx_zep_rt {
	struct nrf_wifi_fmac_priv *fmac_priv;
	struct rpu_conf_params conf_params;
};
```

## src/early_shell_start.c
```c
/*
 * Copyright (c) 2026 Nordic Semiconductor ASA
 *
 * SPDX-License-Identifier: LicenseRef-Nordic-5-Clause
 */

#include <zephyr/init.h>
#include <zephyr/shell/shell.h>
#include <zephyr/shell/shell_uart.h>

/*
 * CONFIG_SHELL_AUTOSTART is disabled for this sample (see prj.conf): the
 * shell thread only calls shell_start() itself when autostart is enabled,
 * and that call happens whenever the thread first gets scheduled - not
 * guaranteed to be before the SYS_INIT(APPLICATION, 0) boot banner on
 * this sample's thin boot. shell_start() is what enables the shell's log
 * backend (SHELL_LOG_BACKEND_DISABLED -> ENABLED), and printk()/LOG_*
 * messages emitted while it is still disabled are silently dropped.
 *
 * Call shell_start() ourselves instead, from a SYS_INIT placed right
 * after the shell UART backend's own init. Both run within POST_KERNEL,
 * which always completes before APPLICATION level starts, so this
 * enables the log backend deterministically before the boot banner runs
 * - no dependency on scheduling order.
 *
 * The priority below must stay a plain literal greater than
 * CONFIG_SHELL_BACKEND_SERIAL_INIT_PRIORITY (currently 90): SYS_INIT's
 * priority argument is token-pasted into a linker section name, so an
 * arithmetic expression there breaks the link with "Undefined
 * initialization levels used".
 */
static int early_shell_start(void)
{
	return shell_start(shell_backend_uart_get_ptr());
}

BUILD_ASSERT(91 > CONFIG_SHELL_BACKEND_SERIAL_INIT_PRIORITY,
	     "early_shell_start must run after the shell UART backend's own init");
SYS_INIT(early_shell_start, POST_KERNEL, 91);
```

## src/ficr_prog.h
```c
/*
 * Copyright (c) 2024 Nordic Semiconductor ASA
 *
 * SPDX-License-Identifier: LicenseRef-Nordic-5-Clause
 */

/**
 * @brief Header containing address/offets and functions for writing
 * the FICR fields of the OTP memory on nRF7002 device
 */

#ifndef __OTP_PROG_H_
#define __OTP_PROG_H_

#include <stdio.h>
#include <stdlib.h>

int write_otp_memory(unsigned int otp_addr, unsigned int *write_val);
int read_otp_memory(unsigned int otp_addr, unsigned int *read_val, int len);
unsigned int check_protection(unsigned int *buff, unsigned int off1, unsigned int off2,
					unsigned int off3, unsigned int off4);

#endif /* __OTP_PROG_H_ */
```

## src/nrf_wifi_radio_ficr_shell.c
```c
/*
 * Copyright (c) 2022 Nordic Semiconductor ASA
 *
 * SPDX-License-Identifier: LicenseRef-Nordic-5-Clause
 */

/* @file
 * @brief NRF Wi-Fi radio test shell module
 */

#include <zephyr/logging/log.h>
#include <fmac_main.h>
#include <util.h>
#include <nrf_wifi_radio_test_shell.h>
#include "ficr_prog.h"

#include "fmac_api_common.h"

extern struct nrf_wifi_drv_priv_zep rpu_drv_priv_zep;
static struct nrf_wifi_ctx_zep *ctx = &rpu_drv_priv_zep.rpu_ctx_zep;

LOG_MODULE_REGISTER(otp_prog, CONFIG_WIFI_LOG_LEVEL);

static void disp_location_status(const struct shell *shell, char *region, unsigned int ret)
{
	switch (ret) {

	case OTP_PROGRAMMED:
		shell_fprintf(shell, SHELL_INFO, "%s Region is locked!!!\n", region);
		break;
	case OTP_ENABLE_PATTERN:
		shell_fprintf(shell, SHELL_INFO, "%s Region is open for R/W\n", region);
		break;
	case OTP_FRESH_FROM_FAB:
		shell_fprintf(shell, SHELL_INFO,
				"%s Region is unprogrammed - program to enable R/W\n", region);
		break;
	default:
		shell_fprintf(shell, SHELL_ERROR, "%s Region is in invalid state\n", region);
		break;
	}
	shell_fprintf(shell, SHELL_INFO, "\n");
}

static void disp_fields_status(const struct shell *shell, unsigned int flags)
{
	if (flags & (~QSPI_KEY_FLAG_MASK)) {
		shell_fprintf(shell, SHELL_INFO, "QSPI Keys are not programmed in OTP\n");
	} else {
		shell_fprintf(shell, SHELL_INFO, "QSPI Keys are programmed in OTP\n");
	}

	if (flags & (~MAC0_ADDR_FLAG_MASK)) {
		shell_fprintf(shell, SHELL_INFO, "MAC0 Address are not programmed in OTP\n");
	} else {
		shell_fprintf(shell, SHELL_INFO, "MAC0 Address is programmed in OTP\n");
	}

	if (flags & (~MAC1_ADDR_FLAG_MASK)) {
		shell_fprintf(shell, SHELL_INFO, "MAC1 Address are not programmed in OTP\n");
	} else {
		shell_fprintf(shell, SHELL_INFO, "MAC1 Address is programmed in OTP\n");
	}

	if (flags & (~CALIB_XO_FLAG_MASK)) {
		shell_fprintf(shell, SHELL_INFO, "CALIB_XO is not programmed in OTP\n");
	} else {
		shell_fprintf(shell, SHELL_INFO, "CALIB_XO is programmed in OTP\n");
	}
}


static int nrf_wifi_radio_test_otp_get_status(const struct shell *shell,
					size_t argc,
					char  *argv[])
{
	unsigned int ret, err;
	unsigned int val[OTP_MAX_WORD_LEN];

	/* read all the OTP memory */
	err = read_otp_memory(0, &val[0], OTP_MAX_WORD_LEN);
	if (err) {
		shell_fprintf(shell, SHELL_ERROR, "FAILED reading otp memory......\n");
		return -ENOEXEC;
	}

	shell_fprintf(shell, SHELL_INFO, "Checking OTP PROTECT Region......\n");
	ret = check_protection(&val[0], REGION_PROTECT, REGION_PROTECT + 1,
							REGION_PROTECT + 2, REGION_PROTECT + 3);

	disp_location_status(shell, "OTP", ret);
	disp_fields_status(shell, val[REGION_DEFAULTS]);

	return 0;
}

static int nrf_wifi_radio_test_otp_read_params(const struct shell *shell,
					size_t argc,
					char  *argv[])
{
	unsigned int val[OTP_MAX_WORD_LEN];
	unsigned int ret, err;

	err = read_otp_memory(0, &val[0], OTP_MAX_WORD_LEN);
	if (err) {
		shell_fprintf(shell, SHELL_ERROR, "FAILED reading otp memory......\n");
		return -ENOEXEC;
	}

	ret = check_protection(&val[0], REGION_PROTECT + 0, REGION_PROTECT + 1,
							REGION_PROTECT + 2, REGION_PROTECT + 3);
	disp_location_status(shell, "OTP", ret);

	shell_fprintf(shell, SHELL_INFO, "PRODTEST.FT.PROGVERSION = 0x%08x\n",
		val[PRODTEST_FT_PROGVERSION]);
	shell_fprintf(shell, SHELL_INFO, "\n");

	shell_fprintf(shell, SHELL_INFO, "PRODTEST.TRIM0 = 0x%08x\n", val[PRODTEST_TRIM0]);
	shell_fprintf(shell, SHELL_INFO, "PRODTEST.TRIM1 = 0x%08x\n", val[PRODTEST_TRIM1]);
	shell_fprintf(shell, SHELL_INFO, "PRODTEST.TRIM2 = 0x%08x\n", val[PRODTEST_TRIM2]);
	shell_fprintf(shell, SHELL_INFO, "PRODTEST.TRIM3 = 0x%08x\n", val[PRODTEST_TRIM3]);
	shell_fprintf(shell, SHELL_INFO, "PRODTEST.TRIM4 = 0x%08x\n", val[PRODTEST_TRIM4]);
	shell_fprintf(shell, SHELL_INFO, "PRODTEST.TRIM5 = 0x%08x\n", val[PRODTEST_TRIM5]);
	shell_fprintf(shell, SHELL_INFO, "PRODTEST.TRIM6 = 0x%08x\n", val[PRODTEST_TRIM6]);
	shell_fprintf(shell, SHELL_INFO, "PRODTEST.TRIM7 = 0x%08x\n", val[PRODTEST_TRIM7]);
	shell_fprintf(shell, SHELL_INFO, "PRODTEST.TRIM8 = 0x%08x\n", val[PRODTEST_TRIM8]);
	shell_fprintf(shell, SHELL_INFO, "PRODTEST.TRIM9 = 0x%08x\n", val[PRODTEST_TRIM9]);
	shell_fprintf(shell, SHELL_INFO, "PRODTEST.TRIM10 = 0x%08x\n",
		val[PRODTEST_TRIM10]);
	shell_fprintf(shell, SHELL_INFO, "PRODTEST.TRIM11 = 0x%08x\n",
		val[PRODTEST_TRIM11]);
	shell_fprintf(shell, SHELL_INFO, "PRODTEST.TRIM12 = 0x%08x\n",
		val[PRODTEST_TRIM12]);
	shell_fprintf(shell, SHELL_INFO, "PRODTEST.TRIM13 = 0x%08x\n",
		val[PRODTEST_TRIM13]);
	shell_fprintf(shell, SHELL_INFO, "PRODTEST.TRIM14 = 0x%08x\n",
		val[PRODTEST_TRIM14]);
	shell_fprintf(shell, SHELL_INFO, "\n");

	shell_fprintf(shell, SHELL_INFO, "INFO.PART = 0x%08x\n", val[INFO_PART]);
	shell_fprintf(shell, SHELL_INFO, "INFO.VARIANT = 0x%08x\n", val[INFO_VARIANT]);
	shell_fprintf(shell, SHELL_INFO, "\n");

	shell_fprintf(shell, SHELL_INFO, "INFO.UUID0 = 0x%08x\n", val[INFO_UUID + 0]);
	shell_fprintf(shell, SHELL_INFO, "INFO.UUID1 = 0x%08x\n", val[INFO_UUID + 1]);
	shell_fprintf(shell, SHELL_INFO, "INFO.UUID2 = 0x%08x\n", val[INFO_UUID + 2]);
	shell_fprintf(shell, SHELL_INFO, "INFO.UUID3 = 0x%08x\n", val[INFO_UUID + 3]);
	shell_fprintf(shell, SHELL_INFO, "\n");

	shell_fprintf(shell, SHELL_INFO, "REGION.PROTECT0 = 0x%08x\n", val[REGION_PROTECT + 0]);
	shell_fprintf(shell, SHELL_INFO, "REGION.PROTECT1 = 0x%08x\n", val[REGION_PROTECT + 1]);
	shell_fprintf(shell, SHELL_INFO, "REGION.PROTECT2 = 0x%08x\n", val[REGION_PROTECT + 2]);
	shell_fprintf(shell, SHELL_INFO, "REGION.PROTECT3 = 0x%08x\n", val[REGION_PROTECT + 3]);
	shell_fprintf(shell, SHELL_INFO, "\n");

	if (val[REGION_PROTECT + 0] != OTP_FRESH_FROM_FAB) {
		shell_fprintf(shell, SHELL_INFO, "MAC0.ADDRESS0 = 0x%08x\n", val[MAC0_ADDR]);
		shell_fprintf(shell, SHELL_INFO, "MAC0.ADDRESS1 = 0x%08x\n", val[MAC0_ADDR + 1]);
		shell_fprintf(shell, SHELL_INFO, "MAC0.ADDRESS = %02x:%02x:%02x:%02x:%02x:%02x\n",
			(uint8_t)(val[MAC0_ADDR]), (uint8_t)(val[MAC0_ADDR] >> 8),
			(uint8_t)(val[MAC0_ADDR] >> 16), (uint8_t)(val[MAC0_ADDR] >> 24),
			(uint8_t)(val[MAC0_ADDR + 1]), (uint8_t)(val[MAC0_ADDR + 1] >> 8));
		shell_fprintf(shell, SHELL_INFO, "\n");

		shell_fprintf(shell, SHELL_INFO, "MAC1.ADDRESS0 = 0x%08x\n", val[MAC1_ADDR]);
		shell_fprintf(shell, SHELL_INFO, "MAC1.ADDRESS1 = 0x%08x\n", val[MAC1_ADDR + 1]);
		shell_fprintf(shell, SHELL_INFO, "MAC1.ADDRESS = %02x:%02x:%02x:%02x:%02x:%02x\n",
			(uint8_t)(val[MAC1_ADDR]), (uint8_t)(val[MAC1_ADDR] >> 8),
			(uint8_t)(val[MAC1_ADDR] >> 16), (uint8_t)(val[MAC1_ADDR] >> 24),
			(uint8_t)(val[MAC1_ADDR + 1]), (uint8_t)(val[MAC1_ADDR + 1] >> 8));
		shell_fprintf(shell, SHELL_INFO, "\n");

		shell_fprintf(shell, SHELL_INFO, "CALIB.XO = 0x%02x\n", val[CALIB_XO] & 0xFF);

		shell_fprintf(shell, SHELL_INFO, "REGION_DEFAULTS = 0x%08x\n",
			val[REGION_DEFAULTS]);
		shell_fprintf(shell, SHELL_INFO, "\n");
	}
	return 0;
}

static int nrf_wifi_radio_test_otp_read_retrim_version(const struct shell *shell,
					size_t argc,
					char  *argv[])
{
	unsigned int val[1];
	unsigned int err;

	err = read_otp_memory(REGION_PROTECT, &val[0], 1);
	if (err) {
		shell_fprintf(shell, SHELL_ERROR, "FAILED reading otp memory......\n");
		return -ENOEXEC;
	}

	if (val[0] == OTP_FRESH_FROM_FAB) {
		shell_fprintf(shell, SHELL_ERROR,
				"Region is unprogrammed - program to enable R/W\n");
	} else {
		err = read_otp_memory(PRODRETEST_PROGVERSION, &val[0], 1);
		shell_fprintf(shell, SHELL_INFO, "\nPRODRETEST.PROGVERSION = 0x%08x\n",
		val[0]);
		shell_fprintf(shell, SHELL_INFO, "\n");
	}
	return 0;
}

static int nrf_wifi_radio_test_otp_read_retrim_params(const struct shell *shell,
					size_t argc,
					char  *argv[])
{
	unsigned int val[RETRIM_LEN];
	unsigned int err;

	err = read_otp_memory(REGION_PROTECT, val, 1);
	if (err) {
		shell_fprintf(shell, SHELL_ERROR, "FAILED reading otp memory......\n");
		return -ENOEXEC;
	}

	if (val[0] == OTP_FRESH_FROM_FAB) {
		shell_fprintf(shell, SHELL_ERROR,
				"Region is unprogrammed - program to enable R/W\n");
	} else {
		shell_fprintf(shell, SHELL_INFO, "\n");
		err = read_otp_memory(PRODRETEST_TRIM0, val, RETRIM_LEN);
		for (int i = 0; i < RETRIM_LEN; i++) {
			shell_fprintf(shell, SHELL_INFO, "PRODRETEST.TRIM%d = 0x%08x\n", i, val[i]);
		}
		shell_fprintf(shell, SHELL_INFO, "\n");
	}

	return 0;
}

static int nrf_wifi_radio_test_otp_write_params(const struct shell *shell,
					size_t argc,
					char  *argv[])
{
	unsigned int field;
	unsigned int write_val[20];
	unsigned int val[OTP_MAX_WORD_LEN];
	unsigned int ret, err;
	int status = 0;

	if (argc < 2) {
		shell_fprintf(shell, SHELL_ERROR, "invalid # of args : %d\n", argc);
		return -ENOEXEC;
	}

	field  = strtoul(argv[1], NULL, 0);
	/* Align to 32-bit word address */
	field >>= 2;

	if (field < REGION_PROTECT) {
		shell_fprintf(shell, SHELL_ERROR, "INVALID Address 0x%x......\n", field << 2);
		return -ENOEXEC;
	}

	if ((field >= PRODRETEST_PROGVERSION) && (field <= PRODRETEST_TRIM14)) {
		shell_fprintf(shell, SHELL_ERROR, "INVALID Address 0x%x......\n", field << 2);
		return -ENOEXEC;
	}

	err = read_otp_memory(REGION_PROTECT, &val[REGION_PROTECT], 4);
	if (err) {
		shell_fprintf(shell, SHELL_ERROR, "FAILED reading otp memory......\n");
		return -ENOEXEC;
	}

	ret = check_protection(&val[0], REGION_PROTECT, REGION_PROTECT + 1,
						REGION_PROTECT + 2, REGION_PROTECT + 3);
	disp_location_status(shell, "OTP", ret);
	if (ret != OTP_ENABLE_PATTERN && ret != OTP_FRESH_FROM_FAB) {
		shell_fprintf(shell, SHELL_ERROR, "USER Region is not Writeable\n");
		return -ENOEXEC;
	}

	switch (field) {
	case REGION_PROTECT:
		if (argc != 3) {
			shell_fprintf(shell, SHELL_ERROR,
					"invalid # of args for REGION_PROTECT (expected 3) : %d\n",
					argc);
			return -ENOEXEC;
		}
		write_val[0]  = strtoul(argv[2], NULL, 0);
		/* All consecutive 4 words of the REGION_PROTECT are written */
		write_otp_memory(REGION_PROTECT, &write_val[0]);
		break;
	case MAC0_ADDR:
	case MAC1_ADDR:
		struct nrf_wifi_fmac_dev_ctx *fmac_dev_ctx = ctx->rpu_ctx;

		if (!fmac_dev_ctx) {
			shell_fprintf(shell, SHELL_ERROR, "Driver not initialized\n");
			return -ENOEXEC;
		}

		if (argc != 4) {
			shell_fprintf(shell, SHELL_ERROR,
				   "invalid # of args for MAC ADDR write (expected 4) : %d\n",
					argc);
			return -ENOEXEC;
		}
		write_val[0] = strtoul(argv[2], NULL, 0);
		write_val[1] = strtoul(argv[3], NULL, 0) & 0xFFFF;

		if (!nrf_wifi_utils_is_mac_addr_valid((const char *)&write_val[0])) {
			shell_fprintf(shell,
				      SHELL_ERROR,
				      "Invalid MAC address. MAC address cannot be all 0's, broadcast or multicast address\n");
			return -ENOEXEC;
		}

		status = write_otp_memory(field, &write_val[0]);
		break;
	case CALIB_XO:
	case REGION_DEFAULTS:
		if (argc != 3) {
			shell_fprintf(shell, SHELL_ERROR,
			  "invalid # of args for field %d (expected 3) : %d\n", field, argc);
			return -ENOEXEC;
		}
		write_val[0]  = strtoul(argv[2], NULL, 0);
		status = write_otp_memory(field, &write_val[0]);
		break;
	case QSPI_KEY:
		if (argc != 6) {
			shell_fprintf(shell, SHELL_ERROR,
					"invalid # of args for QSPI_KEY (expected 6) : %d\n", argc);
			return -ENOEXEC;
		}
		write_val[0]  = strtoul(argv[2], NULL, 0);
		write_val[1]  = strtoul(argv[3], NULL, 0);
		write_val[2]  = strtoul(argv[4], NULL, 0);
		write_val[3]  = strtoul(argv[5], NULL, 0);
		/* All consecutive 4 words of the qspi keys are written now */
		status = write_otp_memory(QSPI_KEY, &write_val[0]);
		break;
	default:
		shell_fprintf(shell, SHELL_ERROR, "unsupported field %d\n", field);
		return -ENOEXEC;
	}

	if (!status) {
		shell_fprintf(shell, SHELL_INFO, "Finished Writing OTP params\n");
	}

	return 0;
}

static int nrf_wifi_radio_test_otp_write_retrim_version(const struct shell *shell,
					size_t argc,
					char  *argv[])
{
	unsigned int field;
	unsigned int write_val;
	unsigned int val[OTP_MAX_WORD_LEN];
	unsigned int ret, err;
	int status = 0;

	field = PRODRETEST_PROGVERSION;

	if (argc != 2) {
		shell_fprintf(shell, SHELL_ERROR,
		  "invalid # of args for field %d (expected 2) : %d\n", field, argc);
		return -ENOEXEC;
	}

	err = read_otp_memory(REGION_PROTECT, &val[REGION_PROTECT], 4);
	if (err) {
		shell_fprintf(shell, SHELL_ERROR, "FAILED reading otp memory......\n");
		return -ENOEXEC;
	}

	ret = check_protection(&val[0], REGION_PROTECT, REGION_PROTECT + 1,
						REGION_PROTECT + 2, REGION_PROTECT + 3);
	disp_location_status(shell, "OTP", ret);
	if (ret != OTP_ENABLE_PATTERN && ret != OTP_FRESH_FROM_FAB) {
		shell_fprintf(shell, SHELL_ERROR, "USER Region is not Writeable\n");
		return -ENOEXEC;
	}

	write_val  = strtoul(argv[1], NULL, 0);
	status = write_otp_memory(field, &write_val);

	if (!status) {
		shell_fprintf(shell, SHELL_INFO, "Finished Writing Retrim version\n");
	}

	return 0;
}

static int nrf_wifi_radio_test_otp_write_retrim_params(const struct shell *shell,
					size_t argc,
					char  *argv[])
{
	unsigned int index;
	unsigned int field;
	unsigned int write_val;
	unsigned int val[OTP_MAX_WORD_LEN];
	unsigned int ret, err;
	int status = 0;

	index = strtoul(argv[1], NULL, 0);
	field = index+PRODRETEST_TRIM0;

	if ((field < PRODRETEST_TRIM0) || (field > PRODRETEST_TRIM14)) {
		shell_fprintf(shell, SHELL_ERROR, "INVALID Index %d......\n", index);
		return -ENOEXEC;
	}

	err = read_otp_memory(REGION_PROTECT, &val[REGION_PROTECT], 4);
	if (err) {
		shell_fprintf(shell, SHELL_ERROR, "FAILED reading otp memory......\n");
		return -ENOEXEC;
	}

	ret = check_protection(&val[0], REGION_PROTECT, REGION_PROTECT + 1,
						REGION_PROTECT + 2, REGION_PROTECT + 3);
	disp_location_status(shell, "OTP", ret);
	if (ret != OTP_ENABLE_PATTERN && ret != OTP_FRESH_FROM_FAB) {
		shell_fprintf(shell, SHELL_ERROR, "USER Region is not Writeable\n");
		return -ENOEXEC;
	}

	switch (field) {
	case PRODRETEST_TRIM0:
	case PRODRETEST_TRIM1:
	case PRODRETEST_TRIM2:
	case PRODRETEST_TRIM3:
	case PRODRETEST_TRIM4:
	case PRODRETEST_TRIM5:
	case PRODRETEST_TRIM6:
	case PRODRETEST_TRIM7:
	case PRODRETEST_TRIM8:
	case PRODRETEST_TRIM9:
	case PRODRETEST_TRIM10:
	case PRODRETEST_TRIM11:
	case PRODRETEST_TRIM12:
	case PRODRETEST_TRIM13:
	case PRODRETEST_TRIM14:
		if (argc != 3) {
			shell_fprintf(shell, SHELL_ERROR,
				"invalid # of args for field %d (expected 3) : %d\n", field, argc);
			return -ENOEXEC;
		}
		write_val  = strtoul(argv[2], NULL, 0);
		status = write_otp_memory(field, &write_val);
		break;
	default:
		shell_fprintf(shell, SHELL_ERROR, "unsupported field %d\n", field);
		return -ENOEXEC;
	}

	if (!status) {
		shell_fprintf(shell, SHELL_INFO, "Finished Writing Retrim param\n");
	}

	return 0;
}

SHELL_STATIC_SUBCMD_SET_CREATE(
	nrf_wifi_radio_otp_subcmds,
	SHELL_CMD_ARG(otp_get_status,
			  NULL,
			  "Read OTP status",
			  nrf_wifi_radio_test_otp_get_status,
			  1,
			  0),
	SHELL_CMD_ARG(otp_read_params,
			  NULL,
			  "Read User region status and information on programmed fields",
			  nrf_wifi_radio_test_otp_read_params,
			  1,
			  0),
	SHELL_CMD_ARG(otp_read_retrim_version,
			  NULL,
			  "Read Retrim Version",
			  nrf_wifi_radio_test_otp_read_retrim_version,
			  1,
			  0),
	SHELL_CMD_ARG(otp_read_retrim_params,
			  NULL,
			  "Read Retrim Params",
			  nrf_wifi_radio_test_otp_read_retrim_params,
			  1,
			  0),
	SHELL_CMD_ARG(otp_write_params,
			  NULL,
			  "Write OTP Params\n"
			  "otp_write_params <addr offset> [arg1] [arg2]...[argN]",
			  nrf_wifi_radio_test_otp_write_params,
			  2,
			  16),
	SHELL_CMD_ARG(otp_write_retrim_version,
			  NULL,
			  "Write OTP Retrim Version\n"
			  "otp_write_retrim_version <retrim version>",
			  nrf_wifi_radio_test_otp_write_retrim_version,
			  2,
			  0),
	SHELL_CMD_ARG(otp_write_retrim_params,
			  NULL,
			  "Write OTP Retrim Params\n"
			  "otp_write_params <retrim index> [retrim data]",
			  nrf_wifi_radio_test_otp_write_retrim_params,
			  3,
			  0),
	SHELL_SUBCMD_SET_END);


SHELL_CMD_REGISTER(wifi_radio_ficr_prog,
		   &nrf_wifi_radio_otp_subcmds,
		   "nRF Wi-Fi radio FICR commands",
		   NULL);


static int nrf_wifi_radio_otp_shell_init(void)
{

	return 0;
}


SYS_INIT(nrf_wifi_radio_otp_shell_init,
	 APPLICATION,
	 CONFIG_APPLICATION_INIT_PRIORITY);
```
