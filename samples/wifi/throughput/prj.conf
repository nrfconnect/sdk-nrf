## CMakeLists.txt
```
#
# Copyright (c) 2023 Nordic Semiconductor ASA
#
# SPDX-License-Identifier: LicenseRef-Nordic-5-Clause
#

cmake_minimum_required(VERSION 3.20.0)

find_package(Zephyr REQUIRED HINTS $ENV{ZEPHYR_BASE})
project(nrf_wifi_throughput)

target_include_directories(app PUBLIC ${ZEPHYR_BASE}/subsys/net/lib)

target_sources(app PRIVATE src/main.c)
```

## sample.yaml
```
sample:
  description: Wi-Fi throughput sample application
  name: Wi-Fi throughput
tests:
  sample.nrf7002.throughput:
    sysbuild: true
    build_only: true
    integration_platforms:
      - nrf7002dk/nrf5340/cpuapp
    platform_allow: nrf7002dk/nrf5340/cpuapp
    tags:
      - ci_build
      - sysbuild
      - ci_samples_wifi
  sample.nrf7002eb_interposer_p1.nrf7002eb.throughput:
    sysbuild: true
    build_only: true
    extra_args:
      - throughput_SHIELD="nrf7002eb_interposer_p1;nrf7002eb"
      - throughput_SNIPPET=nrf70-wifi
    integration_platforms:
      - nrf54h20dk/nrf54h20/cpuapp
    platform_allow:
      - nrf54h20dk/nrf54h20/cpuapp
    tags:
      - ci_build
      - sysbuild
      - ci_samples_wifi
  # Used by QA to measure memory footprints
  sample.nrf7002.iot_devices:
    sysbuild: true
    build_only: true
    extra_args: EXTRA_CONF_FILE=overlay-iot-devices.conf
    integration_platforms:
      - nrf7002dk/nrf5340/cpuapp
    platform_allow: nrf7002dk/nrf5340/cpuapp
    tags:
      - ci_build
      - sysbuild
      - ci_samples_wifi
  sample.nrf7002.high_performance:
    sysbuild: true
    build_only: true
    extra_args: EXTRA_CONF_FILE=overlay-high-performance.conf
    integration_platforms:
      - nrf7002dk/nrf5340/cpuapp
    platform_allow: nrf7002dk/nrf5340/cpuapp
    tags:
      - ci_build
      - sysbuild
      - ci_samples_wifi
  sample.nrf7002.memory_optimized:
    sysbuild: true
    build_only: true
    extra_args: EXTRA_CONF_FILE=overlay-memory-optimized.conf
    integration_platforms:
      - nrf7002dk/nrf5340/cpuapp
    platform_allow: nrf7002dk/nrf5340/cpuapp
    tags:
      - ci_build
      - sysbuild
      - ci_samples_wifi
  sample.nrf7002.rx_prioritized:
    sysbuild: true
    build_only: true
    extra_args: EXTRA_CONF_FILE=overlay-rx-prio.conf
    integration_platforms:
      - nrf7002dk/nrf5340/cpuapp
    platform_allow: nrf7002dk/nrf5340/cpuapp
    tags:
      - ci_build
      - sysbuild
      - ci_samples_wifi
  sample.nrf7002.tx_prioritized:
    sysbuild: true
    build_only: true
    extra_args: EXTRA_CONF_FILE=overlay-tx-prio.conf
    integration_platforms:
      - nrf7002dk/nrf5340/cpuapp
    platform_allow: nrf7002dk/nrf5340/cpuapp
    tags:
      - ci_build
      - sysbuild
      - ci_samples_wifi
  sample.nrf54lm20.iot_devices:
    sysbuild: true
    build_only: true
    extra_args:
      - EXTRA_CONF_FILE=overlay-iot-devices.conf
      - throughput_SHIELD=nrf7002eb2
    integration_platforms:
      - nrf54lm20dk/nrf54lm20a/cpuapp
      - nrf54lm20dk/nrf54lm20b/cpuapp
    platform_allow:
      - nrf54lm20dk/nrf54lm20a/cpuapp
      - nrf54lm20dk/nrf54lm20b/cpuapp
    tags:
      - ci_build
      - sysbuild
      - ci_samples_wifi
  sample.nrf54lm20.high_performance:
    sysbuild: true
    build_only: true
    extra_args:
      - EXTRA_CONF_FILE=overlay-high-performance.conf
      - throughput_SHIELD=nrf7002eb2
    integration_platforms:
      - nrf54lm20dk/nrf54lm20a/cpuapp
      - nrf54lm20dk/nrf54lm20b/cpuapp
    platform_allow:
      - nrf54lm20dk/nrf54lm20a/cpuapp
      - nrf54lm20dk/nrf54lm20b/cpuapp
    tags:
      - ci_build
      - sysbuild
      - ci_samples_wifi
  sample.nrf54lm20.memory_optimized:
    sysbuild: true
    build_only: true
    extra_args:
      - EXTRA_CONF_FILE=overlay-memory-optimized.conf
      - throughput_SHIELD=nrf7002eb2
    integration_platforms:
      - nrf54lm20dk/nrf54lm20a/cpuapp
      - nrf54lm20dk/nrf54lm20b/cpuapp
    platform_allow:
      - nrf54lm20dk/nrf54lm20a/cpuapp
      - nrf54lm20dk/nrf54lm20b/cpuapp
    tags:
      - ci_build
      - sysbuild
      - ci_samples_wifi
  sample.nrf54lm20.rx_prioritized:
    sysbuild: true
    build_only: true
    extra_args:
      - EXTRA_CONF_FILE=overlay-rx-prio.conf
      - throughput_SHIELD=nrf7002eb2
    integration_platforms:
      - nrf54lm20dk/nrf54lm20a/cpuapp
      - nrf54lm20dk/nrf54lm20b/cpuapp
    platform_allow:
      - nrf54lm20dk/nrf54lm20a/cpuapp
      - nrf54lm20dk/nrf54lm20b/cpuapp
    tags:
      - ci_build
      - sysbuild
      - ci_samples_wifi
  sample.nrf54lm20.tx_prioritized:
    sysbuild: true
    build_only: true
    extra_args:
      - EXTRA_CONF_FILE=overlay-tx-prio.conf
      - throughput_SHIELD=nrf7002eb2
    integration_platforms:
      - nrf54lm20dk/nrf54lm20a/cpuapp
      - nrf54lm20dk/nrf54lm20b/cpuapp
    platform_allow:
      - nrf54lm20dk/nrf54lm20a/cpuapp
      - nrf54lm20dk/nrf54lm20b/cpuapp
    tags:
      - ci_build
      - sysbuild
      - ci_samples_wifi
  sample.nrf7120.iot_devices:
    sysbuild: true
    build_only: true
    extra_args:
      - EXTRA_CONF_FILE=nrf71-iot-devices.conf
      - EXTRA_DTC_OVERLAY_FILE=${ZEPHYR_NRFXLIB_MODULE_DIR}/nrf71_wifi/bins/0.1.0/nrf7120_wifi_patch.dtsi
      - CONFIG_WIFI_NRF71_PATCH=y
    integration_platforms:
      - nrf7120dk/nrf7120/cpuapp
      - nrf7120dk/nrf7120/cpuapp/ns
    platform_allow:
      - nrf7120dk/nrf7120/cpuapp
      - nrf7120dk/nrf7120/cpuapp/ns
    tags:
      - ci_build
      - sysbuild
      - ci_samples_nrf71_wifi
  sample.nrf7120.high_performance:
    sysbuild: true
    build_only: true
    extra_args:
      - EXTRA_CONF_FILE=nrf71-high-performance.conf
      - EXTRA_DTC_OVERLAY_FILE=${ZEPHYR_NRFXLIB_MODULE_DIR}/nrf71_wifi/bins/0.1.0/nrf7120_wifi_patch.dtsi
      - CONFIG_WIFI_NRF71_PATCH=y
    integration_platforms:
      - nrf7120dk/nrf7120/cpuapp
      - nrf7120dk/nrf7120/cpuapp/ns
    platform_allow:
      - nrf7120dk/nrf7120/cpuapp
      - nrf7120dk/nrf7120/cpuapp/ns
    tags:
      - ci_build
      - sysbuild
      - ci_samples_nrf71_wifi
  sample.nrf7120.memory_optimized:
    sysbuild: true
    build_only: true
    extra_args:
      - EXTRA_CONF_FILE=nrf71-memory-optimized.conf
      - EXTRA_DTC_OVERLAY_FILE=${ZEPHYR_NRFXLIB_MODULE_DIR}/nrf71_wifi/bins/0.1.0/nrf7120_wifi_patch.dtsi
      - CONFIG_WIFI_NRF71_PATCH=y
    integration_platforms:
      - nrf7120dk/nrf7120/cpuapp
      - nrf7120dk/nrf7120/cpuapp/ns
    platform_allow:
      - nrf7120dk/nrf7120/cpuapp
      - nrf7120dk/nrf7120/cpuapp/ns
    tags:
      - ci_build
      - sysbuild
      - ci_samples_nrf71_wifi
  sample.nrf7120.rx_prioritized:
    sysbuild: true
    build_only: true
    extra_args:
      - EXTRA_CONF_FILE=nrf71-rx-prio.conf
      - EXTRA_DTC_OVERLAY_FILE=${ZEPHYR_NRFXLIB_MODULE_DIR}/nrf71_wifi/bins/0.1.0/nrf7120_wifi_patch.dtsi
      - CONFIG_WIFI_NRF71_PATCH=y
    integration_platforms:
      - nrf7120dk/nrf7120/cpuapp
      - nrf7120dk/nrf7120/cpuapp/ns
    platform_allow:
      - nrf7120dk/nrf7120/cpuapp
      - nrf7120dk/nrf7120/cpuapp/ns
    tags:
      - ci_build
      - sysbuild
      - ci_samples_nrf71_wifi
  sample.nrf7120.tx_prioritized:
    sysbuild: true
    build_only: true
    extra_args:
      - EXTRA_CONF_FILE=nrf71-tx-prio.conf
      - EXTRA_DTC_OVERLAY_FILE=${ZEPHYR_NRFXLIB_MODULE_DIR}/nrf71_wifi/bins/0.1.0/nrf7120_wifi_patch.dtsi
      - CONFIG_WIFI_NRF71_PATCH=y
    integration_platforms:
      - nrf7120dk/nrf7120/cpuapp
      - nrf7120dk/nrf7120/cpuapp/ns
    platform_allow:
      - nrf7120dk/nrf7120/cpuapp
      - nrf7120dk/nrf7120/cpuapp/ns
    tags:
      - ci_build
      - sysbuild
      - ci_samples_nrf71_wifi
```

## prj.conf
```kconfig
#
# Copyright (c) 2023 Nordic Semiconductor ASA
#
# SPDX-License-Identifier: LicenseRef-Nordic-5-Clause
#
CONFIG_WIFI=y
CONFIG_WIFI_NRF70=y

# WPA supplicant
CONFIG_WIFI_NM_WPA_SUPPLICANT=y
CONFIG_NET_L2_WIFI_SHELL=y

CONFIG_NET_ZPERF=y
CONFIG_NET_ZPERF_SERVER=y

# Networking
CONFIG_NETWORKING=y
CONFIG_NET_SOCKETS=y
CONFIG_NET_LOG=y
CONFIG_NET_IPV6=y
CONFIG_NET_IPV4=y
CONFIG_NET_UDP=y
CONFIG_NET_TCP=y
CONFIG_NET_DHCPV4=y
CONFIG_DNS_RESOLVER=y

CONFIG_NET_STATISTICS=y
CONFIG_NET_STATISTICS_WIFI=y
CONFIG_NET_STATISTICS_USER_API=y

CONFIG_NET_PKT_RX_COUNT=8
CONFIG_NET_PKT_TX_COUNT=8

# Below section is the primary contributor to SRAM and is currently
# tuned for performance, but this will be revisited in the future.
CONFIG_NET_BUF_RX_COUNT=16
CONFIG_NET_BUF_TX_COUNT=16
CONFIG_NET_TC_TX_COUNT=1

CONFIG_NET_IF_UNICAST_IPV6_ADDR_COUNT=4
CONFIG_NET_IF_MCAST_IPV6_ADDR_COUNT=5
CONFIG_NET_MAX_CONTEXTS=5
CONFIG_NET_CONTEXT_SYNC_RECV=y

CONFIG_INIT_STACKS=y

CONFIG_NET_L2_ETHERNET=y
CONFIG_NET_SHELL=y
CONFIG_ZVFS_POLL_MAX=12

# Memories
CONFIG_MAIN_STACK_SIZE=5200
CONFIG_SHELL_STACK_SIZE=5200
CONFIG_NET_TX_STACK_SIZE=4096
CONFIG_NET_RX_STACK_SIZE=4096

# Debugging
CONFIG_STACK_SENTINEL=y
CONFIG_DEBUG_COREDUMP=y
CONFIG_DEBUG_COREDUMP_BACKEND_LOGGING=y
CONFIG_DEBUG_COREDUMP_MEMORY_DUMP_MIN=y
CONFIG_SHELL_CMDS_RESIZE=n
#CONFIG_DEBUG=y
CONFIG_WIFI_NM_WPA_SUPPLICANT_LOG_LEVEL_INF=y

# Kernel options
CONFIG_ENTROPY_GENERATOR=y

# Logging
CONFIG_LOG=y
CONFIG_PRINTK=y
CONFIG_SHELL=y
CONFIG_SHELL_GETOPT=y
CONFIG_DEVICE_SHELL=y
CONFIG_POSIX_TIMERS=y
CONFIG_DATE_SHELL=y
CONFIG_NET_CONFIG_AUTO_INIT=n

# Disabled to avoid pulling in CONFIG_THREAD_RUNTIME_STATS, whose
# per-context-switch overhead reduces throughput.
CONFIG_POSIX_MULTI_PROCESS=n

CONFIG_WIFI_CREDENTIALS=y
CONFIG_FLASH=y
CONFIG_FLASH_PAGE_LAYOUT=y
CONFIG_FLASH_MAP=y
CONFIG_NVS=y
CONFIG_SETTINGS=y
CONFIG_SETTINGS_NVS=y

# printing of scan results puts pressure on queues in new locking
# design in net_mgmt. So, use a higher timeout for a crowded
# environment.
CONFIG_NET_MGMT_EVENT_QUEUE_TIMEOUT=5000
```

## nrf71-high-performance.conf
```kconfig
CONFIG_NRF71_WIFI_AP_SUPPORT=n
CONFIG_NRF71_WIFI_P2P_SUPPORT=n
CONFIG_NET_PKT_TX_COUNT=40
CONFIG_NET_PKT_RX_COUNT=40
CONFIG_NET_BUF_TX_COUNT=80
CONFIG_NET_BUF_RX_COUNT=40
CONFIG_NRF71_WIFI_RX_NUM_BUFS=24
CONFIG_NRF71_WIFI_CTRL_HEAP_SIZE=25000
CONFIG_NRF71_WIFI_DATA_HEAP_SIZE=250000
CONFIG_SPEED_OPTIMIZATIONS=y
CONFIG_PICOLIBC_USE_MODULE=y
CONFIG_CACHE_MANAGEMENT=y
CONFIG_NRF71_WIFI_UTIL_SHELL=n
CONFIG_NRF71_WIFI_MAX_TX_AGGREGATION=7
CONFIG_NRF71_WIFI_MAX_TX_TOKENS=12
CONFIG_NRF71_WIFI_MAX_TX_PENDING_QLEN=36
CONFIG_ZVFS_POLL_MAX=20
# Sockets: select + poll take up more stack
CONFIG_MAIN_STACK_SIZE=5200
CONFIG_SHELL_STACK_SIZE=5200
CONFIG_NET_MGMT_EVENT_STACK_SIZE=4600

CONFIG_NET_PKT_BUF_TX_DATA_POOL_SIZE=90000
CONFIG_NET_PKT_BUF_RX_DATA_POOL_SIZE=60000
CONFIG_NET_TCP_MAX_SEND_WINDOW_SIZE=32768
CONFIG_NET_TCP_MAX_RECV_WINDOW_SIZE=32768
CONFIG_NET_CONTEXT_SNDBUF=y
CONFIG_NET_CONTEXT_RCVBUF=y

CONFIG_NET_ZPERF_MAX_PACKET_SIZE=1600
CONFIG_NET_ZPERF_TCP_RECEIVER_BUF_SIZE=2048
# Only for async zperf
CONFIG_ZPERF_WORK_Q_THREAD_PRIORITY=5

# Avoid per-context-switch scheduler overhead
CONFIG_THREAD_MONITOR=n
CONFIG_TIMESLICING=n
```

## nrf71-iot-devices.conf
```kconfig
CONFIG_NRF71_WIFI_AP_SUPPORT=n
CONFIG_NRF71_WIFI_P2P_SUPPORT=n
CONFIG_NET_PKT_TX_COUNT=6
CONFIG_NET_PKT_RX_COUNT=8
CONFIG_NET_BUF_TX_COUNT=12
CONFIG_NET_BUF_RX_COUNT=8
CONFIG_NRF71_WIFI_RX_NUM_BUFS=8
CONFIG_NRF71_WIFI_CTRL_HEAP_SIZE=25000
CONFIG_NRF71_WIFI_DATA_HEAP_SIZE=30000
CONFIG_SPEED_OPTIMIZATIONS=y
CONFIG_PICOLIBC_USE_MODULE=y
CONFIG_CACHE_MANAGEMENT=y
CONFIG_NRF70_QSPI_LOW_POWER=n
CONFIG_NRF71_WIFI_UTIL_SHELL=n
CONFIG_NRF71_WIFI_MAX_TX_AGGREGATION=1
CONFIG_NRF71_WIFI_MAX_TX_TOKENS=5
CONFIG_ZVFS_POLL_MAX=20
# Sockets: select + poll take up more stack
CONFIG_MAIN_STACK_SIZE=5200
CONFIG_SHELL_STACK_SIZE=5200
CONFIG_NET_MGMT_EVENT_STACK_SIZE=4600

CONFIG_NET_PKT_BUF_TX_DATA_POOL_SIZE=15000
CONFIG_NET_PKT_BUF_RX_DATA_POOL_SIZE=6400
# Pinned so TCP RX does not shrink with the smaller RX pool
CONFIG_NET_TCP_MAX_RECV_WINDOW_SIZE=4266
CONFIG_NET_CONTEXT_SNDBUF=y
CONFIG_NET_CONTEXT_RCVBUF=y

CONFIG_NET_ZPERF_MAX_PACKET_SIZE=1600
CONFIG_NET_ZPERF_TCP_RECEIVER_BUF_SIZE=2048
# Only for async zperf
CONFIG_ZPERF_WORK_Q_THREAD_PRIORITY=5

# Avoid per-context-switch scheduler overhead
CONFIG_THREAD_MONITOR=n
CONFIG_TIMESLICING=n
```

## nrf71-memory-optimized.conf
```kconfig
CONFIG_NRF71_WIFI_AP_SUPPORT=n
CONFIG_NRF71_WIFI_P2P_SUPPORT=n
CONFIG_NET_PKT_TX_COUNT=6
CONFIG_NET_PKT_RX_COUNT=6
CONFIG_NET_BUF_TX_COUNT=12
CONFIG_NET_BUF_RX_COUNT=6
CONFIG_NRF71_WIFI_RX_NUM_BUFS=6
CONFIG_NRF71_WIFI_CTRL_HEAP_SIZE=25000
CONFIG_NRF71_WIFI_DATA_HEAP_SIZE=25000
CONFIG_SPEED_OPTIMIZATIONS=y
CONFIG_PICOLIBC_USE_MODULE=y
CONFIG_CACHE_MANAGEMENT=y
CONFIG_NRF71_WIFI_UTIL_SHELL=n
CONFIG_NRF71_WIFI_MAX_TX_AGGREGATION=1
CONFIG_NRF71_WIFI_MAX_TX_TOKENS=5
CONFIG_ZVFS_POLL_MAX=20
# Sockets: select + poll take up more stack
CONFIG_MAIN_STACK_SIZE=5200
CONFIG_SHELL_STACK_SIZE=5200
CONFIG_NET_MGMT_EVENT_STACK_SIZE=4600

CONFIG_NET_PKT_BUF_TX_DATA_POOL_SIZE=8192
CONFIG_NET_PKT_BUF_RX_DATA_POOL_SIZE=8192
CONFIG_NET_CONTEXT_SNDBUF=y
CONFIG_NET_CONTEXT_RCVBUF=y

CONFIG_NET_ZPERF_MAX_PACKET_SIZE=1600
CONFIG_NET_ZPERF_TCP_RECEIVER_BUF_SIZE=2048
# Only for async zperf
CONFIG_ZPERF_WORK_Q_THREAD_PRIORITY=5

# Avoid per-context-switch scheduler overhead
CONFIG_THREAD_MONITOR=n
CONFIG_TIMESLICING=n
```

## nrf71-rx-prio.conf
```kconfig
CONFIG_NRF71_WIFI_AP_SUPPORT=n
CONFIG_NRF71_WIFI_P2P_SUPPORT=n
CONFIG_NET_PKT_TX_COUNT=10
CONFIG_NET_PKT_RX_COUNT=64
CONFIG_NET_BUF_TX_COUNT=20
CONFIG_NET_BUF_RX_COUNT=64
CONFIG_NRF71_WIFI_RX_NUM_BUFS=24
CONFIG_NRF71_WIFI_CTRL_HEAP_SIZE=25000
CONFIG_NRF71_WIFI_DATA_HEAP_SIZE=250000
CONFIG_SPEED_OPTIMIZATIONS=y
CONFIG_PICOLIBC_USE_MODULE=y
CONFIG_CACHE_MANAGEMENT=y
CONFIG_NRF70_QSPI_LOW_POWER=n
CONFIG_NRF71_WIFI_UTIL_SHELL=n
CONFIG_NRF71_WIFI_MAX_TX_AGGREGATION=2
CONFIG_NRF71_WIFI_MAX_TX_TOKENS=5
CONFIG_ZVFS_POLL_MAX=20
# Sockets: select + poll take up more stack
CONFIG_MAIN_STACK_SIZE=5200
CONFIG_SHELL_STACK_SIZE=5200
CONFIG_NET_MGMT_EVENT_STACK_SIZE=4600

CONFIG_NET_PKT_BUF_TX_DATA_POOL_SIZE=20000
CONFIG_NET_PKT_BUF_RX_DATA_POOL_SIZE=110000
CONFIG_NET_TCP_MAX_RECV_WINDOW_SIZE=65535
CONFIG_NET_CONTEXT_SNDBUF=y
CONFIG_NET_CONTEXT_RCVBUF=y

CONFIG_NET_ZPERF_MAX_PACKET_SIZE=1600
CONFIG_NET_ZPERF_TCP_RECEIVER_BUF_SIZE=2048
# Only for async zperf
CONFIG_ZPERF_WORK_Q_THREAD_PRIORITY=5

# Avoid per-context-switch scheduler overhead
CONFIG_THREAD_MONITOR=n
CONFIG_TIMESLICING=n
```

## nrf71-tx-prio.conf
```kconfig
CONFIG_NRF71_WIFI_AP_SUPPORT=n
CONFIG_NRF71_WIFI_P2P_SUPPORT=n
CONFIG_NET_PKT_TX_COUNT=64
CONFIG_NET_PKT_RX_COUNT=10
CONFIG_NET_BUF_TX_COUNT=128
CONFIG_NET_BUF_RX_COUNT=10
CONFIG_NRF71_WIFI_RX_NUM_BUFS=10
CONFIG_NRF71_WIFI_CTRL_HEAP_SIZE=25000
CONFIG_NRF71_WIFI_DATA_HEAP_SIZE=250000
CONFIG_SPEED_OPTIMIZATIONS=y
CONFIG_PICOLIBC_USE_MODULE=y
CONFIG_CACHE_MANAGEMENT=y
CONFIG_NRF71_WIFI_UTIL_SHELL=n
CONFIG_NRF71_WIFI_MAX_TX_AGGREGATION=7
CONFIG_NRF71_WIFI_MAX_TX_TOKENS=12
CONFIG_NRF71_WIFI_MAX_TX_PENDING_QLEN=48
CONFIG_ZVFS_POLL_MAX=20
# Sockets: select + poll take up more stack
CONFIG_MAIN_STACK_SIZE=5200
CONFIG_SHELL_STACK_SIZE=5200
CONFIG_NET_MGMT_EVENT_STACK_SIZE=4600

CONFIG_NET_PKT_BUF_TX_DATA_POOL_SIZE=130000
CONFIG_NET_PKT_BUF_RX_DATA_POOL_SIZE=16000
CONFIG_NET_TCP_MAX_SEND_WINDOW_SIZE=65535
CONFIG_NET_CONTEXT_SNDBUF=y
CONFIG_NET_CONTEXT_RCVBUF=y

CONFIG_NET_ZPERF_MAX_PACKET_SIZE=1600
CONFIG_NET_ZPERF_TCP_RECEIVER_BUF_SIZE=2048
# Only for async zperf
CONFIG_ZPERF_WORK_Q_THREAD_PRIORITY=5

# Avoid per-context-switch scheduler overhead
CONFIG_THREAD_MONITOR=n
CONFIG_TIMESLICING=n
```

## overlay-high-performance.conf
```kconfig
CONFIG_NRF70_AP_MODE=n
CONFIG_NRF70_P2P_MODE=n
CONFIG_NET_PKT_TX_COUNT=30
CONFIG_NET_PKT_RX_COUNT=27
CONFIG_NET_BUF_TX_COUNT=60
CONFIG_NET_BUF_RX_COUNT=27
CONFIG_NRF70_RX_NUM_BUFS=48
CONFIG_NRF_WIFI_CTRL_HEAP_SIZE=15000
CONFIG_NRF_WIFI_DATA_HEAP_SIZE=204856
CONFIG_SPEED_OPTIMIZATIONS=y
CONFIG_NRF70_QSPI_LOW_POWER=n
CONFIG_NRF70_UTIL=n
CONFIG_NRF70_MAX_TX_AGGREGATION=9
CONFIG_NRF70_MAX_TX_TOKENS=12
CONFIG_ZVFS_POLL_MAX=20
# Sockets: select + poll take up more stack
CONFIG_MAIN_STACK_SIZE=5200
CONFIG_SHELL_STACK_SIZE=5200
CONFIG_NET_MGMT_EVENT_STACK_SIZE=4600

CONFIG_NET_PKT_BUF_TX_DATA_POOL_SIZE=45000
CONFIG_NET_PKT_BUF_RX_DATA_POOL_SIZE=25000
```

## src/main.c
```c
/*
 * Copyright (c) 2023 Nordic Semiconductor ASA
 *
 * SPDX-License-Identifier: LicenseRef-Nordic-5-Clause
 */

/** @file
 * @brief WiFi Throughput sample
 */

#include <zephyr/sys/printk.h>
#include <zephyr/kernel.h>
#if defined(CONFIG_NRFX_CLOCK_HFCLK) && defined(CLOCK_FEATURE_HFCLK_DIVIDE_PRESENT)
#include <zephyr/drivers/clock_control/nrf_clock_control.h>

#define HFCLK_REQUESTED_FREQUENCY MHZ(128)
#endif
#include <stdio.h>

int main(void)
{
#if defined(CONFIG_NRFX_CLOCK_HFCLK) && defined(CLOCK_FEATURE_HFCLK_DIVIDE_PRESENT)
	clock_control_set_rate(DEVICE_DT_GET_ONE(nordic_nrf_clock_hfclk), NULL,
			       (clock_control_subsys_rate_t)HFCLK_REQUESTED_FREQUENCY);
#endif
	printk("Starting %s with CPU frequency: %d MHz\n", CONFIG_BOARD, SystemCoreClock/MHZ(1));

	return 0;
}
```
