## CMakeLists.txt
```
#
# Copyright (c) 2022 Nordic Semiconductor ASA
#
# SPDX-License-Identifier: LicenseRef-Nordic-5-Clause
#

cmake_minimum_required(VERSION 3.20.0)

find_package(Zephyr REQUIRED HINTS $ENV{ZEPHYR_BASE})
project(nrf_wifi_sta)

target_include_directories(app PUBLIC ${ZEPHYR_BASE}/subsys/net/ip)

target_sources(app PRIVATE src/main.c)
target_sources_ifdef(CONFIG_SAMPLE_STA_LED_SUPPORT app PRIVATE src/led.c)
```

## Kconfig
```
#
# Copyright (c) 2022 Nordic Semiconductor
#
# SPDX-License-Identifier: LicenseRef-Nordic-5-Clause
#

source "Kconfig.zephyr"

menu "Nordic Sta sample"

config SAMPLE_STA_LED_SUPPORT
	bool "LED support"
	default y
	help
	  Enable LED indication for Wi-Fi connection and disconnection events.

config SAMPLE_STA_MAC_CONFIG_SUPPORT
	bool "MAC address configuration support"
	default y
	help
	  Enable setting a local MAC address when the nRF7002 OTP is not
	  programmed with a MAC address.

config CONNECTION_IDLE_TIMEOUT
	int "Time to be waited for a station to connect"
	default 30

config NRF70_QSPI_ENCRYPTION_KEY
	string "16 bytes QSPI encryption key, only for testing purposes"
	depends on BOARD_NRF7002DK_NRF5340_CPUAPP
	help
	  Specify the QSPI encryption key

config STA_CONN_TIMEOUT_SEC
	int "Overall Connection timeout i.e., time to be waited for a station to connect and get an IP address"
	# Zephyr DHCP retry is 1 minute, so set the default to 70 seconds
	default 70
	# 512 has no special meaning, just a reasonable upper limit
	range 0 512
	help
	  Specify the connection timeout, in seconds. This is the overall timeout i.e., time to be waited for
	  a station to connect and get an IP address. DHCP retries should be taken into account when setting
	  this value. If the timeout is set to 0, the connection will not timeout.

config STA_SAMPLE_START_WIFI_THREAD_STACK_SIZE
	int "Stack size for Wi-Fi start thread"
	default 4096
	help
	  Set the stack size for the Wi-Fi start thread.

config STA_SAMPLE_CONNECT_RETRY_DELAY_SEC
	int "Delay before retrying a failed Wi-Fi connection"
	default 5
	range 1 300
	help
	  Seconds to wait before issuing another connect request after a
	  failed attempt. Supplicant remains ready across connect failures;
	  this delay avoids tight retry loops.

endmenu
```

## Kconfig.sysbuild
```
#
# Copyright (c) 2024 Nordic Semiconductor ASA
#
# SPDX-License-Identifier: LicenseRef-Nordic-5-Clause
#

source "${ZEPHYR_NRF_MODULE_DIR}/samples/wifi/Kconfig.sysbuild.nrf70"

source "share/sysbuild/Kconfig"
```

## sample.yaml
```
sample:
  description: Wi-Fi station sample application
  name: Wi-Fi station
tests:
  sample.nrf7002.sta:
    sysbuild: true
    build_only: true
    integration_platforms:
      - nrf7002dk/nrf5340/cpuapp
    platform_allow: nrf7002dk/nrf5340/cpuapp
    tags:
      - ci_build
      - sysbuild
      - ci_samples_wifi
  sample.nrf7002.sta.no_wifi_ready:
    sysbuild: true
    build_only: true
    extra_args: CONFIG_WIFI_READY_LIB=n
    integration_platforms:
      - nrf7002dk/nrf5340/cpuapp
    platform_allow: nrf7002dk/nrf5340/cpuapp
    tags:
      - ci_build
      - sysbuild
      - ci_samples_wifi
  sample.nrf7001.sta:
    sysbuild: true
    build_only: true
    integration_platforms:
      - nrf7002dk/nrf5340/cpuapp/nrf7001
    platform_allow: nrf7002dk/nrf5340/cpuapp/nrf7001
    tags:
      - ci_build
      - sysbuild
      - ci_samples_wifi
    skip: true
  sample.nrf7002_eks.sta:
    sysbuild: true
    build_only: true
    extra_args: SHIELD=nrf7002ek
    integration_platforms:
      - nrf5340dk/nrf5340/cpuapp
    platform_allow:
      - nrf5340dk/nrf5340/cpuapp
      - nrf52840dk/nrf52840
    extra_configs:
      - CONFIG_NET_TX_STACK_SIZE=3700
      - CONFIG_NET_RX_STACK_SIZE=3700
    tags:
      - ci_build
      - sysbuild
      - ci_samples_wifi
  sample.nrf7001_eks.sta:
    sysbuild: true
    build_only: true
    extra_args: SHIELD=nrf7002ek_nrf7001
    integration_platforms:
      - nrf52840dk/nrf52840
    platform_allow:
      - nrf5340dk/nrf5340/cpuapp
      - nrf52840dk/nrf52840
    extra_configs:
      - CONFIG_NET_TX_STACK_SIZE=3700
      - CONFIG_NET_RX_STACK_SIZE=3700
    tags:
      - ci_build
      - sysbuild
      - ci_samples_wifi
  sample.nrf7002_eb.thingy53.sta:
    sysbuild: true
    build_only: true
    extra_args: sta_SHIELD=nrf7002eb
    integration_platforms:
      - thingy53/nrf5340/cpuapp
    platform_allow: thingy53/nrf5340/cpuapp
    tags:
      - ci_build
      - sysbuild
      - ci_samples_wifi
  sample.nrf7002eb_interposer_p1.nrf7002eb.sta:
    sysbuild: true
    build_only: true
    extra_args:
      - sta_SHIELD="nrf7002eb_interposer_p1;nrf7002eb"
      - sta_SNIPPET=nrf70-wifi
    integration_platforms:
      - nrf54h20dk/nrf54h20/cpuapp
      - nrf54l15dk/nrf54l15/cpuapp
    platform_allow:
      - nrf54h20dk/nrf54h20/cpuapp
      - nrf54l15dk/nrf54l15/cpuapp
    tags:
      - ci_build
      - sysbuild
      - ci_samples_wifi
  sample.nrf7002eb2.sta:
    sysbuild: true
    build_only: true
    extra_args:
      - sta_SHIELD="nrf7002eb2"
      - SNIPPET=nrf70-wifi
    integration_platforms:
      - nrf54l15dk/nrf54l15/cpuapp
    platform_allow:
      - nrf54l15dk/nrf54l15/cpuapp
    tags:
      - ci_build
      - sysbuild
      - ci_samples_wifi
  sample.54lm20dk.nrf7002eb2.sta:
    sysbuild: true
    build_only: true
    extra_args:
      - sta_SHIELD="nrf7002eb2"
    integration_platforms:
      - nrf54lm20dk/nrf54lm20a/cpuapp
      - nrf54lm20dk/nrf54lm20b/cpuapp
    platform_allow:
      - nrf54lm20dk/nrf54lm20a/cpuapp
      - nrf54lm20dk/nrf54lm20b/cpuapp
    tags:
      - ci_build
      - sysbuild
      - ci_samples_wifi
  sample.nrf7120.sta:
    sysbuild: true
    build_only: true
    integration_platforms:
      - nrf7120dk/nrf7120/cpuapp
      - nrf7120dk/nrf7120/cpuapp/ns
    platform_allow:
      - nrf7120dk/nrf7120/cpuapp
      - nrf7120dk/nrf7120/cpuapp/ns
      - nrf7120dk/nrf7120e/cpuapp
      - nrf7120dk/nrf7120e/cpuapp/ns
    tags:
      - ci_build
      - sysbuild
      - ci_samples_nrf71_wifi
```

## prj.conf
```kconfig
#
# Copyright (c) 2022 Nordic Semiconductor ASA
#
# SPDX-License-Identifier: LicenseRef-Nordic-5-Clause
#
CONFIG_WIFI=y

# WPA supplicant
CONFIG_WIFI_NM_WPA_SUPPLICANT=y
CONFIG_WIFI_READY_LIB=y
CONFIG_NRF_WIFI_RPU_RECOVERY=y

CONFIG_WIFI_CREDENTIALS=y
CONFIG_WIFI_CREDENTIALS_STATIC=y
CONFIG_WIFI_CREDENTIALS_STATIC_SSID="Myssid_sta"
CONFIG_WIFI_CREDENTIALS_STATIC_PASSWORD="Mypassword"

# Networking
CONFIG_NETWORKING=y
CONFIG_NET_SOCKETS=y
CONFIG_NET_LOG=y
CONFIG_NET_IPV4=y
CONFIG_NET_UDP=y
CONFIG_NET_TCP=y
CONFIG_NET_DHCPV4=y

CONFIG_NET_PKT_RX_COUNT=16
CONFIG_NET_PKT_TX_COUNT=16

# Below section is the primary contributor to SRAM and is currently
# tuned for performance, but this will be revisited in the future.
CONFIG_NET_BUF_RX_COUNT=16
CONFIG_NET_BUF_TX_COUNT=32
CONFIG_HEAP_MEM_POOL_SIZE=37000
CONFIG_HEAP_MEM_POOL_IGNORE_MIN=y
CONFIG_NRF_WIFI_CTRL_HEAP_SIZE=20000
CONFIG_NRF_WIFI_DATA_HEAP_SIZE=40000
CONFIG_NET_TC_TX_COUNT=1

CONFIG_NET_IF_UNICAST_IPV4_ADDR_COUNT=1
CONFIG_NET_MAX_CONTEXTS=5
CONFIG_NET_CONTEXT_SYNC_RECV=y

CONFIG_INIT_STACKS=y

CONFIG_NET_L2_ETHERNET=y
CONFIG_NET_L2_ETHERNET_MGMT=y

CONFIG_NET_CONFIG_SETTINGS=y
CONFIG_NET_CONFIG_INIT_TIMEOUT=0

CONFIG_ZVFS_POLL_MAX=10

# Memories
CONFIG_MAIN_STACK_SIZE=5200
CONFIG_NET_TX_STACK_SIZE=4096
CONFIG_NET_RX_STACK_SIZE=4096
CONFIG_STA_SAMPLE_START_WIFI_THREAD_STACK_SIZE=5200

# Debugging
CONFIG_STACK_SENTINEL=y
CONFIG_DEBUG_COREDUMP=y
CONFIG_DEBUG_COREDUMP_BACKEND_LOGGING=y
CONFIG_DEBUG_COREDUMP_MEMORY_DUMP_MIN=y
CONFIG_SHELL_CMDS_RESIZE=n


# Kernel options
CONFIG_ENTROPY_GENERATOR=y

# Logging
CONFIG_LOG=y
CONFIG_LOG_BUFFER_SIZE=2048
CONFIG_POSIX_TIMERS=y

CONFIG_NET_CONFIG_MY_IPV4_ADDR="192.168.1.99"
CONFIG_NET_CONFIG_MY_IPV4_NETMASK="255.255.255.0"
CONFIG_NET_CONFIG_MY_IPV4_GW="192.168.1.1"

# printing of scan results puts pressure on queues in new locking
# design in net_mgmt. So, use a higher timeout for a crowded
# environment.
CONFIG_NET_MGMT_EVENT_QUEUE_TIMEOUT=5000
```

## overlay-zperf.conf
```kconfig
CONFIG_NET_ZPERF=y
CONFIG_NET_ZPERF_SERVER=y
# Mimic real-world conditions
CONFIG_NET_ZPERF_MAX_PACKET_SIZE=1500
CONFIG_NRF70_QSPI_LOW_POWER=n
# To enable optimization configuration options
CONFIG_PICOLIBC_USE_MODULE=y
CONFIG_SPEED_OPTIMIZATIONS=y
# Debug
CONFIG_NRF70_UTIL=y
CONFIG_SHELL=y
CONFIG_SHELL_STACK_SIZE=5200
CONFIG_NET_SHELL=y
CONFIG_SHELL_GETOPT=y
CONFIG_SHELL_CMDS_RESIZE=n
CONFIG_NRF70_UTIL=y
CONFIG_NET_L2_WIFI_SHELL=y
CONFIG_NET_STATISTICS=y
CONFIG_NET_STATISTICS_WIFI=y
CONFIG_NET_STATISTICS_USER_API=y
CONFIG_SYS_HEAP_RUNTIME_STATS=y

# Disable rate limiting to avoid log flooding (default is drop)
CONFIG_LOG_RATELIMIT=n
```

## boards/nrf52840dk_nrf52840.conf
```kconfig
CONFIG_WIFI_READY_LIB=n

#NRF70 specific configuration
CONFIG_WIFI_NRF70=y
CONFIG_NRF70_RX_NUM_BUFS=16
```

## boards/nrf54lm20dk_nrf54lm20b_cpuapp.conf
```kconfig
#
# Copyright (c) 2026 Nordic Semiconductor ASA
#
# SPDX-License-Identifier: LicenseRef-Nordic-5-Clause
#

#NRF70 specific configuration
CONFIG_WIFI_NRF70=y
CONFIG_NRF70_RX_NUM_BUFS=16
```

## boards/nrf7002dk_nrf5340_cpuapp.conf
```kconfig
#
# Copyright (c) 2026 Nordic Semiconductor ASA
#
# SPDX-License-Identifier: LicenseRef-Nordic-5-Clause
#

#NRF70 specific configuration
CONFIG_WIFI_NRF70=y
CONFIG_NRF70_RX_NUM_BUFS=16
CONFIG_NRF_WIFI_RPU_RECOVERY=y
CONFIG_NRF_WIFI_CTRL_HEAP_SIZE=20000
CONFIG_NRF_WIFI_DATA_HEAP_SIZE=40000
```

## boards/nrf7120dk_nrf7120_cpuapp.conf
```kconfig
#
# Copyright (c) 2026 Nordic Semiconductor
#
# SPDX-License-Identifier: LicenseRef-Nordic-5-Clause
#

CONFIG_NRF71_WIFI=y
CONFIG_NRF71_WIFI_RPU_RECOVERY=y
CONFIG_NRF71_WIFI_CTRL_HEAP_SIZE=20000
CONFIG_NRF71_WIFI_DATA_HEAP_SIZE=90000

CONFIG_SAMPLE_STA_LED_SUPPORT=n
CONFIG_SAMPLE_STA_MAC_CONFIG_SUPPORT=n

# Lower System ON idle current: see lib_nrf71_idle_power. Keep the
# default RAM_RETAIN_FULL tier; RAM_RETAIN_USED_ONLY has been observed
# to cause issues on Wi-Fi builds.
CONFIG_NRF71_IDLE_POWER=y

# This sample is primarily used for power measurements on this board;
# silence the console for a clean idle-current reading, matching the
# nrf71-idle-power-quiet snippet. NET_LOG selects LOG, so it has to be
# turned off explicitly too, or prj.conf's CONFIG_NET_LOG=y would keep
# forcing LOG back on.
CONFIG_NET_LOG=n
CONFIG_SERIAL=n
CONFIG_CONSOLE=n
CONFIG_UART_CONSOLE=n
CONFIG_DEBUG_COREDUMP=n
CONFIG_LOG=n
CONFIG_PRINTK=n
CONFIG_BOOT_BANNER=n
CONFIG_NCS_BOOT_BANNER=n
```

## boards/nrf7120dk_nrf7120_cpuapp_ns.conf
```kconfig
#
# Copyright (c) 2026 Nordic Semiconductor
#
# SPDX-License-Identifier: LicenseRef-Nordic-5-Clause
#

# Lower System ON idle current: see lib_nrf71_idle_power. Keep the
# default RAM_RETAIN_FULL tier; RAM_RETAIN_USED_ONLY has been observed
# to cause issues on Wi-Fi builds.
CONFIG_NRF71_IDLE_POWER=y

# This sample is primarily used for power measurements on this board;
# silence the console for a clean idle-current reading, matching the
# nrf71-idle-power-quiet snippet. NET_LOG selects LOG, so it has to be
# turned off explicitly too, or prj.conf's CONFIG_NET_LOG=y would keep
# forcing LOG back on.
CONFIG_NET_LOG=n
CONFIG_SERIAL=n
CONFIG_CONSOLE=n
CONFIG_UART_CONSOLE=n
CONFIG_DEBUG_COREDUMP=n
CONFIG_LOG=n
CONFIG_PRINTK=n
CONFIG_BOOT_BANNER=n
CONFIG_NCS_BOOT_BANNER=n
```

## app.overlay
```dts
/*
 * Copyright (c) 2026 Nordic Semiconductor ASA
 *
 * SPDX-License-Identifier: LicenseRef-Nordic-5-Clause
 */

/*
 * This overlay is applied to all boards and sets the local MAC address
 * for the Wi-Fi interface when the nRF70 OTP is not programmed.
 *
 * The MAC address should use a locally administered address (LAA) with
 * the second least significant bit of the first octet set to 1.
 * Nordic OUI prefix for LAA: F6:CE:36:xx:xx:xx
 */

&wlan0 {
	local-mac-address = [f6 ce 36 00 00 01];
};
```

## boards/thingy91x_nrf9151_ns.overlay
```dts
#include <thingy91x_wifi.dtsi>
```

## src/main.c
```c
/*
 * Copyright (c) 2022 Nordic Semiconductor ASA
 *
 * SPDX-License-Identifier: LicenseRef-Nordic-5-Clause
 */

/** @file
 * @brief WiFi station sample
 */

#include <zephyr/logging/log.h>
LOG_MODULE_REGISTER(sta, CONFIG_LOG_DEFAULT_LEVEL);

#include <zephyr/kernel.h>
#include <stdio.h>
#include <stdlib.h>
#include <zephyr/shell/shell.h>
#include <zephyr/sys/printk.h>
#include <zephyr/init.h>

#include <zephyr/net/net_if.h>
#include <zephyr/net/wifi_mgmt.h>
#include <zephyr/net/wifi.h>
#include <zephyr/net/net_event.h>

#ifdef CONFIG_WIFI_READY_LIB
#include <net/wifi_ready.h>
#endif /* CONFIG_WIFI_READY_LIB */

#ifdef CONFIG_SAMPLE_STA_LED_SUPPORT
#include "led.h"
#endif /* CONFIG_SAMPLE_STA_LED_SUPPORT */

#if defined(CONFIG_BOARD_NRF7002DK_NRF5340_CPUAPP_NRF7001) || \
	defined(CONFIG_BOARD_NRF7002DK_NRF5340_CPUAPP)
#include <zephyr/drivers/wifi/nrf_wifi/bus/qspi_if.h>
#endif

#include "net_private.h"

#if defined(CONFIG_NRF71_IDLE_POWER)
#include <nrf71_idle_power.h>
#endif

#define WIFI_SHELL_MODULE "wifi"

#ifdef CONFIG_SAMPLE_STA_MAC_CONFIG_SUPPORT
#include <zephyr/net/ethernet_mgmt.h>
/* DTS node for the Wi-Fi interface - MAC address from local-mac-address property */
#define WIFI_NODE DT_CHOSEN(zephyr_wifi)
static const uint8_t wifi_mac_addr[6] = DT_PROP_OR(WIFI_NODE, local_mac_address, {0});
#endif /* CONFIG_SAMPLE_STA_MAC_CONFIG_SUPPORT */

#define WIFI_SHELL_MGMT_EVENTS (NET_EVENT_WIFI_CONNECT_RESULT |		\
				NET_EVENT_WIFI_DISCONNECT_RESULT)

#define MAX_SSID_LEN        32
#define STATUS_POLLING_MS   300

static struct net_mgmt_event_callback wifi_shell_mgmt_cb;
static struct net_mgmt_event_callback net_shell_mgmt_cb;

#ifdef CONFIG_WIFI_READY_LIB
#define WIFI_READY_SYNC_TIMEOUT_S 10

static K_SEM_DEFINE(wifi_ready_state_changed_sem, 0, 1);
static bool wifi_ready_status;
static bool skip_next_ready_wait;
#endif /* CONFIG_WIFI_READY_LIB */

static struct {
	const struct shell *sh;
	union {
		struct {
			uint8_t connected	: 1;
			uint8_t connect_result	: 1;
			uint8_t disconnect_requested	: 1;
			uint8_t _unused		: 5;
		};
		uint8_t all;
	};
} context;

static int cmd_wifi_status(void)
{
	struct net_if *iface = net_if_get_default();
	struct wifi_iface_status status = { 0 };

	if (net_mgmt(NET_REQUEST_WIFI_IFACE_STATUS, iface, &status,
				sizeof(struct wifi_iface_status))) {
		LOG_INF("Status request failed");

		return -ENOEXEC;
	}

	LOG_INF("==================");
	LOG_INF("State: %s", wifi_state_txt(status.state));

	if (status.state >= WIFI_STATE_ASSOCIATED) {
		uint8_t mac_string_buf[sizeof("xx:xx:xx:xx:xx:xx")];

		LOG_INF("Interface Mode: %s",
		       wifi_mode_txt(status.iface_mode));
		LOG_INF("Link Mode: %s",
		       wifi_link_mode_txt(status.link_mode));
		LOG_INF("SSID: %.32s", status.ssid);
		LOG_INF("BSSID: %s",
		       net_sprint_ll_addr_buf(
				status.bssid, WIFI_MAC_ADDR_LEN,
				mac_string_buf, sizeof(mac_string_buf)));
		LOG_INF("Band: %s", wifi_band_txt(status.band));
		LOG_INF("Channel: %d", status.channel);
		LOG_INF("Security: %s", wifi_security_txt(status.security));
		LOG_INF("MFP: %s", wifi_mfp_txt(status.mfp));
		LOG_INF("RSSI: %d", status.rssi);
	}
	return 0;
}

static void handle_wifi_connect_result(struct net_mgmt_event_callback *cb)
{
	const struct wifi_status *status =
		(const struct wifi_status *) cb->info;

	if (context.connected) {
		return;
	}

	if (status->status) {
		if (status->status < WIFI_STATUS_CONN_LAST_STATUS) {
			LOG_ERR("Connection failed (%s)",
				wifi_conn_status_txt(status->status));
		} else {
			LOG_ERR("Connection failed (%d)", status->status);
		}
	} else {
		LOG_INF("Connected");
		context.connected = true;
#ifdef CONFIG_SAMPLE_STA_LED_SUPPORT
		led_set_connected(true);
#endif /* CONFIG_SAMPLE_STA_LED_SUPPORT */

	}

	context.connect_result = true;
}

static void handle_wifi_disconnect_result(struct net_mgmt_event_callback *cb)
{
	const struct wifi_status *status =
		(const struct wifi_status *) cb->info;

	if (!context.connected) {
		return;
	}

	if (context.disconnect_requested) {
		LOG_INF("Disconnection request %s (%d)",
			 status->status ? "failed" : "done",
					status->status);
		context.disconnect_requested = false;
	} else {
		LOG_INF("Received Disconnected");
		context.connected = false;
#ifdef CONFIG_SAMPLE_STA_LED_SUPPORT
		led_set_connected(false);
#endif /* CONFIG_SAMPLE_STA_LED_SUPPORT */
	}

	cmd_wifi_status();
}

static void wifi_mgmt_event_handler(struct net_mgmt_event_callback *cb,
				     uint64_t mgmt_event, struct net_if *iface)
{
	switch (mgmt_event) {
	case NET_EVENT_WIFI_CONNECT_RESULT:
		handle_wifi_connect_result(cb);
		break;
	case NET_EVENT_WIFI_DISCONNECT_RESULT:
		handle_wifi_disconnect_result(cb);
		break;
	default:
		break;
	}
}

static void print_dhcp_ip(struct net_mgmt_event_callback *cb)
{
	/* Get DHCP info from struct net_if_dhcpv4 and print */
	const struct net_if_dhcpv4 *dhcpv4 = cb->info;
	const struct in_addr *addr = &dhcpv4->requested_ip;
	char dhcp_info[128];

	net_addr_ntop(AF_INET, addr, dhcp_info, sizeof(dhcp_info));

	LOG_INF("DHCP IP address: %s", dhcp_info);
}
static void net_mgmt_event_handler(struct net_mgmt_event_callback *cb,
				    uint64_t mgmt_event, struct net_if *iface)
{
	switch (mgmt_event) {
	case NET_EVENT_IPV4_DHCP_BOUND:
		print_dhcp_ip(cb);
		break;
	default:
		break;
	}
}

static int wifi_connect(void)
{
	struct net_if *iface = net_if_get_first_wifi();

	context.connected = false;
	context.connect_result = false;

	if (net_mgmt(NET_REQUEST_WIFI_CONNECT_STORED, iface, NULL, 0)) {
		LOG_ERR("Connection request failed");

		return -ENOEXEC;
	}

	LOG_INF("Connection requested");

	return 0;
}

int bytes_from_str(const char *str, uint8_t *bytes, size_t bytes_len)
{
	size_t i;
	char byte_str[3];

	if (strlen(str) != bytes_len * 2) {
		LOG_ERR("Invalid string length: %zu (expected: %d)\n",
			strlen(str), bytes_len * 2);
		return -EINVAL;
	}

	for (i = 0; i < bytes_len; i++) {
		memcpy(byte_str, str + i * 2, 2);
		byte_str[2] = '\0';
		bytes[i] = strtol(byte_str, NULL, 16);
	}

	return 0;
}

#ifdef CONFIG_SAMPLE_STA_MAC_CONFIG_SUPPORT
static bool is_mac_addr_set(struct net_if *iface)
{
	struct net_linkaddr *linkaddr = net_if_get_link_addr(iface);
	struct net_eth_addr wifi_addr;

	if (!linkaddr || linkaddr->len != WIFI_MAC_ADDR_LEN) {
		return false;
	}

	memcpy(wifi_addr.addr, linkaddr->addr, WIFI_MAC_ADDR_LEN);

	return net_eth_is_addr_valid(&wifi_addr);
}
#endif /* CONFIG_SAMPLE_STA_MAC_CONFIG_SUPPORT */

#ifdef CONFIG_WIFI_READY_LIB
static int sta_wifi_wait_ready_event(k_timeout_t timeout)
{
	int ret;

	ret = k_sem_take(&wifi_ready_state_changed_sem, timeout);
	if (ret) {
		LOG_ERR("Failed to take Wi-Fi ready semaphore: %d", ret);
		return ret;
	}

	return 0;
}

#endif /* CONFIG_WIFI_READY_LIB */

int start_app(void)
{
#if defined(CONFIG_BOARD_NRF7002DK_NRF5340_CPUAPP_NRF7001) || \
	defined(CONFIG_BOARD_NRF7002DK_NRF5340_CPUAPP)
	if (strlen(CONFIG_NRF70_QSPI_ENCRYPTION_KEY)) {
		int ret;
		char key[QSPI_KEY_LEN_BYTES];

		ret = bytes_from_str(CONFIG_NRF70_QSPI_ENCRYPTION_KEY, key, sizeof(key));
		if (ret) {
			LOG_ERR("Failed to parse encryption key: %d\n", ret);
			return 0;
		}

		LOG_DBG("QSPI Encryption key: ");
		for (int i = 0; i < QSPI_KEY_LEN_BYTES; i++) {
			LOG_DBG("%02x", key[i]);
		}
		LOG_DBG("\n");

		ret = qspi_enable_encryption(key);
		if (ret) {
			LOG_ERR("Failed to enable encryption: %d\n", ret);
			return 0;
		}
		LOG_INF("QSPI Encryption enabled");
	} else {
		LOG_INF("QSPI Encryption disabled");
	}
#endif /* CONFIG_BOARD_NRF7002DK_NRF5340_CPUAPP_NRF7001 || CONFIG_BOARD_NRF7002DK_NRF5340_CPUAPP */

	LOG_INF("Static IP address (overridable): %s/%s -> %s",
		CONFIG_NET_CONFIG_MY_IPV4_ADDR,
		CONFIG_NET_CONFIG_MY_IPV4_NETMASK,
		CONFIG_NET_CONFIG_MY_IPV4_GW);

#ifdef CONFIG_SAMPLE_STA_MAC_CONFIG_SUPPORT
	/* Set MAC from DTS if interface has no valid MAC and DTS provides one */
	if (!is_mac_addr_set(net_if_get_default())) {
		if (!net_eth_is_addr_valid((struct net_eth_addr *)wifi_mac_addr)) {
			LOG_ERR("No valid MAC address: OTP not programmed and no valid "
				"local-mac-address in DTS");
			return -EINVAL;
		}

		struct net_if *iface = net_if_get_default();
		int ret;
		struct ethernet_req_params params;

		/* Set a local MAC address from DTS overlay */
		if (net_if_is_admin_up(iface)) {
#ifdef CONFIG_WIFI_READY_LIB
			/* Reset semaphore to discard any stale events before bringing down */
			k_sem_reset(&wifi_ready_state_changed_sem);
#endif /* CONFIG_WIFI_READY_LIB */
			ret = net_if_down(iface);
			if (ret < 0 && ret != -EALREADY) {
				LOG_ERR("Cannot bring down iface (%d)", ret);
				return ret;
			}
#ifdef CONFIG_WIFI_READY_LIB
			/* Wait for Wi-Fi to be not ready (supplicant processed down event) */
			LOG_INF("Waiting for Wi-Fi to be not ready");
			ret = sta_wifi_wait_ready_event(K_SECONDS(WIFI_READY_SYNC_TIMEOUT_S));
			if (ret) {
				return ret;
			}
			if (wifi_ready_status) {
				LOG_WRN("Wi-Fi still ready after interface down");
			}
#endif /* CONFIG_WIFI_READY_LIB */
		}

		memcpy(params.mac_address.addr, wifi_mac_addr, sizeof(wifi_mac_addr));

		net_mgmt(NET_REQUEST_ETHERNET_SET_MAC_ADDRESS, iface,
				&params, sizeof(params));

#ifdef CONFIG_WIFI_READY_LIB
		/* Reset semaphore to discard any stale events before bringing up */
		k_sem_reset(&wifi_ready_state_changed_sem);
#endif /* CONFIG_WIFI_READY_LIB */
		ret = net_if_up(iface);
		if (ret < 0 && ret != -EALREADY) {
			LOG_ERR("Cannot bring up iface (%d)", ret);
			return ret;
		}
#ifdef CONFIG_WIFI_READY_LIB
		LOG_INF("Waiting for Wi-Fi to be ready after interface up");
		ret = sta_wifi_wait_ready_event(K_SECONDS(WIFI_READY_SYNC_TIMEOUT_S));
		if (ret) {
			return ret;
		}
		if (!wifi_ready_status) {
			LOG_ERR("Wi-Fi not ready after interface up");
			return -EIO;
		}
#endif /* CONFIG_WIFI_READY_LIB */

		LOG_INF("OTP not programmed, using MAC from DTS: %s", net_sprint_ll_addr(
							net_if_get_link_addr(iface)->addr,
							net_if_get_link_addr(iface)->len));
	}
#endif /* CONFIG_SAMPLE_STA_MAC_CONFIG_SUPPORT */

	while (1) {
#ifdef CONFIG_WIFI_READY_LIB
		int ret;

		if (!skip_next_ready_wait) {
			LOG_INF("Waiting for Wi-Fi to be ready");
#if defined(CONFIG_NRF71_IDLE_POWER)
			nrf71_idle_power_suspend_console();
#endif
			ret = sta_wifi_wait_ready_event(K_FOREVER);
#if defined(CONFIG_NRF71_IDLE_POWER)
			nrf71_idle_power_resume_console();
#endif
			if (ret) {
				return ret;
			}

			if (!wifi_ready_status) {
				continue;
			}
		}

		skip_next_ready_wait = false;
#endif /* CONFIG_WIFI_READY_LIB */
		wifi_connect();

		while (!context.connect_result) {
			cmd_wifi_status();
			k_sleep(K_MSEC(STATUS_POLLING_MS));
		}

		if (context.connected) {
			cmd_wifi_status();
#ifdef CONFIG_WIFI_READY_LIB
#if defined(CONFIG_NRF71_IDLE_POWER)
			nrf71_idle_power_suspend_console();
#endif
			ret = sta_wifi_wait_ready_event(K_FOREVER);
#if defined(CONFIG_NRF71_IDLE_POWER)
			nrf71_idle_power_resume_console();
#endif
			if (ret) {
				return ret;
			}
			/* Supplicant not-ready/ready (e.g. RPU recovery): reconnect. */
			continue;
#else
#if defined(CONFIG_NRF71_IDLE_POWER)
			nrf71_idle_power_suspend_console();
#endif
			k_sleep(K_FOREVER);
#endif /* CONFIG_WIFI_READY_LIB */
		}

		LOG_WRN("Connection failed, retrying in %d s",
			CONFIG_STA_SAMPLE_CONNECT_RETRY_DELAY_SEC);
#ifdef CONFIG_WIFI_READY_LIB
		skip_next_ready_wait = wifi_ready_status;
#endif /* CONFIG_WIFI_READY_LIB */
		k_sleep(K_SECONDS(CONFIG_STA_SAMPLE_CONNECT_RETRY_DELAY_SEC));
	}

	return 0;
}

#ifdef CONFIG_WIFI_READY_LIB
void start_wifi_thread(void);
#define THREAD_PRIORITY K_PRIO_COOP(CONFIG_NUM_COOP_PRIORITIES - 1)
K_KERNEL_THREAD_DEFINE(start_wifi_thread_id, CONFIG_STA_SAMPLE_START_WIFI_THREAD_STACK_SIZE,
		       start_wifi_thread, NULL, NULL, NULL,
		       THREAD_PRIORITY, 0, -1);

void start_wifi_thread(void)
{
	start_app();
}

void wifi_ready_cb(bool wifi_ready)
{
	if (wifi_ready_status != wifi_ready) {
		LOG_INF("Wi-Fi is %sready", wifi_ready ? "" : "not ");
	}

	wifi_ready_status = wifi_ready;
	k_sem_give(&wifi_ready_state_changed_sem);
}
#endif /* CONFIG_WIFI_READY_LIB */

void net_mgmt_callback_init(void)
{
	memset(&context, 0, sizeof(context));

	net_mgmt_init_event_callback(&wifi_shell_mgmt_cb,
				     wifi_mgmt_event_handler,
				     WIFI_SHELL_MGMT_EVENTS);

	net_mgmt_add_event_callback(&wifi_shell_mgmt_cb);

	net_mgmt_init_event_callback(&net_shell_mgmt_cb,
				     net_mgmt_event_handler,
				     NET_EVENT_IPV4_DHCP_BOUND);

	net_mgmt_add_event_callback(&net_shell_mgmt_cb);

	LOG_INF("Starting %s with CPU frequency: %d MHz", CONFIG_BOARD, SystemCoreClock/MHZ(1));
	k_sleep(K_SECONDS(1));
}

#ifdef CONFIG_WIFI_READY_LIB
static int register_wifi_ready(void)
{
	int ret = 0;
	wifi_ready_callback_t cb;
	struct net_if *iface = net_if_get_first_wifi();

	if (!iface) {
		LOG_ERR("Failed to get Wi-Fi interface");
		return -1;
	}

	cb.wifi_ready_cb = wifi_ready_cb;

	LOG_DBG("Registering Wi-Fi ready callbacks");
	ret = register_wifi_ready_callback(cb, iface);
	if (ret) {
		LOG_ERR("Failed to register Wi-Fi ready callbacks %s", strerror(ret));
		return ret;
	}

	return ret;
}

static int sta_sample_register_wifi_ready(void)
{
	int ret = register_wifi_ready();

	if (ret == -EALREADY) {
		return 0;
	}

	return ret;
}

SYS_INIT(sta_sample_register_wifi_ready, APPLICATION, 94);
#endif /* CONFIG_WIFI_READY_LIB */

int main(void)
{
	net_mgmt_callback_init();

#ifdef CONFIG_WIFI_READY_LIB
	k_thread_start(start_wifi_thread_id);
#else
	start_app();
#endif /* CONFIG_WIFI_READY_LIB */
	return 0;
}
```

## src/led.c
```c
/*
 * Copyright (c) 2026 Nordic Semiconductor ASA
 *
 * SPDX-License-Identifier: LicenseRef-Nordic-5-Clause
 */

#include "led.h"

#include <zephyr/kernel.h>
#include <zephyr/drivers/gpio.h>
#include <zephyr/logging/log.h>

LOG_MODULE_REGISTER(led, CONFIG_LOG_DEFAULT_LEVEL);

/* 1000 msec = 1 sec */
#define LED_SLEEP_TIME_MS   100

/* The devicetree node identifier for the "led0" alias. */
#define LED0_NODE DT_ALIAS(led0)
/*
 * A build error on this line means your board is unsupported.
 * See the sample documentation for information on how to fix this.
 */
static const struct gpio_dt_spec led = GPIO_DT_SPEC_GET(LED0_NODE, gpios);

static bool connected;

void led_set_connected(bool is_connected)
{
	connected = is_connected;
}

static void toggle_led(void)
{
	int ret;

	if (!device_is_ready(led.port)) {
		LOG_ERR("LED device is not ready");
		return;
	}

	ret = gpio_pin_configure_dt(&led, GPIO_OUTPUT_ACTIVE);
	if (ret < 0) {
		LOG_ERR("Error %d: failed to configure LED pin", ret);
		return;
	}

	while (1) {
		if (connected) {
			gpio_pin_toggle_dt(&led);
			k_msleep(LED_SLEEP_TIME_MS);
		} else {
			gpio_pin_set_dt(&led, 0);
			k_msleep(LED_SLEEP_TIME_MS);
		}
	}
}

K_KERNEL_THREAD_DEFINE(led_thread_id, 1024, toggle_led, NULL, NULL, NULL,
		       7, 0, 0);
```

## src/led.h
```c
/*
 * Copyright (c) 2026 Nordic Semiconductor ASA
 *
 * SPDX-License-Identifier: LicenseRef-Nordic-5-Clause
 */

#ifndef LED_H_
#define LED_H_

#include <stdbool.h>

void led_set_connected(bool connected);

#endif /* LED_H_ */
```
