## samples/wifi/nrf_cloud/sample.yaml
```yaml
sample:
  name: Wi-Fi nRF Cloud Sample
tests:
  sample.wifi.conn.mqtt:
    sysbuild: true
    build_only: true
    integration_platforms:
      - nrf7002dk/nrf5340/cpuapp/ns
      - nrf7120dk/nrf7120/cpuapp/ns
    platform_allow:
      - nrf7002dk/nrf5340/cpuapp/ns
      - nrf7120dk/nrf7120/cpuapp/ns
    extra_args:
      - EXTRA_CONF_FILE="mqtt.conf"
      - platform:nrf7120:EXTRA_DTC_OVERLAY_FILE=${ZEPHYR_NRFXLIB_MODULE_DIR}/nrf71_wifi/bins/0.1.0/nrf7120_wifi_patch.dtsi
      - platform:nrf7120:CONFIG_WIFI_NRF71_PATCH=y
    tags:
      - ci_build
      - sysbuild
      - ci_samples_wifi
  sample.wifi.conn.coap.nofota:
    sysbuild: true
    build_only: true
    integration_platforms:
      - nrf7120dk/nrf7120/cpuapp/ns
    platform_allow:
      - nrf7120dk/nrf7120/cpuapp/ns
    extra_args:
      - EXTRA_CONF_FILE="coap.conf"
      - EXTRA_DTC_OVERLAY_FILE=${ZEPHYR_NRFXLIB_MODULE_DIR}/nrf71_wifi/bins/0.1.0/nrf7120_wifi_patch.dtsi
      - CONFIG_WIFI_NRF71_PATCH=y
    tags:
      - ci_build
      - sysbuild
      - ci_samples_wifi
  sample.wifi.conn.coap:
    sysbuild: true
    build_only: true
    integration_platforms:
      - nrf7002dk/nrf5340/cpuapp/ns
      - nrf7120dk/nrf7120/cpuapp
    platform_allow:
      - nrf7002dk/nrf5340/cpuapp/ns
      - nrf7120dk/nrf7120/cpuapp
    extra_args:
      - EXTRA_CONF_FILE="coap.conf;coap-fota.conf"
      - platform:nrf7120:EXTRA_DTC_OVERLAY_FILE=${ZEPHYR_NRFXLIB_MODULE_DIR}/nrf71_wifi/bins/0.1.0/nrf7120_wifi_patch.dtsi
      - platform:nrf7120:CONFIG_WIFI_NRF71_PATCH=y
    tags:
      - ci_build
      - sysbuild
      - ci_samples_wifi
  sample.wifi.conn.nrf7002eb2.mqtt:
    sysbuild: true
    build_only: true
    integration_platforms:
      - nrf54lm20dk/nrf54lm20a/cpuapp/ns
      - nrf54lm20dk/nrf54lm20b/cpuapp/ns
    platform_allow:
      - nrf54lm20dk/nrf54lm20a/cpuapp/ns
      - nrf54lm20dk/nrf54lm20b/cpuapp/ns
    extra_args:
      - SHIELD=nrf7002eb2
      - EXTRA_CONF_FILE="mqtt.conf"
    tags:
      - ci_build
      - sysbuild
      - ci_samples_wifi
  sample.wifi.conn.nrf7002eb2.coap:
    sysbuild: true
    build_only: true
    integration_platforms:
      - nrf54lm20dk/nrf54lm20a/cpuapp/ns
      - nrf54lm20dk/nrf54lm20b/cpuapp/ns
    platform_allow:
      - nrf54lm20dk/nrf54lm20a/cpuapp/ns
      - nrf54lm20dk/nrf54lm20b/cpuapp/ns
    extra_args:
      - SHIELD=nrf7002eb2
      - EXTRA_CONF_FILE="coap.conf;coap-fota.conf"
    tags:
      - ci_build
      - sysbuild
      - ci_samples_wifi
```

## samples/wifi/nwrt/Kconfig
```kconfig
# Copyright (c) 2026 Nordic Semiconductor ASA
# SPDX-License-Identifier: LicenseRef-Nordic-5-Clause

mainmenu "nWRT application"

config NWRT_SWD_ONLY
	bool "SWD-only mode (no Wi-Fi driver init)"
	help
	  Skip nRF71 Wi-Fi driver bring-up. main() runs the shadow poll loop
	  immediately so the host can exercise submit/ack/result over J-Link.
	  RF commands complete with result -19 (NODEV); invalid submits return -22.

source "Kconfig.zephyr"
```

## samples/wifi/nwrt/west.yml
```yaml
# Copyright (c) 2026 Nordic Semiconductor ASA
# SPDX-License-Identifier: Apache-2.0

manifest:
  version: 0.13

  remotes:
    - name: ncs
      url-base: https://github.com/nrfconnect

    - name: nordic-bb
      url-base: ssh://git@bitbucket.nordicsemi.no:7999

  self:
    path: nWRT

  projects:
    - name: nrf
      remote: ncs
      repo-path: sdk-nrf
      revision: main
      import: true
```

## samples/wifi/offloaded_raw_tx/Kconfig
```kconfig
#
# Copyright (c) 2024 Nordic Semiconductor
#
# SPDX-License-Identifier: LicenseRef-Nordic-5-Clause
#

source "Kconfig.zephyr"

menu "Offloaded Raw TX sample"

config SAMPLE_OFFLOADED_RAW_TX_GENERATE_MAC_ADDRESS
	bool "Random Wi-Fi MAC address"
	depends on ENTROPY_GENERATOR
	help
	  The option specifies the MAC address to be used by the sample.
	  This is only used when the nRF7002 OTP is not programmed with a MAC address.

config SAMPLE_OFFLOADED_RAW_TX_BEACON_INTERVAL
	int "Beacon interval in milliseconds"
	default 100
	range 20 10000
	help
	  The option sets the time Time interval (in ms) between beacon transmissions.

choice SAMPLE_OFFLOADED_RAW_TX_BAND
	prompt "Operating band for initial transmission"
	default SAMPLE_OFFLOADED_RAW_TX_BAND_2GHZ
	help
	  Band on which the initial channel resides. Set explicitly for 6 GHz
	  channels on nRF71, where channel numbers overlap with lower bands.

config SAMPLE_OFFLOADED_RAW_TX_BAND_AUTO
	bool "Auto (infer from channel number)"

config SAMPLE_OFFLOADED_RAW_TX_BAND_2GHZ
	bool "2.4 GHz"

config SAMPLE_OFFLOADED_RAW_TX_BAND_5GHZ
	bool "5 GHz"

config SAMPLE_OFFLOADED_RAW_TX_BAND_6GHZ
	bool "6 GHz"
	depends on WIFI_NRF71

endchoice

endmenu
```

## samples/wifi/offloaded_raw_tx/boards/nrf7120dk_nrf7120_cpuapp_ns.conf
```kconfig
#
# Copyright (c) 2026 Nordic Semiconductor
#
# SPDX-License-Identifier: LicenseRef-Nordic-5-Clause
#

CONFIG_NRF71_WIFI=y
CONFIG_NRF71_WIFI_OFFLOADED_RAW_TX_MODE=y
CONFIG_ENTROPY_GENERATOR=y
```

## samples/wifi/p2p/Kconfig
```kconfig
#
# Copyright (c) 2026 Nordic Semiconductor
#
# SPDX-License-Identifier: LicenseRef-Nordic-5-Clause
#

menu "Nordic P2P sample"

choice SAMPLE_P2P_MODE
	prompt "P2P device mode"
	default SAMPLE_P2P_CLI_MODE

config SAMPLE_P2P_CLI_MODE
	bool "CLI mode (Client: Find peer and connect)"
	help
	  This configuration option enables the device to act as a P2P client.

config SAMPLE_P2P_GO_MODE
	bool "GO mode (Group owner: Group add/remove)"
	select NRF70_AP_MODE
	select NRF71_AP_MODE if SOC_NRF7120
	help
	  This configuration option enables the device to act as a P2P Group Owner.

config SAMPLE_P2P_GO_PERSISTENT_MODE
	bool "GO mode (Persistent: autonomous persistent group)"
	select NRF70_AP_MODE
	select NRF71_AP_MODE if SOC_NRF7120
	help
	  This configuration option enables an autonomous persistent Group Owner
	  (P2P_GROUP_ADD with persistent_set) that verifies in code, across cycles,
	  that the stored group is reused. GO-only; persistence is RAM-only here.

endchoice

if SAMPLE_P2P_CLI_MODE

choice SAMPLE_P2P_DISCOVERY_TYPE
	prompt "P2P discovery type"
	default SAMPLE_P2P_DISCOVERY_FULL

config SAMPLE_P2P_DISCOVERY_FULL
	bool "Full discovery"
	help
	  This configuration option enables the device to scan
	  all Wi‑Fi channels while searching for P2P peers.

config SAMPLE_P2P_DISCOVERY_SOCIAL
	bool "Social discovery"
	help
	  This configuration option enables the device to
	  scan only the Wi-Fi Direct social channels (1, 6, 11).

config SAMPLE_P2P_DISCOVERY_PROGRESSIVE
	bool "Progressive discovery"
	help
	  This configuration option enables alternating
	  between social channel scans and full scans.

endchoice

config SAMPLE_P2P_FIND_TIMEOUT_S
	int "P2P discovery timeout (seconds)"
	default 30
	help
	  This configuration option sets the timeout, in seconds,
	  during which the device performs P2P peer discovery.

config SAMPLE_P2P_GO_INTENT_VALUE
	int "GO intent value"
	default 0
	range 0 15
	help
	  This configuration option sets the Group Owner
	  intent value used during P2P negotiation.

config SAMPLE_P2P_FREQUENCY
	int "P2P connection frequency (MHz)"
	default 2462
	help
	  This configuration option sets the frequency used when
	  initiating the P2P connection.

config SAMPLE_P2P_JOIN
	bool "Join an existing P2P group"
	help
	  This configuration option enables the device to join an
	  existing P2P group instead of creating a new one.

config SAMPLE_P2P_PEER_ADDRESS
	string "P2P peer MAC address"
	help
	  This configuration option sets the MAC address of the peer P2P device.

config SAMPLE_P2P_DHCP_TIMEOUT_S
	int "DHCP timeout in seconds"
	default 20

config SAMPLE_P2P_ECHO_CLI_MODE
	bool "Echo client mode"
	default n
	help
	  This configuration options helps to start a TCP echo client.
	  Connect to Go IP address and send test strings and validates
	  the echoed response.

if SAMPLE_P2P_ECHO_CLI_MODE

config SAMPLE_ECHO_SERVER_ADDR
	string "Echo server (P2P GO) IPv4 address"
	default "192.168.1.99"
	help
	  This configuration option sets the IPv4 address of the P2P Group
	  Owner running the echo server. It must match CONFIG_NET_CONFIG_MY_IPV4_ADDR
	  used when building the GO image, since the two are set independently.

config SAMPLE_ECHO_CLI_PORT
	int "P2P server port for echo client"
	default 4242
	help
	  This configuration option sets the operating port used when creating
	  the P2P Echo Client. It must match CONFIG_SAMPLE_ECHO_SERVER_PORT on
	  the GO image, since the two are set independently.

config SAMPLE_ECHO_CLI_COUNT
	int "Number of echo requests to send"
	default 10
	help
	  This configuration option sets how many echo request/response
	  iterations the client performs before returning.

config SAMPLE_ECHO_CLI_INTERVAL_MS
	int "Delay between echo requests (ms)"
	default 1000
	help
	  This configuration option sets the delay, in milliseconds, between
	  successive echo requests sent by the client.

config SAMPLE_ECHO_CLI_REPLY_TIMEOUT_MS
	int "Echo reply timeout (ms)"
	default 5000
	help
	  This configuration option sets how long, in milliseconds, the client
	  waits for an echo reply before aborting the echo test.

endif

endif

config SAMPLE_P2P_ECHO_MSG_BUF_SIZE
	int "Echo message buffer size (bytes)"
	depends on SAMPLE_P2P_ECHO_CLI_MODE || SAMPLE_P2P_ECHO_SERVER_MODE
	default 128
	help
	  Size, in bytes, of the TCP buffer used by the echo client (to hold the
	  reply) and the echo server (to receive and echo back). Data larger than
	  this is handled in chunks of this size.

choice SAMPLE_P2P_CONNECTION_METHODS
	prompt "P2P connection methods"
	default SAMPLE_P2P_CONNECTION_METHOD_PIN

config SAMPLE_P2P_CONNECTION_METHOD_PIN
	bool "PIN method"
	help
	  This configuration option enables establishing the P2P connection using a WPS PIN.

config SAMPLE_P2P_CONNECTION_METHOD_PBC
	bool "Push Button Configuration (PBC)"
	help
	  This configuration option enables the device to establish
	  the P2P connection using WPS Push Button Configuration (PBC).

endchoice

if SAMPLE_P2P_CONNECTION_METHOD_PIN

config SAMPLE_P2P_METHOD_DISPLAY
	bool "Display PIN method"
	default y
	help
	  This configuration option enables the device to generate
	  and display a PIN which must be entered on the peer device.

config SAMPLE_P2P_METHOD_KEYPAD
	bool "Keypad PIN method"
	help
	  This configuration option enables the device to
	  use the PIN provided by the peer device.

endif

if SAMPLE_P2P_METHOD_KEYPAD

config SAMPLE_P2P_CONNECTION_METHOD_PIN_VALUE
	string "PIN value"
	help
	  This configuration option sets the PIN value to be
	  used when the keypad method is selected.

endif

if SAMPLE_P2P_GO_MODE || SAMPLE_P2P_GO_PERSISTENT_MODE

config SAMPLE_P2P_DHCPV4_SERVER
	bool "DHCPv4 server"
	select NET_DHCPV4_SERVER
	default y
	help
	  This configuration option enables DHCPV4 server settings.

config SAMPLE_P2P_DHCPV4_POOL_START
	string "Start address of DHCPv4 pool"
	default "192.168.1.2"
	help
	  This configuration option sets the start IP address of DHCPv4 pool.

config SAMPLE_P2P_GO_FREQ
	int "P2P GO operating frequency (MHz)"
	default 2462
	help
	  This configuration option sets the operating frequency
	  used when creating the P2P Group Owner group.

config SAMPLE_P2P_GO_VHT
	bool "VHT support"
	help
	  This configuration option enables the device to allow
	  Very High Throughput (VHT) capabilities when creating the P2P group.

config SAMPLE_P2P_GO_BSSID
	string "GO BSSID"
	help
	  This configuration option sets the BSSID to be used when creating the P2P group.
	  If left empty, the BSSID is selected automatically.

config SAMPLE_P2P_IFACE_NAME
	string "Interface name"
	default "wlan0"
	help
	  This configuration option sets the interface name used when removing the P2P group.

config SAMPLE_P2P_PEER_DISCONN_TIMEOUT_S
	int "Timeout waiting for peer disconnect (seconds)"
	default 30
	help
	  This configuration option sets the timeout for waiting for a peer to disconnect.

config SAMPLE_P2P_ECHO_SERVER_MODE
	bool "Echo Server mode"
	default n
	help
	  This configuration option helps to start a TCP echo server in GO mode.
	  Listen on a fixed port and echo back whatever data is received.

if SAMPLE_P2P_ECHO_SERVER_MODE

config SAMPLE_ECHO_SERVER_PORT
	int "P2P server port for echo server"
	default 4242
	help
	  This configuration option sets the operating port used when creating
	  the P2P Echo Server. It must match CONFIG_SAMPLE_ECHO_CLI_PORT on the
	  CLI image, since the two are set independently.

config SAMPLE_ECHO_POLL_INTERVAL_MS
	int "Echo server poll interval (ms)"
	default 1000
	help
	  This configuration option sets how often, in milliseconds, the echo
	  server re-checks the P2P peer connection state while waiting for a
	  client connection or data. It bounds how long P2P group teardown can
	  be delayed after the peer disconnects.

endif

endif

if SAMPLE_P2P_GO_PERSISTENT_MODE

config SAMPLE_P2P_GO_PERSISTENT_CYCLES
	int "Number of persistence-verification cycles to run in this boot"
	range 2 100
	default 3
	help
	  Number of verification cycles. Cycle 1 creates the persistent group and
	  records its id/SSID; later cycles re-invoke it by id and check the SSID
	  is unchanged. At least 2 are needed (create + verify).

endif

endmenu

source "Kconfig.zephyr"
```

## samples/wifi/p2p/boards/nrf7120dk_nrf7120_cpuapp.conf
```kconfig
#
# Copyright (c) 2026 Nordic Semiconductor
#
# SPDX-License-Identifier: LicenseRef-Nordic-5-Clause
#

CONFIG_WIFI_NRF71=y
CONFIG_NRF71_P2P_MODE=y
CONFIG_NRF71_MAX_TX_AGGREGATION=12
CONFIG_NRF71_RX_NUM_BUFS=16
```

## samples/wifi/p2p/boards/nrf7120dk_nrf7120_cpuapp_ns.conf
```kconfig
#
# Copyright (c) 2026 Nordic Semiconductor
#
# SPDX-License-Identifier: LicenseRef-Nordic-5-Clause
#

CONFIG_NRF71_WIFI=y
CONFIG_NRF71_WIFI_P2P_SUPPORT=y
CONFIG_NRF71_WIFI_AP_SUPPORT=y
CONFIG_NRF71_WIFI_MAX_TX_AGGREGATION=12
CONFIG_NRF71_WIFI_RX_NUM_BUFS=16
CONFIG_NRF71_WIFI_DATA_HEAP_SIZE=130000
```

## samples/wifi/promiscuous/boards/nrf7120dk_nrf7120_cpuapp.conf
```kconfig
#
# Copyright (c) 2026 Nordic Semiconductor
#
# SPDX-License-Identifier: LicenseRef-Nordic-5-Clause
#

CONFIG_NRF71_WIFI=y
CONFIG_NRF71_WIFI_PROMISCUOUS_SUPPORT=y
CONFIG_NRF71_WIFI_CTRL_HEAP_SIZE=20000
CONFIG_NRF71_WIFI_DATA_HEAP_SIZE=168192
CONFIG_NRF71_WIFI_RX_NUM_BUFS=48
CONFIG_NRF71_WIFI_MAX_TX_AGGREGATION=12
```

## samples/wifi/provisioning/ble/Kconfig.sysbuild
```kconfig
#
# Copyright (c) 2023 Nordic Semiconductor
#
# SPDX-License-Identifier: LicenseRef-Nordic-5-Clause
#

source "${ZEPHYR_NRF_MODULE_DIR}/samples/wifi/Kconfig.sysbuild.nrf70"
source "share/sysbuild/Kconfig"

config NRF_DEFAULT_IPC_RADIO
	default y
```

## samples/wifi/provisioning/ble/boards/thingy53_nrf5340_cpuapp.conf
```kconfig
#
# Copyright (c) 2026 Nordic Semiconductor ASA
#
# SPDX-License-Identifier: LicenseRef-Nordic-5-Clause
#

#NRF70 specific configuration
CONFIG_WIFI_NRF70=y
CONFIG_NRF70_SR_COEX=y
CONFIG_NRF70_SR_COEX_RF_SWITCH=y
```

## samples/wifi/radio_test/multi_domain/boards/nrf7002dk_nrf5340_cpuapp_nrf7001.conf
```kconfig
#
# Copyright (c) 2026 Nordic Semiconductor ASA
#
# SPDX-License-Identifier: LicenseRef-Nordic-5-Clause
#

#NRF70 specific configuration
CONFIG_NRF70_RADIO_TEST=y
CONFIG_NRF70_SR_COEX=y
```

## samples/wifi/radio_test/single_domain/Kconfig
```kconfig
#
# Copyright (c) 2024 Nordic Semiconductor
#
# SPDX-License-Identifier: LicenseRef-Nordic-5-Clause
#

mainmenu "Nordic Wi-Fi Bluetooth LE Radio test sample"

config SAMPLE_WIFI_RADIO_TEST_WIFI_ONLY
	bool "Wi-Fi only mode"
	help
	  Enable Wi-Fi only radio test mode, excluding peripheral BLE radio test
	  sources. BLE stack support remains enabled on combo chips.

rsource "../../../../samples/peripheral/radio_test/Kconfig"
```
