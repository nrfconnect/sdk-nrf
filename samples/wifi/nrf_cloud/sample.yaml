## samples/wifi/radio_test/single_domain/boards/nrf7120dk_nrf7120_cpuapp.conf
```kconfig
# Copyright (c) 2026 Nordic Semiconductor ASA
#
# SPDX-License-Identifier: LicenseRef-Nordic-5-Clause

CONFIG_WIFI_NRF70=n
CONFIG_NRF70_RADIO_TEST=n
CONFIG_NRF71_RADIO_TEST=y
CONFIG_NRF71_SR_COEX=y
CONFIG_SOC_NRF71_WIFI_BOOT=y

# Peripheral radio_test (BLE radio) dependencies
CONFIG_NRFX_GPPI=y
```

## samples/wifi/radio_test/single_domain/boards/nrf7120dk_nrf7120_cpuapp_ns.conf
```kconfig
#
# Copyright (c) 2026 Nordic Semiconductor
#
# SPDX-License-Identifier: LicenseRef-Nordic-5-Clause
#

CONFIG_WIFI_NRF71=y
CONFIG_NRF71_WIFI_RADIO_TEST_MODE=y
CONFIG_NRF71_WIFI_CTRL_HEAP_SIZE=32768

# Enable the necessary drivers
CONFIG_NRFX_TIMER=y
CONFIG_NRFX_GPPI=y
```

## samples/wifi/raw_tx_packet/boards/nrf7120dk_nrf7120_cpuapp.conf
```kconfig
#
# Copyright (c) 2026 Nordic Semiconductor
#
# SPDX-License-Identifier: LicenseRef-Nordic-5-Clause
#

CONFIG_WIFI_NRF71=y
CONFIG_NRF71_WIFI_TX_INJECTION_SUPPORT=y
CONFIG_NRF71_WIFI_LOW_POWER_SUPPORT=n
CONFIG_NRF71_WIFI_ZERO_COPY_TX=n
```

## samples/wifi/recal_monitor/sample.yaml
```yaml
sample:
  description: Wi-Fi recalibration monitor provider framework sample
  name: Recalibration monitor providers
tests:
  sample.wifi.recal_monitor.nrf7120dk:
    sysbuild: true
    build_only: true
    integration_platforms:
      - nrf7120dk/nrf7120/cpuapp
    platform_allow:
      - nrf7120dk/nrf7120/cpuapp
    tags:
      - ci_build
      - sysbuild
      - ci_samples_wifi
  sample.wifi.recal_monitor.chosen_override.nrf7120dk:
    sysbuild: true
    build_only: true
    extra_dtc_overlay_files:
      - chosen_override.overlay
    integration_platforms:
      - nrf7120dk/nrf7120/cpuapp
    platform_allow:
      - nrf7120dk/nrf7120/cpuapp
    tags:
      - ci_build
      - sysbuild
      - ci_samples_wifi
```

## samples/wifi/scan/Kconfig.sysbuild
```kconfig
#
# Copyright (c) 2026 Nordic Semiconductor ASA
#
# SPDX-License-Identifier: LicenseRef-Nordic-5-Clause
#

source "${ZEPHYR_NRF_MODULE_DIR}/samples/wifi/Kconfig.sysbuild.nrf70"

source "share/sysbuild/Kconfig"
```

## samples/wifi/shell/boards/nrf7002dk_nrf5340_cpuapp.conf
```kconfig
#
# Copyright (c) 2026 Nordic Semiconductor ASA
#
# SPDX-License-Identifier: LicenseRef-Nordic-5-Clause
#

# Cut RAM
CONFIG_DNS_RESOLVER_AI_MAX_ENTRIES=2
```

## samples/wifi/shutdown/Kconfig
```kconfig
#
# Copyright (c) 2023 Nordic Semiconductor
#
# SPDX-License-Identifier: LicenseRef-Nordic-5-Clause
#

source "Kconfig.zephyr"

choice SHUTDOWN_OPERATION_MODE
	prompt "Sample operation mode"
	default OPERATION_MODE_CONTINUOUS
	help
	  Select the operation mode for the sample.

config OPERATION_MODE_CONTINUOUS
	bool "Continuous mode"
	help
	  In this mode, the sample will continue to run alternating between
	  Wi-Fi shutdown and startup.

config OPERATION_MODE_ONE_SHOT
	bool "One-shot mode"
	help
	  In this mode, the sample will shutdown Wi-Fi only once and then exit.

config OPERATION_MODE_BUTTONS
	bool "Enable button interaction"
	help
	  Enable button interaction in the sample. If enabled, the sample will
	  enable use of buttons to toggle the Wi-Fi shutdown or startup.
endchoice

config SHUTDOWN_TIMEOUT_S
	int "Wi-Fi shutdown timeout"
	default 5
	help
	  Timeout in seconds after the Wi-Fi shutdown operation.

config SHUTDOWN_STAY_UP
	bool "Keep the Wi-Fi interface up and idle (skip shutdown)"
	help
	  For idle-current measurement with the interface up. In one-shot or
	  buttons mode, bring the interface up and scan once, then idle
	  forever with the interface still up instead of bringing Wi-Fi down.
	  Lets the driver's power save put the radio to sleep between beacons
	  while the host idles.
```
