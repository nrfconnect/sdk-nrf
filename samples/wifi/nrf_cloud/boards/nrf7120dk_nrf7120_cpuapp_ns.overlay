/*
 * Copyright (c) 2026 Nordic Semiconductor ASA
 *
 * SPDX-License-Identifier: LicenseRef-Nordic-5-Clause
 */

/ {
	chosen {
		/* location library uses ncs,location-wifi for non-NRF70 Wi-Fi drivers */
		ncs,location-wifi = &wlan0;
	};
};
