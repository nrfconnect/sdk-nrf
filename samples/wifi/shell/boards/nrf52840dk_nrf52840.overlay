/*
 * Copyright (c) 2022 Nordic Semiconductor ASA
 *
 * SPDX-License-Identifier: LicenseRef-Nordic-5-Clause
 */

/* Disabled because of a conflict on P1.08 - Arduino pin D7 (host-irq-gpios
 * in nrf7002ek). */
&spi1 {
	status = "disabled";
};

/* Disabled because of conflicts on P1.01 and P1.02 - Arduino pins D0 and D1
 * (iovdd-ctrl-gpios and bucken-gpios in nrf7002ek, respectively). */
&uart1 {
	status = "disabled";
};
