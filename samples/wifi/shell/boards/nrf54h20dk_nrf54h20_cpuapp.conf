## samples/wifi/twt/sample.yaml
```yaml
sample:
  description: Wi-Fi TWT sample application
  name: Wi-Fi TWT sample
tests:
  sample.wifi.twt:
    sysbuild: true
    build_only: true
    integration_platforms:
      - nrf7002dk/nrf5340/cpuapp
    platform_allow: nrf7002dk/nrf5340/cpuapp
    # Dummy IP address for building the sample
    extra_args: CONFIG_TRAFFIC_GEN_REMOTE_IPV4_ADDR="1.2.3.4"
    tags:
      - ci_build
      - sysbuild
      - ci_samples_wifi
  sample.nrf7002eb_interposer_p1.nrf7002eb.twt:
    sysbuild: true
    build_only: true
    extra_args:
      - twt_SHIELD="nrf7002eb_interposer_p1;nrf7002eb"
      - twt_SNIPPET=nrf70-wifi
      # Dummy IP address for building the sample
      - CONFIG_TRAFFIC_GEN_REMOTE_IPV4_ADDR="1.2.3.4"
    integration_platforms:
      - nrf54h20dk/nrf54h20/cpuapp
      - nrf54l15dk/nrf54l15/cpuapp
    platform_allow:
      - nrf54h20dk/nrf54h20/cpuapp
      - nrf54l15dk/nrf54l15/cpuapp
    tags:
      - ci_build
      - sysbuild
      - ci_samples_wifi
  sample.nrf7002eb2.twt:
    sysbuild: true
    build_only: true
    extra_args:
      - twt_SHIELD="nrf7002eb2"
      - twt_SNIPPET=nrf70-wifi
      # Dummy IP address for building the sample
      - CONFIG_TRAFFIC_GEN_REMOTE_IPV4_ADDR="1.2.3.4"
    integration_platforms:
      - nrf54l15dk/nrf54l15/cpuapp
    platform_allow:
      - nrf54l15dk/nrf54l15/cpuapp
    tags:
      - ci_build
      - sysbuild
      - ci_samples_wifi
  sample.54lm20dk.nrf7002eb2.twt:
    sysbuild: true
    build_only: true
    extra_args:
      - twt_SHIELD="nrf7002eb2"
      # Dummy IP address for building the sample
      - CONFIG_TRAFFIC_GEN_REMOTE_IPV4_ADDR="1.2.3.4"
    integration_platforms:
      - nrf54lm20dk/nrf54lm20a/cpuapp
    platform_allow:
      - nrf54lm20dk/nrf54lm20a/cpuapp
    tags:
      - ci_build
      - sysbuild
      - ci_samples_wifi
```

## samples/wifi/vtf/sample.yaml
```yaml
sample:
  description: VTF provider framework sample
  name: VTF providers
tests:
  sample.wifi.vtf.nrf7120dk:
    sysbuild: true
    build_only: true
    integration_platforms:
      - nrf7120dk/nrf7120/cpuapp
    platform_allow:
      - nrf7120dk/nrf7120/cpuapp
    tags:
      - ci_build
      - sysbuild
      - ci_samples_wifi
```

## samples/wifi/wfa_qt_app/Kconfig
```kconfig
#
# Copyright (c) 2023 Nordic Semiconductor
#
# SPDX-License-Identifier: LicenseRef-Nordic-5-Clause
#

source "Kconfig.zephyr"

menu "Nordic WFA QT sample"

config NET_CONFIG_USB_IPV4_ADDR
	string "USB IPv4 address"
	help
	  Static IPv4 address for USB interface

config NET_CONFIG_SLIP_IPV4_ADDR
	string "SLIP IPv4 address"
	help
	  Static IPv4 address for SLIP (Serial Line Internet Protocol) interface.

config NET_CONFIG_SLIP_IPV4_MASK
	string "SLIP IPv4 subnet mask"
	help
	  Static IPv4 subnet mask for SLIP (Serial Line Internet Protocol) interface.

endmenu
```

## samples/wifi/wfa_qt_app/sample.yaml
```yaml
sample:
  description: WFA QuickTrack control application
  name: WFA QT App
tests:
  sample.nrf7002.wfa_qt_app:
    sysbuild: true
    build_only: true
    integration_platforms:
      - nrf7002dk/nrf5340/cpuapp
    platform_allow: nrf7002dk/nrf5340/cpuapp
    tags:
      - ci_build
      - sysbuild
      - ci_samples_wifi
  sample.nrf7002.enterprise_mode.wfa_qt_app.netusb:
    sysbuild: true
    build_only: true
    extra_args:
      - EXTRA_CONF_FILE="overlay-netusb.conf;overlay-enterprise.conf"
      - wfa_qt_app_SNIPPET="wifi-enterprise"
    integration_platforms:
      - nrf7002dk/nrf5340/cpuapp
    platform_allow: nrf7002dk/nrf5340/cpuapp
    tags:
      - ci_build
      - sysbuild
      - ci_samples_wifi
  sample.nrf7002.enterprise_mode.wfa_qt_app.slip:
    sysbuild: true
    build_only: true
    extra_args:
      - EXTRA_CONF_FILE="overlay-slip.conf;overlay-enterprise.conf"
      - EXTRA_DTC_OVERLAY_FILE="nrf7002_uart_pipe.overlay"
      - wfa_qt_app_SNIPPET="wifi-enterprise"
    integration_platforms:
      - nrf7002dk/nrf5340/cpuapp
    platform_allow: nrf7002dk/nrf5340/cpuapp
    tags:
      - ci_build
      - sysbuild
      - ci_samples_wifi
  sample.nrf7002_eks.wfa_qt_app:
    sysbuild: true
    build_only: true
    extra_args: SHIELD=nrf7002ek
    integration_platforms:
      - nrf5340dk/nrf5340/cpuapp
    platform_allow: nrf5340dk/nrf5340/cpuapp
    tags:
      - ci_build
      - sysbuild
      - ci_samples_wifi
  sample.nrf7002eb_interposer_p1.nrf7002eb.wfa_qt_app:
    sysbuild: true
    build_only: true
    extra_args:
      - wfa_qt_app_SHIELD="nrf7002eb_interposer_p1;nrf7002eb"
      - wfa_qt_app_SNIPPET=nrf70-wifi
    integration_platforms:
      - nrf54h20dk/nrf54h20/cpuapp
    platform_allow:
      - nrf54h20dk/nrf54h20/cpuapp
    tags:
      - ci_build
      - sysbuild
      - ci_samples_wifi
  sample.54lm20dk.nrf7002eb2.wfa_qt_app.netusb:
    sysbuild: true
    build_only: true
    extra_args:
      - wfa_qt_app_SHIELD="nrf7002eb2"
      - EXTRA_CONF_FILE="overlay-usb-next.conf"
      - EXTRA_DTC_OVERLAY_FILE="usbd_next_ecm.overlay"
    integration_platforms:
      - nrf54lm20dk/nrf54lm20a/cpuapp
    platform_allow:
      - nrf54lm20dk/nrf54lm20a/cpuapp
    tags:
      - ci_build
      - sysbuild
      - ci_samples_wifi
  sample.54lm20dk.nrf7002eb2.wfa_qt_app.slip:
    sysbuild: true
    build_only: true
    extra_args:
      - wfa_qt_app_SHIELD="nrf7002eb2"
      - EXTRA_CONF_FILE="overlay-slip.conf"
      - EXTRA_DTC_OVERLAY_FILE="nrf54lm20_uart_pipe.overlay"
    integration_platforms:
      - nrf54lm20dk/nrf54lm20a/cpuapp
    platform_allow:
      - nrf54lm20dk/nrf54lm20a/cpuapp
    tags:
      - ci_build
      - sysbuild
      - ci_samples_wifi
```
