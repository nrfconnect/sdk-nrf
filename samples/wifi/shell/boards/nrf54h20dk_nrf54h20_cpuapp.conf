## samples/wifi/sta/sample.yaml
```yaml
sample:
  description: Wi-Fi station sample
    application
  name: Wi-Fi station
tests:
  sample.nrf7002.sta:
    sysbuild: true
    build_only: true
    integration_platforms:
      - nrf7002dk/nrf5340/cpuapp
    platform_allow: nrf7002dk/nrf5340/cpuapp
    tags: ci_build sysbuild ci_samples_wifi
  sample.nrf7002.sta.no_wifi_ready:
    sysbuild: true
    build_only: true
    extra_args: CONFIG_WIFI_READY_LIB=n
    integration_platforms:
      - nrf7002dk/nrf5340/cpuapp
    platform_allow: nrf7002dk/nrf5340/cpuapp
    tags: ci_build sysbuild ci_samples_wifi
  sample.nrf7001.sta:
    sysbuild: true
    build_only: true
    integration_platforms:
      - nrf7002dk/nrf5340/cpuapp/nrf7001
    platform_allow: nrf7002dk/nrf5340/cpuapp/nrf7001
    tags: ci_build sysbuild ci_samples_wifi
    skip: true
  sample.nrf7002_eks.sta:
    sysbuild: true
    build_only: true
    extra_args: SHIELD=nrf7002ek
    integration_platforms:
      - nrf5340dk/nrf5340/cpuapp
      - nrf52840dk/nrf52840
    platform_allow: nrf5340dk/nrf5340/cpuapp nrf52840dk/nrf52840
    extra_configs:
      - CONFIG_NET_TX_STACK_SIZE=3700
      - CONFIG_NET_RX_STACK_SIZE=3700
    tags: ci_build sysbuild ci_samples_wifi
  sample.nrf7001_eks.sta:
    sysbuild: true
    build_only: true
    extra_args: SHIELD=nrf7002ek_nrf7001
    integration_platforms:
      - nrf5340dk/nrf5340/cpuapp
      - nrf52840dk/nrf52840
    platform_allow: nrf5340dk/nrf5340/cpuapp nrf52840dk/nrf52840
    extra_configs:
      - CONFIG_NET_TX_STACK_SIZE=3700
      - CONFIG_NET_RX_STACK_SIZE=3700
    tags: ci_build sysbuild ci_samples_wifi
  sample.nrf7002_eb.thingy53.sta:
    sysbuild: true
    build_only: true
    extra_args: sta_SHIELD=nrf7002eb
    integration_platforms:
      - thingy53/nrf5340/cpuapp
    platform_allow: thingy53/nrf5340/cpuapp
    tags: ci_build sysbuild ci_samples_wifi
  sample.nrf7002eb_interposer_p1.nrf7002eb.sta:
    sysbuild: true
    build_only: true
    extra_args:
      - sta_SHIELD=nrf7002eb_interposer_p1 nrf7002eb
      - sta_SNIPPET=nrf70-wifi
    platform_allow:
      - nrf54h20dk/nrf54h20/cpuapp
      - nrf54l15pdk/nrf54l15/cpuapp
      - nrf54l15dk/nrf54l15/cpuapp
    tags: ci_build sysbuild ci_samples_wifi
```

## samples/wifi/thread_coex/Kconfig
```kconfig
#
# Copyright (c) 2024 Nordic Semiconductor
#
# SPDX-License-Identifier: LicenseRef-Nordic-5-Clause
#

source "Kconfig.zephyr"

menu "WiFi and Thread Coex sample"

config NET_CONFIG_PEER_IPV4_ADDR
	string "Peer IPv4 address"
	default "192.168.1.253"

config NET_CONFIG_PEER_IPV4_PORT
	int "Peer IPv4 port"
	default 5001

config WIFI_THREAD_STACK_SIZE
	int "Wi-Fi thread stack size"
	default 4096

config WIFI_THREAD_PRIORITY
	int "Wi-Fi thread priority"
	default 5

config WIFI_ZPERF_SERVER
	bool "Zperf role: server or client"
	default n

config WIFI_ZPERF_PROT_UDP
	bool "UDP or TCP"
	default y

config WIFI_ZPERF_PKT_SIZE
	int "packet size"
	default 1024

config WIFI_ZPERF_RATE
	int "rate in kbps"
	default 10000

# Thread configurations
config OT_CHANNEL
	int "Thread device operating channel"
	default 18

config OT_PAN_ID
	int "Thread device PAN ID"
	default 1

config OT_ROLE_CLIENT
	bool "Thread device role"
	default y

config OT_PACKET_SIZE
	int "Thread device packet size"
	default 256

config OT_RATE_BPS
	int "Thread device rate in bits per seconds"
	default 10000

config NET_CONFIG_THREAD_PORT
	int "Port for Thread zperf"
	default 5001

config OT_ZPERF_PROT_UDP
	bool "UDP or TCP"
	default y

# Test parameters
choice TEST_TYPE
	prompt "Test type"
	default TEST_TYPE_WLAN_OT

config TEST_TYPE_WLAN_ONLY
	bool "WLAN only"
	help
	  Enable WLAN only

config TEST_TYPE_OT_ONLY
	bool "Thread only"
	help
	  Enable Thread only

config TEST_TYPE_WLAN_OT
	bool "WLAN and Thread"
	help
	  Enable WLAN and Thread
endchoice

config TEST_TYPE_WLAN
	bool "WLAN"
	default y if TEST_TYPE_WLAN_ONLY || TEST_TYPE_WLAN_OT
	select WIFI
	help
	  Enable WLAN

config TEST_TYPE_OT
	bool "Thread"
	default y if TEST_TYPE_OT_ONLY || TEST_TYPE_WLAN_OT
	help
	  Enable Thread

config COEX_TEST_DURATION
	int "test duration in milliseconds"
	default 20000

config COEX_SEP_ANTENNAS
	bool "No support for shared antenna in Thread and WLAN. Set it to yes"
	default y

config SR_PROTOCOL_BLE
	bool "Indicates if the SR protocol is Bluetooth LE or not"
	default n

endmenu
```

## samples/wifi/thread_coex/Kconfig.sysbuild
```kconfig
#
# Copyright (c) 2024 Nordic Semiconductor
#
# SPDX-License-Identifier: LicenseRef-Nordic-5-Clause
#

source "share/sysbuild/Kconfig"

config NRF_DEFAULT_IPC_RADIO
	depends on SOC_SERIES_NRF53 || SOC_SERIES_NRF54H
	default y
```

## samples/wifi/thread_coex/sample.yaml
```yaml
sample:
  description: Wi-Fi Thread coex sample
    application
  name: Wi-Fi Thread coex
tests:
  sample.nrf7002.thread_coex_sep_ant:
    sysbuild: true
    build_only: true
    integration_platforms:
      - nrf7002dk/nrf5340/cpuapp
    extra_args: CONFIG_MPSL_CX=y ipc_radio_CONFIG_MPSL_CX=y
                CONFIG_COEX_SEP_ANTENNAS=y
                EXTRA_CONF_FILE="overlay-wifi-udp-client-thread-udp-client.conf"
    platform_allow: nrf7002dk/nrf5340/cpuapp
    tags: ci_build sysbuild ci_samples_wifi
  sample.nrf7001.thread_coex:
    sysbuild: true
    build_only: true
    integration_platforms:
      - nrf7002dk/nrf5340/cpuapp/nrf7001
    extra_args: CONFIG_MPSL_CX=y ipc_radio_CONFIG_MPSL_CX=y
                CONFIG_COEX_SEP_ANTENNAS=y
                EXTRA_CONF_FILE="overlay-wifi-udp-client-thread-udp-client.conf"
    platform_allow: nrf7002dk/nrf5340/cpuapp/nrf7001
    tags: ci_build sysbuild ci_samples_wifi
  sample.nrf7002ek.thread_coex:
    sysbuild: true
    build_only: true
    integration_platforms:
      - nrf5340dk/nrf5340/cpuapp
    extra_args: SHIELD=nrf7002ek
                CONFIG_MPSL_CX=y ipc_radio_CONFIG_MPSL_CX=y
                CONFIG_COEX_SEP_ANTENNAS=y
                EXTRA_CONF_FILE="overlay-wifi-udp-client-thread-udp-client.conf"
    platform_allow: nrf5340dk/nrf5340/cpuapp
    tags: ci_build sysbuild ci_samples_wifi
  sample.nrf7001ek.thread_coex:
    sysbuild: true
    build_only: true
    integration_platforms:
      - nrf5340dk/nrf5340/cpuapp
    extra_args: SHIELD=nrf7002ek_nrf7001
                CONFIG_MPSL_CX=y ipc_radio_CONFIG_MPSL_CX=y
                CONFIG_COEX_SEP_ANTENNAS=y
                EXTRA_CONF_FILE="overlay-wifi-udp-client-thread-udp-client.conf"
    platform_allow: nrf5340dk/nrf5340/cpuapp
    tags: ci_build sysbuild ci_samples_wifi
  sample.nrf7002_eb.thingy53.thread_coex:
    sysbuild: true
    build_only: true
    extra_args: thread_coex_SHIELD=nrf7002eb ipc_radio_SHIELD=nrf7002eb_coex
                CONFIG_MPSL_CX=y ipc_radio_CONFIG_MPSL_CX=y
                CONFIG_COEX_SEP_ANTENNAS=y
                EXTRA_CONF_FILE="overlay-wifi-udp-client-thread-udp-client.conf"
    integration_platforms:
      - thingy53/nrf5340/cpuapp
    platform_allow: thingy53/nrf5340/cpuapp
    tags: ci_build sysbuild ci_samples_wifi
```

## samples/wifi/throughput/sample.yaml
```yaml
sample:
  description: Wi-Fi throughput sample application
  name: Wi-Fi throughput
tests:
  sample.nrf7002.throughput:
    sysbuild: true
    build_only: true
    integration_platforms:
      - nrf7002dk/nrf5340/cpuapp
    platform_allow: nrf7002dk/nrf5340/cpuapp
    tags:
      - ci_build
      - sysbuild
      - ci_samples_wifi
  sample.nrf7002eb_interposer_p1.nrf7002eb.throughput:
    sysbuild: true
    build_only: true
    extra_args:
      - throughput_SHIELD="nrf7002eb_interposer_p1;nrf7002eb"
      - throughput_SNIPPET=nrf70-wifi
    integration_platforms:
      - nrf54h20dk/nrf54h20/cpuapp
    platform_allow:
      - nrf54h20dk/nrf54h20/cpuapp
    tags:
      - ci_build
      - sysbuild
      - ci_samples_wifi
  # Used by QA to measure memory footprints
  sample.nrf7002.iot_devices:
    sysbuild: true
    build_only: true
    extra_args: EXTRA_CONF_FILE=overlay-iot-devices.conf
    integration_platforms:
      - nrf7002dk/nrf5340/cpuapp
    platform_allow: nrf7002dk/nrf5340/cpuapp
    tags:
      - ci_build
      - sysbuild
      - ci_samples_wifi
  sample.nrf7002.high_performance:
    sysbuild: true
    build_only: true
    extra_args: EXTRA_CONF_FILE=overlay-high-performance.conf
    integration_platforms:
      - nrf7002dk/nrf5340/cpuapp
    platform_allow: nrf7002dk/nrf5340/cpuapp
    tags:
      - ci_build
      - sysbuild
      - ci_samples_wifi
  sample.nrf7002.memory_optimized:
    sysbuild: true
    build_only: true
    extra_args: EXTRA_CONF_FILE=overlay-memory-optimized.conf
    integration_platforms:
      - nrf7002dk/nrf5340/cpuapp
    platform_allow: nrf7002dk/nrf5340/cpuapp
    tags:
      - ci_build
      - sysbuild
      - ci_samples_wifi
  sample.nrf7002.rx_prioritized:
    sysbuild: true
    build_only: true
    extra_args: EXTRA_CONF_FILE=overlay-rx-prio.conf
    integration_platforms:
      - nrf7002dk/nrf5340/cpuapp
    platform_allow: nrf7002dk/nrf5340/cpuapp
    tags:
      - ci_build
      - sysbuild
      - ci_samples_wifi
  sample.nrf7002.tx_prioritized:
    sysbuild: true
    build_only: true
    extra_args: EXTRA_CONF_FILE=overlay-tx-prio.conf
    integration_platforms:
      - nrf7002dk/nrf5340/cpuapp
    platform_allow: nrf7002dk/nrf5340/cpuapp
    tags:
      - ci_build
      - sysbuild
      - ci_samples_wifi
  sample.nrf54lm20.iot_devices:
    sysbuild: true
    build_only: true
    extra_args:
      - EXTRA_CONF_FILE=overlay-iot-devices.conf
      - throughput_SHIELD=nrf7002eb2
    integration_platforms:
      - nrf54lm20dk/nrf54lm20a/cpuapp
    platform_allow: nrf54lm20dk/nrf54lm20a/cpuapp
    tags:
      - ci_build
      - sysbuild
      - ci_samples_wifi
  sample.nrf54lm20.high_performance:
    sysbuild: true
    build_only: true
    extra_args:
      - EXTRA_CONF_FILE=overlay-high-performance.conf
      - throughput_SHIELD=nrf7002eb2
    integration_platforms:
      - nrf54lm20dk/nrf54lm20a/cpuapp
    platform_allow: nrf54lm20dk/nrf54lm20a/cpuapp
    tags:
      - ci_build
      - sysbuild
      - ci_samples_wifi
  sample.nrf54lm20.memory_optimized:
    sysbuild: true
    build_only: true
    extra_args:
      - EXTRA_CONF_FILE=overlay-memory-optimized.conf
      - throughput_SHIELD=nrf7002eb2
    integration_platforms:
      - nrf54lm20dk/nrf54lm20a/cpuapp
    platform_allow: nrf54lm20dk/nrf54lm20a/cpuapp
    tags:
      - ci_build
      - sysbuild
      - ci_samples_wifi
  sample.nrf54lm20.rx_prioritized:
    sysbuild: true
    build_only: true
    extra_args:
      - EXTRA_CONF_FILE=overlay-rx-prio.conf
      - throughput_SHIELD=nrf7002eb2
    integration_platforms:
      - nrf54lm20dk/nrf54lm20a/cpuapp
    platform_allow: nrf54lm20dk/nrf54lm20a/cpuapp
    tags:
      - ci_build
      - sysbuild
      - ci_samples_wifi
  sample.nrf54lm20.tx_prioritized:
    sysbuild: true
    build_only: true
    extra_args:
      - EXTRA_CONF_FILE=overlay-tx-prio.conf
      - throughput_SHIELD=nrf7002eb2
    integration_platforms:
      - nrf54lm20dk/nrf54lm20a/cpuapp
    platform_allow: nrf54lm20dk/nrf54lm20a/cpuapp
    tags:
      - ci_build
      - sysbuild
      - ci_samples_wifi
```

## samples/wifi/twt/Kconfig
```kconfig
#
# Copyright (c) 2023 Nordic Semiconductor
#
# SPDX-License-Identifier: LicenseRef-Nordic-5-Clause
#

source "Kconfig.zephyr"

menu "Nordic TWT sample"

# Traffic gen
rsource "modules/traffic_gen/Kconfig"

config CONNECTION_IDLE_TIMEOUT
	int "Time to be waited for a station to connect"
	default 30

config STA_CONN_TIMEOUT_SEC
	int "Overall Connection timeout (time to be waited for a station to connect and get an IP address)"
	# Zephyr DHCP retry is 1 minute, so set the default to 70 seconds
	default 70
	# 512 has no special meaning, just a reasonable upper limit
	range 0 512
	help
	  Specify the connection timeout, in seconds. This is the overall timeout (time to be waited for
	  a station to connect and get an IP address). DHCP retries should be taken into account when setting
	  this value. If the timeout is set to 0, the connection will not timeout.

config TWT_TRIGGER_ENABLE
	bool "Enable trigger mode"
	help
	  STA expects AP to send triggers for start of every service period.

config TWT_ANNOUNCED_MODE
	bool "Enable announced mode"
	help
	  STA announces its wakeup to AP for every service period start.

config TWT_WAKE_INTERVAL
	int "TWT awake interval"
	help
	  The period where STA is awake and does data transfer, interval should be in us.
	default 65000

config TWT_INTERVAL
	int "TWT service interval"
	help
	  The period for TWT that includes both wake and sleep durations, interval should be in us.
	  Please note higher intervals can be rejected by AP or cause interoperability issues.
	default 524000

choice TWT_TRAFFIC_PATTERN
	prompt "Specifies the TWT traffic pattern either continuous tx or scheduled tx"
	default CONTINUOUS_TX

config CONTINUOUS_TX
	bool "Send traffic continuously"
	help
	  Send traffic continuously without any restrictions, irrespective of sleep and awake periods.

config SCHEDULED_TX
	bool "Send traffic based on TWT schedule"
	help
	  Send traffic based on the TWT schedule and only transmits during the awake periods.

endchoice

endmenu
```

## samples/wifi/twt/modules/traffic_gen/Kconfig
```kconfig
#
# Copyright (c) 2023 Nordic Semiconductor
#
# SPDX-License-Identifier: LicenseRef-Nordic-5-Clause
#
#
config TRAFFIC_GEN
	bool "Traffic generation module"
	select NET_CONTEXT_RCVTIMEO

choice TRAFFIC_GEN_SELECT_ROLE
	prompt "APP should be either client or server"
	default TRAFFIC_GEN_CLIENT

config TRAFFIC_GEN_CLIENT
	bool "Traffic gen module acts as a Client"
	help
	  Enable this option to send uplink traffic to traffic gen server

config TRAFFIC_GEN_SERVER
	bool "Traffic gen module acts as a Server"
	help
	  Enable this option to receive downlink traffic from traffic gen
	  client (A python client running in Cloud).

endchoice

config TRAFFIC_GEN_DURATION
	int "Traffic gen will simulate traffic for a specified duration"
	default 30
	help
	  Specifies how long traffic gen should simulate traffic

config TRAFFIC_GEN_REMOTE_IPV4_ADDR
	string "Traffic gen remote host IPv4 address"
	help
	  Specifies the traffic gen server IPv4 address

config TRAFFIC_GEN_REMOTE_PORT_NUM
	int "Traffic gen remote host port number"
	default 7777
	help
	  Configures the traffic gen remote host port number

config TRAFFIC_GEN_PAYLOAD_SIZE
	int "Traffic gen payload size"
	default 1024
	help
	  Configures the payload size of the traffic gen packets

config TRAFFIC_GEN_TYPE_TCP
	bool "Traffic type"
	default y
	help
	  Enable this option to select the TCP traffic type

module = TRAFFIC_GEN
module-dep = LOG
module-str = Log level for sample
source "${ZEPHYR_BASE}/subsys/logging/Kconfig.template.log_config"
```
