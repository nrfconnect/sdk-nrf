## samples/wifi/shell/sysbuild/mcuboot/boards/thingy91x_nrf5340_cpuapp.conf
```kconfig
#
# Copyright (c) 2024 Nordic Semiconductor ASA
#
# SPDX-License-Identifier: LicenseRef-Nordic-5-Clause
#

# modified to use external flash

# MCUBoot settings
CONFIG_BOOT_MAX_IMG_SECTORS=512

CONFIG_SPI=y
CONFIG_SPI_NOR=y
CONFIG_SPI_NOR_FLASH_LAYOUT_PAGE_SIZE=4096
CONFIG_SPI_NOR_SFDP_DEVICETREE=y

# MCUboot serial recovery
CONFIG_MCUBOOT_SERIAL=y

# Disable Zephyr console
CONFIG_LOG=n
CONFIG_CONSOLE=n
CONFIG_CONSOLE_HANDLER=n
CONFIG_UART_CONSOLE=n

# Serial
CONFIG_SERIAL=y
CONFIG_UART_NRFX=y
CONFIG_UART_INTERRUPT_DRIVEN=y
CONFIG_UART_LINE_CTRL=y

# MCUboot serial recovery
CONFIG_GPIO=y
CONFIG_MCUBOOT_SERIAL=y
CONFIG_BOOT_SERIAL_CDC_ACM=y

# Required by USB
CONFIG_MULTITHREADING=y

# USB
CONFIG_USB_DEVICE_STACK=y
CONFIG_USB_DEVICE_PRODUCT="MCUBOOT"
CONFIG_USB_CDC_ACM=y
CONFIG_USB_COMPOSITE_DEVICE=y
CONFIG_USB_MASS_STORAGE=n
CONFIG_USB_DEVICE_MANUFACTURER="Nordic Semiconductor"
CONFIG_USB_DEVICE_VID=0x1915
CONFIG_USB_DEVICE_PID=0x910A

CONFIG_BOOT_SERIAL_BOOT_MODE=y

CONFIG_PM_PARTITION_SIZE_MCUBOOT=0x13E00

# The following configurations are required to support simultaneous multi image update
CONFIG_PCD_APP=y
CONFIG_UPDATEABLE_IMAGE_NUMBER=2
CONFIG_BOOT_UPGRADE_ONLY=y
# The network core cannot access external flash directly. The flash simulator must be used to
# provide a memory region that is used to forward the new firmware to the network core.
CONFIG_FLASH_SIMULATOR=y
CONFIG_FLASH_SIMULATOR_DOUBLE_WRITES=y
CONFIG_FLASH_SIMULATOR_STATS=n

CONFIG_BOOT_IMAGE_ACCESS_HOOKS=y

# Makes it possible to update the network core using the flash simulator
CONFIG_NRF53_RECOVERY_NETWORK_CORE=y

CONFIG_MCUBOOT_SERIAL_DIRECT_IMAGE_UPLOAD=y
CONFIG_BOOT_SERIAL_IMG_GRP_IMAGE_STATE=y

# Skip checks on the secondary image to make it possible to update MCUBoot on S1/S0
CONFIG_MCUBOOT_VERIFY_IMG_ADDRESS=n

CONFIG_SPI=y
CONFIG_FLASH=y
CONFIG_SPI_NOR=y
CONFIG_SPI_NOR_FLASH_LAYOUT_PAGE_SIZE=4096
CONFIG_SPI_NOR_SFDP_DEVICETREE=y

CONFIG_MFD_NPM1300=n

CONFIG_BOOT_SERIAL_NO_APPLICATION=y

CONFIG_PM_DEVICE_RUNTIME=y
```

## samples/wifi/shutdown/sample.yaml
```yaml
sample:
  description: Wi-Fi shutdown sample application
  name: Wi-Fi shutdown
tests:
  sample.nrf7002.shutdown:
    sysbuild: true
    build_only: true
    integration_platforms:
      - nrf7002dk/nrf5340/cpuapp
    platform_allow: nrf7002dk/nrf5340/cpuapp
    tags:
      - ci_build
      - sysbuild
      - ci_samples_wifi
  sample.nrf7002_eks.shutdown:
    sysbuild: true
    build_only: true
    extra_args: SHIELD=nrf7002ek
    integration_platforms:
      - nrf5340dk/nrf5340/cpuapp
      - nrf52840dk/nrf52840
    platform_allow:
      - nrf5340dk/nrf5340/cpuapp
      - nrf52840dk/nrf52840
    tags:
      - ci_build
      - sysbuild
      - ci_samples_wifi
  sample.nrf7000_location.shutdown:
    sysbuild: true
    build_only: true
    extra_args: SHIELD=nrf7002ek_nrf7000
    integration_platforms:
      - nrf5340dk/nrf5340/cpuapp
      - nrf9160dk/nrf9160/ns
      - nrf9161dk/nrf9161/ns
      - nrf52840dk/nrf52840
    platform_allow:
      - nrf5340dk/nrf5340/cpuapp
      - nrf9160dk/nrf9160/ns
      - nrf9161dk/nrf9161/ns
      - nrf9151dk/nrf9151/ns
      - nrf52840dk/nrf52840
    tags:
      - ci_build
      - sysbuild
      - ci_samples_wifi
  sample.nrf7002eb_interposer_p1.nrf7002eb.shutdown:
    sysbuild: true
    build_only: true
    extra_args:
      - shutdown_SHIELD="nrf7002eb_interposer_p1;nrf7002eb"
      - shutdown_SNIPPET=nrf70-wifi
    integration_platforms:
      - nrf54h20dk/nrf54h20/cpuapp
    platform_allow:
      - nrf54h20dk/nrf54h20/cpuapp
    tags:
      - ci_build
      - sysbuild
      - ci_samples_wifi
  sample.nrf7002eb2.shutdown:
    sysbuild: true
    build_only: true
    extra_args:
      - shutdown_SHIELD="nrf7002eb2"
      - SNIPPET=nrf70-wifi
    integration_platforms:
      - nrf54l15dk/nrf54l15/cpuapp
    platform_allow:
      - nrf54l15dk/nrf54l15/cpuapp
    tags:
      - ci_build
      - sysbuild
      - ci_samples_wifi
  sample.54lm20dk.nrf7002eb2.shutdown:
    sysbuild: true
    build_only: true
    extra_args:
      - shutdown_SHIELD="nrf7002eb2"
    integration_platforms:
      - nrf54lm20dk/nrf54lm20a/cpuapp
    platform_allow:
      - nrf54lm20dk/nrf54lm20a/cpuapp
    tags:
      - ci_build
      - sysbuild
      - ci_samples_wifi
```

## samples/wifi/softap/boards/nrf7120dk_nrf7120_cpuapp.conf
```kconfig
#
# Copyright (c) 2026 Nordic Semiconductor
#
# SPDX-License-Identifier: LicenseRef-Nordic-5-Clause
#

CONFIG_WIFI_NRF71=y
CONFIG_NRF71_AP_MODE=y
CONFIG_NRF71_RX_NUM_BUFS=16
CONFIG_NRF_WIFI_DATA_HEAP_SIZE=90000
```

## samples/wifi/softap/sample.yaml
```yaml
sample:
  description: Wi-Fi SoftAP sample application
  name: Wi-Fi SoftAP
tests:
  sample.nrf7002.softap:
    sysbuild: true
    build_only: true
    integration_platforms:
      - nrf7002dk/nrf5340/cpuapp
    platform_allow: nrf7002dk/nrf5340/cpuapp
    tags:
      - ci_build
      - sysbuild
      - ci_samples_wifi
  sample.nrf7002_eks.softap:
    sysbuild: true
    build_only: true
    extra_args: SHIELD=nrf7002ek
    integration_platforms:
      - nrf5340dk/nrf5340/cpuapp
    platform_allow: nrf5340dk/nrf5340/cpuapp
    tags:
      - ci_build
      - sysbuild
      - ci_samples_wifi
  sample.nrf7001.softap:
    sysbuild: true
    build_only: true
    integration_platforms:
      - nrf7002dk/nrf5340/cpuapp/nrf7001
    platform_allow: nrf7002dk/nrf5340/cpuapp/nrf7001
    tags:
      - ci_build
      - sysbuild
      - ci_samples_wifi
  sample.nrf7001_eks.softap:
    sysbuild: true
    build_only: true
    extra_args: SHIELD=nrf7002ek_nrf7001
    integration_platforms:
      - nrf5340dk/nrf5340/cpuapp
    platform_allow: nrf5340dk/nrf5340/cpuapp
    tags:
      - ci_build
      - sysbuild
      - ci_samples_wifi
  sample.nrf54h20.softap:
    sysbuild: true
    build_only: true
    extra_args:
      - softap_SHIELD="nrf7002eb_interposer_p1;nrf7002eb"
      - softap_SNIPPET=nrf70-wifi
    integration_platforms:
      - nrf54h20dk/nrf54h20/cpuapp
    platform_allow:
      - nrf54h20dk/nrf54h20/cpuapp
    tags:
      - ci_build
      - sysbuild
      - ci_samples_wifi
  sample.nrf54l15.softap:
    sysbuild: true
    build_only: true
    extra_args:
      - softap_SHIELD="nrf7002eb_interposer_p1;nrf7002eb"
      - softap_SNIPPET=nrf70-wifi
      - CONFIG_HEAP_MEM_POOL_IGNORE_MIN=n
    integration_platforms:
      - nrf54l15dk/nrf54l15/cpuapp
    platform_allow:
      - nrf54l15dk/nrf54l15/cpuapp
    tags:
      - ci_build
      - sysbuild
      - ci_samples_wifi
  sample.nrf7002eb2.softap:
    sysbuild: true
    build_only: true
    extra_args:
      - softap_SHIELD="nrf7002eb2"
      - softap_SNIPPET=nrf70-wifi
    integration_platforms:
      - nrf54l15dk/nrf54l15/cpuapp
    platform_allow:
      - nrf54l15dk/nrf54l15/cpuapp
    tags:
      - ci_build
      - sysbuild
      - ci_samples_wifi
  sample.54lm20dk.nrf7002eb2.softap:
    sysbuild: true
    build_only: true
    extra_args:
      - softap_SHIELD="nrf7002eb2"
    integration_platforms:
      - nrf54lm20dk/nrf54lm20a/cpuapp
    platform_allow:
      - nrf54lm20dk/nrf54lm20a/cpuapp
    tags:
      - ci_build
      - sysbuild
      - ci_samples_wifi
```

## samples/wifi/sr_coex/Kconfig
```kconfig
#
# Copyright (c) 2023 Nordic Semiconductor
#
# SPDX-License-Identifier: LicenseRef-Nordic-5-Clause
#

source "Kconfig.zephyr"

menu "Nordic Coex sample"

#------------------------------ Wi-Fi configurations
config STA_SSID
	string "SSID"
	default "wifi_sr_coex_24"
	help
	  Specify the SSID to connect

choice  STA_KEY_MGMT_SELECT
	prompt "Security Option"
	default STA_KEY_MGMT_NONE

config STA_KEY_MGMT_NONE
	bool "Open Security"
	help
	  Enable for Open Security

config STA_KEY_MGMT_WPA2
	bool "WPA2 Security"
	help
	  Enable for WPA2 Security

config STA_KEY_MGMT_WPA2_256
	bool "WPA2 SHA 256 Security"
	help
	  Enable for WPA2-PSK-256 Security

config STA_KEY_MGMT_WPA3
	bool "WPA3 Security"
	help
	  Enable for WPA3 Security
endchoice

config STA_PASSWORD
	string "Passphrase (WPA2) or password (WPA3)"
	help
	  Specify the Password to connect

config NET_CONFIG_PEER_IPV4_ADDR
	string "Peer IPv4 address"
	default "192.168.1.253"

config NET_CONFIG_PEER_IPV4_PORT
	int "Peer IPv4 port"
	default 5001

config WIFI_THREAD_STACK_SIZE
	int "Wi-Fi thread stack size"
	default 4096

config WIFI_THREAD_PRIORITY
	int "Wi-Fi thread priority"
	default 5

config WIFI_ZPERF_SERVER
	bool "Zperf role: server or client"
	default n

config WIFI_ZPERF_PROT_UDP
	bool "UDP or TCP"
	default y

config WIFI_ZPERF_PKT_SIZE
	int "packet size"
	default 1024

config WIFI_ZPERF_RATE
	int "rate in kbps"
	default 15000

config WIFI_BAND_2PT4G
	bool "Indicates if WLAN operating band is 2.4GHz or 5GHz"
	default y

#------------------------------ BLE configurations
config BT_ROLE_CENTRAL
	bool "BT device role"
	default y

config BT_GAP_ADV_FAST_INT_MIN_2
	int "BT GAP ADV interval min value. Each unit 0.625milliseconds"
	default 160

config BT_GAP_ADV_FAST_INT_MAX_2
	int "BT GAP ADV interval max value. Each unit 0.625milliseconds"
	default 240

config BT_LE_SCAN_INTERVAL
	int "BT LE Scan interval  value. Each unit is 0.625milliseconds."
	default 16

config BT_LE_SCAN_WINDOW
	int "BT LE Scan Window value. Each unit is 0.625milliseconds."
	default 16

config BT_INTERVAL_MIN
	int "BLE min connection interval. Each unit 1.25milliseconds"
	default 80

config BT_INTERVAL_MAX
	int "BLE max connection interval. Each unit 1.25milliseconds"
	default 80

config BT_SUPERVISION_TIMEOUT
	int "BT LE supervision timeout"
	default 1000

config BT_CONN_LATENCY
	int "BT LE connection latency"
	default 0

rsource "test/Kconfig"
endmenu
```

## samples/wifi/sr_coex/sample.yaml
```yaml
sample:
  description: Wi-Fi BLE coex sample
    application
  name: Wi-Fi BLE coex
tests:
  sample.nrf7002.ble_coex_sep_ant:
    build_only: true
    integration_platforms:
      - nrf7002dk_nrf5340_cpuapp
    extra_args: CONFIG_MPSL_CX=y hci_rpmsg_CONFIG_MPSL_CX=y
                CONFIG_COEX_SEP_ANTENNAS=y
    platform_allow: nrf7002dk_nrf5340_cpuapp
    tags: ci_build
  sample.nrf7002.ble_coex_sha_ant:
    build_only: true
    integration_platforms:
      - nrf7002dk_nrf5340_cpuapp
    extra_args: CONFIG_MPSL_CX=y hci_rpmsg_CONFIG_MPSL_CX=y
                CONFIG_COEX_SEP_ANTENNAS=n
    platform_allow: nrf7002dk_nrf5340_cpuapp
    tags: ci_build
  sample.nrf7001.ble_coex:
    build_only: true
    integration_platforms:
      - nrf7002dk_nrf7001_nrf5340_cpuapp
    extra_args: CONFIG_MPSL_CX=y hci_rpmsg_CONFIG_MPSL_CX=y
                CONFIG_COEX_SEP_ANTENNAS=y
    platform_allow: nrf7002dk_nrf7001_nrf5340_cpuapp
    tags: ci_build
  # Daughter boards (EK's/EB's) do not have a shared antenna
  sample.nrf7002ek.ble_coex:
    build_only: true
    integration_platforms:
      - nrf5340dk_nrf5340_cpuapp
    extra_args: SHIELD=nrf7002ek hci_rpmsg_SHIELD=nrf7002ek_coex
                CONFIG_MPSL_CX=y hci_rpmsg_CONFIG_MPSL_CX=y
                CONFIG_COEX_SEP_ANTENNAS=y
    platform_allow: nrf5340dk_nrf5340_cpuapp
    tags: ci_build
  sample.nrf7001ek.ble_coex:
    build_only: true
    integration_platforms:
      - nrf5340dk_nrf5340_cpuapp
    extra_args: SHIELD=nrf7002ek_nrf7001 hci_rpmsg_SHIELD=nrf7002ek_nrf7001_coex
                CONFIG_MPSL_CX=y hci_rpmsg_CONFIG_MPSL_CX=y
                CONFIG_COEX_SEP_ANTENNAS=y
    platform_allow: nrf5340dk_nrf5340_cpuapp
  sample.nrf7002_eb.thingy53.sr_coex:
    build_only: true
    extra_args: SHIELD=nrf7002eb hci_rpmsg_SHIELD=nrf7002eb_coex
                CONFIG_MPSL_CX=y hci_rpmsg_CONFIG_MPSL_CX=y
                CONFIG_COEX_SEP_ANTENNAS=y
    integration_platforms:
      - thingy53_nrf5340_cpuapp
    platform_allow: thingy53_nrf5340_cpuapp
    tags: ci_build
```

## samples/wifi/sr_coex/test/Kconfig
```kconfig
#
# Copyright (c) 2023 Nordic Semiconductor
#
# SPDX-License-Identifier: LicenseRef-Nordic-5-Clause
#

menu "Nordic Coex sample - test"

#-------------------------------------- test parameters
choice TEST_TYPE
	prompt "Test type"
	default TEST_TYPE_WLAN_BLE

config TEST_TYPE_WLAN_ONLY
	bool "WLAN only"
	help
	  Enable WLAN only

config TEST_TYPE_BLE_ONLY
	bool "BLE only"
	help
	  Enable BLE only

config TEST_TYPE_WLAN_BLE
	bool "WLAN and BLE"
	help
	  Enable WLAN and BLE
endchoice

config TEST_TYPE_WLAN
	bool "WLAN"
	default y if TEST_TYPE_WLAN_ONLY || TEST_TYPE_WLAN_BLE
	select WIFI
	help
	  Enable WLAN

config TEST_TYPE_BLE
	bool "BLE"
	default y if TEST_TYPE_BLE_ONLY || TEST_TYPE_WLAN_BLE
	help
	  Enable BLE

config COEX_TEST_DURATION
	int "test duration in milliseconds"
	default 20000

config COEX_SEP_ANTENNAS
	bool "Control if the antennas are shared/serparate for BT and WLAN"
	default y

config DEBUG_PRINT_WIFI_SCAN_INFO
	bool "Print Wi-Fi Scan info for debug purpose"
	default n

config DEBUG_PRINT_WIFI_DHCP_INFO
	bool "Print Wi-Fi DHCP info for debug purpose"
	default n

config DEBUG_PRINT_WIFI_CONN_INFO
	bool "Print Wi-Fi Connection info for debug purpose"
	default n

config PRINTS_FOR_AUTOMATION
	bool "Print info required for automation."
	default y

#-------------------------------------- test cases
config WIFI_TP_UDP_CLIENT_BLE_TP_CENTRAL
	bool "Select to run UDP client and central test"
	default n

config WIFI_TP_UDP_CLIENT_BLE_TP_PERIPH
	bool "Select to run UDP client and peripheral test"
	default n

config WIFI_TP_UDP_SERVER_BLE_TP_CENTRAL
	bool "Select to run UDP server and central test"
	default n

config WIFI_TP_UDP_SERVER_BLE_TP_PERIPH
	bool "Select to run UDP server and peripheral test"
	default n

config WIFI_TP_TCP_CLIENT_BLE_TP_CENTRAL
	bool "Select to run TCP client and central test"
	default n

config WIFI_TP_TCP_CLIENT_BLE_TP_PERIPH
	bool "Select to run TCP client and peripheral test"
	default n

config WIFI_TP_TCP_SERVER_BLE_TP_CENTRAL
	bool "Select to run TCP server and central test"
	default n

config WIFI_TP_TCP_SERVER_BLE_TP_PERIPH
	bool "Select to run TCP server and peripheral test"
	default n
endmenu
```

## samples/wifi/sta/Kconfig
```kconfig
#
# Copyright (c) 2022 Nordic Semiconductor
#
# SPDX-License-Identifier: LicenseRef-Nordic-5-Clause
#

source "Kconfig.zephyr"

menu "Nordic Sta sample"

config CONNECTION_IDLE_TIMEOUT
	int "Time to be waited for a station to connect"
	default 30

config NRF70_QSPI_ENCRYPTION_KEY
	string "16 bytes QSPI encryption key, only for testing purposes"
	depends on BOARD_NRF7002DK_NRF5340_CPUAPP
	help
	  Specify the QSPI encryption key

config STA_CONN_TIMEOUT_SEC
	int "Overall Connection timeout i.e., time to be waited for a station to connect and get an IP address"
	# Zephyr DHCP retry is 1 minute, so set the default to 70 seconds
	default 70
	# 512 has no special meaning, just a reasonable upper limit
	range 0 512
	help
	  Specify the connection timeout, in seconds. This is the overall timeout i.e., time to be waited for
	  a station to connect and get an IP address. DHCP retries should be taken into account when setting
	  this value. If the timeout is set to 0, the connection will not timeout.

config STA_SAMPLE_START_WIFI_THREAD_STACK_SIZE
	int "Stack size for Wi-Fi start thread"
	default 4096
	help
	  Set the stack size for the Wi-Fi start thread.
endmenu
```
