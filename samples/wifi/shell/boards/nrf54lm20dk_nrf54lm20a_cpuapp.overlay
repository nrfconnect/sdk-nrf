/delete-node/ &boot_partition;
/delete-node/ &slot0_partition;
/delete-node/ &slot1_partition;
/delete-node/ &storage_partition;

&cpuapp_rram {
	partitions {
		slot0_partition: partition@0 {
			compatible = "zephyr,mapped-partition";
			label = "image-0";
			reg = <0x0 0x1fb000>;
		};

		storage_partition: partition@1fb000 {
			compatible = "zephyr,mapped-partition";
			label = "storage";
			reg = <0x1fb000 0x2000>;
		};
	};
};
