/* Copyright (c) 2024 Nordic Semiconductor ASA
 *
 * SPDX-License-Identifier: LicenseRef-Nordic-5-Clause
 */

/* modified to use external flash */

#include "../../../boards/thingy91x_nrf5340_cpuapp_partitions.dtsi"

&flash_ext {
	status = "okay";
};

&spi3 {
	status = "okay";
};

/ {
	chosen {
		zephyr,code-partition = &s0_partition;
		nordic,pm-ext-flash = &flash_ext;
	};
};
