/*
 * Copyright (c) 2026 Nordic Semiconductor ASA
 *
 * SPDX-License-Identifier: LicenseRef-Nordic-5-Clause
 */

/* Define partition layout so &b0_partition referenced by
 * nrf/samples/bootloader/app.overlay resolves correctly.
 */
#include "../../../boards/thingy91x_nrf5340_cpuapp_partitions.dtsi"
