## CMakeLists.txt
```
#
# Copyright (c) 2023 Nordic Semiconductor ASA
#
# SPDX-License-Identifier: LicenseRef-Nordic-5-Clause
#

cmake_minimum_required(VERSION 3.20.0)

find_package(Zephyr REQUIRED HINTS $ENV{ZEPHYR_BASE})
project(nrf_wfa_qt_app)

target_include_directories_ifdef(CONFIG_SAMPLE_WIFI_USBD
  app PRIVATE ${ZEPHYR_NRF_MODULE_DIR}/samples/wifi/common/src
)

target_sources_ifdef(CONFIG_SAMPLE_WIFI_USBD
  app PRIVATE ${ZEPHYR_NRF_MODULE_DIR}/samples/wifi/common/src/wifi_sample_usbd.c
)
target_sources(app PRIVATE src/qt_app_main.c)
```

## Kconfig
```
#
# Copyright (c) 2023 Nordic Semiconductor
#
# SPDX-License-Identifier: LicenseRef-Nordic-5-Clause
#

source "Kconfig.zephyr"
source "${ZEPHYR_NRF_MODULE_DIR}/samples/wifi/common/Kconfig.usbd"

menu "Nordic WFA QT sample"

config NET_CONFIG_USB_IPV4_ADDR
	string "USB IPv4 address"
	help
	  Static IPv4 address for USB interface

config NET_CONFIG_SLIP_IPV4_ADDR
	string "SLIP IPv4 address"
	help
	  Static IPv4 address for SLIP (Serial Line Internet Protocol) interface.

config NET_CONFIG_SLIP_IPV4_MASK
	string "SLIP IPv4 subnet mask"
	help
	  Static IPv4 subnet mask for SLIP (Serial Line Internet Protocol) interface.

config WFA_QT_SAMPLE_DHCPV4_POOL_START
	string "Start address of DHCPv4 pool"
	default "192.168.65.2"
	help
	  Set the start IP address of DHCPv4 pool.

endmenu
```

## sample.yaml
```
sample:
  description: WFA QuickTrack control application
  name: WFA QT App
common:
  tags:
    - ci_build
    - sysbuild
    - ci_samples_wifi
tests:
  sample.nrf7002.wfa_qt_app:
    sysbuild: true
    build_only: true
    integration_platforms:
      - nrf7002dk/nrf5340/cpuapp
    platform_allow: nrf7002dk/nrf5340/cpuapp
  sample.nrf7002.enterprise_mode.wfa_qt_app.netusb:
    sysbuild: true
    build_only: true
    extra_args:
      - EXTRA_CONF_FILE="overlay-netusb.conf;overlay-enterprise.conf"
      - wfa_qt_app_SNIPPET="nordic-wifi-enterprise"
    integration_platforms:
      - nrf7002dk/nrf5340/cpuapp
    platform_allow: nrf7002dk/nrf5340/cpuapp
  sample.nrf7002.enterprise_mode.wfa_qt_app.slip:
    sysbuild: true
    build_only: true
    extra_args:
      - EXTRA_CONF_FILE="overlay-slip.conf;overlay-enterprise.conf"
      - EXTRA_DTC_OVERLAY_FILE="nrf7002_uart_pipe.overlay"
      - wfa_qt_app_SNIPPET="nordic-wifi-enterprise"
    integration_platforms:
      - nrf7002dk/nrf5340/cpuapp
    platform_allow: nrf7002dk/nrf5340/cpuapp
  sample.nrf7002_eks.wfa_qt_app:
    sysbuild: true
    build_only: true
    extra_args: SHIELD=nrf7002ek
    integration_platforms:
      - nrf5340dk/nrf5340/cpuapp
    platform_allow: nrf5340dk/nrf5340/cpuapp
  sample.nrf7002eb_interposer_p1.nrf7002eb.wfa_qt_app:
    sysbuild: true
    build_only: true
    extra_args:
      - wfa_qt_app_SHIELD="nrf7002eb_interposer_p1;nrf7002eb"
      - wfa_qt_app_SNIPPET=nrf70-wifi
      - EXTRA_CONF_FILE="usb-next.conf"
      - EXTRA_DTC_OVERLAY_FILE=usbd_next_ecm.overlay
    integration_platforms:
      - nrf54h20dk/nrf54h20/cpuapp
    platform_allow:
      - nrf54h20dk/nrf54h20/cpuapp
  sample.54lm20dk.nrf7002eb2.wfa_qt_app.netusb:
    sysbuild: true
    build_only: true
    extra_args:
      - wfa_qt_app_SHIELD="nrf7002eb2"
      - EXTRA_CONF_FILE="usb-next.conf"
      - EXTRA_DTC_OVERLAY_FILE=usbd_next_ecm.overlay
    integration_platforms:
      - nrf54lm20dk/nrf54lm20a/cpuapp
      - nrf54lm20dk/nrf54lm20b/cpuapp
    platform_allow:
      - nrf54lm20dk/nrf54lm20a/cpuapp
      - nrf54lm20dk/nrf54lm20b/cpuapp
  sample.54lm20dk.nrf7002eb2.wfa_qt_app.slip:
    sysbuild: true
    build_only: true
    extra_args:
      - wfa_qt_app_SHIELD="nrf7002eb2"
      - EXTRA_CONF_FILE="overlay-slip.conf"
      - EXTRA_DTC_OVERLAY_FILE="nrf54lm20_uart_pipe.overlay"
    integration_platforms:
      - nrf54lm20dk/nrf54lm20a/cpuapp
      - nrf54lm20dk/nrf54lm20b/cpuapp
    platform_allow:
      - nrf54lm20dk/nrf54lm20a/cpuapp
      - nrf54lm20dk/nrf54lm20b/cpuapp
  sample.nrf7120.wfa_qt_app.slip:
    sysbuild: true
    build_only: true
    extra_args:
      - EXTRA_CONF_FILE="overlay-slip.conf"
      - EXTRA_DTC_OVERLAY_FILE="nrf7120_uart_pipe.overlay"
    integration_platforms:
      - nrf7120dk/nrf7120/cpuapp
      - nrf7120dk/nrf7120/cpuapp/ns
    platform_allow:
      - nrf7120dk/nrf7120/cpuapp
      - nrf7120dk/nrf7120/cpuapp/ns
    tags:
      - ci_samples_nrf71_wifi
  sample.wfa_qt_app.rtt:
    sysbuild: true
    build_only: true
    extra_args:
      - EXTRA_CONF_FILE="rtt.conf"
    integration_platforms:
      - nrf7002dk/nrf5340/cpuapp
      - nrf7120dk/nrf7120/cpuapp
    platform_allow:
      - nrf7002dk/nrf5340/cpuapp
      - nrf7120dk/nrf7120/cpuapp
```

## prj.conf
```kconfig
#
# Copyright (c) 2023 Nordic Semiconductor ASA
#
# SPDX-License-Identifier: LicenseRef-Nordic-5-Clause
#
CONFIG_WIFI=y
CONFIG_WFA_QT_CONTROL_APP=y

# WPA supplicant
CONFIG_WIFI_NM_WPA_SUPPLICANT=y
CONFIG_NET_L2_WIFI_SHELL=y
CONFIG_WIFI_NM_WPA_SUPPLICANT_ADVANCED_FEATURES=y

# System settings
CONFIG_COMMON_LIBC_MALLOC_ARENA_SIZE=40000

CONFIG_NET_CONFIG_INIT_TIMEOUT=0

# Networking
CONFIG_NETWORKING=y
CONFIG_NET_SOCKETS=y
CONFIG_NET_LOG=y
CONFIG_NET_IPV6=y
CONFIG_NET_IPV4=y
CONFIG_NET_UDP=y
CONFIG_NET_TCP=y
CONFIG_NET_DHCPV4=y
CONFIG_NET_DHCPV4_SERVER=y
CONFIG_DNS_RESOLVER=y

CONFIG_NET_STATISTICS=y
CONFIG_NET_STATISTICS_WIFI=y
CONFIG_NET_STATISTICS_USER_API=y

CONFIG_NET_PKT_RX_COUNT=8
CONFIG_NET_PKT_TX_COUNT=8

# Below section is the primary contributor to SRAM and is currently
# tuned for performance, but this will be revisited in the future.
CONFIG_NET_BUF_RX_COUNT=16
CONFIG_NET_BUF_TX_COUNT=16
CONFIG_HEAP_MEM_POOL_SIZE=40144
CONFIG_NET_TC_TX_COUNT=1

CONFIG_NET_IF_UNICAST_IPV6_ADDR_COUNT=4
CONFIG_NET_IF_MCAST_IPV6_ADDR_COUNT=5
CONFIG_NET_MAX_CONTEXTS=5
CONFIG_NET_CONTEXT_SYNC_RECV=y

CONFIG_INIT_STACKS=y

CONFIG_NET_L2_ETHERNET=y
CONFIG_NET_SHELL=y

# Memories
CONFIG_MAIN_STACK_SIZE=5200
CONFIG_SHELL_STACK_SIZE=5200
CONFIG_NET_TX_STACK_SIZE=4096
CONFIG_NET_RX_STACK_SIZE=4096

# Debugging
CONFIG_STACK_SENTINEL=y
CONFIG_DEBUG_COREDUMP=y
CONFIG_DEBUG_COREDUMP_BACKEND_LOGGING=y
CONFIG_DEBUG_COREDUMP_MEMORY_DUMP_MIN=y
CONFIG_SHELL_CMDS_RESIZE=n
#CONFIG_DEBUG=y
CONFIG_WIFI_NM_WPA_SUPPLICANT_LOG_LEVEL_INF=y

# Kernel options
CONFIG_ENTROPY_GENERATOR=y
CONFIG_REBOOT=y

# Logging
CONFIG_LOG=y
CONFIG_PRINTK=y
CONFIG_SHELL=y
CONFIG_SHELL_GETOPT=y
CONFIG_DEVICE_SHELL=y
#CONFIG_POSIX_TIMERS=y
CONFIG_DATE_SHELL=y
CONFIG_NET_CONFIG_AUTO_INIT=n
CONFIG_NET_CONFIG_SETTINGS=y

CONFIG_WIFI_CREDENTIALS=y
CONFIG_FLASH=y
CONFIG_FLASH_PAGE_LAYOUT=y
CONFIG_FLASH_MAP=y
CONFIG_NVS=y
CONFIG_SETTINGS=y
CONFIG_SETTINGS_NVS=y

# printing of scan results puts pressure on queues in new locking
# design in net_mgmt. So, use a typical number of networks in a crowded
# environment as the queue depth.
CONFIG_NET_MGMT_EVENT_QUEUE_SIZE=150
#CONFIG_POSIX_API=y

CONFIG_SHELL_BACKEND_DUMMY=y

# This is needed for WPA3 PMKSA caching test cases
CONFIG_WIFI_NM_WPA_SUPPLICANT_EAPOL=y
```

## overlay-enterprise.conf
```kconfig
CONFIG_NRF_WIFI_DATA_HEAP_SIZE=70000
CONFIG_WIFI_CREDENTIALS=n
# Link-time optimizations to fix flash overflow
CONFIG_LTO=y
CONFIG_ISR_TABLES_LOCAL_DECLARATION=y
CONFIG_WIFI_SHELL_RUNTIME_CERTIFICATES=n
```

## overlay-netusb.conf
```kconfig
# USB Device settings
CONFIG_USB_DEVICE_STACK=y

# Select USB Configurations
CONFIG_USB_DEVICE_NETWORK_ECM=y

# Logging
CONFIG_USB_DRIVER_LOG_LEVEL_INF=y
CONFIG_USB_DEVICE_LOG_LEVEL_INF=y
# Number of IPv4 enabled network interfaces
CONFIG_NET_IF_MAX_IPV4_COUNT=2
CONFIG_NET_IF_UNICAST_IPV4_ADDR_COUNT=2
CONFIG_NET_CONFIG_USB_IPV4_ADDR="192.0.2.1"
CONFIG_USB_NRFX_WORK_QUEUE_STACK_SIZE=2048

# Sample uses deprecated code and needs to be ported to the new USB device stack.
CONFIG_WARN_DEPRECATED=n
```

## overlay-slip.conf
```kconfig
CONFIG_NET_DRIVERS=y
CONFIG_SLIP=y
CONFIG_SLIP_TAP=y
CONFIG_SLIP_MAC_ADDR="00:00:00:00:00:01"

# Shell should be disabled for SLIP to work
CONFIG_NET_SHELL=n
CONFIG_DEVICE_SHELL=n
CONFIG_DATE_SHELL=n
CONFIG_SHELL=y
CONFIG_SHELL_GETOPT=y
CONFIG_SHELL_BACKEND_SERIAL=n
CONFIG_SHELL_BACKEND_DUMMY=y
CONFIG_LOG=n
CONFIG_PRINTK=n

CONFIG_NET_IF_MAX_IPV4_COUNT=2
CONFIG_NET_IF_UNICAST_IPV4_ADDR_COUNT=2

CONFIG_NET_CONFIG_SLIP_IPV4_ADDR="192.0.2.1"
CONFIG_NET_CONFIG_SLIP_IPV4_MASK="255.255.255.0"
```

## overlay-usb-next.conf
```kconfig
CONFIG_USB_DEVICE_STACK_NEXT=y
CONFIG_USBD_CDC_ECM_CLASS=y

CONFIG_LOG=y
CONFIG_USBD_LOG_LEVEL_ERR=y
CONFIG_UDC_DRIVER_LOG_LEVEL_ERR=y
CONFIG_USBD_CDC_ECM_LOG_LEVEL_ERR=y
CONFIG_USBD_THREAD_STACK_SIZE=4096

CONFIG_WIFI_SAMPLE_USBD=y
CONFIG_WIFI_SAMPLE_USBD_PID=0x54A3

# Number of IPv4 enabled network interfaces
CONFIG_NET_IF_MAX_IPV4_COUNT=2
CONFIG_NET_IF_UNICAST_IPV4_ADDR_COUNT=2
CONFIG_NET_CONFIG_USB_IPV4_ADDR="192.0.2.1"
```

## rtt.conf
```kconfig
CONFIG_SHELL=y
CONFIG_SHELL_GETOPT=y
CONFIG_USE_SEGGER_RTT=y
CONFIG_RTT_CONSOLE=y
CONFIG_SHELL_BACKEND_RTT=y
CONFIG_SHELL_BACKEND_RTT_BUFFER=0
CONFIG_SHELL_LOG_BACKEND=n
CONFIG_SHELL_ECHO_STATUS=n
CONFIG_SEGGER_RTT_BUFFER_SIZE_DOWN=1024

CONFIG_LOG_MODE_DEFERRED=y
CONFIG_LOG_BUFFER_SIZE=32768
CONFIG_LOG_BLOCK_IN_THREAD=y
CONFIG_LOG_BLOCK_IN_THREAD_TIMEOUT_MS=1000
CONFIG_LOG_PROCESS_THREAD_CUSTOM_PRIORITY=y
CONFIG_LOG_PROCESS_THREAD_PRIORITY=0
CONFIG_LOG_PROCESS_THREAD_SLEEP_MS=10
CONFIG_LOG_BACKEND_RTT=y
CONFIG_LOG_BACKEND_RTT_BUFFER=1
CONFIG_LOG_BACKEND_RTT_BUFFER_SIZE=16384
CONFIG_LOG_BACKEND_RTT_MODE_BLOCK=y
CONFIG_LOG_BACKEND_RTT_RETRY_CNT=50
CONFIG_LOG_BACKEND_RTT_RETRY_DELAY_MS=1
CONFIG_LOG_BACKEND_SHOW_COLOR=n
CONFIG_LOG_RUNTIME_FILTERING=n

CONFIG_THREAD_NAME=y
```

## usb-next.conf
```kconfig
CONFIG_USB_DEVICE_STACK_NEXT=y
CONFIG_USBD_CDC_ECM_CLASS=y

CONFIG_LOG=y
CONFIG_USBD_LOG_LEVEL_ERR=y
CONFIG_UDC_DRIVER_LOG_LEVEL_ERR=y
CONFIG_USBD_CDC_ECM_LOG_LEVEL_ERR=y
CONFIG_USBD_THREAD_STACK_SIZE=4096

CONFIG_SAMPLE_WIFI_USBD=y
CONFIG_SAMPLE_WIFI_USBD_PID=0x54A3

# Number of IPv4 enabled network interfaces
CONFIG_NET_IF_MAX_IPV4_COUNT=2
CONFIG_NET_IF_UNICAST_IPV4_ADDR_COUNT=2
CONFIG_NET_CONFIG_USB_IPV4_ADDR="192.0.2.1"
```

## nrf54h20_uart_pipe.overlay
```dts
/*
 * Copyright (c) 2024 Nordic Semiconductor ASA
 *
 * SPDX-License-Identifier: LicenseRef-Nordic-5-Clause
 */

/ {
	chosen {
		zephyr,uart-pipe = &uart136;
	};
};

&uart136 {
	compatible = "nordic,nrf-uarte";
	current-speed = <115200>;
	status = "okay";
	hw-flow-control;
};
```

## nrf54lm20_uart_pipe.overlay
```dts
/*
 * Copyright (c) 2025 Nordic Semiconductor ASA
 *
 * SPDX-License-Identifier: LicenseRef-Nordic-5-Clause
 */

/ {
	chosen {
		zephyr,uart-pipe = &uart20;
	};
};

&uart20 {
	compatible = "nordic,nrf-uarte";
	current-speed = <115200>;
	status = "okay";
	hw-flow-control;
};
```

## nrf7002_uart_pipe.overlay
```dts
/*
 * Copyright (c) 2023 Nordic Semiconductor ASA
 *
 * SPDX-License-Identifier: LicenseRef-Nordic-5-Clause
 */

 / {
	chosen {
		zephyr,uart-pipe = &uart0;
	};
};

&uart0 {
	compatible = "nordic,nrf-uarte";
	current-speed = <115200>;
	status = "okay";
	hw-flow-control;
};
```

## nrf7120_uart_pipe.overlay
```dts
/*
 * Copyright (c) 2026 Nordic Semiconductor ASA
 *
 * SPDX-License-Identifier: LicenseRef-Nordic-5-Clause
 */

/ {
	chosen {
		zephyr,uart-pipe = &uart20;
	};
};

&uart20 {
	compatible = "nordic,nrf-uarte";
	current-speed = <115200>;
	status = "okay";
	hw-flow-control;
};
```

## usbd_next_ecm.overlay
```dts
/*
 * Copyright (c) 2026 Nordic Semiconductor ASA
 *
 * SPDX-License-Identifier: LicenseRef-Nordic-5-Clause
 */

/ {
	cdc_ecm_eth0: cdc_ecm_eth0 {
		compatible = "zephyr,cdc-ecm-ethernet";
		remote-mac-address = "00005E005301";
	};
};
```

## src/qt_app_main.c
```c
/*
 * Copyright (c) 2023 Nordic Semiconductor ASA
 *
 * SPDX-License-Identifier: LicenseRef-Nordic-5-Clause
 */

/** @file
 * @brief WiFi QT control app main file.
 */

#include <zephyr/sys/printk.h>
#include <zephyr/kernel.h>
#include <zephyr/device.h>
#include <zephyr/net/net_config.h>

#if defined(CONFIG_USB_DEVICE_STACK)
#include <zephyr/usb/usb_device.h>
#elif defined(CONFIG_USB_DEVICE_STACK_NEXT)
#include "wifi_sample_usbd.h"
#endif

#if defined(CONFIG_NRFX_CLOCK_HFCLK) && defined(CLOCK_FEATURE_HFCLK_DIVIDE_PRESENT)
#include <zephyr/drivers/clock_control/nrf_clock_control.h>

#define HFCLK_REQUESTED_FREQUENCY MHZ(128)
#endif

#if defined(CONFIG_USB_DEVICE_STACK) || defined(CONFIG_USB_DEVICE_STACK_NEXT)
int init_usb(void)
{
	int ret;

#ifdef CONFIG_USB_DEVICE_STACK
	ret = usb_enable(NULL);
#elif defined(CONFIG_USB_DEVICE_STACK_NEXT)
	ret = wifi_usbd_init();
#endif
	if (ret != 0) {
		printk("Cannot enable USB (%d)", ret);
		return ret;
	}

	return 0;
}
#endif /* CONFIG_USB_DEVICE_STACK || CONFIG_USB_DEVICE_STACK_NEXT */

int main(void)
{
	struct in_addr addr = {0};
	struct in_addr mask;

#if defined(CONFIG_NRFX_CLOCK_HFCLK) && defined(CLOCK_FEATURE_HFCLK_DIVIDE_PRESENT)
	clock_control_set_rate(DEVICE_DT_GET_ONE(nordic_nrf_clock_hfclk), NULL,
			       (clock_control_subsys_rate_t)HFCLK_REQUESTED_FREQUENCY);
#endif
	printk("Starting %s with CPU frequency: %d MHz\n", CONFIG_BOARD, SystemCoreClock/MHZ(1));

#if defined(CONFIG_USB_DEVICE_STACK) || defined(CONFIG_USB_DEVICE_STACK_NEXT)
	init_usb();
#ifdef CONFIG_USB_DEVICE_STACK
	/* Redirect static IP address to netusb*/
	const struct device *usb_dev = device_get_binding("eth_netusb");
#elif defined(CONFIG_USB_DEVICE_STACK_NEXT)
	const struct device *usb_dev = device_get_binding("cdc_ecm_eth0");
#endif /* CONFIG_USB_DEVICE_STACK */
	struct net_if *iface = net_if_lookup_by_dev(usb_dev);

	if (!iface) {
		printk("Cannot find network interface: %s", "eth_netusb");
		return -1;
	}
	if (sizeof(CONFIG_NET_CONFIG_USB_IPV4_ADDR) > 1) {
		if (net_addr_pton(AF_INET, CONFIG_NET_CONFIG_USB_IPV4_ADDR, &addr)) {
			printk("Invalid address: %s", CONFIG_NET_CONFIG_USB_IPV4_ADDR);
			return -1;
		}
		net_if_ipv4_addr_add(iface, &addr, NET_ADDR_MANUAL, 0);
	}
	if (sizeof(CONFIG_NET_CONFIG_MY_IPV4_NETMASK) > 1) {
		/* If not empty */
		if (net_addr_pton(AF_INET, CONFIG_NET_CONFIG_MY_IPV4_NETMASK, &mask)) {
			printk("Invalid netmask: %s", CONFIG_NET_CONFIG_MY_IPV4_NETMASK);
		} else {
			net_if_ipv4_set_netmask_by_addr(iface, &addr, &mask);
		}
	}
#endif /* CONFIG_USB_DEVICE_STACK || CONFIG_USB_DEVICE_STACK_NEXT */

#ifdef CONFIG_SLIP
	const struct device *slip_dev = device_get_binding(CONFIG_SLIP_DRV_NAME);
	struct net_if *slip_iface = net_if_lookup_by_dev(slip_dev);

	if (!slip_iface) {
		printk("Cannot find network interface: %s", CONFIG_SLIP_DRV_NAME);
		return -1;
	}

	if (sizeof(CONFIG_NET_CONFIG_SLIP_IPV4_ADDR) > 1) {
		if (net_addr_pton(AF_INET, CONFIG_NET_CONFIG_SLIP_IPV4_ADDR, &addr)) {
			printk("Invalid address: %s", CONFIG_NET_CONFIG_SLIP_IPV4_ADDR);
			return -1;
		}
		net_if_ipv4_addr_add(slip_iface, &addr, NET_ADDR_MANUAL, 0);
	}

	if (sizeof(CONFIG_NET_CONFIG_SLIP_IPV4_MASK) > 1) {
		/* If not empty */
		if (net_addr_pton(AF_INET, CONFIG_NET_CONFIG_SLIP_IPV4_MASK, &mask)) {
			printk("Invalid netmask: %s", CONFIG_NET_CONFIG_SLIP_IPV4_MASK);
		} else {
			net_if_ipv4_set_netmask_by_addr(slip_iface, &addr, &mask);
		}
	}
#endif /* CONFIG_SLIP */

#ifdef CONFIG_NET_CONFIG_SETTINGS
	/* Without this, DHCPv4 starts on first interface and if that is not Wi-Fi or
	 * only supports IPv6, then its an issue. (E.g., OpenThread)
	 *
	 * So, we start DHCPv4 on Wi-Fi interface always, independent of the ordering.
	 */
	const struct device *dev = DEVICE_DT_GET(DT_CHOSEN(zephyr_wifi));
	struct net_if *wifi_iface = net_if_lookup_by_dev(dev);

	if (!wifi_iface) {
		printk("Cannot find network interface: %s", "wlan0");
		return -1;
	}
	if (sizeof(CONFIG_NET_CONFIG_MY_IPV4_ADDR) > 1) {
		if (net_addr_pton(AF_INET, CONFIG_NET_CONFIG_MY_IPV4_ADDR, &addr)) {
			printk("Invalid address: %s", CONFIG_NET_CONFIG_MY_IPV4_ADDR);
			return -1;
		}
		net_if_ipv4_addr_add(wifi_iface, &addr, NET_ADDR_MANUAL, 0);
	}
	if (sizeof(CONFIG_NET_CONFIG_MY_IPV4_NETMASK) > 1) {
		/* If not empty */
		if (net_addr_pton(AF_INET, CONFIG_NET_CONFIG_MY_IPV4_NETMASK, &mask)) {
			printk("Invalid netmask: %s", CONFIG_NET_CONFIG_MY_IPV4_NETMASK);
		} else {
			net_if_ipv4_set_netmask_by_addr(wifi_iface, &addr, &mask);
		}
	}

	/* As both are Ethernet, we need to set specific interface*/
	net_if_set_default(wifi_iface);

	net_config_init_app(dev, "Initializing network");
#endif

	return 0;
}
```
