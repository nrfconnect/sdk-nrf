## samples/wifi/wifi_provision/Kconfig
```kconfig
#
# Copyright (c) 2024 Nordic Semiconductor ASA
#
# SPDX-License-Identifier: LicenseRef-Nordic-5-Clause
#

menu "Wi-Fi provision"

menu "Zephyr Kernel"
source "Kconfig.zephyr"
endmenu

module = WIFI_PROVISION_SAMPLE
module-str = Wi-Fi provision sample
source "${ZEPHYR_BASE}/subsys/logging/Kconfig.template.log_config"

endmenu
```

## samples/wifi/wifi_provision/boards/nrf7002dk_nrf5340_cpuapp_ns.conf
```kconfig
#
# Copyright (c) 2024 Nordic Semiconductor ASA
#
# SPDX-License-Identifier: LicenseRef-Nordic-5-Clause
#

# Optimize TF-M
CONFIG_TFM_PROFILE_TYPE_SMALL=y
CONFIG_PM_PARTITION_SIZE_TFM_SRAM=0xc000
CONFIG_PM_PARTITION_SIZE_TFM=0x20000

# Optimize Wi-Fi stack to save some memory
CONFIG_HEAP_MEM_POOL_SIZE=81920
CONFIG_NRF700X_RX_NUM_BUFS=16
CONFIG_NRF700X_MAX_TX_AGGREGATION=4

# Wi-Fi
CONFIG_WIFI=y
CONFIG_WIFI_NRF700X=y
CONFIG_WPA_SUPP=y
CONFIG_NET_L2_ETHERNET=y

# General
CONFIG_LOG=y
CONFIG_LOG_MODE_IMMEDIATE=y
CONFIG_ASSERT=y
## Temporarily enable FS support so that linking succeeds
CONFIG_FILE_SYSTEM=y
CONFIG_MAIN_STACK_SIZE=8192

# DK Butons and LEDs
CONFIG_DK_LIBRARY=y

# Link time optimization
CONFIG_LTO=y
CONFIG_ISR_TABLES_LOCAL_DECLARATION=y

# Networking config
CONFIG_NETWORKING=y
CONFIG_NET_CONNECTION_MANAGER=y
CONFIG_NET_IPV4=y
CONFIG_NET_IPV6=y
CONFIG_NET_TCP=y
CONFIG_NET_UDP=y
CONFIG_NET_SOCKETS=y
CONFIG_POSIX_MAX_FDS=20
CONFIG_NET_SOCKETS_TLS_MAX_CONTEXTS=2

# Zephyr NET Connection Manager connectivity layer
CONFIG_L2_WIFI_CONNECTIVITY=y
CONFIG_L2_WIFI_CONNECTIVITY_AUTO_CONNECT=n
CONFIG_L2_WIFI_CONNECTIVITY_AUTO_DOWN=n

# Wi-Fi Provisioning
CONFIG_WIFI_PROVISION=y
CONFIG_WIFI_PROVISION_LOG_LEVEL_DBG=y

# IP address configuration - Initial IP address used by DHCPv4 server
CONFIG_NET_CONFIG_INIT_TIMEOUT=0
CONFIG_NET_CONFIG_MY_IPV4_ADDR="192.0.2.1"

# (M)DNS
CONFIG_MDNS_RESPONDER=y
CONFIG_DNS_SD=y
CONFIG_MDNS_RESPONDER_DNS_SD=y
CONFIG_NET_HOSTNAME_ENABLE=y
CONFIG_NET_HOSTNAME_UNIQUE=n
CONFIG_NET_HOSTNAME="wifiprov"
## Disable POSIX uname support to suppress build warning that hostname is too long
CONFIG_POSIX_UNAME=n

# DHCPv4 client - used during assignment of dynamic IP post provisioning to Access Point
CONFIG_NET_DHCPV4=y

# MBed TLS heap size, required by WPA supplicant and MBed TLS
CONFIG_MBEDTLS_HEAP_SIZE=81920
CONFIG_MBEDTLS_RSA_C=y

# Store TLS credentials to protected storage
CONFIG_TLS_CREDENTIALS_BACKEND_PROTECTED_STORAGE=y

# Extras - Remove
CONFIG_THREAD_NAME=y
CONFIG_LTO=n
CONFIG_ISR_TABLES_LOCAL_DECLARATION=n
# Shell and Wi-fi Credentials
CONFIG_SHELL=y
CONFIG_NET_SHELL=y
CONFIG_SHELL_STACK_SIZE=6144
CONFIG_NET_L2_WIFI_SHELL=y
CONFIG_ASSERT=n
CONFIG_MAIN_STACK_SIZE=16384
```

## samples/wifi/wifi_provision/sample.yaml
```yaml
sample:
  name: Wi-Fi Provision
tests:
  sample.wifi.wifi_provision:
    build_only: true
    integration_platforms:
      - nrf7002dk_nrf5340_cpuapp_ns
    platform_allow: nrf7002dk_nrf5340_cpuapp_ns
    tags: ci_build
```

## samples/zephyr/basic/blinky/sample.yaml
```yaml
sample:
  name: Blinky Sample
common:
  tags:
    - LED
    - gpio
    - ci_tests_drivers_hpf
  depends_on: gpio
  sysbuild: true
  harness: console
  harness_config:
    type: multi_line
    ordered: true
    regex:
      - "LED state: ON"
      - "LED state: OFF"

tests:
  nrf.extended.sample.basic.blinky:
    platform_allow:
      - nrf54ls05dk/nrf54ls05b/cpuapp
      - nrf54lv10dk/nrf54lv10a/cpuapp
      - nrf54lv10dk/nrf54lv10a/cpuapp/ns
      - nrf54lm20dongle/nrf54lm20b/cpuapp
    integration_platforms:
      - nrf54lv10dk/nrf54lv10a/cpuapp

  nrf.extended.sample.basic.blinky.hpf.gpio.icmsg:
    platform_allow:
      - nrf54l15dk/nrf54l15/cpuapp
      - nrf54lm20dk/nrf54lm20a/cpuapp
    integration_platforms:
      - nrf54l15dk/nrf54l15/cpuapp
    extra_args:
      - SB_CONFIG_HPF=y
      - SB_CONFIG_HPF_GPIO=y
      - SB_CONFIG_HPF_GPIO_BACKEND_ICMSG=y
      - SB_CONFIG_PARTITION_MANAGER=n
      - FILE_SUFFIX=hpf_gpio

  nrf.extended.sample.basic.blinky.hpf.gpio.mbox:
    platform_allow:
      - nrf54l15dk/nrf54l15/cpuapp
      - nrf54lm20dk/nrf54lm20a/cpuapp
    integration_platforms:
      - nrf54l15dk/nrf54l15/cpuapp
    extra_args:
      - SB_CONFIG_HPF=y
      - SB_CONFIG_HPF_GPIO=y
      - SB_CONFIG_HPF_GPIO_BACKEND_MBOX=y
      - SB_CONFIG_PARTITION_MANAGER=n
      - FILE_SUFFIX=hpf_gpio

  nrf.extended.sample.basic.blinky.hpf.gpio.icbmsg:
    platform_allow:
      - nrf54l15dk/nrf54l15/cpuapp
      - nrf54lm20dk/nrf54lm20a/cpuapp
    integration_platforms:
      - nrf54l15dk/nrf54l15/cpuapp
    extra_args:
      - SB_CONFIG_HPF=y
      - SB_CONFIG_HPF_GPIO=y
      - SB_CONFIG_HPF_GPIO_BACKEND_ICBMSG=y
      - SB_CONFIG_PARTITION_MANAGER=n
      - FILE_SUFFIX=hpf_gpio
```

## samples/zephyr/bluetooth/beacon/sample.yaml
```yaml
sample:
  name: Bluetooth Beacon
tests:
  nrf.extended.sample.bluetooth.beacon:
    tags: bluetooth
    platform_allow:
      - nrf54lv10dk/nrf54lv10a/cpuapp
      - nrf54lv10dk/nrf54lv10a/cpuapp/ns
      - nrf54lv10dk@0.2.0/nrf54lv10a/cpuapp
    integration_platforms:
      - nrf54lv10dk/nrf54lv10a/cpuapp
    harness: console
    timeout: 10
    harness_config:
      type: multi_line
      regex:
        - "Starting Beacon Demo"
        - "Bluetooth initialized"
        - "Beacon started, advertising"
    extra_args:
      - CONF_FILE="${ZEPHYR_BASE}/samples/bluetooth/beacon/prj.conf"
```

## samples/zephyr/bluetooth/ccp_call_control_client/sample.yaml
```yaml
sample:
  description: Bluetooth Low Energy Call Control Profile Server sample
  name: Bluetooth Low Energy Call Control Profile Server sample
tests:
  sample.bluetooth.ccp_call_control_client:
    platform_allow:
      - nrf5340dk/nrf5340/cpuapp
      - nrf5340bsim/nrf5340/cpuapp
    integration_platforms:
      - nrf5340dk/nrf5340/cpuapp
    harness: console
    timeout: 10
    harness_config:
      type: multi_line
      regex:
        - "CCP Call Control Client initialized"
        - "Bluetooth initialized"
        - "Connecting to found CCP server"
    extra_args:
      - CONF_FILE="${ZEPHYR_BASE}/samples/bluetooth/ccp_call_control_client/prj.conf"
    tags: bluetooth
    sysbuild: true
```

## samples/zephyr/bluetooth/ccp_call_control_server/sample.yaml
```yaml
sample:
  description: Bluetooth Low Energy Call Control Profile Call Control Server sample
  name: Bluetooth Low Energy Call Control Profile Call Control Server sample
tests:
  sample.bluetooth.ccp_call_control_server:
    platform_allow:
      - nrf5340dk/nrf5340/cpuapp
      - nrf5340bsim/nrf5340/cpuapp
    integration_platforms:
      - nrf5340dk/nrf5340/cpuapp
    harness: console
    timeout: 10
    harness_config:
      type: multi_line
      regex:
        - "CCP Call Control Server initialized"
        - "Registered GTBS bearer"
        - "Advertising successfully started"
    extra_args:
      - CONF_FILE="${ZEPHYR_BASE}/samples/bluetooth/ccp_call_control_server/prj.conf"
    tags: bluetooth
    sysbuild: true
```

## samples/zephyr/bluetooth/hci_uart/sample.yaml
```yaml
sample:
  name: Bluetooth HCI UART
  description: Allows Zephyr to provide Bluetooth connectivity via UART
tests:
  nrf.extended.sample.bluetooth.hci_uart:
    tags: bluetooth
    platform_allow:
      - nrf54lv10dk/nrf54lv10a/cpuapp
      - nrf54lv10dk/nrf54lv10a/cpuapp/ns
      - nrf54lv10dk@0.2.0/nrf54lv10a/cpuapp
    integration_platforms:
      - nrf54lv10dk/nrf54lv10a/cpuapp
    build_only: true
    extra_args:
      - CONF_FILE="${ZEPHYR_BASE}/samples/bluetooth/hci_uart/prj.conf"
```

## samples/zephyr/bluetooth/peripheral_hr/sample.yaml
```yaml
sample:
  name: Bluetooth Peripheral HR
  description: Demonstrates the HR (Heart Rate) GATT Service
tests:
  nrf.extended.sample.bluetooth.peripheral_hr:
    tags: bluetooth
    platform_allow:
      - nrf54lv10dk/nrf54lv10a/cpuapp
      - nrf54lv10dk/nrf54lv10a/cpuapp/ns
      - nrf54lv10dk@0.2.0/nrf54lv10a/cpuapp
    integration_platforms:
      - nrf54lv10dk/nrf54lv10a/cpuapp
    harness: console
    timeout: 10
    harness_config:
      type: multi_line
      regex:
        - "Bluetooth initialized"
        - "Advertising successfully started"
        - "Start blinking LED"
    extra_args:
      - CONF_FILE="${ZEPHYR_BASE}/samples/bluetooth/peripheral_hr/prj.conf"
```

## samples/zephyr/boards/nordic/clock_control/sample.yaml
```yaml
sample:
  name: Clock control sample
common:
  tags:
    - ci_samples_zephyr_boards_nordic_clock_control
  harness: console
  harness_config:
    type: one_line
    regex:
      - "clock spec request released"
tests:
  nrf.extended.sample.boards.nrf.clock_control.fll16m:
    platform_allow:
      - nrf9251dk/nrf9251/cpuapp
    extra_args:
      - CONF_FILE="${ZEPHYR_BASE}/samples/boards/nordic/clock_control/configs/fll16m.conf"
      - DTC_OVERLAY_FILE="${ZEPHYR_BASE}/samples/boards/nordic/clock_control/configs/fll16m.overlay"
  nrf.extended.sample.boards.nrf.clock_control.lfclk:
    platform_allow:
      - nrf9251dk/nrf9251/cpuapp
    extra_args:
      - CONF_FILE="${ZEPHYR_BASE}/samples/boards/nordic/clock_control/configs/lfclk.conf"
      - DTC_OVERLAY_FILE="${ZEPHYR_BASE}/samples/boards/nordic/clock_control/configs/lfclk.overlay"
  nrf.extended.sample.boards.nrf.clock_control.uart133:
    platform_allow:
      - nrf9251dk/nrf9251/cpuapp
    extra_args:
      - CONF_FILE="configs/uart133.conf"
      - DTC_OVERLAY_FILE="configs/uart133.overlay"
  nrf.extended.sample.boards.nrf.clock_control.uart135:
    depends_on:
      - future_target
    extra_args:
      - CONF_FILE="${ZEPHYR_BASE}/samples/boards/nordic/clock_control/configs/uart135.conf"
      - DTC_OVERLAY_FILE="${ZEPHYR_BASE}/samples/boards/nordic/clock_control/configs/uart135.overlay"
  nrf.extended.sample.boards.nrf.clock_control.cpuapp_hsfll:
    platform_allow:
      - nrf9251dk/nrf9251/cpuapp
    extra_args:
      - CONF_FILE="${ZEPHYR_BASE}/samples/boards/nordic/clock_control/configs/cpuapp_hsfll.conf"
      - DTC_OVERLAY_FILE="${ZEPHYR_BASE}/samples/boards/nordic/clock_control/configs/cpuapp_hsfll.overlay"
  nrf.extended.sample.boards.nrf.clock_control.global_hsfll:
    platform_allow:
      - nrf9251dk/nrf9251/cpuapp
    extra_args:
      - CONF_FILE="${ZEPHYR_BASE}/samples/boards/nordic/clock_control/configs/global_hsfll.conf"
      - DTC_OVERLAY_FILE="${ZEPHYR_BASE}/samples/boards/nordic/clock_control/configs/global_hsfll.overlay"
  nrf.extended.sample.boards.nrf.clock_control.global_hsfll.req_low_freq_n:
    platform_allow:
      - nrf9251dk/nrf9251/cpuapp
    extra_configs:
      - CONFIG_CLOCK_CONTROL_NRF_HSFLL_GLOBAL_REQ_LOW_FREQ=n
    extra_args:
      - CONF_FILE="${ZEPHYR_BASE}/samples/boards/nordic/clock_control/configs/global_hsfll.conf"
      - DTC_OVERLAY_FILE="${ZEPHYR_BASE}/samples/boards/nordic/clock_control/configs/global_hsfll.overlay"
  nrf.extended.sample.boards.nrf.clock_control.audiopll:
    platform_allow:
      - nrf9251dk/nrf9251/cpuapp
    extra_args:
      - CONF_FILE="${ZEPHYR_BASE}/samples/boards/nordic/clock_control/configs/audiopll.conf"
      - DTC_OVERLAY_FILE="${ZEPHYR_BASE}/samples/boards/nordic/clock_control/configs/audiopll.overlay"
```

## samples/zephyr/boards/nordic/nrf_sys_event/sample.yaml
```yaml
common:
  tags:
    - ci_samples_zephyr_boards_nordic_nrf_sys_event
  harness: console
  harness_config:
    type: one_line
    regex:
      - "constant latency mode disabled"
  platform_allow:
    - nrf54ls05dk/nrf54ls05b/cpuapp
    - nrf54lv10dk/nrf54lv10a/cpuapp
  integration_platforms:
    - nrf54lv10dk/nrf54lv10a/cpuapp

tests:
  nrf.extended.sample.boards.nordic.nrf_sys_event: {}
  nrf.extended.sample.boards.nordic.nrf_sys_event.force_constlat:
    extra_configs:
      - CONFIG_SOC_NRF_FORCE_CONSTLAT=y
  nrf.extended.sample.boards.nordic.nrf_sys_event.rramc_wakeup:
    harness: pytest
    harness_config:
      pytest_root:
        - "${ZEPHYR_BASE}/samples/boards/nordic/nrf_sys_event/pytest/test_reg_event.py"
    extra_configs:
      - CONFIG_NRF_SYS_EVENT_IRQ_LATENCY=y
```

## samples/zephyr/boards/nordic/nrfx/sample.yaml
```yaml
sample:
  name: nrfx use example
tests:
  nrf.extended.sample.boards.nrf.nrfx:
    platform_allow:
      - nrf7120dk/nrf7120/cpuapp
    integration_platforms:
      - nrf7120dk/nrf7120/cpuapp
    tags:
      - ci_samples_zephyr_boards_nordic_nrfx
      - board
    harness: console
    harness_config:
      type: multi_line
      ordered: true
      regex:
        - "nrfx_gpiote initialized"
        - "\\(D\\)PPI configured, leaving main()"
```

## samples/zephyr/boards/nordic/spis_wakeup/sample.yaml
```yaml
common:
  sysbuild: true
  depends_on: spi

sample:
  name: SPI wakeup sample
tests:
  nrf.extended.sample.drivers.spis.wakeup:
    tags:
      - ci_samples_zephyr_boards_nordic_spis_wakeup
      - spi
      - ppk_power_measure
    platform_allow:
      - nrf54h20dk/nrf54h20/cpuapp
    integration_platforms:
      - nrf54h20dk/nrf54h20/cpuapp
    harness: pytest
    harness_config:
      fixture: spi_loopback
      pytest_root:
        - "${CUSTOM_ROOT_TEST_DIR}/test_measure_power_consumption.py::test_measure_and_data_dump_spis_wakeup"
```

## samples/zephyr/boards/nordic/system_off/boards/nrf7120dk_nrf7120_cpuapp.conf
```kconfig
# Disable RC Oscillator so that LFXO will be used
CONFIG_CLOCK_CONTROL_NRF_K32SRC_RC=n

# Output log immediately
CONFIG_LOG_MODE_IMMEDIATE=y
```

## samples/zephyr/boards/nordic/system_off/boards/nrf7120pdk_nrf7120_cpuapp.conf
```kconfig
CONFIG_CLOCK_CONTROL_NRF=n

# Output log immediately
CONFIG_LOG_MODE_IMMEDIATE=y
```
