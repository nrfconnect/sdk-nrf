## samples/zephyr/boards/nordic/system_off/sample.yaml
```yaml
sample:
  name: Low Power State Sample for nRF5x and nRF71
common:
  tags:
    - ci_samples_zephyr_boards_nordic_system_off
  timeout: 20
tests:
  nrf.extended.sample.boards.nrf.system_off:
    integration_platforms:
      - nrf54ls05dk/nrf54ls05b/cpuapp
    platform_allow:
      - nrf54ls05dk/nrf54ls05b/cpuapp
      - nrf54ls05dk@0.0.0/nrf54ls05b/cpuapp
      - nrf54ls05dk@0.2.0/nrf54ls05b/cpuapp
      - nrf54lv10dk/nrf54lv10a/cpuapp
      - nrf54lv10dk/nrf54lv10a/cpuapp/ns
      - nrf54lv10dk@0.2.0/nrf54lv10a/cpuapp
    harness: console
    harness_config:
      type: multi_line
      ordered: true
      regex:
        - "system off demo"
        - "Retained data not supported"
        - "Entering system off; press sw0 to restart"
  nrf.extended.sample.boards.nrf.system_off.retained_mem:
    integration_platforms:
      - nrf54ls05dk/nrf54ls05b/cpuapp
    platform_allow:
      - nrf54ls05dk/nrf54ls05b/cpuapp
      - nrf54ls05dk@0.0.0/nrf54ls05b/cpuapp
      - nrf54ls05dk@0.2.0/nrf54ls05b/cpuapp
      - nrf54lv10dk/nrf54lv10a/cpuapp
      - nrf54lv10dk/nrf54lv10a/cpuapp/ns
      - nrf54lv10dk@0.2.0/nrf54lv10a/cpuapp
    extra_configs:
      - CONFIG_APP_USE_RETAINED_MEM=y
    harness: console
    harness_config:
      type: multi_line
      ordered: true
      regex:
        - "system off demo"
        - "Retained data: valid"
        - "Boot count: 1"
        - "Off count: 0"
        - "Active Ticks:"
        - "Entering system off; press sw0 to restart"
  nrf.extended.sample.boards.nrf.system_off.grtc_wakeup:
    integration_platforms:
      - nrf54ls05dk/nrf54ls05b/cpuapp
    platform_allow:
      - nrf54ls05dk/nrf54ls05b/cpuapp
      - nrf54ls05dk@0.0.0/nrf54ls05b/cpuapp
      - nrf54ls05dk@0.2.0/nrf54ls05b/cpuapp
      - nrf54lv10dk/nrf54lv10a/cpuapp
      - nrf54lv10dk/nrf54lv10a/cpuapp/ns
      - nrf54lv10dk@0.2.0/nrf54lv10a/cpuapp
      - nrf7120dk/nrf7120/cpuapp
    extra_configs:
      - CONFIG_GRTC_WAKEUP_ENABLE=y
      - CONFIG_GPIO_WAKEUP_ENABLE=n
    harness: console
    harness_config:
      type: multi_line
      ordered: true
      regex:
        - "system off demo"
        - "Retained data not supported"
        - "Entering system off; wait 2 seconds to restart"
        - "system off demo"
        - "Retained data not supported"
        - "Entering system off; wait 2 seconds to restart"
        - "system off demo"
        - "Wakeup from System OFF by GRTC."
        - "Retained data not supported"
        - "Entering system off; wait 2 seconds to restart"
  nrf.extended.sample.boards.nrf.system_off.retained_mem.grtc_wakeup:
    integration_platforms:
      - nrf54ls05dk/nrf54ls05b/cpuapp
    platform_allow:
      - nrf54ls05dk/nrf54ls05b/cpuapp
      - nrf54ls05dk@0.0.0/nrf54ls05b/cpuapp
      - nrf54ls05dk@0.2.0/nrf54ls05b/cpuapp
      - nrf54lv10dk/nrf54lv10a/cpuapp
      - nrf54lv10dk/nrf54lv10a/cpuapp/ns
      - nrf54lv10dk@0.2.0/nrf54lv10a/cpuapp
      - nrf7120dk/nrf7120/cpuapp
    extra_configs:
      - CONFIG_APP_USE_RETAINED_MEM=y
      - CONFIG_GRTC_WAKEUP_ENABLE=y
      - CONFIG_GPIO_WAKEUP_ENABLE=n
    harness: console
    harness_config:
      type: multi_line
      ordered: true
      regex:
        - "system off demo"
        - "Retained data: valid"
        - "Boot count: 1"
        - "Off count: 0"
        - "Active Ticks:"
        - "Entering system off; wait 2 seconds to restart"
        - "system off demo"
        - "Retained data: valid"
        - "Boot count: 2"
        - "Off count: 1"
        - "Active Ticks:"
        - "Entering system off; wait 2 seconds to restart"
        - "Wakeup from System OFF by GRTC."
```

## samples/zephyr/drivers/adc/adc_dt/sample.yaml
```yaml
sample:
  name: ADC devicetree driver sample
tests:
  nrf.extended.sample.drivers.adc.adc_dt:
    tags:
      - ci_samples_zephyr_drivers_adc
    # depends_on: adc
    integration_platforms:
      - nrf54ls05dk/nrf54ls05b/cpuapp
    platform_allow:
      - nrf54ls05dk@0.0.0/nrf54ls05b/cpuapp
      - nrf54ls05dk/nrf54ls05b/cpuapp
      - nrf54lv10dk/nrf54lv10a/cpuapp
      - nrf54lv10dk@0.2.0/nrf54lv10a/cpuapp
    harness: console
    timeout: 10
    harness_config:
      type: multi_line
      regex:
        - "ADC reading\\[\\d+\\]:"
        - "- .+, channel \\d+: -?\\d+"
```

## samples/zephyr/drivers/audio/dmic/sample.yaml
```yaml
sample:
  name: DMIC sample
tests:
  nrf.extended.sample.drivers.audio.dmic:
    tags:
      - dmic
      - ci_samples_zephyr_drivers_audio_dmic
    filter: dt_nodelabel_enabled("dmic_dev")
    harness: console
    harness_config:
      type: multi_line
      ordered: true
      regex:
        - "DMIC sample"
        - "Exiting"
    platform_allow:
      - nrf54lm20pdk/nrf54lm20a/cpuapp
      - nrf54lm20pdk@0.0.0/nrf54lm20a/cpuapp
      - nrf54lm20pdk@0.2.0/nrf54lm20a/cpuapp
      - nrf54lm20pdk@0.2.0.csp/nrf54lm20a/cpuapp
    integration_platforms:
      - nrf54lm20pdk/nrf54lm20a/cpuapp
      - nrf54lm20pdk@0.0.0/nrf54lm20a/cpuapp
      - nrf54lm20pdk@0.2.0/nrf54lm20a/cpuapp
      - nrf54lm20pdk@0.2.0.csp/nrf54lm20a/cpuapp
```

## samples/zephyr/drivers/counter/alarm/Kconfig.sysbuild
```kconfig
#
# Copyright (c) 2026 Nordic Semiconductor
#
# SPDX-License-Identifier: LicenseRef-Nordic-5-Clause
#

config PARTITION_MANAGER
	default n if SOC_NRF54LV10A_ENGA

source "share/sysbuild/Kconfig"
```
