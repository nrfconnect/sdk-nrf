## CMakeLists.txt
```
#
# Copyright (c) 2023 Nordic Semiconductor ASA
#
# SPDX-License-Identifier: LicenseRef-Nordic-5-Clause
#

cmake_minimum_required(VERSION 3.20.0)

find_package(Zephyr REQUIRED HINTS $ENV{ZEPHYR_BASE})
project(nrf_wifi_raw_tx_packet)

target_include_directories(app PUBLIC ${ZEPHYR_BASE}/subsys/net/ip)

target_sources_ifdef(CONFIG_RAW_TX_PKT_SAMPLE_CONNECTION_MODE app PRIVATE src/wifi_connection.c)

target_sources(app PRIVATE src/main.c)
```

## Kconfig
```
#
# Copyright (c) 2023 Nordic Semiconductor
#
# SPDX-License-Identifier: LicenseRef-Nordic-5-Clause
#

source "Kconfig.zephyr"

menu "Nordic Raw Tx Packet sample"

config RAW_TX_PKT_SAMPLE_CONNECTION_TIMEOUT
	int "Time to wait for a station to connect"
	default 30

config RAW_TX_PKT_SAMPLE_DHCP_TIMEOUT_S
	int "DHCP timeout in seconds"
	default 20

config RAW_TX_PKT_SAMPLE_STA_ONLY_MODE
	bool "Set Wi-Fi Station mode"
	help
	  Set the device operating mode as Station mode.

config RAW_TX_PKT_SAMPLE_INJECTION_ENABLE
	bool "Set Wi-Fi TX injection mode"
	default y
	help
	  Set the device operating mode as TX injection mode.

choice RAW_TX_PKT_SAMPLE_OP_MODE
	prompt "Choose Wi-Fi operation mode"
	default RAW_TX_PKT_SAMPLE_NON_CONNECTED_MODE

config RAW_TX_PKT_SAMPLE_CONNECTION_MODE
	bool "Connected Station mode"
	help
	  Enable the option to select Connected Station mode.

config RAW_TX_PKT_SAMPLE_NON_CONNECTED_MODE
	bool "Non-connected Station mode"
	help
	  Enable the option to select non-connected Station mode.
endchoice

config RAW_TX_PKT_SAMPLE_CHANNEL
	int "Channel for non-connected Station mode"
	depends on RAW_TX_PKT_SAMPLE_NON_CONNECTED_MODE
	range 1 233
	help
	  Specify the Wi-Fi channel for transmitting raw TX packets in non-connected Station mode.
	  The valid channel range is 1 to 233.

config RAW_TX_PKT_SAMPLE_RATE_VALUE
	int "MCS index or Data rate value"
	default 0
	help
	  Specify the Wi-Fi data rate value for raw TX packet transmission.
	  The value represents either the data rate in Mbps or Modulation and coding (MCS) index.
	  Note: 5.5Mbps is treated specially as 55 to avoid floating point usage.
	  Legacy: 1, 2, 55, 11, 6, 9, 12, 18, 24, 36, 48, 54
	  MCS index: 0-7

config RAW_TX_PKT_SAMPLE_RATE_FLAGS
	int "Rate flag value"
	range 0 4
	default 1
	help
	  Specify the rate flag value to be used for raw TX packet transmission.
	  Rate Flags:
	  0 - Legacy
	  1 - 11n format
	  2 - VHT format
	  3 - HE_SU
	  4 - HE_ER_SU

config RAW_TX_PKT_SAMPLE_QUEUE_NUM
	int "Queue number"
	default 0
	range 0 4
	help
	  Specify the transmission queue number for raw TX packets.
	  0 - Background
	  1 - Best effort
	  2 - Video
	  3 - Voice
	  4 - Beacon.

config RAW_TX_PKT_SAMPLE_AGGREGATION_ENABLE
	bool "Raw packets TX aggregation"
	depends on NRF70_RAW_DATA_TX
	help
	  When enabled, sets the raw TX header aggregation field so the nRF70
	  driver may coalesce multiple MPDUs per RAW_TX command (up to
	  num_frames).

config RAW_TX_PKT_SAMPLE_NUM_FRAMES
	int "Number of frames to aggregate"
	default 4
	range 1 16
	depends on RAW_TX_PKT_SAMPLE_AGGREGATION_ENABLE
	help
	  Maximum number of MPDUs to aggregate per TX command when aggregation
	  is enabled. Must not exceed CONFIG_NRF70_MAX_TX_AGGREGATION.

choice
	prompt "Select transmission mode"
	default RAW_TX_PKT_SAMPLE_TX_MODE_CONTINUOUS

config RAW_TX_PKT_SAMPLE_TX_MODE_CONTINUOUS
	bool "Continuous transmission mode"

config RAW_TX_PKT_SAMPLE_TX_MODE_FIXED
	bool "Fixed transmission mode"

endchoice

if RAW_TX_PKT_SAMPLE_TX_MODE_FIXED
config RAW_TX_PKT_SAMPLE_FIXED_NUM_PACKETS
	int "Number of packets"
	default 1
	help
	  Specify the number of packets to be sent when using Fixed mode of transmission.
endif

config RAW_TX_PKT_SAMPLE_INTER_FRAME_DELAY_MS
	int "Inter-Frame Delay (milliseconds)"
	default 10
	help
	  Specify the inter-frame delay duration for raw TX packet transmission.

config RAW_TX_PKT_SAMPLE_WIFI_IFACE_OPER_UP_TIMEOUT_S
	int "Timeout for checking interface operational up status (seconds)"
	default 10 if RAW_TX_PKT_SAMPLE_NON_CONNECTED_MODE
	default 40 if RAW_TX_PKT_SAMPLE_CONNECTION_MODE
	help
	  specify the timeout (seconds) for checking if the Wi-Fi interface is operationally up.
endmenu
```

## sample.yaml
```
sample:
  description: Wi-Fi Raw Tx Packet sample application
  name: Wi-Fi Raw Tx Packet sample
tests:
  sample.nrf7002.raw_tx_packet:
    sysbuild: true
    build_only: true
    integration_platforms:
      - nrf7002dk/nrf5340/cpuapp
    platform_allow: nrf7002dk/nrf5340/cpuapp
    tags:
      - ci_build
      - sysbuild
      - ci_samples_wifi
  sample.nrf7002_eks.raw_tx_packet:
    sysbuild: true
    build_only: true
    extra_args: SHIELD=nrf7002ek
    integration_platforms:
      - nrf5340dk/nrf5340/cpuapp
    platform_allow: nrf5340dk/nrf5340/cpuapp
    tags:
      - ci_build
      - sysbuild
      - ci_samples_wifi
  sample.nrf7001.raw_tx_packet:
    sysbuild: true
    build_only: true
    integration_platforms:
      - nrf7002dk/nrf5340/cpuapp/nrf7001
    platform_allow: nrf7002dk/nrf5340/cpuapp/nrf7001
    tags:
      - ci_build
      - sysbuild
      - ci_samples_wifi
  sample.nrf7002eb_interposer_p1.nrf7002eb.raw_tx_packet:
    sysbuild: true
    build_only: true
    extra_args:
      - raw_tx_packet_SHIELD="nrf7002eb_interposer_p1;nrf7002eb"
      - raw_tx_packet_SNIPPET=nrf70-wifi
    integration_platforms:
      - nrf54h20dk/nrf54h20/cpuapp
      - nrf54l15dk/nrf54l15/cpuapp
    platform_allow:
      - nrf54h20dk/nrf54h20/cpuapp
      - nrf54l15dk/nrf54l15/cpuapp
    tags:
      - ci_build
      - sysbuild
      - ci_samples_wifi
  sample.nrf7002eb2.raw_tx_packet:
    sysbuild: true
    build_only: true
    extra_args:
      - raw_tx_packet_SHIELD="nrf7002eb2"
      - raw_tx_packet_SNIPPET=nrf70-wifi
    integration_platforms:
      - nrf54l15dk/nrf54l15/cpuapp
    platform_allow:
      - nrf54l15dk/nrf54l15/cpuapp
    tags:
      - ci_build
      - sysbuild
      - ci_samples_wifi
  sample.54lm20dk.nrf7002eb2.raw_tx_packet:
    sysbuild: true
    build_only: true
    extra_args:
      - raw_tx_packet_SHIELD="nrf7002eb2"
    integration_platforms:
      - nrf54lm20dk/nrf54lm20a/cpuapp
      - nrf54lm20dk/nrf54lm20b/cpuapp
    platform_allow:
      - nrf54lm20dk/nrf54lm20a/cpuapp
      - nrf54lm20dk/nrf54lm20b/cpuapp
    tags:
      - ci_build
      - sysbuild
      - ci_samples_wifi
  sample.nrf7120.raw_tx_packet:
    sysbuild: true
    build_only: true
    extra_args:
      - EXTRA_DTC_OVERLAY_FILE=${ZEPHYR_NRFXLIB_MODULE_DIR}/nrf71_wifi/bins/0.1.0/nrf7120_wifi_patch.dtsi
      - CONFIG_WIFI_NRF71_PATCH=y
      # sysbuild by default is nRF70, to avoid Kconfig warns disable it
      - SB_CONFIG_WIFI_NRF70=n
    integration_platforms:
      - nrf7120dk/nrf7120/cpuapp
      - nrf7120dk/nrf7120/cpuapp/ns
    platform_allow:
      - nrf7120dk/nrf7120/cpuapp
      - nrf7120dk/nrf7120/cpuapp/ns
    tags:
      - ci_build
      - sysbuild
      - ci_samples_nrf71_wifi
```

## sysbuild.conf
```
#
# Copyright (c) 2024 Nordic Semiconductor ASA
#
# SPDX-License-Identifier: LicenseRef-Nordic-5-Clause
#

SB_CONFIG_WIFI_NRF70_SYSTEM_WITH_RAW_MODES=y
```

## prj.conf
```kconfig
#
# Copyright (c) 2023 Nordic Semiconductor ASA
#
# SPDX-License-Identifier: LicenseRef-Nordic-5-Clause
#
CONFIG_WIFI=y

# WPA supplicant
CONFIG_WIFI_NM_WPA_SUPPLICANT=y

CONFIG_WIFI_CREDENTIALS=y
CONFIG_WIFI_CREDENTIALS_STATIC=y
CONFIG_WIFI_CREDENTIALS_STATIC_SSID="Myssid"
CONFIG_WIFI_CREDENTIALS_STATIC_PASSWORD="Mypassword"

# Networking
CONFIG_NETWORKING=y
CONFIG_NET_SOCKETS=y
CONFIG_NET_LOG=y
CONFIG_NET_IPV4=y
CONFIG_NET_UDP=y
CONFIG_NET_TCP=y
CONFIG_NET_DHCPV4=y

CONFIG_NET_PKT_RX_COUNT=8
CONFIG_NET_PKT_TX_COUNT=8

# Below section is the primary contributor to SRAM and is currently
# tuned for performance, but this will be revisited in the future.
CONFIG_NET_BUF_RX_COUNT=8
CONFIG_NET_BUF_TX_COUNT=16
CONFIG_NET_TC_TX_COUNT=1

CONFIG_NET_IF_UNICAST_IPV4_ADDR_COUNT=1
CONFIG_NET_MAX_CONTEXTS=5
CONFIG_NET_CONTEXT_SYNC_RECV=y

CONFIG_INIT_STACKS=y

CONFIG_NET_L2_ETHERNET=y

CONFIG_NET_CONFIG_SETTINGS=y
CONFIG_NET_CONFIG_INIT_TIMEOUT=0

CONFIG_ZVFS_POLL_MAX=10

# Memories
CONFIG_MAIN_STACK_SIZE=5200
CONFIG_NET_TX_STACK_SIZE=4096
CONFIG_NET_RX_STACK_SIZE=4096

# Debugging
CONFIG_STACK_SENTINEL=y
CONFIG_DEBUG_COREDUMP=y
CONFIG_DEBUG_COREDUMP_BACKEND_LOGGING=y
CONFIG_DEBUG_COREDUMP_MEMORY_DUMP_MIN=y
CONFIG_SHELL_CMDS_RESIZE=n


# Kernel options
CONFIG_ENTROPY_GENERATOR=y

# Logging
CONFIG_LOG=y
CONFIG_LOG_BUFFER_SIZE=2048
CONFIG_POSIX_TIMERS=y
CONFIG_POSIX_API=y

CONFIG_NET_CONFIG_MY_IPV4_ADDR="192.168.1.99"
CONFIG_NET_CONFIG_MY_IPV4_NETMASK="255.255.255.0"
CONFIG_NET_CONFIG_MY_IPV4_GW="192.168.1.1"

# printing of scan results puts pressure on queues in new locking
# design in net_mgmt. So, use a higher timeout for a crowded
# environment.
CONFIG_NET_MGMT_EVENT_QUEUE_TIMEOUT=5000
```

## boards/nrf7002dk_nrf5340_cpuapp.conf
```kconfig
#
# Copyright (c) 2026 Nordic Semiconductor ASA
#
# SPDX-License-Identifier: LicenseRef-Nordic-5-Clause
#

#NRF70 specific configuration
CONFIG_WIFI_NRF70=y
CONFIG_NRF_WIFI_LOW_POWER=n
CONFIG_NRF70_RAW_DATA_TX=y
```

## boards/nrf7002dk_nrf5340_cpuapp_nrf7001.conf
```kconfig
#
# Copyright (c) 2026 Nordic Semiconductor ASA
#
# SPDX-License-Identifier: LicenseRef-Nordic-5-Clause
#

#NRF70 specific configuration
CONFIG_WIFI_NRF70=y
CONFIG_NRF_WIFI_LOW_POWER=n
CONFIG_NRF_WIFI_ZERO_COPY_TX=n
CONFIG_NRF70_RAW_DATA_TX=y
```

## boards/nrf7120dk_nrf7120_cpuapp.conf
```kconfig
#
# Copyright (c) 2026 Nordic Semiconductor
#
# SPDX-License-Identifier: LicenseRef-Nordic-5-Clause
#

CONFIG_NRF71_WIFI=y
CONFIG_NRF71_WIFI_TX_INJECTION_SUPPORT=y
CONFIG_NRF71_WIFI_LOW_POWER_SUPPORT=n
CONFIG_NRF71_WIFI_ZERO_COPY_TX=n
```

## socs/nrf7120_cpuapp.overlay
```dts
/*
 * Copyright (c) 2026 Nordic Semiconductor ASA
 *
 * SPDX-License-Identifier: LicenseRef-Nordic-5-Clause
 */

#include <vendor/nordic/nrf7120_wifi_patch_0_1_0.dtsi>
```

## src/main.c
```c
/*
 * Copyright (c) 2023 Nordic Semiconductor ASA
 *
 * SPDX-License-Identifier: LicenseRef-Nordic-5-Clause
 */

/** @file
 * @brief Wi-Fi Raw Tx Packet sample
 */

#include <zephyr/logging/log.h>
LOG_MODULE_REGISTER(raw_tx_packet, CONFIG_LOG_DEFAULT_LEVEL);

#if defined(CONFIG_POSIX_API)
#include <zephyr/posix/arpa/inet.h>
#include <zephyr/posix/netdb.h>
#include <zephyr/posix/unistd.h>
#include <zephyr/posix/sys/socket.h>
#endif

#include <zephyr/net/ethernet.h>
#include <zephyr/net/socket.h>

#include "net_private.h"
#include "wifi_connection.h"

#define BEACON_PAYLOAD_LENGTH 256
#define DEFAULT_RAW_TX_WIFI_CHANNEL 6
#define PADDING_ZERO_THRESHOLD 10
#define DS_PARAMETER_SET_ELEMENT_ID 3
#define DS_PARAMETER_SET_LENGTH 1
#define CONTINUOUS_MODE_TRANSMISSION 0
#define FIXED_MODE_TRANSMISSION 1

#define IEEE80211_SEQ_CTRL_SEQ_NUM_MASK 0xFFF0
#define IEEE80211_SEQ_NUMBER_INC BIT(4) /* 0-3 is fragment number */
#define NRF_WIFI_MAGIC_NUM_RAWTX 0x12345678
#define AGGR_DISABLE 0
#define AGGR_ENABLE  1

static struct net_mgmt_event_callback net_iface_mgmt_cb;
K_SEM_DEFINE(wait_for_oper_up, 0, 1);

struct beacon {
	uint16_t frame_control;
	uint16_t duration;
	uint8_t da[6];
	uint8_t sa[6];
	uint8_t bssid[6];
	uint16_t seq_ctrl;
	uint8_t payload[BEACON_PAYLOAD_LENGTH];
} __packed;

static struct beacon test_beacon_frame = {
	.frame_control = htons(0X8000),
	.duration = 0X0000,
	.da = {0XFF, 0XFF, 0XFF, 0XFF, 0XFF, 0XFF},
	/* Transmitter Address: A0:69:60:E3:52:15 */
	.sa = {0XA0, 0X69, 0X60, 0XE3, 0X52, 0X15},
	.bssid = {0XA0, 0X69, 0X60, 0XE3, 0X52, 0X15},
	.seq_ctrl = 0X0001,
	/* SSID: NRF_RAW_TX_PACKET_APP */
	.payload = {
		0X0C, 0XA2, 0X28, 0X00, 0X00, 0X00, 0X00, 0X00, 0X64, 0X00,
		0X11, 0X04, 0X00, 0X15, 0X4E, 0X52, 0X46, 0X5F, 0X52, 0X41,
		0X57, 0X5F, 0X54, 0X58, 0X5F, 0X50, 0X41, 0X43, 0X4B, 0X45,
		0X54, 0X5F, 0X41, 0X50, 0X50, 0X01, 0X08, 0X82, 0X84, 0X8B,
		0X96, 0X0C, 0X12, 0X18, 0X24, 0X03, 0X01, 0X06, 0X05, 0X04,
		0X00, 0X02, 0X00, 0X00, 0X2A, 0X01, 0X04, 0X32, 0X04, 0X30,
		0X48, 0X60, 0X6C, 0X30, 0X14, 0X01, 0X00, 0X00, 0X0F, 0XAC,
		0X04, 0X01, 0X00, 0X00, 0X0F, 0XAC, 0X04, 0X01, 0X00, 0X00,
		0X0F, 0XAC, 0X02, 0X0C, 0X00, 0X3B, 0X02, 0X51, 0X00, 0X2D,
		0X1A, 0X0C, 0X00, 0X17, 0XFF, 0XFF, 0X00, 0X00, 0X00, 0X00,
		0X00, 0X00, 0X00, 0X2C, 0X01, 0X01, 0X00, 0X00, 0X00, 0X00,
		0X00, 0X00, 0X00, 0X00, 0X00, 0X00, 0X00, 0X3D, 0X16, 0X06,
		0X00, 0X00, 0X00, 0X00, 0X00, 0X00, 0X00, 0X00, 0X00, 0X00,
		0X00, 0X00, 0X00, 0X00, 0X00, 0X00, 0X00, 0X00, 0X00, 0X00,
		0X00, 0X7F, 0X08, 0X04, 0X00, 0X00, 0X02, 0X00, 0X00, 0X00,
		0X40, 0XFF, 0X1A, 0X23, 0X01, 0X78, 0X10, 0X1A, 0X00, 0X00,
		0X00, 0X20, 0X0E, 0X09, 0X00, 0X09, 0X80, 0X04, 0X01, 0XC4,
		0X00, 0XFA, 0XFF, 0XFA, 0XFF, 0X61, 0X1C, 0XC7, 0X71, 0XFF,
		0X07, 0X24, 0XF0, 0X3F, 0X00, 0X81, 0XFC, 0XFF, 0XDD, 0X18,
		0X00, 0X50, 0XF2, 0X02, 0X01, 0X01, 0X01, 0X00, 0X03, 0XA4,
		0X00, 0X00, 0X27, 0XA4, 0X00, 0X00, 0X42, 0X43, 0X5E, 0X00,
		0X62, 0X32, 0X2F, 0X00
	}
};

/* TODO: Copied from nRF70 Wi-Fi driver, need to be moved to a common place */
struct raw_tx_pkt_header {
	unsigned int magic_num;
	unsigned char data_rate;
	unsigned short packet_length;
	unsigned char tx_mode;
	unsigned char queue;
	unsigned char aggregation;
	unsigned char num_frames;
	unsigned char reserved;
} __packed;

#ifdef CONFIG_RAW_TX_PKT_SAMPLE_NON_CONNECTED_MODE
static void wifi_set_channel(void)
{
	struct net_if *iface;
	struct wifi_channel_info channel_info = {0};
	int ret;

	channel_info.oper = WIFI_MGMT_SET;

	iface = net_if_get_first_wifi();
	if (iface == NULL) {
		LOG_ERR("Failed to get Wi-Fi iface");
		return;
	}

	channel_info.if_index = net_if_get_by_iface(iface);
	channel_info.channel = CONFIG_RAW_TX_PKT_SAMPLE_CHANNEL;
	if ((channel_info.channel < WIFI_CHANNEL_MIN) ||
		   (channel_info.channel > WIFI_CHANNEL_MAX)) {
		LOG_ERR("Invalid channel number. Range is (1-233)");
		return;
	}

	ret = net_mgmt(NET_REQUEST_WIFI_CHANNEL, iface,
		       &channel_info, sizeof(channel_info));
	if (ret) {
		LOG_ERR(" Channel setting failed %d\n", ret);
			return;
	}

	LOG_INF("Wi-Fi channel set to %d", channel_info.channel);
}
#endif

static void wifi_set_mode(int mode_val)
{
	int ret;
	struct net_if *iface = NULL;
	struct wifi_mode_info mode_info = {0};

	mode_info.oper = WIFI_MGMT_SET;

	iface = net_if_get_first_wifi();
	if (iface == NULL) {
		LOG_ERR("Failed to get Wi-Fi iface");
		return;
	}

	mode_info.if_index = net_if_get_by_iface(iface);
	mode_info.mode = mode_val;

	ret = net_mgmt(NET_REQUEST_WIFI_MODE, iface, &mode_info, sizeof(mode_info));
	if (ret) {
		LOG_ERR("Mode setting failed %d", ret);
	}
}

#ifdef CONFIG_RAW_TX_PKT_SAMPLE_INJECTION_ENABLE
static int wifi_set_tx_injection_mode(void)
{
	struct net_if *iface;

	iface = net_if_get_first_wifi();
	if (!iface) {
		LOG_ERR("Failed to get Wi-Fi iface");
		return -1;
	}

	if (net_eth_txinjection_mode(iface, true)) {
		LOG_ERR("TX Injection mode enable failed");
		return -1;
	}

	LOG_INF("TX Injection mode enabled");
	return 0;
}
#endif /* CONFIG_RAW_TX_PKT_SAMPLE_INJECTION_ENABLE */

static int setup_raw_pkt_socket(int *sockfd, struct sockaddr_ll *sa)
{
	struct net_if *iface = NULL;
	int ret;

	/* proto=0 implies a TX only socket */
	*sockfd = socket(AF_PACKET, SOCK_RAW, 0);
	if (*sockfd < 0) {
		LOG_ERR("Unable to create a socket %d", errno);
		return -1;
	}

	iface = net_if_get_first_wifi();
	if (!iface) {
		LOG_ERR("Failed to get Wi-Fi interface");
		return -1;
	}

	sa->sll_family = AF_PACKET;
	sa->sll_ifindex = net_if_get_by_iface(iface);

	/* Bind the socket */
	ret = bind(*sockfd, (struct sockaddr *)sa, sizeof(struct sockaddr_ll));
	if (ret < 0) {
		LOG_ERR("Error: Unable to bind socket to the network interface:%s",
			strerror(errno));
		close(*sockfd);
		return -1;
	}

	return 0;
}

static unsigned short calculate_beacon_payload_length(const uint8_t *payload,
						      unsigned short max_length)
{
	/* Skip fixed parameters: timestamp(8) + beacon_interval(2) + capability(2) */
	unsigned short pos = 12;
	unsigned short actual_length = pos;

	while (pos < max_length) {
		if ((pos + 1 < max_length) && (payload[pos] == 0) && (payload[pos + 1] == 0)) {
			unsigned short zero_count = 0;
			unsigned short check_pos = pos;

			while (check_pos < max_length && payload[check_pos] == 0) {
				zero_count++;
				check_pos++;
			}

			if (zero_count >= PADDING_ZERO_THRESHOLD) {
				break;
			}
		}

		if (pos + 1 >= max_length) {
			break;
		}

		uint8_t length = payload[pos + 1];

		actual_length = pos + 2 + length;

		pos += 2 + length;

		if (pos >= max_length) {
			break;
		}
	}
	return actual_length;
}

static unsigned short calculate_beacon_frame_length(const struct beacon *beacon_frame)
{
	unsigned short header_length = sizeof(beacon_frame->frame_control) +
				       sizeof(beacon_frame->duration) +
				       sizeof(beacon_frame->da) +
				       sizeof(beacon_frame->sa) +
				       sizeof(beacon_frame->bssid) +
				       sizeof(beacon_frame->seq_ctrl);

	unsigned short payload_length = calculate_beacon_payload_length(beacon_frame->payload,
									BEACON_PAYLOAD_LENGTH);

	return header_length + payload_length;
}

static void update_beacon_channel(void)
{
	uint8_t channel;
	struct net_if *iface = net_if_get_first_wifi();

	if (!iface) {
		channel = DEFAULT_RAW_TX_WIFI_CHANNEL;
	} else {
#ifdef CONFIG_RAW_TX_PKT_SAMPLE_CONNECTION_MODE
		struct wifi_iface_status status = {0};

		if (net_mgmt(NET_REQUEST_WIFI_IFACE_STATUS, iface, &status, sizeof(status)) == 0) {
			if (status.state >= WIFI_STATE_ASSOCIATED && status.channel > 0) {
				channel = (uint8_t)status.channel;
			} else {
				channel = DEFAULT_RAW_TX_WIFI_CHANNEL;
			}
		} else {
			channel = DEFAULT_RAW_TX_WIFI_CHANNEL;
		}
#else
		channel = CONFIG_RAW_TX_PKT_SAMPLE_CHANNEL;
#endif
	}

	/* Update channel in DS Parameter */
	uint8_t *payload = test_beacon_frame.payload;
	unsigned short pos = 12;

	while ((pos + 2) < BEACON_PAYLOAD_LENGTH) {
		uint8_t tag = payload[pos];
		uint8_t length = payload[pos + 1];

		if (tag == DS_PARAMETER_SET_ELEMENT_ID && length == DS_PARAMETER_SET_LENGTH) {
			payload[pos + 2] = channel;
			return;
		}

		pos += 2 + length;
		if (pos >= BEACON_PAYLOAD_LENGTH) {
			break;
		}
	}
}

static void fill_raw_tx_pkt_hdr(struct raw_tx_pkt_header *raw_tx_pkt)
{
	/* Raw Tx Packet header */
	raw_tx_pkt->magic_num = NRF_WIFI_MAGIC_NUM_RAWTX;
	raw_tx_pkt->data_rate = CONFIG_RAW_TX_PKT_SAMPLE_RATE_VALUE;
	raw_tx_pkt->packet_length = calculate_beacon_frame_length(&test_beacon_frame);
	raw_tx_pkt->tx_mode = CONFIG_RAW_TX_PKT_SAMPLE_RATE_FLAGS;
	raw_tx_pkt->queue = CONFIG_RAW_TX_PKT_SAMPLE_QUEUE_NUM;
#if defined(CONFIG_RAW_TX_PKT_SAMPLE_AGGREGATION_ENABLE)
	raw_tx_pkt->aggregation = AGGR_ENABLE;
	raw_tx_pkt->num_frames = CONFIG_RAW_TX_PKT_SAMPLE_NUM_FRAMES;
#else
	/* nRF71 ignores bytes 9-11 (driver reserved[]); keep disabled. */
	raw_tx_pkt->aggregation = AGGR_DISABLE;
	raw_tx_pkt->num_frames = 1;
#endif
	raw_tx_pkt->reserved = 0;
}

int wifi_send_raw_tx_pkt(int sockfd, char *test_frame,
			size_t buf_length, struct sockaddr_ll *sa)
{
	return sendto(sockfd, test_frame, buf_length, 0,
			(struct sockaddr *)sa, sizeof(*sa));
}

static int get_pkt_transmit_count(unsigned int *mode_of_transmission,
					unsigned int *num_tx_pkts)
{
#ifdef CONFIG_RAW_TX_PKT_SAMPLE_TX_MODE_FIXED
	*mode_of_transmission = 1;
	*num_tx_pkts = CONFIG_RAW_TX_PKT_SAMPLE_FIXED_NUM_PACKETS;
	if (*num_tx_pkts == 0) {
		LOG_ERR("Can't send %d number of raw tx packets", *num_tx_pkts);
		return -1;
	}
	LOG_INF("Sending %d number of raw tx packets", *num_tx_pkts);
#else
	*mode_of_transmission = 0;
	*num_tx_pkts = UINT_MAX;
	LOG_INF("Sending raw tx packets continuously");
#endif
	return 0;
}

static void increment_seq_control(void)
{
	test_beacon_frame.seq_ctrl = (test_beacon_frame.seq_ctrl +
				      IEEE80211_SEQ_NUMBER_INC) &
				      IEEE80211_SEQ_CTRL_SEQ_NUM_MASK;
	if (test_beacon_frame.seq_ctrl > IEEE80211_SEQ_CTRL_SEQ_NUM_MASK) {
		test_beacon_frame.seq_ctrl = 0X0010;
	}
}

static void wifi_send_raw_tx_packets(void)
{
	struct sockaddr_ll sa;
	int sockfd, ret;
	struct raw_tx_pkt_header packet;
	char *test_frame = NULL;
	unsigned int buf_length, num_pkts, transmission_mode, num_failures = 0;
	unsigned short beacon_frame_length = calculate_beacon_frame_length(&test_beacon_frame);

	update_beacon_channel();

	ret = setup_raw_pkt_socket(&sockfd, &sa);
	if (ret < 0) {
		LOG_ERR("Setting socket for raw pkt transmission failed %d", errno);
		return;
	}

	fill_raw_tx_pkt_hdr(&packet);

	LOG_INF("Raw TX header: aggregation=%u num_frames=%u inter_frame_delay=%d ms",
		packet.aggregation, packet.num_frames,
		CONFIG_RAW_TX_PKT_SAMPLE_INTER_FRAME_DELAY_MS);

	ret = get_pkt_transmit_count(&transmission_mode, &num_pkts);
	if (ret < 0) {
		close(sockfd);
		return;
	}

	test_frame = malloc(sizeof(struct raw_tx_pkt_header) + beacon_frame_length);
	if (!test_frame) {
		LOG_ERR("Malloc failed for send buffer %d", errno);
		return;
	}

	buf_length = sizeof(struct raw_tx_pkt_header) + beacon_frame_length;
	memcpy(test_frame, &packet, sizeof(struct raw_tx_pkt_header));

	if (num_pkts == 1) {
		memcpy(test_frame + sizeof(struct raw_tx_pkt_header),
		       &test_beacon_frame, beacon_frame_length);

		ret = wifi_send_raw_tx_pkt(sockfd, test_frame, buf_length, &sa);
		if (ret < 0) {
			LOG_ERR("Unable to send beacon frame: %s", strerror(errno));
			close(sockfd);
			free(test_frame);
			return;
		}
	} else {
		for (int i = 0; i < num_pkts; i++) {
			memcpy(test_frame + sizeof(struct raw_tx_pkt_header),
			       &test_beacon_frame, beacon_frame_length);

			ret = sendto(sockfd, test_frame, buf_length, 0,
					(struct sockaddr *)&sa, sizeof(sa));
			if (ret < 0) {
				LOG_ERR("Unable to send beacon frame: %s", strerror(errno));
				num_failures++;
			}

			increment_seq_control();

			k_msleep(CONFIG_RAW_TX_PKT_SAMPLE_INTER_FRAME_DELAY_MS);
		}
	}

	LOG_INF("Sent %d packets with %d failures on socket", num_pkts, num_failures);

	/* close the socket */
	close(sockfd);
	free(test_frame);
}

/* Net iface events handler */
static void net_events_handler(struct net_mgmt_event_callback *cb,
			       uint64_t mgmt_event, struct net_if *iface)
{
	switch (mgmt_event) {
	case NET_EVENT_IF_UP:
		LOG_DBG("Interface is up");
		k_sem_give(&wait_for_oper_up);
		break;
	default:
		break;
	}
}

int main(void)
{
	int mode;

	net_mgmt_init_event_callback(&net_iface_mgmt_cb, net_events_handler,
				     NET_EVENT_IF_UP);
	net_mgmt_add_event_callback(&net_iface_mgmt_cb);

	mode = BIT(0);
	/* This is to set mode to STATION */
	wifi_set_mode(mode);

#ifdef CONFIG_RAW_TX_PKT_SAMPLE_INJECTION_ENABLE
	if (wifi_set_tx_injection_mode()) {
		return -1;
	}
#endif

#ifdef CONFIG_RAW_TX_PKT_SAMPLE_CONNECTION_MODE
	int status;

	status = try_wifi_connect();
	if (status < 0) {
		return status;
	}
#else
	wifi_set_channel();
#endif
	if (k_sem_take(&wait_for_oper_up,
			K_SECONDS(CONFIG_RAW_TX_PKT_SAMPLE_WIFI_IFACE_OPER_UP_TIMEOUT_S)) != 0) {
		LOG_ERR("Timeout waiting for iface to become operational after %d seconds",
			CONFIG_RAW_TX_PKT_SAMPLE_WIFI_IFACE_OPER_UP_TIMEOUT_S);
		return -1;
	}

	wifi_send_raw_tx_packets();

	return 0;
}
```

## src/wifi_connection.c
```c
/*
 * Copyright (c) 2023 Nordic Semiconductor ASA
 *
 * SPDX-License-Identifier: LicenseRef-Nordic-5-Clause
 */

/** @file
 * @brief Wi-Fi Connection
 */

#include <zephyr/logging/log.h>
LOG_MODULE_REGISTER(wifi_connect, CONFIG_LOG_DEFAULT_LEVEL);

#include <stdlib.h>
#include <zephyr/net/wifi_mgmt.h>
#include "net_private.h"


#define WIFI_SHELL_MGMT_EVENTS (NET_EVENT_WIFI_CONNECT_RESULT |		\
				NET_EVENT_WIFI_DISCONNECT_RESULT)

#define MAX_SSID_LEN        32
#define STATUS_POLLING_MS   300

K_SEM_DEFINE(wait_for_dhcp, 0, 1);
static struct net_mgmt_event_callback wifi_shell_mgmt_cb;
static struct net_mgmt_event_callback net_shell_mgmt_cb;

static struct {
	const struct shell *sh;
	union {
		struct {
			uint8_t connected	: 1;
			uint8_t connect_result	: 1;
			uint8_t disconnect_requested	: 1;
			uint8_t _unused		: 5;
		};
		uint8_t all;
	};
} context;

static int cmd_wifi_status(void)
{
	struct net_if *iface = NULL;
	struct wifi_iface_status status = { 0 };
	int ret;

	iface = net_if_get_first_wifi();
	if (!iface) {
		LOG_ERR("Failed to get Wi-Fi iface");
		return -1;
	}

	ret = net_mgmt(NET_REQUEST_WIFI_IFACE_STATUS, iface, &status,
				sizeof(struct wifi_iface_status));
	if (ret) {
		LOG_INF("Status request failed: %d\n", ret);
		return ret;
	}

	LOG_INF("==================");
	LOG_INF("State: %s", wifi_state_txt(status.state));

	if (status.state >= WIFI_STATE_ASSOCIATED) {
		uint8_t mac_string_buf[sizeof("xx:xx:xx:xx:xx:xx")];

		LOG_INF("Interface Mode: %s",
		       wifi_mode_txt(status.iface_mode));
		LOG_INF("Link Mode: %s",
		       wifi_link_mode_txt(status.link_mode));
		LOG_INF("SSID: %.32s", status.ssid);
		LOG_INF("BSSID: %s",
		       net_sprint_ll_addr_buf(
				status.bssid, WIFI_MAC_ADDR_LEN,
				mac_string_buf, sizeof(mac_string_buf)));
		LOG_INF("Band: %s", wifi_band_txt(status.band));
		LOG_INF("Channel: %d", status.channel);
		LOG_INF("Security: %s", wifi_security_txt(status.security));
		LOG_INF("MFP: %s", wifi_mfp_txt(status.mfp));
		LOG_INF("RSSI: %d", status.rssi);
		LOG_INF("TWT: %s", status.twt_capable ? "Supported" : "Not supported");
	}
	return 0;
}

static void handle_wifi_connect_result(struct net_mgmt_event_callback *cb)
{
	const struct wifi_status *status =
		(const struct wifi_status *) cb->info;

	if (context.connected) {
		return;
	}

	if (status->status) {
		LOG_ERR("Connection failed (%d)", status->status);
	} else {
		LOG_INF("Connected");
		context.connected = true;
	}

	context.connect_result = status->conn_status;
}

static void handle_wifi_disconnect_result(struct net_mgmt_event_callback *cb)
{
	const struct wifi_status *status =
		(const struct wifi_status *) cb->info;

	if (!context.connected) {
		return;
	}

	if (context.disconnect_requested) {
		LOG_INF("Disconnection request %s (%d)",
			 status->status ? "failed" : "done",
					status->status);
		context.disconnect_requested = false;
	} else {
		LOG_INF("Received Disconnected");
		context.connected = false;
	}

	cmd_wifi_status();
}

static void wifi_mgmt_event_handler(struct net_mgmt_event_callback *cb,
				     uint64_t mgmt_event, struct net_if *iface)
{
	switch (mgmt_event) {
	case NET_EVENT_WIFI_CONNECT_RESULT:
		handle_wifi_connect_result(cb);
		break;
	case NET_EVENT_WIFI_DISCONNECT_RESULT:
		handle_wifi_disconnect_result(cb);
		break;
	default:
		break;
	}
}

static void print_dhcp_ip(struct net_mgmt_event_callback *cb)
{
	/* Get DHCP info from struct net_if_dhcpv4 and print */
	const struct net_if_dhcpv4 *dhcpv4 = cb->info;
	const struct in_addr *addr = &dhcpv4->requested_ip;
	char dhcp_info[128];

	net_addr_ntop(AF_INET, addr, dhcp_info, sizeof(dhcp_info));

	LOG_INF("DHCP IP address: %s", dhcp_info);
	k_sem_give(&wait_for_dhcp);
}

static void net_mgmt_event_handler(struct net_mgmt_event_callback *cb,
				    uint64_t mgmt_event, struct net_if *iface)
{
	switch (mgmt_event) {
	case NET_EVENT_IPV4_DHCP_BOUND:
		print_dhcp_ip(cb);
		break;
	default:
		break;
	}
}

static int wifi_connect(void)
{
	struct net_if *iface = NULL;

	iface = net_if_get_first_wifi();
	if (!iface) {
		LOG_ERR("Failed to get Wi-Fi iface");
		return -1;
	}

	context.connected = false;
	context.connect_result = WIFI_STATUS_CONN_FAIL;

	if (net_mgmt(NET_REQUEST_WIFI_CONNECT_STORED, iface, NULL, 0)) {
		LOG_ERR("Connection request failed");

		return -ENOEXEC;
	}

	LOG_INF("Connection requested");

	return 0;
}

int try_wifi_connect(void)
{
	memset(&context, 0, sizeof(context));

	net_mgmt_init_event_callback(&wifi_shell_mgmt_cb,
				     wifi_mgmt_event_handler,
				     WIFI_SHELL_MGMT_EVENTS);

	net_mgmt_add_event_callback(&wifi_shell_mgmt_cb);

	net_mgmt_init_event_callback(&net_shell_mgmt_cb,
				     net_mgmt_event_handler,
				     NET_EVENT_IPV4_DHCP_BOUND);

	net_mgmt_add_event_callback(&net_shell_mgmt_cb);

	k_sleep(K_SECONDS(1));

	LOG_INF("Static IP address (overridable): %s/%s -> %s",
		CONFIG_NET_CONFIG_MY_IPV4_ADDR,
		CONFIG_NET_CONFIG_MY_IPV4_NETMASK,
		CONFIG_NET_CONFIG_MY_IPV4_GW);

	while (1) {
		wifi_connect();

		while (context.connect_result) {
			cmd_wifi_status();
			k_sleep(K_MSEC(STATUS_POLLING_MS));
		}

		if (context.connected) {
			k_sem_take(&wait_for_dhcp,
				   K_SECONDS(CONFIG_RAW_TX_PKT_SAMPLE_DHCP_TIMEOUT_S));
			break;
		} else if (context.connect_result) {
			LOG_ERR("Connection unsuccessful with reason (%d)", context.connect_result);
			return -1;
		}
	}

	return 0;
}
```

## src/wifi_connection.h
```c
/*
 * Copyright (c) 2023 Nordic Semiconductor ASA
 *
 * SPDX-License-Identifier: LicenseRef-Nordic-5-Clause
 */

/** @file
 * @brief Wi-Fi Connection
 */

int try_wifi_connect(void);
```
