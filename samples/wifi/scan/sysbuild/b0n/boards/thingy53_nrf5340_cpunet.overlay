/*
 * Copyright (c) 2024 Nordic Semiconductor ASA
 *
 * SPDX-License-Identifier: LicenseRef-Nordic-5-Clause
 */

/* Define b0n partition layout so &b0n_partition referenced by
 * nrf/samples/nrf5340/netboot/app.overlay resolves correctly.
 */
#include <samples/matter/nrf5340_cpunet_partitions.dtsi>

/ {
	chosen {
		zephyr,code-partition = &b0n_partition;
	};
};
