## samples/wifi/softap/boards/nrf54h20dk_nrf54h20_cpuapp.conf
```kconfig
#
# Copyright (c) 2026 Nordic Semiconductor ASA
#
# SPDX-License-Identifier: LicenseRef-Nordic-5-Clause
#

#NRF70 specific configuration
CONFIG_WIFI_NRF70=y
CONFIG_NRF70_AP_MODE=y
```

## samples/wifi/softap/boards/nrf54l15dk_nrf54l15_cpuapp.conf
```kconfig
CONFIG_WIFI_CREDENTIALS=y
# Needed for Wi-Fi credentials
CONFIG_FLASH=y
CONFIG_FLASH_PAGE_LAYOUT=y
CONFIG_FLASH_MAP=y
CONFIG_ZMS=y
CONFIG_SETTINGS=y

#NRF70 specific configuration
CONFIG_WIFI_NRF70=y
CONFIG_NRF70_AP_MODE=y
```

## samples/wifi/sta/Kconfig.sysbuild
```kconfig
#
# Copyright (c) 2024 Nordic Semiconductor ASA
#
# SPDX-License-Identifier: LicenseRef-Nordic-5-Clause
#

source "${ZEPHYR_NRF_MODULE_DIR}/samples/wifi/Kconfig.sysbuild.nrf70"

source "share/sysbuild/Kconfig"
```

## samples/wifi/sta/boards/nrf52840dk_nrf52840.conf
```kconfig
CONFIG_WIFI_READY_LIB=n

#NRF70 specific configuration
CONFIG_WIFI_NRF70=y
CONFIG_NRF70_RX_NUM_BUFS=16
```

## samples/wifi/thread_coex/boards/nrf7002dk_nrf5340_cpuapp_nrf7001.conf
```kconfig
#
# Copyright (c) 2026 Nordic Semiconductor ASA
#
# SPDX-License-Identifier: LicenseRef-Nordic-5-Clause
#

#NRF70 specific configuration
CONFIG_WIFI_NRF70=y
CONFIG_NRF70_SR_COEX=y
CONFIG_NRF70_SR_COEX_RF_SWITCH=y
CONFIG_NRF70_RX_NUM_BUFS=48
CONFIG_NRF70_MAX_TX_AGGREGATION=12
CONFIG_NRF70_MAX_TX_PENDING_QLEN=12
CONFIG_NRF70_QSPI_LOW_POWER=n
```

## samples/zephyr/boards/nordic/spis_wakeup/Kconfig.sysbuild
```kconfig
#
# Copyright (c) 2026 Nordic Semiconductor ASA
#
# SPDX-License-Identifier: LicenseRef-Nordic-5-Clause
#

if SUPPORT_NETCORE

choice NETCORE
	default NETCORE_WAKEUP_TRIGGER

config NETCORE_WAKEUP_TRIGGER
	bool "Radio core is a wakeup trigger source"

endchoice

config NETCORE_IMAGE_NAME
	default "wakeup_trigger" if NETCORE_WAKEUP_TRIGGER

config NETCORE_IMAGE_PATH
	default "$(APP_DIR)/wakeup_trigger" if NETCORE_WAKEUP_TRIGGER

endif # SUPPORT_NETCORE

if SUPPORT_PPRCORE

choice PPRCORE
	default PPRCORE_WAKEUP_TRIGGER if SOC_NRF9251_CPUAPP
	default PPRCORE_NONE

config PPRCORE_WAKEUP_TRIGGER
	bool "PPR core is a wakeup trigger source"

endchoice

config PPRCORE_IMAGE_NAME
	default "wakeup_trigger" if PPRCORE_WAKEUP_TRIGGER

config PPRCORE_IMAGE_PATH
	default "$(APP_DIR)/wakeup_trigger" if PPRCORE_WAKEUP_TRIGGER

endif # SUPPORT_PPRCORE

source "share/sysbuild/Kconfig"
```

## samples/zephyr/drivers/adc/adc_sequence/sample.yaml
```yaml
sample:
  name: ADC driver sequence sample
common:
  tags:
    - ci_samples_zephyr_drivers_adc
  harness: console
  timeout: 10
  harness_config:
    type: multi_line
    regex:
      - "ADC sequence reading \\[\\d+\\]:"
      - "- .+, channel \\d+, \\d+ sequence samples:"
      - "- - \\d+ (= \\d+mV)|(\\(value in mV not available\\))"
  platform_allow:
    - nrf54ls05dk/nrf54ls05a/cpuapp
    - nrf54ls05dk/nrf54ls05b/cpuapp
    - nrf54lc10dk/nrf54lc10a/cpuapp
    - nrf54lc10dk/nrf54lc10a/cpuapp/ns
    - nrf7120dk/nrf7120/cpuapp
    - nrf7120dk/nrf7120/cpuapp/ns
    - nrf7120dk/nrf7120e/cpuapp
    - nrf9251dk/nrf9251/cpuapp
    - nrf9251dk/nrf9251/cpuppr
  integration_platforms:
    - nrf54ls05dk/nrf54ls05b/cpuapp

tests:
  nrf.extended.sample.drivers.adc.adc_sequence: {}
  nrf.extended.sample.drivers.adc.adc_sequence.8bit:
    extra_configs:
      - CONFIG_SEQUENCE_RESOLUTION=8
```

## samples/zephyr/net/mqtt_sn_publisher/sample.yaml
```yaml
sample:
  description: MQTT-SN publisher sample application
  name: MQTT-SN publisher
tests:
  nrf.extended.sample.net.mqtt_sn_publisher.wifi-ipv4:
    tags:
      - ci_build
      - sysbuild
      - ci_samples_net
    extra_args:
      - SNIPPET=wifi-ipv4
    platform_allow:
      - nrf7002dk/nrf5340/cpuapp
      - nrf7120dk/nrf7120/cpuapp
    integration_platforms:
      - nrf7002dk/nrf5340/cpuapp
      - nrf7120dk/nrf7120/cpuapp
```

## samples/zephyr/net/sockets/coap_server/sample.yaml
```yaml
sample:
  description: BSD Sockets API CoAP server example
  name: socket_coap_server
tests:
  nrf.extended.sample.net.sockets.coap_server.wifi-ipv4:
    tags:
      - ci_build
      - sysbuild
      - ci_samples_net
    extra_args:
      - SNIPPET=wifi-ipv4
      - platform:nrf7120:EXTRA_DTC_OVERLAY_FILE=${ZEPHYR_NRFXLIB_MODULE_DIR}/nrf71_wifi/bins/0.1.0/nrf7120_wifi_patch.dtsi
      - platform:nrf7120:CONFIG_WIFI_NRF71_PATCH=y
    platform_allow:
      - nrf7002dk/nrf5340/cpuapp
      - nrf7120dk/nrf7120/cpuapp
    integration_platforms:
      - nrf7002dk/nrf5340/cpuapp
      - nrf7120dk/nrf7120/cpuapp
  nrf.extended.sample.net.sockets.coap_server.wifi-ipv4.dtls:
    tags:
      - ci_build
      - sysbuild
      - ci_samples_net
    extra_args:
      - SNIPPET=wifi-ipv4
      - EXTRA_CONF_FILE="overlay-dtls.conf"
      - platform:nrf7120:EXTRA_DTC_OVERLAY_FILE=${ZEPHYR_NRFXLIB_MODULE_DIR}/nrf71_wifi/bins/0.1.0/nrf7120_wifi_patch.dtsi
      - platform:nrf7120:CONFIG_WIFI_NRF71_PATCH=y
    platform_allow:
      - nrf7002dk/nrf5340/cpuapp
      - nrf7120dk/nrf7120/cpuapp
    integration_platforms:
      - nrf7002dk/nrf5340/cpuapp
      - nrf7120dk/nrf7120/cpuapp
  nrf.extended.sample.net.sockets.coap_server.wifi-ipv6:
    tags:
      - ci_build
      - sysbuild
      - ci_samples_net
    extra_args:
      - SNIPPET=wifi-ipv6
      - platform:nrf7120:EXTRA_DTC_OVERLAY_FILE=${ZEPHYR_NRFXLIB_MODULE_DIR}/nrf71_wifi/bins/0.1.0/nrf7120_wifi_patch.dtsi
      - platform:nrf7120:CONFIG_WIFI_NRF71_PATCH=y
    platform_allow:
      - nrf7002dk/nrf5340/cpuapp
      - nrf7120dk/nrf7120/cpuapp
    integration_platforms:
      - nrf7002dk/nrf5340/cpuapp
      - nrf7120dk/nrf7120/cpuapp
  nrf.extended.sample.net.sockets.coap_server.wifi-ipv6.dtls:
    tags:
      - ci_build
      - sysbuild
      - ci_samples_net
    extra_args:
      - SNIPPET=wifi-ipv6
      - EXTRA_CONF_FILE="overlay-dtls.conf"
      - platform:nrf7120:EXTRA_DTC_OVERLAY_FILE=${ZEPHYR_NRFXLIB_MODULE_DIR}/nrf71_wifi/bins/0.1.0/nrf7120_wifi_patch.dtsi
      - platform:nrf7120:CONFIG_WIFI_NRF71_PATCH=y
    platform_allow:
      - nrf7002dk/nrf5340/cpuapp
      - nrf7120dk/nrf7120/cpuapp
    integration_platforms:
      - nrf7002dk/nrf5340/cpuapp
      - nrf7120dk/nrf7120/cpuapp
```

## samples/zephyr/sysbuild/hello_world/Kconfig.sysbuild
```kconfig
# Copyright (c) 2025 Nordic Semiconductor ASA
# SPDX-License-Identifier: Apache-2.0

choice FLPRCORE
	default FLPRCORE_HELLO_WORLD_CPUFLPR

config FLPRCORE_HELLO_WORLD_CPUFLPR
	bool "hello_world image"

endchoice

config FLPRCORE_IMAGE_NAME
	default "hello_world_cpuflpr" if FLPRCORE_HELLO_WORLD_CPUFLPR

config FLPRCORE_IMAGE_PATH
	default "$(ZEPHYR_BASE)/samples/sysbuild/hello_world" if FLPRCORE_HELLO_WORLD_CPUFLPR

source "share/sysbuild/Kconfig"
```

## soc/nordic/Kconfig.soc
```kconfig
# Copyright (c) 2025 Nordic Semiconductor ASA

# SPDX-License-Identifier: LicenseRef-Nordic-5-Clause

rsource "$(ZEPHYR_BASE)/soc/nordic/Kconfig.soc"
rsource "*/Kconfig.soc"
```

## soc/nordic/Kconfig.sysbuild
```kconfig
# Copyright (c) 2025 Nordic Semiconductor ASA
# SPDX-License-Identifier: LicenseRef-Nordic-5-Clause

rsource "$(ZEPHYR_BASE)/soc/nordic/Kconfig.sysbuild"
rsource "common/vpr/Kconfig.sysbuild"

rsource "*/Kconfig.sysbuild"
```

## soc/nordic/nrf71/Kconfig.defconfig
```kconfig
# Nordic Semiconductor nRF71 MCU line

# Copyright (c) 2026 Nordic Semiconductor ASA
# SPDX-License-Identifier: LicenseRef-Nordic-5-Clause

if SOC_SERIES_NRF71

config SOC_SERIES_NRF71_SKIP_PREV_IMAGE_INIT
	default y if SECURE_BOOT

endif # SOC_SERIES_NRF71
```

## soc/nordic/nrf92/Kconfig.sysbuild
```kconfig
# Copyright (c) 2026 Nordic Semiconductor ASA
# SPDX-License-Identifier: LicenseRef-Nordic-5-Clause

config HAS_NORDIC_VPR_LAUNCHER_IMAGE
	default y if SOC_NRF9251_CPUPPR || SOC_NRF9251_CPUFLPR

config SOC_NRF9251_GENERATE_BICR
	bool "Generate nRF9251 BICR file"
	depends on SOC_NRF9251
	default y
	help
	  This option generates a BICR file (bicr.hex) in the sysbuild build
	  directory. Board directory must contain a "bicr.json" file for this
	  option to work.

config SOC_NRF9251_BICR_NAME
	string "Name of nRF9251 BICR file to use"
	depends on SOC_NRF9251_GENERATE_BICR
	default "bicr.json"
	help
	  The file will be searched for in the main application folder first,
	  then board folder if not found.
```

## subsys/bluetooth/fast_pair/fp_crypto/Kconfig.fp_crypto
```kconfig
#
# Copyright (c) 2026 Nordic Semiconductor ASA
#
# SPDX-License-Identifier: LicenseRef-Nordic-5-Clause
#

config BT_FAST_PAIR_CRYPTO
	bool
	default y
	help
	  Add Fast Pair crypto source files.

if BT_FAST_PAIR_CRYPTO

choice BT_FAST_PAIR_CRYPTO_BACKEND
	prompt "Cryptographic backend selection"
	default BT_FAST_PAIR_CRYPTO_OBERON
	help
	  Select the Fast Pair cryptographic backend.

config BT_FAST_PAIR_CRYPTO_OBERON
	bool "Fast Pair with Oberon cryptographic backend"
	select NRF_OBERON
	select BT_FAST_PAIR_CRYPTO_AES256_ECB_SUPPORT
	select BT_FAST_PAIR_CRYPTO_SECP160R1_SUPPORT
	select BT_FAST_PAIR_CRYPTO_SECP256R1_SUPPORT
	depends on !DT_HAS_NORDIC_IRONSIDE_CALL_ENABLED
	help
	  Select Oberon cryptographic backend for Fast Pair.

config BT_FAST_PAIR_CRYPTO_PSA
	bool "Fast Pair with PSA cryptographic backend [EXPERIMENTAL]"
	select EXPERIMENTAL
	select MBEDTLS_ENABLE_HEAP if !DT_HAS_NORDIC_IRONSIDE_CALL_ENABLED
	select PSA_CRYPTO
	select PSA_WANT_ALG_SHA_256
	select PSA_WANT_ALG_HMAC
	select PSA_WANT_ALG_ECDH
	select PSA_WANT_KEY_TYPE_ECC_KEY_PAIR_IMPORT
	select PSA_WANT_KEY_TYPE_ECC_KEY_PAIR_EXPORT
	select PSA_WANT_KEY_TYPE_ECC_KEY_PAIR_GENERATE
	select PSA_WANT_KEY_TYPE_ECC_KEY_PAIR_DERIVE
	select PSA_WANT_ECC_SECP_R1_256
	select PSA_WANT_KEY_TYPE_AES
	select PSA_WANT_ALG_ECB_NO_PADDING
	# The AES-ECB drivers gate on an explicit key size, so both widths this
	# backend uses have to be requested: AES-128 for Fast Pair, AES-256 for
	# the FHN Ephemeral ID.
	select PSA_WANT_AES_KEY_SIZE_128
	select PSA_WANT_AES_KEY_SIZE_256
	select BT_FAST_PAIR_CRYPTO_AES256_ECB_SUPPORT
	# secp160r1 is not expressible in PSA, so it comes from the Nordic PSA
	# extension API, which is CRACEN-only.
	select PSA_EXT_ECC_SECP_R1_160 if HAS_HW_NRF_CRACEN && !BUILD_WITH_TFM
	select BT_FAST_PAIR_CRYPTO_SECP160R1_SUPPORT if HAS_HW_NRF_CRACEN && !BUILD_WITH_TFM
	depends on !TFM_PROFILE_TYPE_MINIMAL
	help
	  Select PSA cryptographic backend for Fast Pair. The backend relies on
	  PSA crypto APIs for cryptographical operations.

endchoice

# A backend supporting a given crypto operation selects a related Kconfig option.
config BT_FAST_PAIR_CRYPTO_AES256_ECB_SUPPORT
	bool

config BT_FAST_PAIR_CRYPTO_SECP160R1_SUPPORT
	bool

config BT_FAST_PAIR_CRYPTO_SECP256R1_SUPPORT
	bool

module = FP_CRYPTO
module-str = Fast Pair crypto library
source "$(ZEPHYR_BASE)/subsys/logging/Kconfig.template.log_config"

endif # BT_FAST_PAIR_CRYPTO
```

## subsys/bluetooth/host_extensions/Kconfig
```kconfig
#
# Copyright (c) 2024 Nordic Semiconductor
#
# SPDX-License-Identifier: LicenseRef-Nordic-5-Clause
#

config BT_RADIO_NOTIFICATION_CONN_CB
	bool "Radio Notification connection callback"
	depends on BT_LL_SOFTDEVICE || \
		   (BT_LL_SOFTDEVICE_HEADERS_INCLUDE && !SOC_COMPATIBLE_NRF5340_CPUAPP)
	select BT_HCI_VS_EVT_USER
	select BT_CTLR_SDC_CONN_ANCHOR_POINT_REPORT
	help
	  Enables the support for setting up a radio notification
	  callback to trigger a configurable amount of time before the
	  connection event starts.
	  This feature can be used to synchronize data sampling
	  with on-air data transmission.

config BT_NRF_CONN_SET_LTK
	bool "Custom LTK support"
	depends on BT_SMP
	help
	  Enables the bt_nrf_conn_set_ltk() API.

config BT_NRF_LE_POWER_CONTROL_EXT
	bool "LE Power Control extensions"
	depends on BT_TRANSMIT_POWER_CONTROL || BT_CTLR_LE_POWER_CONTROL
	help
	  Enables the vendor-specific extensions to LE Power Control:

	  * bt_conn_set_conn_power_control_request_params() sets the LE Power Control Request
	    parameters for a single connection, instead of for all connections as
	    bt_conn_set_power_control_request_params() does.
	    This allows, for example, the lower limit of the RSSI golden range, which determines the
	    Acceptable Power Reduction (APR) sent in LL_POWER_CONTROL_RSP, to differ between
	    connections.
	  * bt_conn_set_tx_power_bounds() sets the lowest and highest local TX power of a connection.
	    The bounds are honored when the peer requests a change of the local TX power.
	  * bt_nrf_power_control_rsp_report_enable() enables reports to the host with the full content of
	    LL_POWER_CONTROL_RSP, including the Acceptable Power Reduction (APR) and the minimum and
	    maximum power flags of the peer, for the procedures that the host initiated.

	  In the SoftDevice Controller, this enables the vendor-specific HCI commands that the
	  APIs use, see sdc_hci_cmd_vs_set_conn_power_control_request_params(),
	  sdc_hci_cmd_vs_set_conn_tx_power_bounds() and sdc_hci_cmd_vs_power_control_rsp_report_enable().
	  When the host and the controller are built as separate images, enable this option in
	  both images.
	  The APIs and the commands are not included in the build when this option is disabled.
```

## subsys/bluetooth/mesh/Kconfig.rpl
```kconfig
#
# Copyright (c) 2022 Nordic Semiconductor ASA
#
# SPDX-License-Identifier: LicenseRef-Nordic-5-Clause
#

# Option enabled when the NCS implementation of RPL should be used instead of
# the Zephyr one.
config BT_MESH_RPL_NCS
	bool

choice BT_MESH_RPL_STORAGE_MODE
	prompt "Replay protection list storage mode"
	default BT_MESH_RPL_STORAGE_MODE_EMDS if EMDS

config BT_MESH_RPL_STORAGE_MODE_EMDS
	bool "Persistent storage of RPL in Emergency Data Storage"
	depends on EMDS
	select BT_MESH_RPL_NCS
	help
	  Persistent storage of RPL in Emergency Data Storage.

config BT_MESH_RPL_STORAGE_MODE_ZMS
	bool "Persistent storage of RPL in Zephyr Memory Storage"
	depends on ZMS
	depends on !ZMS_ID_64BIT
	select BT_MESH_RPL_NCS
	select EXPERIMENTAL
	help
	  Persistent storage of RPL directly in a dedicated ZMS partition.
	  This approach does not use the Settings subsystem for RPL storage.

endchoice

if BT_MESH_RPL_STORAGE_MODE_EMDS

config BT_MESH_RPL_INDEX
	int "Unique index for the storage of RPL data"
	default 999
	help
	  This value defines the storage index for the RPL data in Emergency
	  Data Storage, and can not overlap with any other index in the
	  Emergency Data Storage.

endif # BT_MESH_RPL_STORAGE_MODE_EMDS
```
