## CMakeLists.txt
```
#
# Copyright (c) 2023 Nordic Semiconductor ASA
#
# SPDX-License-Identifier: LicenseRef-Nordic-5-Clause
#

cmake_minimum_required(VERSION 3.20.0)

find_package(Zephyr REQUIRED HINTS $ENV{ZEPHYR_BASE})
project(nrf_wifi_shutdown)

target_include_directories(app PUBLIC ${ZEPHYR_BASE}/subsys/net/ip)

target_sources(app PRIVATE src/main.c)
```

## Kconfig
```
#
# Copyright (c) 2023 Nordic Semiconductor
#
# SPDX-License-Identifier: LicenseRef-Nordic-5-Clause
#

source "Kconfig.zephyr"

choice SHUTDOWN_OPERATION_MODE
	prompt "Sample operation mode"
	default OPERATION_MODE_CONTINUOUS
	help
	  Select the operation mode for the sample.

config OPERATION_MODE_CONTINUOUS
	bool "Continuous mode"
	help
	  In this mode, the sample will continue to run alternating between
	  Wi-Fi shutdown and startup.

config OPERATION_MODE_ONE_SHOT
	bool "One-shot mode"
	help
	  In this mode, the sample will shutdown Wi-Fi only once and then exit.

config OPERATION_MODE_BUTTONS
	bool "Enable button interaction"
	help
	  Enable button interaction in the sample. If enabled, the sample will
	  enable use of buttons to toggle the Wi-Fi shutdown or startup.
endchoice

config SHUTDOWN_TIMEOUT_S
	int "Wi-Fi shutdown timeout"
	default 5
	help
	  Timeout in seconds after the Wi-Fi shutdown operation.

config SHUTDOWN_STAY_UP
	bool "Stay up with Wi-Fi interface up for idle measurement"
	help
	  For idle-current measurement with the interface up. In one-shot or
	  buttons mode, bring the interface up and scan once, then idle
	  forever with the interface still up instead of bringing Wi-Fi down.
	  Lets the driver's power save put the radio to sleep between beacons
	  while the host idles.
```

## sample.yaml
```
sample:
  description: Wi-Fi shutdown sample application
  name: Wi-Fi shutdown
tests:
  sample.nrf7002.shutdown:
    sysbuild: true
    build_only: true
    integration_platforms:
      - nrf7002dk/nrf5340/cpuapp
    platform_allow: nrf7002dk/nrf5340/cpuapp
    tags:
      - ci_build
      - sysbuild
      - ci_samples_wifi
  sample.nrf7002_eks.shutdown:
    sysbuild: true
    build_only: true
    extra_args: SHIELD=nrf7002ek
    integration_platforms:
      - nrf5340dk/nrf5340/cpuapp
      - nrf52840dk/nrf52840
    platform_allow:
      - nrf5340dk/nrf5340/cpuapp
      - nrf52840dk/nrf52840
    tags:
      - ci_build
      - sysbuild
      - ci_samples_wifi
  sample.nrf7000_location.shutdown:
    sysbuild: true
    build_only: true
    extra_args: SHIELD=nrf7002ek_nrf7000
    integration_platforms:
      - nrf5340dk/nrf5340/cpuapp
      - nrf9160dk/nrf9160/ns
      - nrf9161dk/nrf9161/ns
      - nrf52840dk/nrf52840
    platform_allow:
      - nrf5340dk/nrf5340/cpuapp
      - nrf9160dk/nrf9160/ns
      - nrf9161dk/nrf9161/ns
      - nrf9151dk/nrf9151/ns
      - nrf52840dk/nrf52840
    tags:
      - ci_build
      - sysbuild
      - ci_samples_wifi
  sample.nrf7002eb_interposer_p1.nrf7002eb.shutdown:
    sysbuild: true
    build_only: true
    extra_args:
      - shutdown_SHIELD="nrf7002eb_interposer_p1;nrf7002eb"
      - shutdown_SNIPPET=nrf70-wifi
    integration_platforms:
      - nrf54h20dk/nrf54h20/cpuapp
    platform_allow:
      - nrf54h20dk/nrf54h20/cpuapp
    tags:
      - ci_build
      - sysbuild
      - ci_samples_wifi
  sample.nrf7002eb2.shutdown:
    sysbuild: true
    build_only: true
    extra_args:
      - shutdown_SHIELD="nrf7002eb2"
      - SNIPPET=nrf70-wifi
    integration_platforms:
      - nrf54l15dk/nrf54l15/cpuapp
    platform_allow:
      - nrf54l15dk/nrf54l15/cpuapp
    tags:
      - ci_build
      - sysbuild
      - ci_samples_wifi
  sample.54lm20dk.nrf7002eb2.shutdown:
    sysbuild: true
    build_only: true
    extra_args:
      - shutdown_SHIELD="nrf7002eb2"
    integration_platforms:
      - nrf54lm20dk/nrf54lm20a/cpuapp
      - nrf54lm20dk/nrf54lm20b/cpuapp
    platform_allow:
      - nrf54lm20dk/nrf54lm20a/cpuapp
      - nrf54lm20dk/nrf54lm20b/cpuapp
    tags:
      - ci_build
      - sysbuild
      - ci_samples_wifi
  sample.nrf7120.shutdown:
    sysbuild: true
    build_only: true
    extra_args:
      - EXTRA_DTC_OVERLAY_FILE=${ZEPHYR_NRFXLIB_MODULE_DIR}/nrf71_wifi/bins/0.1.0/nrf7120_wifi_patch.dtsi
      - CONFIG_WIFI_NRF71_PATCH=y
    integration_platforms:
      - nrf7120dk/nrf7120/cpuapp
      - nrf7120dk/nrf7120/cpuapp/ns
    platform_allow:
      - nrf7120dk/nrf7120/cpuapp
      - nrf7120dk/nrf7120/cpuapp/ns
    tags:
      - ci_build
      - sysbuild
      - ci_samples_nrf71_wifi
  sample.nrf7120.shutdown.host_idle:
    sysbuild: true
    build_only: true
    extra_args:
      - shutdown_CONFIG_OPERATION_MODE_ONE_SHOT=y
      - shutdown_SNIPPET="nrf71-idle-power;nrf71-idle-power-quiet"
      - EXTRA_DTC_OVERLAY_FILE=${ZEPHYR_NRFXLIB_MODULE_DIR}/nrf71_wifi/bins/0.1.0/nrf7120_wifi_patch.dtsi
      - CONFIG_WIFI_NRF71_PATCH=y
    integration_platforms:
      - nrf7120dk/nrf7120/cpuapp
    platform_allow:
      - nrf7120dk/nrf7120/cpuapp
    tags:
      - ci_build
      - sysbuild
      - ci_samples_nrf71_wifi
  sample.nrf7120.shutdown.host_idle.diag:
    sysbuild: true
    build_only: true
    extra_args:
      - shutdown_CONFIG_OPERATION_MODE_ONE_SHOT=y
      - shutdown_SNIPPET="nrf71-idle-power;nrf71-idle-power-diag"
      - EXTRA_DTC_OVERLAY_FILE=${ZEPHYR_NRFXLIB_MODULE_DIR}/nrf71_wifi/bins/0.1.0/nrf7120_wifi_patch.dtsi
      - CONFIG_WIFI_NRF71_PATCH=y
    integration_platforms:
      - nrf7120dk/nrf7120/cpuapp
    platform_allow:
      - nrf7120dk/nrf7120/cpuapp
    tags:
      - ci_build
      - sysbuild
      - ci_samples_nrf71_wifi
```

## sysbuild.conf
```
#
# Copyright (c) 2024 Nordic Semiconductor ASA
#
# SPDX-License-Identifier: LicenseRef-Nordic-5-Clause
#

SB_CONFIG_WIFI_NRF70=y
SB_CONFIG_WIFI_NRF70_SCAN_ONLY=y
SB_CONFIG_PARTITION_MANAGER=n
```

## prj.conf
```kconfig
#
# Copyright (c) 2023 Nordic Semiconductor ASA
#
# SPDX-License-Identifier: LicenseRef-Nordic-5-Clause
#
CONFIG_WIFI=y
CONFIG_NET_L2_WIFI_MGMT=y

# Networking
CONFIG_NETWORKING=y
CONFIG_NET_L2_ETHERNET=y
CONFIG_NET_NATIVE=n
CONFIG_NET_OFFLOAD=y

CONFIG_INIT_STACKS=y

# Memories
CONFIG_MAIN_STACK_SIZE=5200

# Debugging
CONFIG_STACK_SENTINEL=y
CONFIG_DEBUG_COREDUMP=y
CONFIG_DEBUG_COREDUMP_BACKEND_LOGGING=y
CONFIG_DEBUG_COREDUMP_MEMORY_DUMP_MIN=y

# Logging
CONFIG_LOG=y
CONFIG_PRINTK=y
# If below config is enabled, printk logs are
# buffered. For unbuffered messages, disable this.
CONFIG_LOG_PRINTK=n

# printing of scan results puts pressure on queues in new locking
# design in net_mgmt. So, use a higher timeout for a crowded
# environment.
CONFIG_NET_MGMT_EVENT_QUEUE_TIMEOUT=5000

CONFIG_DK_LIBRARY=y
```

## host-idle-diag.conf
```kconfig
# Host idle diagnostics build.
#
# Same idle path as host-idle.conf, but keeps logging enabled and
# prints a power-state snapshot (POWER/MEMCONF/GRTC/LFXO) right before the
# host idles. Read CONSTLATSTAT to see whether constant-latency mode is
# holding HFCLK on, and MEMCONF to confirm which RAM sections were powered
# down. Serial output itself draws current, so use this to find where the
# current goes, not for the final number.

CONFIG_OPERATION_MODE_ONE_SHOT=y

CONFIG_NRF71_IDLE_POWER=y
CONFIG_NRF71_IDLE_POWER_RAM_RETAIN_UNUSED_ONLY=y
CONFIG_NRF71_IDLE_DIAGNOSTICS=y
```

## host-idle.conf
```kconfig
# Host idle current measurement (clean number).
#
# Wi-Fi is brought up, scanned once and shut down, then the host SoC idles
# forever. Serial/logging is off so the reading is not polluted by the UART
# (and its HFCLK request). Use host-idle-diag.conf instead when you
# need the register snapshot.

CONFIG_OPERATION_MODE_ONE_SHOT=y

# nRF71 idle power helpers: power down RAM the image does not use and let
# devices runtime-suspend while idle.
CONFIG_NRF71_IDLE_POWER=y
CONFIG_NRF71_IDLE_POWER_RAM_RETAIN_UNUSED_ONLY=y

# Silence the console for a clean measurement. Coredump-over-logging in
# prj.conf pulls in the logging core, so drop it here too.
CONFIG_SERIAL=n
CONFIG_CONSOLE=n
CONFIG_UART_CONSOLE=n
CONFIG_DEBUG_COREDUMP=n
CONFIG_LOG=n
CONFIG_PRINTK=n
CONFIG_BOOT_BANNER=n
CONFIG_NCS_BOOT_BANNER=n
```

## overlay-host-idle-diag.conf
```kconfig
# Host idle diagnostics build.
#
# Same idle path as overlay-host-idle.conf, but keeps logging enabled and
# prints a power-state snapshot (POWER/MEMCONF/GRTC/LFXO) right before the
# host idles. Read CONSTLATSTAT to see whether constant-latency mode is
# holding HFCLK on, and MEMCONF to confirm which RAM sections were powered
# down. Serial output itself draws current, so use this to find where the
# current goes, not for the final number.

CONFIG_OPERATION_MODE_ONE_SHOT=y

CONFIG_NRF71_IDLE_POWER=y
CONFIG_NRF71_IDLE_POWER_RAM_RETAIN_UNUSED_ONLY=y
CONFIG_NRF71_IDLE_DIAGNOSTICS=y
```

## overlay-host-idle.conf
```kconfig
# Host idle current measurement (clean number).
#
# Wi-Fi is brought up, scanned once and shut down, then the host SoC idles
# forever. Serial/logging is off so the reading is not polluted by the UART
# (and its HFCLK request). Use overlay-host-idle-diag.conf instead when you
# need the register snapshot.

CONFIG_OPERATION_MODE_ONE_SHOT=y

# nRF71 idle power helpers: power down RAM the image does not use and let
# devices runtime-suspend while idle.
CONFIG_NRF71_IDLE_POWER=y
CONFIG_NRF71_IDLE_POWER_RAM_RETAIN_UNUSED_ONLY=y

# Silence the console for a clean measurement. Coredump-over-logging in
# prj.conf pulls in the logging core, so drop it here too.
CONFIG_SERIAL=n
CONFIG_CONSOLE=n
CONFIG_UART_CONSOLE=n
CONFIG_DEBUG_COREDUMP=n
CONFIG_LOG=n
CONFIG_PRINTK=n
CONFIG_BOOT_BANNER=n
CONFIG_NCS_BOOT_BANNER=n
```

## boards/nrf5340dk_nrf5340_cpuapp.conf
```kconfig
#
# Copyright (c) 2026 Nordic Semiconductor ASA
#
# SPDX-License-Identifier: LicenseRef-Nordic-5-Clause
#

#NRF70 specific configuration
CONFIG_WIFI_NRF70=y
```

## src/main.c
```c
/*
 * Copyright (c) 2023 Nordic Semiconductor ASA
 *
 * SPDX-License-Identifier: LicenseRef-Nordic-5-Clause
 */

/** @file
 * @brief WiFi shutdown sample
 */

#include <zephyr/logging/log.h>
LOG_MODULE_REGISTER(shutdown, CONFIG_LOG_DEFAULT_LEVEL);

#include <zephyr/kernel.h>
#include <stdio.h>
#include <stdlib.h>
#include <zephyr/shell/shell.h>
#include <zephyr/sys/printk.h>
#include <zephyr/init.h>

#include <zephyr/net/net_if.h>
#include <zephyr/net/wifi_mgmt.h>
#include <zephyr/net/net_event.h>
#include <zephyr/net/ethernet.h>
#include <zephyr/net/ethernet_mgmt.h>

#include <dk_buttons_and_leds.h>

#if defined(CONFIG_NRF71_IDLE_POWER)
#include <nrf71_idle_power.h>
#endif

#include "net_private.h"

#define WIFI_SHELL_MODULE "wifi"

/* DTS node for the Wi-Fi interface - MAC address from local-mac-address property */
#define WIFI_NODE DT_CHOSEN(zephyr_wifi)
static const uint8_t wifi_mac_addr[6] = DT_PROP_OR(WIFI_NODE, local_mac_address, {0});

#define WIFI_SHELL_MGMT_EVENTS (NET_EVENT_WIFI_SCAN_RESULT |		\
				NET_EVENT_WIFI_SCAN_DONE)

#define SCAN_TIMEOUT_MS 10000

static uint32_t scan_result;

static struct net_mgmt_event_callback wifi_shell_mgmt_cb;

void exit_shutdown_mode(void);
void enter_shutdown_mode(void);

K_SEM_DEFINE(scan_sem, 0, 1);

static void handle_wifi_scan_result(struct net_mgmt_event_callback *cb)
{
	const struct wifi_scan_result *entry =
		(const struct wifi_scan_result *)cb->info;
	uint8_t mac_string_buf[sizeof("xx:xx:xx:xx:xx:xx")];
	uint8_t ssid_print[WIFI_SSID_MAX_LEN + 1];

	scan_result++;

	if (scan_result == 1U) {
		printk("%-4s | %-32s %-5s | %-4s | %-4s | %-5s | %s\n",
		       "Num", "SSID", "(len)", "Chan", "RSSI", "Security", "BSSID");
	}

	strncpy(ssid_print, entry->ssid, sizeof(ssid_print) - 1);
	ssid_print[sizeof(ssid_print) - 1] = '\0';

	printk("%-4d | %-32s %-5u | %-4u | %-4d | %-5s | %s\n",
	       scan_result, ssid_print, entry->ssid_length,
	       entry->channel, entry->rssi,
	       (entry->security == WIFI_SECURITY_TYPE_PSK ? "WPA/WPA2" : "Open    "),
	       ((entry->mac_length) ?
			net_sprint_ll_addr_buf(entry->mac, WIFI_MAC_ADDR_LEN, mac_string_buf,
						sizeof(mac_string_buf)) : ""));
}

static void handle_wifi_scan_done(struct net_mgmt_event_callback *cb)
{
	const struct wifi_status *status =
		(const struct wifi_status *)cb->info;

	if (status->status) {
		LOG_ERR("Scan request failed (%d)", status->status);
	} else {
		LOG_INF("Scan request done\n");
	}

	scan_result = 0U;
	k_sem_give(&scan_sem);
}

static void wifi_mgmt_event_handler(struct net_mgmt_event_callback *cb,
				     uint64_t mgmt_event, struct net_if *iface)
{
	switch (mgmt_event) {
	case NET_EVENT_WIFI_SCAN_RESULT:
		handle_wifi_scan_result(cb);
		break;
	case NET_EVENT_WIFI_SCAN_DONE:
		handle_wifi_scan_done(cb);
		break;
	default:
		break;
	}
}

static int wifi_scan(void)
{
	struct net_if *iface = net_if_get_default();

	if (net_mgmt(NET_REQUEST_WIFI_SCAN, iface, NULL, 0)) {
		LOG_ERR("Scan request failed");

		return -ENOEXEC;
	}

	LOG_INF("Scan requested\n");

	k_sem_take(&scan_sem, K_MSEC(SCAN_TIMEOUT_MS));

	return 0;
}

static bool is_mac_addr_set(struct net_if *iface)
{
	struct net_linkaddr *linkaddr = net_if_get_link_addr(iface);
	struct net_eth_addr wifi_addr;

	if (!linkaddr || linkaddr->len != WIFI_MAC_ADDR_LEN) {
		return false;
	}

	memcpy(wifi_addr.addr, linkaddr->addr, WIFI_MAC_ADDR_LEN);

	return net_eth_is_addr_valid(&wifi_addr);
}

#ifdef CONFIG_OPERATION_MODE_BUTTONS
static void button_handler_cb(uint32_t button_state, uint32_t has_changed)
{
	if ((has_changed & DK_BTN1_MSK) && (button_state & DK_BTN1_MSK)) {
		exit_shutdown_mode();
	} else if ((has_changed & DK_BTN2_MSK) && (button_state & DK_BTN2_MSK)) {
		enter_shutdown_mode();
	}
}

static void buttons_init(void)
{
	int err;

	err = dk_buttons_init(button_handler_cb);
	if (err) {
		LOG_ERR("Buttons initialization failed.\n");
		return;
	}
}

#endif /* CONFIG_OPERATION_MODE_BUTTONS */

int shutdown_wifi(struct net_if *iface)
{
	int ret;

	if (!net_if_is_admin_up(iface)) {
		return 0;
	}

	ret = net_if_down(iface);
	if (ret) {
		LOG_ERR("Cannot bring down iface (%d)", ret);
		return ret;
	}

	LOG_INF("Interface down");

	return 0;
}

int startup_wifi(struct net_if *iface)
{
	int ret;

	if (!net_if_is_admin_up(iface)) {
		ret = net_if_up(iface);
		if (ret) {
			LOG_ERR("Cannot bring up iface (%d)", ret);
			return ret;
		}

		LOG_INF("Interface up");
	}

	wifi_scan();

	return 0;
}

void enter_shutdown_mode(void)
{
	struct net_if *iface = net_if_get_default();

	shutdown_wifi(iface);
}

void exit_shutdown_mode(void)
{
	struct net_if *iface = net_if_get_default();

	startup_wifi(iface);
}

int main(void)
{
	scan_result = 0U;

	net_mgmt_init_event_callback(&wifi_shell_mgmt_cb,
				     wifi_mgmt_event_handler,
				     WIFI_SHELL_MGMT_EVENTS);

	net_mgmt_add_event_callback(&wifi_shell_mgmt_cb);

	LOG_INF("Starting %s with CPU frequency: %d MHz\n", CONFIG_BOARD, SystemCoreClock / MHZ(1));

	/* Set MAC from DTS if interface has no valid MAC and DTS provides one */
	if (!is_mac_addr_set(net_if_get_default())) {
		if (!net_eth_is_addr_valid((struct net_eth_addr *)wifi_mac_addr)) {
			LOG_ERR("No valid MAC address: OTP not programmed and no valid "
				"local-mac-address in DTS");
			return -EINVAL;
		}

		struct net_if *iface = net_if_get_default();
		int ret;
		struct ethernet_req_params params;

		if (net_if_is_up(iface)) {
			/* Set a local MAC address from DTS overlay */
			ret = net_if_down(iface);
			if (ret) {
				LOG_ERR("Cannot bring down iface (%d)", ret);
				return ret;
			}
		}

		memcpy(params.mac_address.addr, wifi_mac_addr, sizeof(wifi_mac_addr));

		net_mgmt(NET_REQUEST_ETHERNET_SET_MAC_ADDRESS, iface, &params, sizeof(params));

		ret = net_if_up(iface);
		if (ret) {
			LOG_ERR("Cannot bring up iface (%d)", ret);
			return ret;
		}

		LOG_INF("OTP not programmed, using MAC from DTS: %s", net_sprint_ll_addr(
							net_if_get_link_addr(iface)->addr,
							net_if_get_link_addr(iface)->len));
	}

#ifdef CONFIG_OPERATION_MODE_BUTTONS
	buttons_init();
#endif /* CONFIG_OPERATION_MODE_BUTTONS */

#if defined(CONFIG_NRF_WIFI_IF_AUTO_START) || defined(CONFIG_NRF71_WIFI_IF_AUTO_START_SUPPORT)
	exit_shutdown_mode();
	enter_shutdown_mode();
#endif

#if defined(CONFIG_OPERATION_MODE_ONE_SHOT)
	exit_shutdown_mode();
#if !defined(CONFIG_SHUTDOWN_STAY_UP)
	enter_shutdown_mode();
#endif /* !CONFIG_SHUTDOWN_STAY_UP */
#if defined(CONFIG_NRF71_IDLE_POWER)
	nrf71_idle_power_print_snapshot("host-idle");
	/* Nothing else runs from here on, so the console never needs to
	 * resume.
	 */
	nrf71_idle_power_suspend_console();
#endif /* CONFIG_NRF71_IDLE_POWER */
	k_sleep(K_FOREVER);
#elif defined(CONFIG_OPERATION_MODE_BUTTONS)
	/* Button presses print asynchronously from buttons_init()'s IRQ work,
	 * so the console must stay resumed while this mode is active.
	 */
	exit_shutdown_mode();
#if !defined(CONFIG_SHUTDOWN_STAY_UP)
	enter_shutdown_mode();
#endif /* !CONFIG_SHUTDOWN_STAY_UP */
#if defined(CONFIG_NRF71_IDLE_POWER)
	nrf71_idle_power_print_snapshot("host-idle");
#endif /* CONFIG_NRF71_IDLE_POWER */
	k_sleep(K_FOREVER);
#else
	/* Will continuously alternate between shutdown and startup modes
	 * with a defined timeout after shutdown.
	 */
	while (1) {
		exit_shutdown_mode();
		enter_shutdown_mode();
#if defined(CONFIG_NRF71_IDLE_POWER)
		nrf71_idle_power_print_snapshot("host-idle");
		nrf71_idle_power_suspend_console();
#endif /* CONFIG_NRF71_IDLE_POWER */
		k_sleep(K_SECONDS(CONFIG_SHUTDOWN_TIMEOUT_S));
#if defined(CONFIG_NRF71_IDLE_POWER)
		nrf71_idle_power_resume_console();
#endif /* CONFIG_NRF71_IDLE_POWER */
	}
#endif /* CONFIG_OPERATION_MODE_ONE_SHOT */
	return 0;
}
```
