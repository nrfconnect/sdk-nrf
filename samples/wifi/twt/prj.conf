## CMakeLists.txt
```
#
# Copyright (c) 2023 Nordic Semiconductor ASA
#
# SPDX-License-Identifier: LicenseRef-Nordic-5-Clause
#

cmake_minimum_required(VERSION 3.20.0)

find_package(Zephyr REQUIRED HINTS $ENV{ZEPHYR_BASE})
project(nrf_wifi_twt)

target_include_directories(app PUBLIC ${ZEPHYR_BASE}/subsys/net/ip)
target_include_directories(app PRIVATE modules/traffic_gen/inc)

add_subdirectory(modules/traffic_gen)

target_sources(app PRIVATE src/main.c)
```

## Kconfig
```
#
# Copyright (c) 2023 Nordic Semiconductor
#
# SPDX-License-Identifier: LicenseRef-Nordic-5-Clause
#

source "Kconfig.zephyr"

menu "Nordic TWT sample"

# Traffic gen
rsource "modules/traffic_gen/Kconfig"

config CONNECTION_IDLE_TIMEOUT
	int "Time to be waited for a station to connect"
	default 30

config STA_CONN_TIMEOUT_SEC
	int "Overall Connection timeout (time to be waited for a station to connect and get an IP address)"
	# Zephyr DHCP retry is 1 minute, so set the default to 70 seconds
	default 70
	# 512 has no special meaning, just a reasonable upper limit
	range 0 512
	help
	  Specify the connection timeout, in seconds. This is the overall timeout (time to be waited for
	  a station to connect and get an IP address). DHCP retries should be taken into account when setting
	  this value. If the timeout is set to 0, the connection will not timeout.

config TWT_TRIGGER_ENABLE
	bool "Enable trigger mode"
	help
	  STA expects AP to send triggers for start of every service period.

config TWT_ANNOUNCED_MODE
	bool "Enable announced mode"
	help
	  STA announces its wakeup to AP for every service period start.

config TWT_WAKE_INTERVAL
	int "TWT awake interval"
	help
	  The period where STA is awake and does data transfer, interval should be in us.
	default 65000

config TWT_INTERVAL
	int "TWT service interval"
	help
	  The period for TWT that includes both wake and sleep durations, interval should be in us.
	  Please note higher intervals can be rejected by AP or cause interoperability issues.
	default 524000

choice TWT_TRAFFIC_PATTERN
	prompt "Specifies the TWT traffic pattern either continuous tx or scheduled tx"
	default CONTINUOUS_TX

config CONTINUOUS_TX
	bool "Send traffic continuously"
	help
	  Send traffic continuously without any restrictions, irrespective of sleep and awake periods.

config SCHEDULED_TX
	bool "Send traffic based on TWT schedule"
	help
	  Send traffic based on the TWT schedule and only transmits during the awake periods.

endchoice

endmenu
```

## sample.yaml
```
sample:
  description: Wi-Fi TWT sample application
  name: Wi-Fi TWT sample
tests:
  sample.wifi.twt:
    sysbuild: true
    build_only: true
    integration_platforms:
      - nrf7002dk/nrf5340/cpuapp
    platform_allow: nrf7002dk/nrf5340/cpuapp
    # Dummy IP address for building the sample
    extra_args: CONFIG_TRAFFIC_GEN_REMOTE_IPV4_ADDR="1.2.3.4"
    tags:
      - ci_build
      - sysbuild
      - ci_samples_wifi
  sample.nrf7002eb_interposer_p1.nrf7002eb.twt:
    sysbuild: true
    build_only: true
    extra_args:
      - twt_SHIELD="nrf7002eb_interposer_p1;nrf7002eb"
      - twt_SNIPPET=nrf70-wifi
      # Dummy IP address for building the sample
      - CONFIG_TRAFFIC_GEN_REMOTE_IPV4_ADDR="1.2.3.4"
    integration_platforms:
      - nrf54h20dk/nrf54h20/cpuapp
      - nrf54l15dk/nrf54l15/cpuapp
    platform_allow:
      - nrf54h20dk/nrf54h20/cpuapp
      - nrf54l15dk/nrf54l15/cpuapp
    tags:
      - ci_build
      - sysbuild
      - ci_samples_wifi
  sample.nrf7002eb2.twt:
    sysbuild: true
    build_only: true
    extra_args:
      - twt_SHIELD="nrf7002eb2"
      - twt_SNIPPET=nrf70-wifi
      # Dummy IP address for building the sample
      - CONFIG_TRAFFIC_GEN_REMOTE_IPV4_ADDR="1.2.3.4"
    integration_platforms:
      - nrf54l15dk/nrf54l15/cpuapp
    platform_allow:
      - nrf54l15dk/nrf54l15/cpuapp
    tags:
      - ci_build
      - sysbuild
      - ci_samples_wifi
  sample.54lm20dk.nrf7002eb2.twt:
    sysbuild: true
    build_only: true
    extra_args:
      - twt_SHIELD="nrf7002eb2"
      # Dummy IP address for building the sample
      - CONFIG_TRAFFIC_GEN_REMOTE_IPV4_ADDR="1.2.3.4"
    integration_platforms:
      - nrf54lm20dk/nrf54lm20a/cpuapp
      - nrf54lm20dk/nrf54lm20b/cpuapp
    platform_allow:
      - nrf54lm20dk/nrf54lm20a/cpuapp
      - nrf54lm20dk/nrf54lm20b/cpuapp
    tags:
      - ci_build
      - sysbuild
      - ci_samples_wifi
  sample.7120dk.twt:
    sysbuild: true
    build_only: true
    extra_args:
      # Dummy IP address for building the sample
      - CONFIG_TRAFFIC_GEN_REMOTE_IPV4_ADDR="1.2.3.4"
    integration_platforms:
      - nrf7120dk/nrf7120/cpuapp
      - nrf7120dk/nrf7120/cpuapp/ns
    platform_allow:
      - nrf7120dk/nrf7120/cpuapp
      - nrf7120dk/nrf7120/cpuapp/ns
      - nrf7120dk/nrf7120e/cpuapp
      - nrf7120dk/nrf7120e/cpuapp/ns
    tags:
      - ci_build
      - sysbuild
      - ci_samples_nrf71_wifi
```

## prj.conf
```kconfig
#
# Copyright (c) 2023 Nordic Semiconductor ASA
#
# SPDX-License-Identifier: LicenseRef-Nordic-5-Clause
#
CONFIG_WIFI=y

# WPA supplicant
CONFIG_WIFI_NM_WPA_SUPPLICANT=y

CONFIG_WIFI_CREDENTIALS=y
CONFIG_WIFI_CREDENTIALS_STATIC=y
CONFIG_WIFI_CREDENTIALS_STATIC_SSID="Myssid_twt"
CONFIG_WIFI_CREDENTIALS_STATIC_PASSWORD="Mypassword"

# Networking
CONFIG_NETWORKING=y
CONFIG_NET_SOCKETS=y
CONFIG_NET_LOG=y
CONFIG_NET_IPV4=y
CONFIG_NET_UDP=y
CONFIG_NET_TCP=y
CONFIG_NET_DHCPV4=y

# Below section is the primary contributor to SRAM and is currently
# tuned for performance, but this will be revisited in the future.
CONFIG_NET_PKT_TX_COUNT=8
CONFIG_NET_PKT_RX_COUNT=16
CONFIG_NET_BUF_TX_COUNT=16
CONFIG_NET_BUF_RX_COUNT=16
#CONFIG_SPEED_OPTIMIZATIONS=y
#CONFIG_NRF70_MAX_TX_TOKENS=12
CONFIG_NET_TC_TX_COUNT=1

# Below configs will increase tcp connection timeout
CONFIG_NET_TCP_INIT_RETRANSMISSION_TIMEOUT=1000
CONFIG_NET_SOCKETS_CONNECT_TIMEOUT=10000
CONFIG_NET_TCP_RETRY_COUNT=10

CONFIG_NET_IF_UNICAST_IPV4_ADDR_COUNT=1
CONFIG_NET_MAX_CONTEXTS=5
CONFIG_NET_CONTEXT_SYNC_RECV=y

CONFIG_INIT_STACKS=y

CONFIG_NET_L2_ETHERNET=y

CONFIG_NET_CONFIG_SETTINGS=y
CONFIG_NET_CONFIG_INIT_TIMEOUT=0

CONFIG_ZVFS_POLL_MAX=10

# Memories
CONFIG_MAIN_STACK_SIZE=5200
CONFIG_NET_TX_STACK_SIZE=4096
CONFIG_NET_RX_STACK_SIZE=4096

# Debugging
CONFIG_STACK_SENTINEL=y
CONFIG_DEBUG_COREDUMP=y
CONFIG_DEBUG_COREDUMP_BACKEND_LOGGING=y
CONFIG_DEBUG_COREDUMP_MEMORY_DUMP_MIN=y
CONFIG_SHELL_CMDS_RESIZE=n


# Kernel options
CONFIG_ENTROPY_GENERATOR=y

# Logging
CONFIG_LOG=y
CONFIG_LOG_BUFFER_SIZE=2048
CONFIG_POSIX_TIMERS=y
CONFIG_POSIX_API=y

CONFIG_PM=y

CONFIG_NET_CONFIG_MY_IPV4_ADDR="192.168.1.99"
CONFIG_NET_CONFIG_MY_IPV4_NETMASK="255.255.255.0"
CONFIG_NET_CONFIG_MY_IPV4_GW="192.168.1.1"

# printing of scan results puts pressure on queues in new locking
# design in net_mgmt. So, use a higher timeout for a crowded
# environment.
CONFIG_NET_MGMT_EVENT_QUEUE_TIMEOUT=5000

CONFIG_TRAFFIC_GEN=y
# IPv4 address of the host running the traffic generator server
CONFIG_TRAFFIC_GEN_REMOTE_IPV4_ADDR="192.168.0.1"
```

## boards/nrf7002dk_nrf5340_cpuapp.conf
```kconfig
#
# Copyright (c) 2026 Nordic Semiconductor
#
# SPDX-License-Identifier: LicenseRef-Nordic-5-Clause
#

#NRF70 specific configuration
CONFIG_WIFI_NRF70=y
```

## boards/nrf7120dk_nrf7120_cpuapp.conf
```kconfig
#
# Copyright (c) 2026 Nordic Semiconductor
#
# SPDX-License-Identifier: LicenseRef-Nordic-5-Clause
#

CONFIG_NRF71_WIFI=y
CONFIG_NRF71_WIFI_RX_NUM_BUFS=16
CONFIG_NRF71_WIFI_DATA_HEAP_SIZE=90000
```

## src/main.c
```c
/*
 * Copyright (c) 2023 Nordic Semiconductor ASA
 *
 * SPDX-License-Identifier: LicenseRef-Nordic-5-Clause
 */

/** @file
 * @brief WiFi TWT sample
 */

#include <zephyr/logging/log.h>
LOG_MODULE_REGISTER(twt, CONFIG_LOG_DEFAULT_LEVEL);

#if defined(CONFIG_POSIX_API)
#include <zephyr/posix/arpa/inet.h>
#include <zephyr/posix/netdb.h>
#include <zephyr/posix/unistd.h>
#include <zephyr/posix/sys/socket.h>
#endif

#include <zephyr/kernel.h>
#include <stdio.h>
#include <stdlib.h>
#include <zephyr/shell/shell.h>
#include <zephyr/sys/printk.h>
#include <zephyr/init.h>

#include <zephyr/net/net_if.h>
#include <zephyr/net/wifi_mgmt.h>
#include <zephyr/net/net_event.h>
#include <zephyr/drivers/gpio.h>


#include "net_private.h"
#include "traffic_gen.h"

#define WIFI_SHELL_MODULE "wifi"

#define WIFI_SHELL_MGMT_EVENTS (NET_EVENT_WIFI_CONNECT_RESULT |		\
				NET_EVENT_WIFI_DISCONNECT_RESULT|	\
				NET_EVENT_WIFI_TWT)

#define MAX_SSID_LEN        32
#define STATUS_POLLING_MS   300
#define TWT_RESP_TIMEOUT_S    20

K_SEM_DEFINE(wait_for_dhcp, 0, 1);
struct traffic_gen_config tg_config;

static struct net_mgmt_event_callback wifi_shell_mgmt_cb;
static struct net_mgmt_event_callback net_shell_mgmt_cb;

static struct {
	const struct shell *sh;
	union {
		struct {
			uint8_t connected	: 1;
			uint8_t connect_result	: 1;
			uint8_t disconnect_requested	: 1;
			uint8_t _unused		: 5;
		};
		uint8_t all;
	};
} context;

static bool twt_supported, twt_resp_received, twt_resp_accept;
static uint32_t twt_flow_id = 1;

static bool wait_for_twt_resp_received(void)
{
	int i, timeout_polls = (TWT_RESP_TIMEOUT_S * 1000) / STATUS_POLLING_MS;

	for (i = 0; i < timeout_polls; i++) {
		k_sleep(K_MSEC(STATUS_POLLING_MS));
		if (twt_resp_received) {
			return twt_resp_accept;
		}
	}

	return false;
}

static int setup_twt(void)
{
	struct net_if *iface = net_if_get_first_wifi();
	struct wifi_twt_params params = { 0 };
	int ret;

	twt_flow_id = 1;
	params.operation = WIFI_TWT_SETUP;
	params.negotiation_type = WIFI_TWT_INDIVIDUAL;
	params.setup_cmd = WIFI_TWT_SETUP_CMD_REQUEST;
	params.dialog_token = 1;
	params.flow_id = twt_flow_id;
	params.setup.responder = 0;
	params.setup.trigger = IS_ENABLED(CONFIG_TWT_TRIGGER_ENABLE);
	params.setup.implicit = 1;
	params.setup.announce = IS_ENABLED(CONFIG_TWT_ANNOUNCED_MODE);
	params.setup.twt_wake_interval = CONFIG_TWT_WAKE_INTERVAL;
	params.setup.twt_interval = CONFIG_TWT_INTERVAL;

	ret = net_mgmt(NET_REQUEST_WIFI_TWT, iface, &params, sizeof(params));
	if (ret) {
		LOG_INF("TWT setup failed: %d", ret);
		return ret;
	}

	LOG_INF("TWT setup requested");

	return 0;
}

static int teardown_twt(void)
{
	struct net_if *iface = net_if_get_first_wifi();
	struct wifi_twt_params params = { 0 };
	int ret;

	params.operation = WIFI_TWT_TEARDOWN;
	params.negotiation_type = WIFI_TWT_INDIVIDUAL;
	params.setup_cmd = WIFI_TWT_TEARDOWN;
	params.dialog_token = 1;
	params.flow_id = twt_flow_id;

	ret = net_mgmt(NET_REQUEST_WIFI_TWT, iface, &params, sizeof(params));
	if (ret) {
		LOG_ERR("%s with %s failed, reason : %s",
			wifi_twt_operation_txt(params.operation),
			wifi_twt_negotiation_type_txt(params.negotiation_type),
			wifi_twt_get_err_code_str(params.fail_reason));
		return ret;
	}

	LOG_INF("TWT teardown success");

	return 0;
}

static int cmd_wifi_status(void)
{
	struct net_if *iface = net_if_get_default();
	struct wifi_iface_status status = { 0 };
	int ret;

	ret = net_mgmt(NET_REQUEST_WIFI_IFACE_STATUS, iface, &status,
				sizeof(struct wifi_iface_status));
	if (ret) {
		LOG_INF("Status request failed: %d\n", ret);
		return ret;
	}

	LOG_INF("==================");
	LOG_INF("State: %s", wifi_state_txt(status.state));

	if (status.state >= WIFI_STATE_ASSOCIATED) {
		uint8_t mac_string_buf[sizeof("xx:xx:xx:xx:xx:xx")];

		LOG_INF("Interface Mode: %s",
		       wifi_mode_txt(status.iface_mode));
		LOG_INF("Link Mode: %s",
		       wifi_link_mode_txt(status.link_mode));
		LOG_INF("SSID: %.32s", status.ssid);
		LOG_INF("BSSID: %s",
		       net_sprint_ll_addr_buf(
				status.bssid, WIFI_MAC_ADDR_LEN,
				mac_string_buf, sizeof(mac_string_buf)));
		LOG_INF("Band: %s", wifi_band_txt(status.band));
		LOG_INF("Channel: %d", status.channel);
		LOG_INF("Security: %s", wifi_security_txt(status.security));
		LOG_INF("MFP: %s", wifi_mfp_txt(status.mfp));
		LOG_INF("RSSI: %d", status.rssi);
		LOG_INF("TWT: %s", status.twt_capable ? "Supported" : "Not supported");

		if (status.twt_capable) {
			twt_supported = 1;
		}
	}

	return 0;
}

static void handle_wifi_connect_result(struct net_mgmt_event_callback *cb)
{
	const struct wifi_status *status =
		(const struct wifi_status *) cb->info;

	if (context.connected) {
		return;
	}

	if (status->status) {
		LOG_ERR("Connection failed (%d)", status->status);
	} else {
		LOG_INF("Connected");
		context.connected = true;
	}

	context.connect_result = true;
}

static void handle_wifi_disconnect_result(struct net_mgmt_event_callback *cb)
{
	const struct wifi_status *status =
		(const struct wifi_status *) cb->info;

	if (!context.connected) {
		return;
	}

	if (context.disconnect_requested) {
		LOG_INF("Disconnection request %s (%d)",
			 status->status ? "failed" : "done",
					status->status);
		context.disconnect_requested = false;
	} else {
		LOG_INF("Received Disconnected");
		context.connected = false;
	}

	cmd_wifi_status();
}

static void print_twt_params(uint8_t dialog_token, uint8_t flow_id,
			     enum wifi_twt_negotiation_type negotiation_type,
			     bool responder, bool implicit, bool announce,
			     bool trigger, uint32_t twt_wake_interval,
			     uint64_t twt_interval)
{
	LOG_INF("TWT Dialog token: %d",
	      dialog_token);
	LOG_INF("TWT flow ID: %d",
	      flow_id);
	LOG_INF("TWT negotiation type: %s",
	      wifi_twt_negotiation_type_txt(negotiation_type));
	LOG_INF("TWT responder: %s",
	       responder ? "true" : "false");
	LOG_INF("TWT implicit: %s",
	      implicit ? "true" : "false");
	LOG_INF("TWT announce: %s",
	      announce ? "true" : "false");
	LOG_INF("TWT trigger: %s",
	      trigger ? "true" : "false");
	LOG_INF("TWT wake interval: %d us",
	      twt_wake_interval);
	LOG_INF("TWT interval: %lld us",
	      twt_interval);
	LOG_INF("========================");
}

static void handle_wifi_twt_event(struct net_mgmt_event_callback *cb)
{
	const struct wifi_twt_params *resp =
		(const struct wifi_twt_params *)cb->info;

	if (resp->operation == WIFI_TWT_TEARDOWN) {
		if (resp->teardown_status == WIFI_TWT_TEARDOWN_SUCCESS) {
			LOG_INF("TWT teardown success received for flow ID %d\n",
				resp->flow_id);
		} else {
			LOG_INF("TWT teardown failed for flow ID %d\n",
				resp->flow_id);
		}
		return;
	}

	if (resp->resp_status == WIFI_TWT_RESP_RECEIVED) {
		LOG_INF("TWT response: %s",
		      wifi_twt_setup_cmd_txt(resp->setup_cmd));

		if (resp->setup_cmd == WIFI_TWT_SETUP_CMD_ACCEPT) {
			twt_resp_accept = true;
		}

		twt_resp_received = true;
		twt_flow_id = resp->flow_id;

		LOG_INF("== TWT negotiated parameters ==");
		print_twt_params(resp->dialog_token,
				 resp->flow_id,
				 resp->negotiation_type,
				 resp->setup.responder,
				 resp->setup.implicit,
				 resp->setup.announce,
				 resp->setup.trigger,
				 resp->setup.twt_wake_interval,
				 resp->setup.twt_interval);
	} else {
		LOG_INF("TWT response timed out\n");
	}
}

static void wifi_mgmt_event_handler(struct net_mgmt_event_callback *cb,
				     uint64_t mgmt_event, struct net_if *iface)
{
	switch (mgmt_event) {
	case NET_EVENT_WIFI_CONNECT_RESULT:
		handle_wifi_connect_result(cb);
		break;
	case NET_EVENT_WIFI_DISCONNECT_RESULT:
		handle_wifi_disconnect_result(cb);
		break;
	case NET_EVENT_WIFI_TWT:
		handle_wifi_twt_event(cb);
		break;
#ifdef CONFIG_SCHEDULED_TX
	case NET_EVENT_WIFI_TWT_SLEEP_STATE: {
		int *twt_state;

		twt_state = (int *)(cb->info);
		if (*twt_state == WIFI_TWT_STATE_SLEEP) {
			traffic_gen_pause(&tg_config);
		} else if (*twt_state == WIFI_TWT_STATE_AWAKE)  {
			traffic_gen_resume(&tg_config);
		} else {
			LOG_INF("UNKNOWN TWT STATE %d", *twt_state);
		}
	}
		break;
#endif
	default:
		break;
	}
}

static void print_dhcp_ip(struct net_mgmt_event_callback *cb)
{
	/* Get DHCP info from struct net_if_dhcpv4 and print */
	const struct net_if_dhcpv4 *dhcpv4 = cb->info;
	const struct in_addr *addr = &dhcpv4->requested_ip;
	char dhcp_info[128];

	net_addr_ntop(AF_INET, addr, dhcp_info, sizeof(dhcp_info));

	LOG_INF("DHCP IP address: %s", dhcp_info);
	k_sem_give(&wait_for_dhcp);
}

static void net_mgmt_event_handler(struct net_mgmt_event_callback *cb,
				    uint64_t mgmt_event, struct net_if *iface)
{
	switch (mgmt_event) {
	case NET_EVENT_IPV4_DHCP_BOUND:
		print_dhcp_ip(cb);
		break;
	default:
		break;
	}
}

static int wifi_connect(void)
{
	struct net_if *iface = net_if_get_first_wifi();

	context.connected = false;
	context.connect_result = false;

	if (net_mgmt(NET_REQUEST_WIFI_CONNECT_STORED, iface, NULL, 0)) {
		LOG_ERR("Connection request failed");

		return -ENOEXEC;
	}

	LOG_INF("Connection requested");

	return 0;
}

int main(void)
{
	memset(&context, 0, sizeof(context));

	net_mgmt_init_event_callback(&wifi_shell_mgmt_cb,
			wifi_mgmt_event_handler,
			WIFI_SHELL_MGMT_EVENTS);

	net_mgmt_add_event_callback(&wifi_shell_mgmt_cb);

	net_mgmt_init_event_callback(&net_shell_mgmt_cb,
			net_mgmt_event_handler,
			NET_EVENT_IPV4_DHCP_BOUND);

	net_mgmt_add_event_callback(&net_shell_mgmt_cb);

	LOG_INF("Starting %s with CPU frequency: %d MHz", CONFIG_BOARD, SystemCoreClock/MHZ(1));
	k_sleep(K_SECONDS(1));

	LOG_INF("Static IP address (overridable): %s/%s -> %s",
			CONFIG_NET_CONFIG_MY_IPV4_ADDR,
			CONFIG_NET_CONFIG_MY_IPV4_NETMASK,
			CONFIG_NET_CONFIG_MY_IPV4_GW);

	while (1) {
		wifi_connect();

		while (!context.connect_result) {
			cmd_wifi_status();
			k_sleep(K_MSEC(STATUS_POLLING_MS));
		}

		cmd_wifi_status();

		if (context.connected) {
			int ret;

			ret = k_sem_take(&wait_for_dhcp, K_SECONDS(CONFIG_STA_CONN_TIMEOUT_SEC));
			if (ret) {
				LOG_ERR("DHCP address not obtained in %d seconds\n",
					CONFIG_STA_CONN_TIMEOUT_SEC);
				return -1;
			}

			if (!twt_supported) {
				LOG_INF("AP is not TWT capable, exiting the sample\n");
				return -1;
			}

			LOG_INF("AP is TWT capable, establishing TWT");

			ret = setup_twt();
			if (ret) {
				LOG_ERR("Failed to establish TWT flow: %d\n", ret);
				return -1;
			}

			if (wait_for_twt_resp_received()) {
				LOG_INF("TWT Setup success");
			} else {
				LOG_INF("TWT Setup timed out\n");
				return -1;
			}

#ifdef CONFIG_TRAFFIC_GEN
			traffic_gen_init(&tg_config);

			ret = traffic_gen_start(&tg_config);
			if (ret < 0) {
				LOG_ERR("Failed to start traffic role ");
				goto teardown;
			}

			ret = traffic_gen_wait_for_report(&tg_config);
			if (ret < 0) {
				LOG_ERR("Failed to get traffic report ");
				goto teardown;
			}
			traffic_gen_get_report(&tg_config);
#endif /* CONFIG_TRAFFIC_GEN */

			/* Wait for few service periods before tearing down */
			k_sleep(K_USEC(5 * CONFIG_TWT_INTERVAL));

teardown:
			ret = teardown_twt();
			if (ret) {
				LOG_ERR("Failed to teardown TWT flow: %d\n", ret);
				return -1;
			}

			k_sleep(K_FOREVER);
		}
	}

	return 0;
}
```
