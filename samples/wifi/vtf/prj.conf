## CMakeLists.txt
```
#
# Copyright (c) 2026 Nordic Semiconductor ASA
#
# SPDX-License-Identifier: LicenseRef-Nordic-5-Clause
#

cmake_minimum_required(VERSION 3.20.0)

find_package(Zephyr REQUIRED HINTS $ENV{ZEPHYR_BASE})
project(vtf_monitoring_sample)

target_sources(app PRIVATE src/main.c)
target_sources_ifdef(CONFIG_VTF_BATTERY_VOLTAGE_MONITOR app PRIVATE src/mock_battery_provider.c)
```

## sample.yaml
```
sample:
  description: VTF provider framework sample
  name: VTF providers
tests:
  sample.wifi.vtf.nrf7120dk:
    sysbuild: true
    build_only: true
    integration_platforms:
      - nrf7120dk/nrf7120/cpuapp
    platform_allow:
      - nrf7120dk/nrf7120/cpuapp
    tags:
      - ci_build
      - sysbuild
      - ci_samples_wifi
```

## prj.conf
```kconfig
#
# Copyright (c) 2026 Nordic Semiconductor ASA
#
# SPDX-License-Identifier: LicenseRef-Nordic-5-Clause
#

# Tier 1: built-in, devicetree-selected sensor provider.
CONFIG_VTF_MONITORING=y
CONFIG_VTF_DIE_TEMP_MONITOR=y

# Tier 2: custom registered provider (mock battery, see
# src/mock_battery_provider.c). VTF_BATTERY_VOLTAGE_MONITOR itself
# carries no code in the driver; it gates this sample's own provider.
CONFIG_VTF_BATTERY_VOLTAGE_MONITOR=y

# Keep the die-temp sensor's own refresh rate in step with the
# snapshot interval below, otherwise the logged die-temp value only
# changes once every few log lines while battery voltage changes every
# line.
CONFIG_VTF_DIE_TEMP_MONITOR_INTERVAL_MS=2000
CONFIG_VTF_SNAPSHOT_INTERVAL_MS=2000

CONFIG_LOG=y
CONFIG_PRINTK=y
```

## chosen_override.overlay
```dts
/*
 * Copyright (c) 2026 Nordic Semiconductor ASA
 *
 * SPDX-License-Identifier: LicenseRef-Nordic-5-Clause
 */

/*
 * Demonstrates the tier-1 devicetree override for the die-temperature
 * provider. This DK has no second temperature sensor, so this points
 * back at the SoC's own `temp` node just to prove the override is
 * picked up; on a custom board, point `nordic,vtf-die-temp-sensor` at
 * your own sensor node instead.
 *
 * Pass with: -DEXTRA_DTC_OVERLAY_FILE=chosen_override.overlay
 */

/ {
	chosen {
		nordic,vtf-die-temp-sensor = &temp;
	};
};
```

## src/main.c
```c
/*
 * Copyright (c) 2026 Nordic Semiconductor ASA
 *
 * SPDX-License-Identifier: LicenseRef-Nordic-5-Clause
 */

/** @file
 * @brief VTF provider framework sample
 */

#include <stdlib.h>

#include <zephyr/kernel.h>
#include <zephyr/logging/log.h>

#include <drivers/vtf_monitoring/vtf_monitoring.h>

LOG_MODULE_REGISTER(vtf_sample, CONFIG_LOG_DEFAULT_LEVEL);

int main(void)
{
	while (1) {
		union vtf_sample_value die_temp;
		union vtf_sample_value battery_voltage;

		vtf_monitoring_sample_get(VTF_CH_DIE_TEMP, &die_temp);
		vtf_monitoring_sample_get(VTF_CH_BATTERY_VOLTAGE, &battery_voltage);

		LOG_INF("die temp: %d.%02d C (tier 1, built-in sensor provider) | "
			"battery: %d mV (tier 2, custom mock provider)",
			die_temp.i32 / 100, abs(die_temp.i32 % 100), battery_voltage.i32);

		k_sleep(K_MSEC(CONFIG_VTF_SNAPSHOT_INTERVAL_MS));
	}
	return 0;
}
```

## src/mock_battery_provider.c
```c
/*
 * Copyright (c) 2026 Nordic Semiconductor ASA
 *
 * SPDX-License-Identifier: LicenseRef-Nordic-5-Clause
 */

/**
 * Tier-2 provider example: no sensor API, no devicetree binding, just
 * a plain init()/sample() pair registered with VTF_CHANNEL_DEFINE().
 * Stands in for whatever a customer's own fuel-gauge library or raw
 * register read would do; simulates a battery discharging from 4200
 * to 3300 mV and back, to make the changing value visible in the log.
 */

#include <zephyr/kernel.h>

#include <drivers/vtf_monitoring/vtf_monitoring.h>

#define MOCK_BATTERY_MAX_MV 4200
#define MOCK_BATTERY_MIN_MV 3300
#define MOCK_BATTERY_STEP_MV 20

static int32_t mock_battery_mv = MOCK_BATTERY_MAX_MV;
static int32_t mock_battery_step_mv = -MOCK_BATTERY_STEP_MV;

static int mock_battery_init(void)
{
	return 0;
}

static int mock_battery_sample(struct vtf_sample *out)
{
	mock_battery_mv += mock_battery_step_mv;
	if (mock_battery_mv <= MOCK_BATTERY_MIN_MV || mock_battery_mv >= MOCK_BATTERY_MAX_MV) {
		mock_battery_step_mv = -mock_battery_step_mv;
	}

	out->type = VTF_SAMPLE_TYPE_INT;
	out->value.i32 = mock_battery_mv;
	out->timestamp_ms = k_uptime_get();
	out->status = VTF_STATUS_OK;
	return 0;
}

VTF_CHANNEL_DEFINE(vtf_channel_mock_battery, VTF_CH_BATTERY_VOLTAGE, mock_battery_sample,
		   mock_battery_init, VTF_SAMPLE_TYPE_INT, i32, MOCK_BATTERY_MAX_MV);
```
