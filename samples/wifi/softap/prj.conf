## CMakeLists.txt
```
#
# Copyright (c) 2024 Nordic Semiconductor ASA
#
# SPDX-License-Identifier: LicenseRef-Nordic-5-Clause
#

cmake_minimum_required(VERSION 3.20.0)

find_package(Zephyr REQUIRED HINTS $ENV{ZEPHYR_BASE})
project(nrf_wifi_softap)

# Needed for net_private.h
target_include_directories(app PUBLIC ${ZEPHYR_BASE}/subsys/net/ip)

target_sources(app PRIVATE src/main.c)
```

## Kconfig
```
source "Kconfig.zephyr"

menu "Nordic SoftAP sample"

config SOFTAP_SAMPLE_DHCPV4_SERVER
	bool "DHCPv4 server"
	select NET_DHCPV4_SERVER
	default y
	help
	  Enable this to configure DHCPV4 server settings.

config SOFTAP_SAMPLE_DHCPV4_POOL_START
	string "Start address of DHCPv4 pool"
	default "192.168.1.2"
	help
	  Set the start IP address of DHCPv4 pool.

config SOFTAP_SAMPLE_REG_DOMAIN
	string "The ISO/IEC alpha2 country code"
	default "00"
	help
	  Set the ISO/IEC alpha2 country code for the country in
	  which the device is currently operating.
	  For world regulatory, use "00".

choice SOFTAP_SAMPLE_FREQUENCY_BAND
	prompt "Wi-Fi frequency band for SoftAp"
	default SOFTAP_SAMPLE_2_4GHz

config SOFTAP_SAMPLE_2_4GHz
	bool "2.4 GHz band"
	help
	  Enable this option if the SoftAP should operate in the 2.4 GHz band.

config SOFTAP_SAMPLE_5GHz
	bool "5 GHz band"
	help
	  Enable this option if the SoftAP should operate in the 5 GHz band.
	  Ensure that you have the appropriate regulatory settings configured.
endchoice

config SOFTAP_SAMPLE_CHANNEL
	int "SoftAP channel"
	range 1 255
	default 1 if SOFTAP_SAMPLE_2_4GHz
	default 36 if SOFTAP_SAMPLE_5GHz
	help
	  Set the Wi-Fi channel on which the SoftAP will operate.

config SOFTAP_SAMPLE_SSID
	string "SoftAP SSID"
	default "Myssid"
	help
	  Set the SSID (Service Set Identifier) for the SoftAP.
	  This is the name that will be broadcasted for client(s) to connect.

choice  SOFTAP_SAMPLE_KEY_MGMT_SELECT
	prompt "Security option for SoftAP"
	default SOFTAP_SAMPLE_KEY_MGMT_WPA2

config SOFTAP_SAMPLE_KEY_MGMT_NONE
	bool "Open security"
	help
	  Enable for open security

config SOFTAP_SAMPLE_KEY_MGMT_WPA2
	bool "WPA2 security"
	help
	  Enable for WPA2 security

config SOFTAP_SAMPLE_KEY_MGMT_WPA2_256
	bool "WPA2 SHA 256 security"
	help
	  Enable for WPA2-PSK-256 security.

config SOFTAP_SAMPLE_KEY_MGMT_WPA3
	bool "WPA3 security"
	help
	  Enable for WPA3 security.
endchoice

config SOFTAP_SAMPLE_PASSWORD
	string "Passphrase (WPA2) or password (WPA3)"
	default "Mypassword"
	help
	  Set the password for SoftAP.

config SOFTAP_SAMPLE_MAX_STATIONS
	int "Maximum number of stations"
	# Experimental support for one, but in future support for up to 8 (nRF70 limitation)
	range 1 1
	default 1
	help
	  Set the maximum number of stations allowed to connect to the SoftAP.

config SOFTAP_SAMPLE_START_WIFI_THREAD_STACK_SIZE
	int "Stack size for Wi-Fi start thread"
	default 4096
	help
	  Set the stack size for the Wi-Fi start thread.
endmenu
```

## sample.yaml
```
sample:
  description: Wi-Fi SoftAP sample application
  name: Wi-Fi SoftAP
tests:
  sample.nrf7002.softap:
    sysbuild: true
    build_only: true
    integration_platforms:
      - nrf7002dk/nrf5340/cpuapp
    platform_allow: nrf7002dk/nrf5340/cpuapp
    tags:
      - ci_build
      - sysbuild
      - ci_samples_wifi
  sample.nrf7002_eks.softap:
    sysbuild: true
    build_only: true
    extra_args: SHIELD=nrf7002ek
    integration_platforms:
      - nrf5340dk/nrf5340/cpuapp
    platform_allow: nrf5340dk/nrf5340/cpuapp
    tags:
      - ci_build
      - sysbuild
      - ci_samples_wifi
  sample.nrf7001.softap:
    sysbuild: true
    build_only: true
    integration_platforms:
      - nrf7002dk/nrf5340/cpuapp/nrf7001
    platform_allow: nrf7002dk/nrf5340/cpuapp/nrf7001
    tags:
      - ci_build
      - sysbuild
      - ci_samples_wifi
  sample.nrf7001_eks.softap:
    sysbuild: true
    build_only: true
    extra_args: SHIELD=nrf7002ek_nrf7001
    integration_platforms:
      - nrf5340dk/nrf5340/cpuapp
    platform_allow: nrf5340dk/nrf5340/cpuapp
    tags:
      - ci_build
      - sysbuild
      - ci_samples_wifi
  sample.nrf54h20.softap:
    sysbuild: true
    build_only: true
    extra_args:
      - softap_SHIELD="nrf7002eb_interposer_p1;nrf7002eb"
      - softap_SNIPPET=nrf70-wifi
    integration_platforms:
      - nrf54h20dk/nrf54h20/cpuapp
    platform_allow:
      - nrf54h20dk/nrf54h20/cpuapp
    tags:
      - ci_build
      - sysbuild
      - ci_samples_wifi
  sample.nrf54l15.softap:
    sysbuild: true
    build_only: true
    extra_args:
      - softap_SHIELD="nrf7002eb_interposer_p1;nrf7002eb"
      - softap_SNIPPET=nrf70-wifi
      - CONFIG_HEAP_MEM_POOL_IGNORE_MIN=n
    integration_platforms:
      - nrf54l15dk/nrf54l15/cpuapp
    platform_allow:
      - nrf54l15dk/nrf54l15/cpuapp
    tags:
      - ci_build
      - sysbuild
      - ci_samples_wifi
  sample.nrf7002eb2.softap:
    sysbuild: true
    build_only: true
    extra_args:
      - softap_SHIELD="nrf7002eb2"
      - softap_SNIPPET=nrf70-wifi
    integration_platforms:
      - nrf54l15dk/nrf54l15/cpuapp
    platform_allow:
      - nrf54l15dk/nrf54l15/cpuapp
    tags:
      - ci_build
      - sysbuild
      - ci_samples_wifi
  sample.54lm20dk.nrf7002eb2.softap:
    sysbuild: true
    build_only: true
    extra_args:
      - softap_SHIELD="nrf7002eb2"
    integration_platforms:
      - nrf54lm20dk/nrf54lm20a/cpuapp
      - nrf54lm20dk/nrf54lm20b/cpuapp
    platform_allow:
      - nrf54lm20dk/nrf54lm20a/cpuapp
      - nrf54lm20dk/nrf54lm20b/cpuapp
    tags:
      - ci_build
      - sysbuild
      - ci_samples_wifi
  sample.7120dk.softap:
    sysbuild: true
    build_only: true
    extra_args:
      - SB_CONFIG_WIFI_NRF70=n
      - EXTRA_DTC_OVERLAY_FILE=${ZEPHYR_NRFXLIB_MODULE_DIR}/nrf71_wifi/bins/0.1.0/nrf7120_wifi_patch.dtsi
      - CONFIG_WIFI_NRF71_PATCH=y
    integration_platforms:
      - nrf7120dk/nrf7120/cpuapp
      - nrf7120dk/nrf7120/cpuapp/ns
    platform_allow:
      - nrf7120dk/nrf7120/cpuapp
      - nrf7120dk/nrf7120/cpuapp/ns
    tags:
      - ci_build
      - sysbuild
      - ci_samples_nrf71_wifi
```

## prj.conf
```kconfig
#
# Copyright (c) 2022 Nordic Semiconductor ASA
#
# SPDX-License-Identifier: LicenseRef-Nordic-5-Clause
#
CONFIG_WIFI=y

# WPA supplicant
CONFIG_WIFI_NM_WPA_SUPPLICANT=y
CONFIG_WIFI_READY_LIB=y

# Soft AP
CONFIG_WIFI_NM_WPA_SUPPLICANT_AP=y

CONFIG_WIFI_NM_WPA_SUPPLICANT_LOG_LEVEL_INF=y

# Networking
CONFIG_NETWORKING=y
CONFIG_NET_SOCKETS=y
CONFIG_NET_LOG=y
CONFIG_NET_IPV4=y
CONFIG_NET_UDP=y
CONFIG_NET_TCP=y

CONFIG_NET_PKT_RX_COUNT=8
CONFIG_NET_PKT_TX_COUNT=8

# Below section is the primary contributor to SRAM and is currently
# tuned for performance, but this will be revisited in the future.
CONFIG_NET_BUF_RX_COUNT=8
CONFIG_NET_BUF_TX_COUNT=16
CONFIG_NET_TC_TX_COUNT=1

CONFIG_NET_IF_UNICAST_IPV4_ADDR_COUNT=1
CONFIG_NET_MAX_CONTEXTS=5
CONFIG_NET_CONTEXT_SYNC_RECV=y

CONFIG_INIT_STACKS=y

CONFIG_NET_L2_ETHERNET=y

CONFIG_NET_CONFIG_SETTINGS=y
CONFIG_NET_CONFIG_INIT_TIMEOUT=0

CONFIG_ZVFS_POLL_MAX=10

# Memories
CONFIG_MAIN_STACK_SIZE=5200
CONFIG_NET_TX_STACK_SIZE=4096
CONFIG_NET_RX_STACK_SIZE=4096
CONFIG_SOFTAP_SAMPLE_START_WIFI_THREAD_STACK_SIZE=5200
CONFIG_MBEDTLS_HEAP_SIZE=1024

# Debugging
CONFIG_STACK_SENTINEL=y
CONFIG_DEBUG_COREDUMP=y
CONFIG_DEBUG_COREDUMP_BACKEND_LOGGING=y
CONFIG_DEBUG_COREDUMP_MEMORY_DUMP_MIN=y
CONFIG_SHELL_CMDS_RESIZE=n


# Kernel options
CONFIG_ENTROPY_GENERATOR=y

# Logging
CONFIG_LOG=y
CONFIG_LOG_BUFFER_SIZE=2048
CONFIG_POSIX_TIMERS=y

CONFIG_NET_CONFIG_MY_IPV4_ADDR="192.168.1.1"
CONFIG_NET_CONFIG_MY_IPV4_NETMASK="255.255.255.0"
CONFIG_NET_CONFIG_MY_IPV4_GW="192.168.1.1"

# printing of scan results puts pressure on queues in new locking
# design in net_mgmt. So, use a higher timeout for a crowded
# environment.
CONFIG_NET_MGMT_EVENT_QUEUE_TIMEOUT=5000

# Temporarily enable FS support so that linking succeeds.
CONFIG_FILE_SYSTEM=y
```

## boards/nrf54h20dk_nrf54h20_cpuapp.conf
```kconfig
#
# Copyright (c) 2026 Nordic Semiconductor ASA
#
# SPDX-License-Identifier: LicenseRef-Nordic-5-Clause
#

#NRF70 specific configuration
CONFIG_WIFI_NRF70=y
CONFIG_NRF70_AP_MODE=y
```

## boards/nrf54l15dk_nrf54l15_cpuapp.conf
```kconfig
CONFIG_WIFI_CREDENTIALS=y
# Needed for Wi-Fi credentials
CONFIG_FLASH=y
CONFIG_FLASH_PAGE_LAYOUT=y
CONFIG_FLASH_MAP=y
CONFIG_ZMS=y
CONFIG_SETTINGS=y

#NRF70 specific configuration
CONFIG_WIFI_NRF70=y
CONFIG_NRF70_AP_MODE=y
```

## boards/nrf7002dk_nrf5340_cpuapp.conf
```kconfig
#
# Copyright (c) 2026 Nordic Semiconductor ASA
#
# SPDX-License-Identifier: LicenseRef-Nordic-5-Clause
#

#NRF70 specific configuration
CONFIG_WIFI_NRF70=y
CONFIG_NRF70_AP_MODE=y
CONFIG_NRF_WIFI_CTRL_HEAP_SIZE=20000
```

## boards/nrf7120dk_nrf7120_cpuapp.conf
```kconfig
#
# Copyright (c) 2026 Nordic Semiconductor
#
# SPDX-License-Identifier: LicenseRef-Nordic-5-Clause
#

CONFIG_NRF71_WIFI=y
CONFIG_NRF71_WIFI_AP_SUPPORT=y
CONFIG_NRF71_WIFI_RX_NUM_BUFS=16
CONFIG_NRF71_WIFI_CTRL_HEAP_SIZE=20000
CONFIG_NRF71_WIFI_DATA_HEAP_SIZE=90000
```

## src/main.c
```c
/*
 * Copyright (c) 2024 Nordic Semiconductor ASA
 *
 * SPDX-License-Identifier: LicenseRef-Nordic-5-Clause
 */

/** @file
 * @brief Wi-Fi Softap sample
 */

#include <zephyr/logging/log.h>
LOG_MODULE_REGISTER(softap, CONFIG_LOG_DEFAULT_LEVEL);

#include <zephyr/net/wifi_mgmt.h>
#include <zephyr/net/wifi_utils.h>
#include "net_private.h"
#include <zephyr/net/dhcpv4_server.h>

#include <net/wifi_ready.h>

#define WIFI_SAP_MGMT_EVENTS (NET_EVENT_WIFI_AP_ENABLE_RESULT)

static K_SEM_DEFINE(wifi_ready_state_changed_sem, 0, 1);
static bool wifi_ready_status;

static struct net_mgmt_event_callback wifi_sap_mgmt_cb;

static K_MUTEX_DEFINE(wifi_ap_sta_list_lock);
struct wifi_ap_sta_node {
	bool valid;
	struct wifi_ap_sta_info sta_info;
};
static struct wifi_ap_sta_node sta_list[CONFIG_SOFTAP_SAMPLE_MAX_STATIONS];
bool dhcp_server_configured;

static void wifi_ap_stations_unlocked(void)
{
	size_t id = 1;

	LOG_INF("AP stations:");
	LOG_INF("============");

	for (int i = 0; i < CONFIG_SOFTAP_SAMPLE_MAX_STATIONS; i++) {
		struct wifi_ap_sta_info *sta;
		uint8_t mac_string_buf[sizeof("xx:xx:xx:xx:xx:xx")];

		if (!sta_list[i].valid) {
			continue;
		}

		sta = &sta_list[i].sta_info;

		LOG_INF("Station %zu:", id++);
		LOG_INF("==========");
		LOG_INF("MAC: %s",
			net_sprint_ll_addr_buf(sta->mac,
					       WIFI_MAC_ADDR_LEN,
					       mac_string_buf,
					       sizeof(mac_string_buf)));
		LOG_INF("Link mode: %s", wifi_link_mode_txt(sta->link_mode));
		LOG_INF("TWT: %s", sta->twt_capable ? "Supported" : "Not supported");
	}

	if (id == 1) {
		LOG_INF("No stations connected");
	}
}

static void handle_wifi_ap_enable_result(struct net_mgmt_event_callback *cb)
{
	const struct wifi_status *status =
		(const struct wifi_status *)cb->info;

	if (status->status) {
		LOG_ERR("AP enable request failed (%d)", status->status);
	} else {
		LOG_INF("AP enable requested");
	}
}

static void handle_wifi_ap_sta_connected(struct net_mgmt_event_callback *cb)
{
	const struct wifi_ap_sta_info *sta_info =
		(const struct wifi_ap_sta_info *)cb->info;
	uint8_t mac_string_buf[sizeof("xx:xx:xx:xx:xx:xx")];
	int i;

	LOG_INF("Station connected: %s",
		net_sprint_ll_addr_buf(sta_info->mac, WIFI_MAC_ADDR_LEN,
				       mac_string_buf, sizeof(mac_string_buf)));

	k_mutex_lock(&wifi_ap_sta_list_lock, K_FOREVER);
	for (i = 0; i < CONFIG_SOFTAP_SAMPLE_MAX_STATIONS; i++) {
		if (!sta_list[i].valid) {
			sta_list[i].sta_info = *sta_info;
			sta_list[i].valid = true;
			break;
		}
	}

	if (i == CONFIG_SOFTAP_SAMPLE_MAX_STATIONS) {
		LOG_ERR("No space to store station info: "
			"Increase CONFIG_SOFTAP_SAMPLE_MAX_STATIONS");
	}

	wifi_ap_stations_unlocked();
	k_mutex_unlock(&wifi_ap_sta_list_lock);
}

static void handle_wifi_ap_sta_disconnected(struct net_mgmt_event_callback *cb)
{
	const struct wifi_ap_sta_info *sta_info =
		(const struct wifi_ap_sta_info *)cb->info;
	uint8_t mac_string_buf[sizeof("xx:xx:xx:xx:xx:xx")];
	int i;

	LOG_INF("Station disconnected: %s",
		net_sprint_ll_addr_buf(sta_info->mac, WIFI_MAC_ADDR_LEN,
				       mac_string_buf, sizeof(mac_string_buf)));

	k_mutex_lock(&wifi_ap_sta_list_lock, K_FOREVER);
	for (i = 0; i < CONFIG_SOFTAP_SAMPLE_MAX_STATIONS; i++) {
		if (!sta_list[i].valid) {
			continue;
		}

		if (!memcmp(sta_list[i].sta_info.mac, sta_info->mac,
			    WIFI_MAC_ADDR_LEN)) {
			sta_list[i].valid = false;
			break;
		}
	}

	if (i == CONFIG_SOFTAP_SAMPLE_MAX_STATIONS) {
		LOG_WRN("No matching MAC address found in the list");
	}

	wifi_ap_stations_unlocked();
	k_mutex_unlock(&wifi_ap_sta_list_lock);
}

static void wifi_mgmt_event_handler(struct net_mgmt_event_callback *cb,
				    uint64_t mgmt_event, struct net_if *iface)
{
	switch (mgmt_event) {
	case NET_EVENT_WIFI_AP_ENABLE_RESULT:
		handle_wifi_ap_enable_result(cb);
		break;
	case NET_EVENT_WIFI_AP_STA_CONNECTED:
		handle_wifi_ap_sta_connected(cb);
		break;
	case NET_EVENT_WIFI_AP_STA_DISCONNECTED:
		handle_wifi_ap_sta_disconnected(cb);
		break;
	default:
		break;
	}
}

static int __wifi_args_to_params(struct wifi_connect_req_params *params)
{
#ifdef CONFIG_SOFTAP_SAMPLE_2_4GHz
	params->band = WIFI_FREQ_BAND_2_4_GHZ;
#elif CONFIG_SOFTAP_SAMPLE_5GHz
	params->band = WIFI_FREQ_BAND_5_GHZ;
#endif
	params->channel = CONFIG_SOFTAP_SAMPLE_CHANNEL;

	/* SSID */
	params->ssid = CONFIG_SOFTAP_SAMPLE_SSID;
	params->ssid_length = strlen(params->ssid);
	if (params->ssid_length > WIFI_SSID_MAX_LEN) {
		LOG_ERR("SSID length is too long, expected is %d characters long",
			WIFI_SSID_MAX_LEN);
		return -1;
	}

#if defined(CONFIG_SOFTAP_SAMPLE_KEY_MGMT_WPA2)
	params->security = 1;
#elif defined(CONFIG_SOFTAP_SAMPLE_KEY_MGMT_WPA2_256)
	params->security = 2;
#elif defined(CONFIG_SOFTAP_SAMPLE_KEY_MGMT_WPA3)
	params->security = 3;
#else
	params->security = 0;
#endif

#if !defined(CONFIG_SOFTAP_SAMPLE_KEY_MGMT_NONE)
	params->psk = CONFIG_SOFTAP_SAMPLE_PASSWORD;
	params->psk_length = strlen(params->psk);
#endif

	return 0;
}

static void cmd_wifi_status(void)
{
	struct net_if *iface;
	struct wifi_iface_status status = { 0 };

	iface = net_if_get_first_wifi();
	if (!iface) {
		LOG_ERR("Failed to get Wi-FI interface");
		return;
	}

	if (net_mgmt(NET_REQUEST_WIFI_IFACE_STATUS, iface, &status,
				sizeof(struct wifi_iface_status))) {
		LOG_ERR("Status request failed");
		return;
	}

	LOG_INF("Status: successful");
	LOG_INF("==================");
	LOG_INF("State: %s", wifi_state_txt(status.state));

	if (status.state >= WIFI_STATE_ASSOCIATED) {
		uint8_t mac_string_buf[sizeof("xx:xx:xx:xx:xx:xx")];

		LOG_INF("Interface Mode: %s", wifi_mode_txt(status.iface_mode));
		LOG_INF("Link Mode: %s", wifi_link_mode_txt(status.link_mode));
		LOG_INF("SSID: %.32s", status.ssid);
		LOG_INF("BSSID: %s",
			net_sprint_ll_addr_buf(status.bssid,
					       WIFI_MAC_ADDR_LEN, mac_string_buf,
					       sizeof(mac_string_buf)));
		LOG_INF("Band: %s", wifi_band_txt(status.band));
		LOG_INF("Channel: %d", status.channel);
		LOG_INF("Security: %s", wifi_security_txt(status.security));
		LOG_INF("MFP: %s", wifi_mfp_txt(status.mfp));
		LOG_INF("Beacon Interval: %d", status.beacon_interval);
		LOG_INF("DTIM: %d", status.dtim_period);
		LOG_INF("TWT: %s",
			status.twt_capable ? "Supported" : "Not supported");
	}
}

static int wifi_softap_enable(void)
{
	struct net_if *iface;
	static struct wifi_connect_req_params cnx_params;
	int ret = -1;

	iface = net_if_get_first_wifi();
	if (!iface) {
		LOG_ERR("Failed to get Wi-Fi iface");
		goto out;
	}

	if (__wifi_args_to_params(&cnx_params)) {
		goto out;
	}

	if (!wifi_utils_validate_chan(cnx_params.band, cnx_params.channel)) {
		LOG_ERR("Invalid channel %d in %d band",
			cnx_params.channel, cnx_params.band);
		goto out;
	}

	ret = net_mgmt(NET_REQUEST_WIFI_AP_ENABLE, iface, &cnx_params,
		       sizeof(struct wifi_connect_req_params));
	if (ret) {
		LOG_ERR("AP mode enable failed: %s", strerror(-ret));
	} else {
		LOG_INF("AP mode enabled");
	}

out:
	return ret;
}

static int wifi_set_reg_domain(void)
{
	struct net_if *iface;
	struct wifi_reg_domain regd = {0};
	int ret = -1;

	iface = net_if_get_first_wifi();
	if (!iface) {
		LOG_ERR("Failed to get Wi-Fi iface");
		return ret;
	}

	regd.oper = WIFI_MGMT_SET;
	strncpy(regd.country_code, CONFIG_SOFTAP_SAMPLE_REG_DOMAIN,
		(WIFI_COUNTRY_CODE_LEN + 1));

	ret = net_mgmt(NET_REQUEST_WIFI_REG_DOMAIN, iface,
		       &regd, sizeof(regd));
	if (ret) {
		LOG_ERR("Cannot %s Regulatory domain: %d", "SET", ret);
	} else {
		LOG_INF("Regulatory domain set to %s", CONFIG_SOFTAP_SAMPLE_REG_DOMAIN);
	}

	return ret;
}

static int configure_dhcp_server(void)
{
	struct net_if *iface;
	struct in_addr pool_start;
	int ret = -1;

	iface = net_if_get_first_wifi();
	if (!iface) {
		LOG_ERR("Failed to get Wi-Fi interface");
		goto out;
	}

	if (net_addr_pton(AF_INET, CONFIG_SOFTAP_SAMPLE_DHCPV4_POOL_START, &pool_start.s_addr)) {
		LOG_ERR("Invalid address: %s", CONFIG_SOFTAP_SAMPLE_DHCPV4_POOL_START);
		goto out;
	}

	ret = net_dhcpv4_server_start(iface, &pool_start);
	if (ret == -EALREADY) {
		dhcp_server_configured = true;
		LOG_ERR("DHCPv4 server already running on interface");
	} else if (ret < 0) {
		LOG_ERR("DHCPv4 server failed to start and returned %d error", ret);
	} else {
		dhcp_server_configured = true;
		LOG_INF("DHCPv4 server started and pool address starts from %s",
			CONFIG_SOFTAP_SAMPLE_DHCPV4_POOL_START);
	}
out:
	return ret;
}

#define CHECK_RET(func, ...) \
	do { \
		ret = func(__VA_ARGS__); \
		if (ret) { \
			LOG_ERR("Failed to configure %s", #func); \
			return -1; \
		} \
	} while (0)

int start_app(void)
{
	int ret;

	CHECK_RET(wifi_set_reg_domain);

	CHECK_RET(configure_dhcp_server);

	CHECK_RET(wifi_softap_enable);

	cmd_wifi_status();

	return 0;
}

int stop_dhcp_server(void)
{
	int ret;

	struct net_if *iface = net_if_get_first_wifi();

	if (!iface) {
		LOG_ERR("Failed to get Wi-Fi interface");
		return -1;
	}

	ret = net_dhcpv4_server_stop(iface);
	if (ret) {
		LOG_ERR("Failed to stop DHCPv4 server, error: %d", ret);
	}

	dhcp_server_configured = false;
	LOG_INF("DHCPv4 server stopped");

	return ret;
}

void start_wifi_thread(void);
#define THREAD_PRIORITY K_PRIO_COOP(CONFIG_NUM_COOP_PRIORITIES - 1)
K_THREAD_DEFINE(start_wifi_thread_id, CONFIG_SOFTAP_SAMPLE_START_WIFI_THREAD_STACK_SIZE,
		start_wifi_thread, NULL, NULL, NULL,
		THREAD_PRIORITY, 0, -1);

void start_wifi_thread(void)
{
	bool waiting_for_wifi = true;

	while (1) {
		int ret;

		if (waiting_for_wifi) {
			LOG_INF("Waiting for Wi-Fi to be ready");
		}

		ret = k_sem_take(&wifi_ready_state_changed_sem, K_FOREVER);
		if (ret) {
			LOG_ERR("Failed to take semaphore: %d", ret);
			return;
		}

		if (!wifi_ready_status) {
			LOG_INF("Wi-Fi is not ready");
			if (dhcp_server_configured) {
				stop_dhcp_server();
			}
			waiting_for_wifi = true;
			continue;
		}
		start_app();
		waiting_for_wifi = false;
	}
}

void wifi_ready_cb(bool wifi_ready)
{
	LOG_DBG("Is Wi-Fi ready?: %s", wifi_ready ? "yes" : "no");
	wifi_ready_status = wifi_ready;
	k_sem_give(&wifi_ready_state_changed_sem);
}

static int register_wifi_ready(void)
{
	int ret = 0;
	wifi_ready_callback_t cb;
	struct net_if *iface = net_if_get_first_wifi();

	if (!iface) {
		LOG_ERR("Failed to get Wi-Fi interface");
		return -1;
	}

	cb.wifi_ready_cb = wifi_ready_cb;

	LOG_DBG("Registering Wi-Fi ready callbacks");
	ret = register_wifi_ready_callback(cb, iface);
	if (ret) {
		LOG_ERR("Failed to register Wi-Fi ready callbacks %s", strerror(ret));
		return ret;
	}

	return ret;
}

void net_mgmt_callback_init(void)
{
	net_mgmt_init_event_callback(&wifi_sap_mgmt_cb,
				     wifi_mgmt_event_handler,
				     WIFI_SAP_MGMT_EVENTS);

	net_mgmt_add_event_callback(&wifi_sap_mgmt_cb);
}

int main(void)
{
	int ret = 0;

	dhcp_server_configured = false;

	net_mgmt_callback_init();

	ret = register_wifi_ready();
	if (ret) {
		return ret;
	}
	k_thread_start(start_wifi_thread_id);

	return ret;
}
```

## src/wpas_events.c
```c
/*
 * Copyright (c) 2024 Nordic Semiconductor ASA
 *
 * SPDX-License-Identifier: LicenseRef-Nordic-5-Clause
 */

#include <zephyr/net/net_event.h>
#include <ctrl_iface_zephyr.h>
#include <supp_events.h>
#include <supp_main.h>
#include <zephyr/logging/log.h>
#include <zephyr/kernel.h>
LOG_MODULE_REGISTER(wpas_event, CONFIG_LOG_DEFAULT_LEVEL);

#define WPAS_READY_TIMEOUT_MS 500

#define WPA_SUPP_EVENTS (NET_EVENT_WPA_SUPP_READY)

static struct net_mgmt_event_callback net_wpa_supp_cb;
extern struct k_work sap_init_work;
K_SEM_DEFINE(wpa_supp_ready_sem, 0, 1);

static void handle_wpa_supp_ready(struct net_mgmt_event_callback *cb)
{
	k_sem_give(&wpa_supp_ready_sem);
	k_work_submit(&sap_init_work);
}

static void wpa_supp_event_handler(struct net_mgmt_event_callback *cb,
	uint32_t mgmt_event, struct net_if *iface)
{
	switch (mgmt_event) {
	case NET_EVENT_WPA_SUPP_READY:
		handle_wpa_supp_ready(cb);
		break;
	default:
		LOG_DBG("Unhandled event (%d)", mgmt_event);
		break;
	}
}

int wait_for_wpa_s_ready(void)
{
	const struct device *dev = NULL;
	struct wpa_supplicant *wpa_s;
	int ret;

	dev = DEVICE_DT_GET(DT_CHOSEN(zephyr_wifi));
	if (!dev) {
		wpa_printf(MSG_ERROR, "Device instance not found");
		return -1;
	}

	wpa_s = z_wpas_get_handle_by_ifname(dev->name);
	if (wpa_s) {
		LOG_INF("WPA Supplicant is already ready: %s", dev->name);
		return 0;
	}

	ret = k_sem_take(&wpa_supp_ready_sem, K_MSEC(WPAS_READY_TIMEOUT_MS));
	if (ret == -EAGAIN) {
		LOG_INF("Timeout waiting for WPA Supplicant to be ready (%d ms)",
			WPAS_READY_TIMEOUT_MS);
		return -1;
	}

	wpa_s = z_wpas_get_handle_by_ifname(dev->name);
	if (!wpa_s) {
		LOG_INF("WPA Supplicant ready event received, but no handle found for %s",
			 dev->name);
		return -1;
	}

	LOG_INF("WPA Supplicant is ready: %s", dev->name);

	return 0;
}



int wpa_supp_events_register(void)
{
	net_mgmt_init_event_callback(&net_wpa_supp_cb, wpa_supp_event_handler, WPA_SUPP_EVENTS);
	net_mgmt_add_event_callback(&net_wpa_supp_cb);

	return 0;
}
```
