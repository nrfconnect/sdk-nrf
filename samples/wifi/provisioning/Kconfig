## samples/wifi/radio_test/sample.yaml
```yaml
sample:
  description: Wi-Fi radio test sample
    application
  name: Wi-Fi radio test
tests:
  sample.nrf7002.radio_test:
    sysbuild: true
    build_only: true
    integration_platforms:
      - nrf7002dk/nrf5340/cpuapp
    platform_allow: nrf7002dk/nrf5340/cpuapp
    tags: ci_build sysbuild ci_samples_wifi
  sample.nrf7001.radio_test:
    sysbuild: true
    build_only: true
    integration_platforms:
      - nrf7002dk/nrf5340/cpuapp/nrf7001
    platform_allow: nrf7002dk/nrf5340/cpuapp/nrf7001
    tags: ci_build sysbuild ci_samples_wifi
    skip: true
  sample.nrf7002.radio_test_combo:
    sysbuild: true
    build_only: true
    extra_args: CONFIG_NRF70_RADIO_TEST_COMBO=y
    integration_platforms:
      - nrf7002dk/nrf5340/cpuapp
    platform_allow: nrf7002dk/nrf5340/cpuapp
    tags: ci_build sysbuild ci_samples_wifi
  sample.nrf5340.radio_test_combo:
    sysbuild: true
    build_only: true
    extra_args: SHIELD=nrf7002ek CONFIG_NRF70_RADIO_TEST_COMBO=y
    integration_platforms:
      - nrf5340dk/nrf5340/cpuapp
    platform_allow: nrf5340dk/nrf5340/cpuapp
    tags: ci_build sysbuild ci_samples_wifi
  sample.nrf7002_eks.radio_test:
    sysbuild: true
    build_only: true
    extra_args: SHIELD=nrf7002ek
    integration_platforms:
      - nrf5340dk/nrf5340/cpuapp
      - nrf52840dk/nrf52840
    platform_allow: nrf5340dk/nrf5340/cpuapp nrf52840dk/nrf52840
    tags: ci_build sysbuild ci_samples_wifi
  sample.nrf7001_eks.radio_test:
    sysbuild: true
    build_only: true
    extra_args: SHIELD=nrf7002ek_nrf7001
    integration_platforms:
      - nrf5340dk/nrf5340/cpuapp
      - nrf52840dk/nrf52840
    platform_allow: nrf5340dk/nrf5340/cpuapp nrf52840dk/nrf52840
    tags: ci_build sysbuild ci_samples_wifi
  sample.nrf7000_eks.radio_test:
    sysbuild: true
    build_only: true
    extra_args: SHIELD=nrf7002ek_nrf7000
    integration_platforms:
      - nrf9160dk/nrf9160/ns
    platform_allow: nrf9160dk/nrf9160/ns
    tags: ci_build sysbuild ci_samples_wifi
  sample.nrf7002_eb.thingy53.radio_test:
    sysbuild: true
    build_only: true
    extra_args: radio_test_SHIELD=nrf7002eb
    integration_platforms:
      - thingy53/nrf5340/cpuapp
    platform_allow: thingy53/nrf5340/cpuapp
    tags: ci_build sysbuild ci_samples_wifi
  sample.thingy91x_nrf7002.radio_test:
    sysbuild: true
    build_only: true
    platform_allow: thingy91x/nrf9151/ns
    tags: ci_build sysbuild ci_samples_wifi
```

## samples/wifi/radio_test/single_domain/sample.yaml
```yaml
sample:
  description: Wi-Fi BLE radio test sample single domain
  name: Wi-Fi BLE radio test Single Domain
tests:
  sample.nrf70.wifi_ble_radio_test_sd:
    sysbuild: true
    build_only: true
    extra_args:
      - single_domain_SHIELD="nrf7002eb_interposer_p1;nrf7002eb"
      - single_domain_SNIPPET=nrf70-wifi
    integration_platforms:
      - nrf54l15dk/nrf54l15/cpuapp
    platform_allow:
      - nrf54l15dk/nrf54l15/cpuapp
    tags:
      - ci_build
      - sysbuild
      - ci_samples_wifi
  sample.nrf7002eb2.wifi_ble_radio_test_sd:
    sysbuild: true
    build_only: true
    extra_args:
      - single_domain_SHIELD="nrf7002eb2"
      - single_domain_SNIPPET=nrf70-wifi
      - CONFIG_NRF_WIFI_CTRL_HEAP_SIZE=51000
    integration_platforms:
      - nrf54l15dk/nrf54l15/cpuapp
    platform_allow:
      - nrf54l15dk/nrf54l15/cpuapp
    tags:
      - ci_build
      - sysbuild
      - ci_samples_wifi
  sample.54lm20dk.nrf7002eb2.wifi_ble_radio_test_sd:
    sysbuild: true
    build_only: true
    extra_args:
      - single_domain_SHIELD="nrf7002eb2"
      - CONFIG_NRFX_TIMER=y
      - CONFIG_NRFX_GPPI=y
    integration_platforms:
      - nrf54lm20dk/nrf54lm20a/cpuapp
    platform_allow:
      - nrf54lm20dk/nrf54lm20a/cpuapp
    tags:
      - ci_build
      - sysbuild
      - ci_samples_wifi
```

## samples/wifi/raw_tx_packet/Kconfig
```kconfig
#
# Copyright (c) 2023 Nordic Semiconductor
#
# SPDX-License-Identifier: LicenseRef-Nordic-5-Clause
#

source "Kconfig.zephyr"

menu "Nordic Raw Tx Packet sample"

config RAW_TX_PKT_SAMPLE_CONNECTION_TIMEOUT
	int "Time to wait for a station to connect"
	default 30

config RAW_TX_PKT_SAMPLE_DHCP_TIMEOUT_S
	int "DHCP timeout in seconds"
	default 20

config RAW_TX_PKT_SAMPLE_STA_ONLY_MODE
	bool "Set Wi-Fi Station mode"
	default n
	help
	  Set the device operating mode as Station mode.

config RAW_TX_PKT_SAMPLE_INJECTION_ENABLE
	bool "Set Wi-Fi TX injection mode"
	default y
	help
	  Set the device operating mode as TX injection mode.

choice RAW_TX_PKT_SAMPLE_OP_MODE
	prompt "Choose Wi-Fi operation mode"
	default RAW_TX_PKT_SAMPLE_NON_CONNECTED_MODE

config RAW_TX_PKT_SAMPLE_CONNECTION_MODE
	bool "Connected Station mode"
	help
	  Enable the option to select Connected Station mode.

config RAW_TX_PKT_SAMPLE_NON_CONNECTED_MODE
	bool "Non-connected Station mode"
	help
	  Enable the option to select non-connected Station mode.
endchoice

config RAW_TX_PKT_SAMPLE_CHANNEL
	int "Channel for non-connected Station mode"
	depends on RAW_TX_PKT_SAMPLE_NON_CONNECTED_MODE
	range 1 233
	help
	  Specify the Wi-Fi channel for transmitting raw TX packets in non-connected Station mode.
	  The valid channel range is 1 to 233.

config RAW_TX_PKT_SAMPLE_RATE_VALUE
	int "MCS index or Data rate value"
	default 0
	help
	  Specify the Wi-Fi data rate value for raw TX packet transmission.
	  The value represents either the data rate in Mbps or Modulation and coding (MCS) index.
	  Note: 5.5Mbps is treated specially as 55 to avoid floating point usage.
	  Legacy: 1, 2, 55, 11, 6, 9, 12, 18, 24, 36, 48, 54
	  MCS index: 0-7

config RAW_TX_PKT_SAMPLE_RATE_FLAGS
	int "Rate flag value"
	range 0 4
	default 1
	help
	  Specify the rate flag value to be used for raw TX packet transmission.
	  Rate Flags:
	  0 - Legacy
	  1 - 11n format
	  2 - VHT format
	  3 - HE_SU
	  4 - HE_ER_SU

config RAW_TX_PKT_SAMPLE_QUEUE_NUM
	int "Queue number"
	default 0
	range 0 4
	help
	  Specify the transmission queue number for raw TX packets.
	  0 - Background
	  1 - Best effort
	  2 - Video
	  3 - Voice
	  4 - Beacon.

choice
	prompt "Select transmission mode"
	default RAW_TX_PKT_SAMPLE_TX_MODE_CONTINUOUS

config RAW_TX_PKT_SAMPLE_TX_MODE_CONTINUOUS
	bool "Continuous transmission mode"

config RAW_TX_PKT_SAMPLE_TX_MODE_FIXED
	bool "Fixed transmission mode"

endchoice

if RAW_TX_PKT_SAMPLE_TX_MODE_FIXED
config RAW_TX_PKT_SAMPLE_FIXED_NUM_PACKETS
	int "Number of packets"
	default 1
	help
	  Specify the number of packets to be sent when using Fixed mode of transmission.
endif

config RAW_TX_PKT_SAMPLE_INTER_FRAME_DELAY_MS
	int "Inter-Frame Delay (milliseconds)"
	default 10
	help
	  Specify the inter-frame delay duration for raw TX packet transmission.

endmenu
```

## samples/wifi/raw_tx_packet/sample.yaml
```yaml
sample:
  description: Wi-Fi Raw Tx Packet sample application
  name: Wi-Fi Raw Tx Packet sample
tests:
  sample.nrf7002.raw_tx_packet:
    sysbuild: true
    build_only: true
    integration_platforms:
      - nrf7002dk/nrf5340/cpuapp
    platform_allow: nrf7002dk/nrf5340/cpuapp
    tags:
      - ci_build
      - sysbuild
      - ci_samples_wifi
  sample.nrf7002_eks.raw_tx_packet:
    sysbuild: true
    build_only: true
    extra_args: SHIELD=nrf7002ek
    integration_platforms:
      - nrf5340dk/nrf5340/cpuapp
    platform_allow: nrf5340dk/nrf5340/cpuapp
    tags:
      - ci_build
      - sysbuild
      - ci_samples_wifi
  sample.nrf7001.raw_tx_packet:
    sysbuild: true
    build_only: true
    integration_platforms:
      - nrf7002dk/nrf5340/cpuapp/nrf7001
    platform_allow: nrf7002dk/nrf5340/cpuapp/nrf7001
    tags:
      - ci_build
      - sysbuild
      - ci_samples_wifi
  sample.nrf7002eb_interposer_p1.nrf7002eb.raw_tx_packet:
    sysbuild: true
    build_only: true
    extra_args:
      - raw_tx_packet_SHIELD="nrf7002eb_interposer_p1;nrf7002eb"
      - raw_tx_packet_SNIPPET=nrf70-wifi
    integration_platforms:
      - nrf54h20dk/nrf54h20/cpuapp
      - nrf54l15dk/nrf54l15/cpuapp
    platform_allow:
      - nrf54h20dk/nrf54h20/cpuapp
      - nrf54l15dk/nrf54l15/cpuapp
    tags:
      - ci_build
      - sysbuild
      - ci_samples_wifi
  sample.nrf7002eb2.raw_tx_packet:
    sysbuild: true
    build_only: true
    extra_args:
      - raw_tx_packet_SHIELD="nrf7002eb2"
      - raw_tx_packet_SNIPPET=nrf70-wifi
    integration_platforms:
      - nrf54l15dk/nrf54l15/cpuapp
    platform_allow:
      - nrf54l15dk/nrf54l15/cpuapp
    tags:
      - ci_build
      - sysbuild
      - ci_samples_wifi
  sample.54lm20dk.nrf7002eb2.raw_tx_packet:
    sysbuild: true
    build_only: true
    extra_args:
      - raw_tx_packet_SHIELD="nrf7002eb2"
    integration_platforms:
      - nrf54lm20dk/nrf54lm20a/cpuapp
    platform_allow:
      - nrf54lm20dk/nrf54lm20a/cpuapp
    tags:
      - ci_build
      - sysbuild
      - ci_samples_wifi
```

## samples/wifi/scan/Kconfig
```kconfig
#
# Copyright (c) 2023 Nordic Semiconductor
#
# SPDX-License-Identifier: LicenseRef-Nordic-5-Clause
#

source "Kconfig.zephyr"

menu "Nordic Scan sample"

config WIFI_MAC_ADDRESS
	string "WiFi MAC address"
	default "F6:CE:36:00:00:01"
	help
		WiFi MAC address to be used by the sample. If not set, the sample will
		use the default MAC address (locally administrative). This is only used
		when the nRF7002 OTP is not programmed with a MAC address.

config WIFI_SCAN_BANDS_LIST
	string "Frequency bands to scan"
	default "2" if WIFI_SCAN_PROFILE_2_4GHz_ACTIVE || WIFI_SCAN_PROFILE_2_4GHz_PASSIVE || WIFI_SCAN_PROFILE_2_4GHz_NON_OVERLAP_CHAN
	default "5" if WIFI_SCAN_PROFILE_5GHz_ACTIVE || WIFI_SCAN_PROFILE_5GHz_PASSIVE || WIFI_SCAN_PROFILE_5GHz_NON_DFS_CHAN
	default "2,5" if WIFI_SCAN_PROFILE_2_4GHz_NON_OVERLAP_AND_5GHz_NON_DFS_CHAN
	default ""
	help
	  Specifies the frequency bands to scan, as follows:
	  2 - 2.4 GHz,
	  5 - 5 GHz,
	  6 - 6 GHz,
	  "" - All bands allowed by the regulatory domain.
	  Multiple bands can be specified as comma separated band values.
	  Only regulatory domain permitted values are allowed.

config WIFI_SCAN_CHAN_LIST
	string "Channel list for scan"
	default "2:1,6,11" if WIFI_SCAN_PROFILE_2_4GHz_NON_OVERLAP_CHAN
	default "5:36,40,44,48,149,153,157,161,165" if WIFI_SCAN_PROFILE_5GHz_NON_DFS_CHAN
	default "2:1,6,11_5:36,40,44,48,149,153,157,161,165" if WIFI_SCAN_PROFILE_2_4GHz_NON_OVERLAP_AND_5GHz_NON_DFS_CHAN
	default ""
	help
	  Specifies the list of channels used to perform scan.

choice
	prompt "Choose a WiFi Scan Profile"

config WIFI_SCAN_PROFILE_DEFAULT
	bool "Scan in all bands and channels"
	help
	  Enable this profile to do Wi-Fi scan in all supported bands and channels.

config WIFI_SCAN_PROFILE_ACTIVE
	bool "Active scan"
	help
	  Enable this profile to do active scan where allowed.

config WIFI_SCAN_PROFILE_PASSIVE
	bool "Passive scan"
	help
	  Enable this profile to do passive scan on all channels.

config WIFI_SCAN_PROFILE_2_4GHz_ACTIVE
	bool "Scan in the 2.4 GHz band using active scan"
	help
	  Enable this profile to scan in the 2.4 GHz band using active scanning where allowed.

config WIFI_SCAN_PROFILE_2_4GHz_PASSIVE
	bool "Scan in the 2.4 GHz band using passive scan"
	help
	  Enable this profile to scan in the 2.4 GHz band using passive scanning on all channels.

config WIFI_SCAN_PROFILE_5GHz_ACTIVE
	bool "Scan in the 5 GHz band using active scan"
	help
	  Enable this profile to scan in the 5 GHz band using active scanning where allowed.

config WIFI_SCAN_PROFILE_5GHz_PASSIVE
	bool "Scan in the 5 GHz band using passive scan"
	help
	  Enable this profile to scan in the 5 GHz band using passive scanning on all channels.

config WIFI_SCAN_PROFILE_2_4GHz_NON_OVERLAP_CHAN
	bool "Scan only non-overlapping channels"
	help
	  Enable this profile to scan only non-overlapping channels (1, 6, 11)
	  in the 2.4 GHz band.

config WIFI_SCAN_PROFILE_5GHz_NON_DFS_CHAN
	bool "Scan only non-DFS channels"
	help
	  Enable this profile to scan only non-DFS channels (36, 40, 44,
	  48, 149, 153, 157, 161, 165) in the 5 GHz band.

config WIFI_SCAN_PROFILE_2_4GHz_NON_OVERLAP_AND_5GHz_NON_DFS_CHAN
	bool "Scan only non-overlapping and non-DFS channels"
	help
	  Enable this profile to scan only non-overlapping channels
	  (1, 6, 11) in the 2.4 GHz band and non-DFS channels (36, 40, 44,
	  48, 149, 153, 157, 161, 165) in the 5 GHz band.

endchoice

endmenu
```

## samples/wifi/scan/boards/nrf7120dk_nrf7120_cpuapp.conf
```kconfig
#
# Copyright (c) 2026 Nordic Semiconductor
#
# SPDX-License-Identifier: LicenseRef-Nordic-5-Clause
#

CONFIG_WIFI_NRF71=y
CONFIG_WIFI_USAGE_MODE_SCAN_ONLY=y
CONFIG_HEAP_MEM_POOL_SIZE=25000
```

## samples/wifi/scan/sample.yaml
```yaml
sample:
  description: Wi-Fi scan sample
    application
  name: Wi-Fi scan
tests:
  sample.nrf7000_eks.scan:
    sysbuild: true
    build_only: true
    extra_args: SHIELD=nrf7002ek_nrf7000
    integration_platforms:
      - nrf5340dk/nrf5340/cpuapp
      - nrf52840dk/nrf52840
      - nrf9160dk/nrf9160/ns
      - nrf9161dk/nrf9161/ns
    platform_allow:
      - nrf5340dk/nrf5340/cpuapp
      - nrf52840dk/nrf52840
      - nrf9160dk/nrf9160/ns
      - nrf9161dk/nrf9161/ns
    tags: ci_build sysbuild ci_samples_wifi
  sample.nrf7000_eks.raw_scan:
    sysbuild: true
    build_only: true
    extra_args: SHIELD=nrf7002ek_nrf7000 CONFIG_WIFI_MGMT_RAW_SCAN_RESULTS=y
    integration_platforms:
      - nrf9160dk/nrf9160/ns
      - nrf9161dk/nrf9161/ns
    platform_allow:
      - nrf9160dk/nrf9160/ns
      - nrf9161dk/nrf9161/ns
      - nrf9151dk/nrf9151/ns
    tags: ci_build sysbuild ci_samples_wifi
  sample.nrf7002_eb.thingy53.scan:
    sysbuild: true
    build_only: true
    extra_args: scan_SHIELD=nrf7002eb
    integration_platforms:
      - thingy53/nrf5340/cpuapp
    platform_allow: thingy53/nrf5340/cpuapp
    tags: ci_build sysbuild ci_samples_wifi
  sample.thingy91x_nrf7000.scan:
    sysbuild: true
    build_only: true
    platform_allow: thingy91x/nrf9151/ns
    extra_args: SHIELD=nrf7002ek_nrf7000
    tags: ci_build sysbuild ci_samples_wifi
  sample.nrf7002eb_interposer_p1.nrf7002eb.scan:
    sysbuild: true
    build_only: true
    extra_args:
      - scan_SHIELD=nrf7002eb_interposer_p1 nrf7002eb
      - scan_SNIPPET=nrf70-wifi
    platform_allow:
      - nrf54h20dk/nrf54h20/cpuapp
      - nrf54l15pdk/nrf54l15/cpuapp
      - nrf54l15dk/nrf54l15/cpuapp
    tags: ci_build sysbuild ci_samples_wifi
```

## samples/wifi/shell/Kconfig
```kconfig
#
# Copyright (c) 2024 Nordic Semiconductor
#
# SPDX-License-Identifier: LicenseRef-Nordic-5-Clause
#

menu "Nordic Shell sample"

if NET_BUF_FIXED_DATA_SIZE

config NET_BUF_DATA_SIZE
	default 1100

endif

# Configure variable network buffer pool sizes for TX and RX
if NET_BUF_VARIABLE_DATA_SIZE

# nRF52 and nRF54 Series targets have less memory
# so smaller pool sizes are recommended for these targets.
config NET_PKT_BUF_TX_DATA_POOL_SIZE
	default 40000 if SOC_SERIES_NRF54H
	default 35000 if !SOC_SERIES_NRF52 && !SOC_SERIES_NRF54L && BUILD_WITH_TFM
	default 50000 if !SOC_SERIES_NRF52 && !SOC_SERIES_NRF54L

config NET_PKT_BUF_RX_DATA_POOL_SIZE
	default 20000 if !SOC_SERIES_NRF52 && !SOC_SERIES_NRF54L

endif

source "Kconfig.zephyr"

endmenu
```

## samples/wifi/shell/boards/nrf52840dk_nrf52840.conf
```kconfig
#
# Copyright (c) 2023 Nordic Semiconductor ASA
#
# SPDX-License-Identifier: LicenseRef-Nordic-5-Clause
#

# Consumes more memory, so, disable for now

# Zephyr NET Connection Manager Connectivity layer.
CONFIG_NET_CONNECTION_MANAGER=n
CONFIG_L2_WIFI_CONNECTIVITY=n
CONFIG_L2_WIFI_CONNECTIVITY_AUTO_CONNECT=n

CONFIG_WIFI_CREDENTIALS=n
CONFIG_FLASH=n
CONFIG_NVS=n
CONFIG_SETTINGS=n
CONFIG_NRF_WIFI_CTRL_HEAP_SIZE=20000
CONFIG_NRF_WIFI_DATA_HEAP_SIZE=40000
```
