## samples/wifi/provisioning/Kconfig
```kconfig
#
# Copyright (c) 2022 Nordic Semiconductor ASA
#
# SPDX-License-Identifier: LicenseRef-Nordic-5-Clause
#
menu "Wi-Fi Provisioning"

module = WIFI_PROVISIONING
module-str = wifi provisioning service
source "${ZEPHYR_BASE}/subsys/logging/Kconfig.template.log_config"

endmenu

source "Kconfig.zephyr"
```

## samples/wifi/provisioning/ble/Kconfig
```kconfig
#
# Copyright (c) 2022 Nordic Semiconductor ASA
#
# SPDX-License-Identifier: LicenseRef-Nordic-5-Clause
#
menu "Wi-Fi Provisioning Sample"

config WIFI_PROV_ADV_DATA_UPDATE
	bool "Enable periodic update of advertisement data"
	default y

if WIFI_PROV_ADV_DATA_UPDATE

	config WIFI_PROV_ADV_DATA_UPDATE_INTERVAL
		int "Periodic update interval in second"
		default 5

endif # WIFI_PROV_ADV_DATA_UPDATE

endmenu

source "Kconfig.zephyr"
```

## samples/wifi/provisioning/ble/sample.yaml
```yaml
sample:
  description: Bluetooth Low Energy Wi-Fi provision sample
  name: Bluetooth LE Wi-Fi provision
tests:
  sample.nrf7002.ble-wifi-provision:
    sysbuild: true
    build_only: true
    integration_platforms:
      - nrf7002dk/nrf5340/cpuapp
    platform_allow: nrf7002dk/nrf5340/cpuapp
    tags:
      - ci_build
      - sysbuild
      - ci_samples_wifi
  sample.nrf7001.ble-wifi-provision:
    sysbuild: true
    build_only: true
    integration_platforms:
      - nrf7002dk/nrf5340/cpuapp/nrf7001
    platform_allow: nrf7002dk/nrf5340/cpuapp/nrf7001
    tags:
      - ci_build
      - sysbuild
      - ci_samples_wifi
    skip: true
  sample.nrf7002_eks.ble-wifi-provision:
    sysbuild: true
    build_only: true
    extra_args: SHIELD=nrf7002ek
    integration_platforms:
      - nrf5340dk/nrf5340/cpuapp
    platform_allow: nrf5340dk/nrf5340/cpuapp
    tags:
      - ci_build
      - sysbuild
      - ci_samples_wifi
  sample.nrf7001_eks.ble-wifi-provision:
    sysbuild: true
    build_only: true
    extra_args: SHIELD=nrf7002ek_nrf7001
    integration_platforms:
      - nrf5340dk/nrf5340/cpuapp
    platform_allow: nrf5340dk/nrf5340/cpuapp
    tags:
      - ci_build
      - sysbuild
      - ci_samples_wifi
  sample.nrf7002_eb.thingy53.ble-wifi-provision:
    sysbuild: true
    build_only: true
    extra_args: ble_SHIELD=nrf7002eb
    integration_platforms:
      - thingy53/nrf5340/cpuapp
    platform_allow: thingy53/nrf5340/cpuapp
    tags:
      - ci_build
      - sysbuild
      - ci_samples_wifi
  sample.nrf7002eb2.nrf54l15.ble-wifi-provision:
    sysbuild: true
    build_only: true
    extra_args:
      - ble_SHIELD="nrf7002eb2"
      - ble_SNIPPET=nrf70-wifi
      - CONFIG_NRF_WIFI_CTRL_HEAP_SIZE=25000
    integration_platforms:
      - nrf54l15dk/nrf54l15/cpuapp
    platform_allow:
      - nrf54l15dk/nrf54l15/cpuapp
    tags:
      - ci_build
      - sysbuild
      - ci_samples_wifi
  sample.nrf7002eb2.nrf54h20.ble-wifi-provision:
    sysbuild: true
    build_only: true
    extra_args:
      - ble_SHIELD="nrf7002eb2"
      - SNIPPET=nrf70-wifi
    integration_platforms:
      - nrf54h20dk/nrf54h20/cpuapp
    platform_allow:
      - nrf54h20dk/nrf54h20/cpuapp
    tags:
      - ci_build
      - sysbuild
      - ci_samples_wifi
  sample.54lm20dk.nrf7002eb2.ble-wifi-provision:
    sysbuild: true
    build_only: true
    extra_args:
      - ble_SHIELD="nrf7002eb2"
    integration_platforms:
      - nrf54lm20dk/nrf54lm20a/cpuapp
    platform_allow:
      - nrf54lm20dk/nrf54lm20a/cpuapp
    tags:
      - ci_build
      - sysbuild
      - ci_samples_wifi
```

## samples/wifi/provisioning/internal/Kconfig
```kconfig
#
# Copyright (c) 2025 Nordic Semiconductor ASA
#
# SPDX-License-Identifier: LicenseRef-Nordic-5-Clause
#

menuconfig WIFI_PROV_CONFIG
	bool "WiFi provisioning configuration"
	default y
	help
	  This option enables WiFi provisioning configuration.

config WIFI_PROV_SSID
	string "WiFi SSID for provisioning"
	default "SampleWiFi"
	help
	  SSID for the WiFi network to be provisioned.

config WIFI_PROV_BSSID
	string "WiFi BSSID for provisioning"
	default "00:11:22:33:44:55"
	help
	  BSSID (MAC address) for the WiFi network to be provisioned.

config WIFI_PROV_PASSPHRASE
	string "WiFi passphrase for provisioning"
	default "samplepassword"
	help
	  Passphrase for the WiFi network to be provisioned.

config WIFI_PROV_AUTH_MODE
	int "WiFi authentication mode"
	default 4
	range 0 23
	help
	  Authentication mode for the WiFi network.
	  0: Open, 1: WEP, 2: WPA_PSK, 3: WPA2_PSK, etc.

config WIFI_PROV_CHANNEL
	int "WiFi channel"
	default 0
	range 0 233
	help
	  Channel for the WiFi network (2.4GHz band).

config WIFI_PROV_BAND
	int "WiFi band"
	default 0
	range 0 2
	help
	  Band for the WiFi network.
	  1: 2.4GHz, 2: 5GHz

config WIFI_PROV_CERT_DIR
	string "Certificate directory path"
	default ""
	help
	  Path to directory containing certificates for enterprise WiFi networks.
	  Leave empty for personal WiFi networks.
	  Certificates should be in PEM format.

config WIFI_PROV_PRIVATE_KEY_PASSWD
	string "Primary private key password"
	default ""
	help
	  Password for the primary private key file.
	  Leave empty to use EAP password.

config WIFI_PROV_PRIVATE_KEY_PASSWD2
	string "Secondary private key password"
	default ""
	help
	  Password for the secondary private key file.
	  Leave empty to use EAP password.

config WIFI_PROV_IDENTITY
	string "EAP identity"
	default "user@example.com"
	help
	  EAP identity for enterprise WiFi networks.

config WIFI_PROV_PASSWORD
	string "EAP password"
	default "user_password"
	help
	  EAP password for enterprise WiFi networks.

config WIFI_PROV_VOLATILE_MEMORY
	bool "Use volatile memory"
	help
	  Store WiFi configuration in volatile memory.
	  If disabled, configuration is stored persistently.

config WIFI_PROV_SCAN_BAND
	int "WiFi scan band"
	default 0
	range 0 2
	help
	  Band for WiFi scanning.
	  0: Any band, 1: 2.4GHz, 2: 5GHz

config WIFI_PROV_SCAN_PASSIVE
	bool "Passive scan mode"
	help
	  Enable passive scanning mode.
	  If disabled, active scanning is used.

config WIFI_PROV_SCAN_PERIOD_MS
	int "Scan period in milliseconds"
	default 0
	range 0 60000
	help
	  Period between WiFi scans in milliseconds.
	  0 means no periodic scanning.

config WIFI_PROV_SCAN_GROUP_CHANNELS
	int "Scan group channels"
	default 0
	range 0 255
	help
	  Group channels for WiFi scanning.
	  0 means no grouping.

config WIFI_PROV_MAX_DATA_SIZE
	int "Maximum Protobuf Data Size"
	default 16384
	range 1024 16384
	help
	  Maximum size for protobuf data in bytes.

config WIFI_PROV_MAX_BASE64_SIZE
	int "Maximum Base64 Input Size"
	default 32768
	range 2048 32768
	help
	  Maximum size for base64 input string in bytes.

module=WIFI_PROV_INTERNAL
module-str=WiFi provisioning internal
source "$(ZEPHYR_BASE)/subsys/logging/Kconfig.template.log_config"

source "Kconfig.zephyr"
```

## samples/wifi/provisioning/internal/sample.yaml
```yaml
sample:
  description: Internal Wi-Fi provision sample
  name: Internal Wi-Fi provision
tests:
  sample.nrf7002.int-wifi-provision:
    sysbuild: true
    build_only: true
    integration_platforms:
      - nrf7002dk/nrf5340/cpuapp
    platform_allow: nrf7002dk/nrf5340/cpuapp
    tags:
      - ci_build
      - sysbuild
      - ci_samples_wifi
  sample.nrf7001.int-wifi-provision:
    sysbuild: true
    build_only: true
    integration_platforms:
      - nrf7002dk/nrf5340/cpuapp/nrf7001
    platform_allow: nrf7002dk/nrf5340/cpuapp/nrf7001
    tags:
      - ci_build
      - sysbuild
      - ci_samples_wifi
    skip: true
  sample.nrf7002_eks.int-wifi-provision:
    sysbuild: true
    build_only: true
    extra_args: SHIELD=nrf7002ek
    integration_platforms:
      - nrf5340dk/nrf5340/cpuapp
    platform_allow: nrf5340dk/nrf5340/cpuapp
    tags:
      - ci_build
      - sysbuild
      - ci_samples_wifi
  sample.nrf7001_eks.int-wifi-provision:
    sysbuild: true
    build_only: true
    extra_args: SHIELD=nrf7002ek_nrf7001
    integration_platforms:
      - nrf5340dk/nrf5340/cpuapp
    platform_allow: nrf5340dk/nrf5340/cpuapp
    tags:
      - ci_build
      - sysbuild
      - ci_samples_wifi
```

## samples/wifi/provisioning/sample.yaml
```yaml
sample:
  description: Wi-Fi provisioning sample
    application
  name: Wi-Fi provisioning
tests:
  sample.nrf7002.provisioning:
    sysbuild: true
    build_only: true
    integration_platforms:
      - nrf7002dk/nrf5340/cpuapp
    platform_allow: nrf7002dk/nrf5340/cpuapp
    tags: ci_build sysbuild
  sample.nrf7001.provisioning:
    sysbuild: true
    build_only: true
    integration_platforms:
      - nrf7002dk/nrf5340/cpuapp/nrf7001
    platform_allow: nrf7002dk/nrf5340/cpuapp/nrf7001
    tags: ci_build sysbuild
    skip: true
  sample.nrf7002_eks.provisioning:
    sysbuild: true
    build_only: true
    extra_args: SHIELD=nrf7002ek
    integration_platforms:
      - nrf5340dk/nrf5340/cpuapp
    platform_allow: nrf5340dk/nrf5340/cpuapp
    tags: ci_build sysbuild
  sample.nrf7001_eks.provisioning:
    sysbuild: true
    build_only: true
    extra_args: SHIELD=nrf7002ek_nrf7001
    integration_platforms:
      - nrf5340dk/nrf5340/cpuapp
    platform_allow: nrf5340dk/nrf5340/cpuapp
    tags: ci_build sysbuild
  sample.nrf7002_eb.thingy53.provisioning:
    sysbuild: true
    build_only: true
    extra_args: provisioning_SHIELD=nrf7002eb
    integration_platforms:
      - thingy53/nrf5340/cpuapp
    platform_allow: thingy53/nrf5340/cpuapp
    tags: ci_build sysbuild
```

## samples/wifi/provisioning/softap/Kconfig
```kconfig
#
# Copyright (c) 2024 Nordic Semiconductor ASA
#
# SPDX-License-Identifier: LicenseRef-Nordic-5-Clause
#

menu "SoftAP Wi-Fi provision sample"

config SOFTAP_WIFI_PROVISION_SAMPLE_PSM_DISABLED_SECONDS
	int "Wi-Fi PSM disabled seconds"
	default 120
	help
	  Time in seconds that Wi-Fi power saving mode is disabled after completed provisioning.
	  Disabling Power Save Mode is needed to make the device discoverable reliably via
	  mDNS post provisioning.
	  Service Discovery has proven to be unstable in PSM.

menu "Zephyr Kernel"
source "Kconfig.zephyr"
endmenu

module = SOFTAP_WIFI_PROVISION_SAMPLE
module-str = SoftAP Wi-Fi provision sample
source "${ZEPHYR_BASE}/subsys/logging/Kconfig.template.log_config"

endmenu
```

## samples/wifi/provisioning/softap/boards/nrf5340dk_nrf5340_cpuapp_ns.conf
```kconfig
#
# Copyright (c) 2026 Nordic Semiconductor ASA
#
# SPDX-License-Identifier: LicenseRef-Nordic-5-Clause
#

# Store Wi-Fi credentials using PSA storage
CONFIG_TFM_PROFILE_TYPE_SMALL=y
CONFIG_MBEDTLS_PSA_CRYPTO_C=y

# Some size optimizations to accommodate non-secure builds.
CONFIG_NET_STATISTICS=n
CONFIG_NET_STATISTICS_WIFI=n
CONFIG_NET_STATISTICS_USER_API=n
CONFIG_NET_PKT_RX_COUNT=8
CONFIG_NET_PKT_TX_COUNT=4
CONFIG_NET_BUF_RX_COUNT=8
CONFIG_NET_BUF_TX_COUNT=8
CONFIG_NET_TC_TX_COUNT=1
CONFIG_NET_TX_STACK_SIZE=2048
CONFIG_NET_RX_STACK_SIZE=2048
```

## samples/wifi/provisioning/softap/boards/nrf54h20dk_nrf54h20_cpuapp.conf
```kconfig
CONFIG_WIFI_CREDENTIALS=y
# Needed for Wi-Fi credentials
CONFIG_FLASH=y
CONFIG_FLASH_PAGE_LAYOUT=y
CONFIG_FLASH_MAP=y
CONFIG_ZMS=y
CONFIG_SETTINGS=y
```

## samples/wifi/provisioning/softap/boards/nrf7120dk_nrf7120_cpuapp_ns.conf
```kconfig
#
# Copyright (c) 2026 Nordic Semiconductor
#
# SPDX-License-Identifier: LicenseRef-Nordic-5-Clause
#

CONFIG_WIFI_NRF71=y
CONFIG_NRF71_AP_MODE=y
CONFIG_NRF71_RX_NUM_BUFS=16
CONFIG_NRF71_MAX_TX_AGGREGATION=4
CONFIG_NRF_WIFI_DATA_HEAP_SIZE=90000

# nRF7120 (SOC_SERIES_NRF71) defaults TFM_ITS_ENCRYPTED=y, which conflicts with
# PSA_FRAMEWORK_HAS_MM_IOVEC (enabled via TFM_PROFILE_TYPE_SMALL in prj.conf).
# TLS credentials use PS (Protected Storage), not ITS, so disabling ITS encryption
# is safe here.
CONFIG_TFM_ITS_ENCRYPTED=n

CONFIG_DK_LIBRARY=n
```

## samples/wifi/provisioning/softap/sample.yaml
```yaml
sample:
  name: SoftAP Wi-Fi Provision sample
tests:
  sample.softap.wifi.provision:
    sysbuild: true
    build_only: true
    platform_allow: nrf7002dk/nrf5340/cpuapp/ns
    integration_platforms:
      - nrf7002dk/nrf5340/cpuapp/ns
    tags:
      - ci_build
      - sysbuild
      - ci_samples_wifi
  sample.nrf7002_eks.softap.wifi.provision:
    sysbuild: true
    build_only: true
    extra_args:
      - softap_SHIELD=nrf7002ek
    integration_platforms:
      - nrf5340dk/nrf5340/cpuapp/ns
    platform_allow:
      - nrf5340dk/nrf5340/cpuapp/ns
    tags:
      - ci_build
      - sysbuild
      - ci_samples_wifi
  sample.nrf54l15.softap.wifi.provision:
    sysbuild: true
    build_only: true
    extra_args:
      - softap_SHIELD="nrf7002eb_interposer_p1;nrf7002eb"
      - softap_SNIPPET=nrf70-wifi
      - CONFIG_HEAP_MEM_POOL_IGNORE_MIN=n
    integration_platforms:
      - nrf54l15dk/nrf54l15/cpuapp
    platform_allow:
      - nrf54l15dk/nrf54l15/cpuapp
    tags:
      - ci_build
      - sysbuild
      - ci_samples_wifi
  sample.54lm20dk.nrf7002eb2.softap.wifi.provision:
    sysbuild: true
    build_only: true
    extra_args:
      - softap_SHIELD="nrf7002eb2"
    integration_platforms:
      - nrf54lm20dk/nrf54lm20a/cpuapp
    platform_allow:
      - nrf54lm20dk/nrf54lm20a/cpuapp
    tags:
      - ci_build
      - sysbuild
      - ci_samples_wifi
```

## samples/wifi/radio_test/Kconfig.sysbuild
```kconfig
#
# Copyright (c) 2024 Nordic Semiconductor
#
# SPDX-License-Identifier: LicenseRef-Nordic-5-Clause
#

menu "Network core configuration"
	depends on SUPPORT_NETCORE

config SUPPORT_NETCORE_PERIPHERAL_RADIO_TEST
	bool
	default y

choice NETCORE
	prompt "Netcore image"
	depends on SUPPORT_NETCORE && !EXTERNAL_CONFIGURED_NETCORE
	default NETCORE_PERIPHERAL_RADIO_TEST if SOC_SERIES_NRF53X

config NETCORE_PERIPHERAL_RADIO_TEST
	bool "peripheral_radio_test"
	depends on SUPPORT_NETCORE_PERIPHERAL_RADIO_TEST
	help
	  Include peripheral_radio_test as the netcore image to use

endchoice

if !NETCORE_NONE

config NETCORE_IMAGE_NAME
	default "peripheral_radio_test" if NETCORE_PERIPHERAL_RADIO_TEST

config NETCORE_IMAGE_PATH
	default "${ZEPHYR_NRF_MODULE_DIR}/samples/peripheral/radio_test/" if NETCORE_PERIPHERAL_RADIO_TEST

endif # !NETCORE_NONE

endmenu

source "${ZEPHYR_BASE}/share/sysbuild/Kconfig"
```

## samples/wifi/radio_test/multi_domain/Kconfig.sysbuild
```kconfig
#
# Copyright (c) 2024 Nordic Semiconductor
#
# SPDX-License-Identifier: LicenseRef-Nordic-5-Clause
#


config SUPPORT_NETCORE_PERIPHERAL_RADIO_TEST
	bool
	default y if SOC_SERIES_NRF53 || SOC_SERIES_NRF54

choice NETCORE

config NETCORE_PERIPHERAL_RADIO_TEST
	bool "peripheral_radio_test"
	depends on SUPPORT_NETCORE_PERIPHERAL_RADIO_TEST
	help
	  Include peripheral_radio_test as the netcore image to use

endchoice

config NETCORE_IMAGE_NAME
	default "peripheral_radio_test" if NETCORE_PERIPHERAL_RADIO_TEST

config NETCORE_IMAGE_PATH
	default "$(ZEPHYR_NRF_MODULE_DIR)/samples/peripheral/radio_test/" if NETCORE_PERIPHERAL_RADIO_TEST

source "share/sysbuild/Kconfig"
```

## samples/wifi/radio_test/multi_domain/boards/nrf7002dk_nrf5340_cpuapp.conf
```kconfig
# Copyright (c) 2026 Nordic Semiconductor ASA
#
# SPDX-License-Identifier: LicenseRef-Nordic-5-Clause

CONFIG_NRF70_RADIO_TEST=y
CONFIG_NRF70_SR_COEX=y
```

## samples/wifi/radio_test/multi_domain/boards/nrf7120dk_nrf7120_cpuapp.conf
```kconfig
# Copyright (c) 2026 Nordic Semiconductor ASA
#
# SPDX-License-Identifier: LicenseRef-Nordic-5-Clause

CONFIG_NRF71_RADIO_TEST=y
CONFIG_NRF71_SR_COEX=y
CONFIG_HEAP_MEM_POOL_SIZE=65536
```

## samples/wifi/radio_test/multi_domain/sysbuild/mcuboot/boards/thingy91x_nrf9151_ns.conf
```kconfig
#
# Copyright (c) 2026 Nordic Semiconductor ASA
#
# SPDX-License-Identifier: LicenseRef-Nordic-5-Clause
#

# Enable SPI NOR driver so FLASH_HAS_DRIVER_ENABLED is set, which
# is required by FLASH_MAP (selected by PM_EXTERNAL_FLASH_MCUBOOT_SECONDARY).
CONFIG_SPI_NOR=y
CONFIG_SPI_NOR_SFDP_RUNTIME=y
```
