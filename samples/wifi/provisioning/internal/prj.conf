## CMakeLists.txt
```
#
# Copyright (c) 2025 Nordic Semiconductor ASA
#
# SPDX-License-Identifier: LicenseRef-Nordic-5-Clause
#

cmake_minimum_required(VERSION 3.20.0)

find_package(Zephyr REQUIRED HINTS $ENV{ZEPHYR_BASE})
project(wifi_prov_internal)

# WiFi Provisioning Configuration
if(CONFIG_WIFI_PROV_CONFIG)
  # Generate sample WiFi configuration
  set(PROTO_DIR ${ZEPHYR_NRF_MODULE_DIR}/subsys/net/lib/wifi_prov_core/proto)
  set(WIFI_CONFIG_SCRIPT ${PROTO_DIR}/generate_wifi_prov_config.py)
  set(WIFI_CONFIG_BIN ${CMAKE_CURRENT_BINARY_DIR}/wifi_config.bin)
  set(WIFI_CONFIG_INC ${CMAKE_CURRENT_BINARY_DIR}/wifi_config.inc)

  # Note: nanopb generation is already handled by wifi_prov_core library
  # which is linked to the app target below

  # Build the command with conditional certificate directory
  set(WIFI_CONFIG_CMD ${Python3_EXECUTABLE} ${WIFI_CONFIG_SCRIPT}
    "${CONFIG_WIFI_PROV_SSID}" "${CONFIG_WIFI_PROV_BSSID}"
    -w "${CONFIG_WIFI_PROV_PASSPHRASE}"
    -a ${CONFIG_WIFI_PROV_AUTH_MODE} -c ${CONFIG_WIFI_PROV_CHANNEL} -b ${CONFIG_WIFI_PROV_BAND}
    -o ${WIFI_CONFIG_BIN}
  )

  # Add certificate directory if specified
  if(CONFIG_WIFI_PROV_CERT_DIR)
    list(APPEND WIFI_CONFIG_CMD -d "${CONFIG_WIFI_PROV_CERT_DIR}")
  endif()

  # Generate the binary file
  add_custom_command(
    OUTPUT ${WIFI_CONFIG_BIN}
    COMMAND ${WIFI_CONFIG_CMD}
    DEPENDS ${WIFI_CONFIG_SCRIPT}
    DEPENDS wifi_prov_core
    WORKING_DIRECTORY ${PROTO_DIR}
    COMMENT "Generating sample WiFi configuration"
  )

  # Use Zephyr's generate_inc_file_for_target to create the .inc file
  generate_inc_file_for_target(app ${WIFI_CONFIG_BIN} ${WIFI_CONFIG_INC})

  # Include generated header directory
  target_include_directories(app PRIVATE ${CMAKE_CURRENT_BINARY_DIR})

  # Include WiFi provisioning library headers and link against it
  target_include_directories(app PRIVATE ${ZEPHYR_NRF_MODULE_DIR}/subsys/net/lib/wifi_prov_core)
  target_include_directories(app PRIVATE $<TARGET_PROPERTY:wifi_prov_core,BINARY_DIR>)
  target_include_directories(app PRIVATE ${ZEPHYR_BASE}/modules/lib/nanopb)
  target_link_libraries(app PRIVATE wifi_prov_core)
endif() # CONFIG_WIFI_PROV_CONFIG

target_sources(app PRIVATE
  src/main.c
  src/prov.c
  src/wifi_prov_transport_stub.c
)
```

## Kconfig
```
#
# Copyright (c) 2025 Nordic Semiconductor ASA
#
# SPDX-License-Identifier: LicenseRef-Nordic-5-Clause
#

menuconfig WIFI_PROV_CONFIG
	bool "WiFi provisioning configuration"
	default y
	help
	  This option enables WiFi provisioning configuration.

config WIFI_PROV_SSID
	string "WiFi SSID for provisioning"
	default "SampleWiFi"
	help
	  SSID for the WiFi network to be provisioned.

config WIFI_PROV_BSSID
	string "WiFi BSSID for provisioning"
	default "00:11:22:33:44:55"
	help
	  BSSID (MAC address) for the WiFi network to be provisioned.

config WIFI_PROV_PASSPHRASE
	string "WiFi passphrase for provisioning"
	default "samplepassword"
	help
	  Passphrase for the WiFi network to be provisioned.

config WIFI_PROV_AUTH_MODE
	int "WiFi authentication mode"
	default 4
	range 0 23
	help
	  Authentication mode for the WiFi network.
	  0: Open, 1: WEP, 2: WPA_PSK, 3: WPA2_PSK, etc.

config WIFI_PROV_CHANNEL
	int "WiFi channel"
	default 0
	range 0 233
	help
	  Channel for the WiFi network (2.4GHz band).

config WIFI_PROV_BAND
	int "WiFi band"
	default 0
	range 0 2
	help
	  Band for the WiFi network.
	  1: 2.4GHz, 2: 5GHz

config WIFI_PROV_CERT_DIR
	string "Certificate directory path"
	default ""
	help
	  Path to directory containing certificates for enterprise WiFi networks.
	  Leave empty for personal WiFi networks.
	  Certificates should be in PEM format.

config WIFI_PROV_PRIVATE_KEY_PASSWD
	string "Primary private key password"
	default ""
	help
	  Password for the primary private key file.
	  Leave empty to use EAP password.

config WIFI_PROV_PRIVATE_KEY_PASSWD2
	string "Secondary private key password"
	default ""
	help
	  Password for the secondary private key file.
	  Leave empty to use EAP password.

config WIFI_PROV_IDENTITY
	string "EAP identity"
	default "user@example.com"
	help
	  EAP identity for enterprise WiFi networks.

config WIFI_PROV_PASSWORD
	string "EAP password"
	default "user_password"
	help
	  EAP password for enterprise WiFi networks.

config WIFI_PROV_VOLATILE_MEMORY
	bool "Use volatile memory"
	help
	  Store WiFi configuration in volatile memory.
	  If disabled, configuration is stored persistently.

config WIFI_PROV_SCAN_BAND
	int "WiFi scan band"
	default 0
	range 0 2
	help
	  Band for WiFi scanning.
	  0: Any band, 1: 2.4GHz, 2: 5GHz

config WIFI_PROV_SCAN_PASSIVE
	bool "Passive scan mode"
	help
	  Enable passive scanning mode.
	  If disabled, active scanning is used.

config WIFI_PROV_SCAN_PERIOD_MS
	int "Scan period in milliseconds"
	default 0
	range 0 60000
	help
	  Period between WiFi scans in milliseconds.
	  0 means no periodic scanning.

config WIFI_PROV_SCAN_GROUP_CHANNELS
	int "Scan group channels"
	default 0
	range 0 255
	help
	  Group channels for WiFi scanning.
	  0 means no grouping.

config WIFI_PROV_MAX_DATA_SIZE
	int "Maximum Protobuf Data Size"
	default 16384
	range 1024 16384
	help
	  Maximum size for protobuf data in bytes.

config WIFI_PROV_MAX_BASE64_SIZE
	int "Maximum Base64 Input Size"
	default 32768
	range 2048 32768
	help
	  Maximum size for base64 input string in bytes.

module=WIFI_PROV_INTERNAL
module-str=WiFi provisioning internal
source "$(ZEPHYR_BASE)/subsys/logging/Kconfig.template.log_config"

source "Kconfig.zephyr"
```

## sample.yaml
```
sample:
  description: Internal Wi-Fi provision sample
  name: Internal Wi-Fi provision
tests:
  sample.nrf7002.int-wifi-provision:
    sysbuild: true
    build_only: true
    integration_platforms:
      - nrf7002dk/nrf5340/cpuapp
    platform_allow: nrf7002dk/nrf5340/cpuapp
    tags:
      - ci_build
      - sysbuild
      - ci_samples_wifi
  sample.nrf7001.int-wifi-provision:
    sysbuild: true
    build_only: true
    integration_platforms:
      - nrf7002dk/nrf5340/cpuapp/nrf7001
    platform_allow: nrf7002dk/nrf5340/cpuapp/nrf7001
    tags:
      - ci_build
      - sysbuild
      - ci_samples_wifi
    skip: true
  sample.nrf7002_eks.int-wifi-provision:
    sysbuild: true
    build_only: true
    extra_args: SHIELD=nrf7002ek
    integration_platforms:
      - nrf5340dk/nrf5340/cpuapp
    platform_allow: nrf5340dk/nrf5340/cpuapp
    tags:
      - ci_build
      - sysbuild
      - ci_samples_wifi
  sample.nrf7001_eks.int-wifi-provision:
    sysbuild: true
    build_only: true
    extra_args: SHIELD=nrf7002ek_nrf7001
    integration_platforms:
      - nrf5340dk/nrf5340/cpuapp
    platform_allow: nrf5340dk/nrf5340/cpuapp
    tags:
      - ci_build
      - sysbuild
      - ci_samples_wifi
```

## sysbuild.conf
```
#
# Copyright (c) 2025 Nordic Semiconductor ASA
#
# SPDX-License-Identifier: LicenseRef-Nordic-5-Clause
#

SB_CONFIG_WIFI_NRF70=y
SB_CONFIG_PARTITION_MANAGER=n
```

## prj.conf
```kconfig
#
# Copyright (c) 2025 Nordic Semiconductor ASA
#
# SPDX-License-Identifier: LicenseRef-Nordic-5-Clause
#
CONFIG_WIFI=y
CONFIG_WIFI_NRF70=y
CONFIG_NANOPB=y
CONFIG_WIFI_PROV_CORE=y
CONFIG_NET_L2_WIFI_MGMT=y
CONFIG_WIFI_CREDENTIALS=y
CONFIG_BASE64=y

# WPA supplicant
CONFIG_WIFI_NM_WPA_SUPPLICANT=y
CONFIG_NET_L2_WIFI_SHELL=y

# Networking
CONFIG_NETWORKING=y
CONFIG_NET_SOCKETS=y
CONFIG_NET_LOG=y
CONFIG_NET_IPV4=y
CONFIG_NET_UDP=y
CONFIG_NET_TCP=y
CONFIG_NET_DHCPV4=y
CONFIG_DNS_RESOLVER=y

CONFIG_NET_STATISTICS=y
CONFIG_NET_STATISTICS_WIFI=y
CONFIG_NET_STATISTICS_USER_API=y

CONFIG_NET_PKT_RX_COUNT=8
CONFIG_NET_PKT_TX_COUNT=8

# Below section is the primary contributor to SRAM and is currently
# tuned for performance, but this will be revisited in the future.
CONFIG_NET_BUF_RX_COUNT=16
CONFIG_NET_BUF_TX_COUNT=16
CONFIG_NET_TC_TX_COUNT=1

CONFIG_NET_IF_UNICAST_IPV6_ADDR_COUNT=4
CONFIG_NET_IF_MCAST_IPV6_ADDR_COUNT=5
CONFIG_NET_MAX_CONTEXTS=5
CONFIG_NET_CONTEXT_SYNC_RECV=y

CONFIG_INIT_STACKS=y

CONFIG_NET_L2_ETHERNET=y
CONFIG_NET_SHELL=y

# Memories
CONFIG_MAIN_STACK_SIZE=5200
# For Enterprise protobuf is ~10k
CONFIG_SHELL_STACK_SIZE=32768

CONFIG_NET_TX_STACK_SIZE=4096
CONFIG_NET_RX_STACK_SIZE=4096

# Debugging
CONFIG_STACK_SENTINEL=y
CONFIG_DEBUG_COREDUMP=y
CONFIG_DEBUG_COREDUMP_BACKEND_LOGGING=y
CONFIG_DEBUG_COREDUMP_MEMORY_DUMP_MIN=y
CONFIG_SHELL_CMDS_RESIZE=n
#CONFIG_DEBUG=y
CONFIG_WIFI_NM_WPA_SUPPLICANT_LOG_LEVEL_INF=y

# Kernel options
CONFIG_ENTROPY_GENERATOR=y
CONFIG_REBOOT=y

# Logging
CONFIG_LOG=y
CONFIG_PRINTK=y
CONFIG_SHELL=y
CONFIG_SHELL_GETOPT=y
CONFIG_DEVICE_SHELL=y
CONFIG_POSIX_TIMERS=y
CONFIG_DATE_SHELL=y
CONFIG_NET_CONFIG_AUTO_INIT=n
CONFIG_POSIX_API=y

CONFIG_WIFI_CREDENTIALS=y
CONFIG_FLASH=y
CONFIG_FLASH_PAGE_LAYOUT=y
CONFIG_FLASH_MAP=y
CONFIG_NVS=y
CONFIG_SETTINGS=y
CONFIG_SETTINGS_NVS=y

# printing of scan results puts pressure on queues in new locking
# design in net_mgmt. So, use a higher timeout for a crowded
# environment.
CONFIG_NET_MGMT_EVENT_QUEUE_TIMEOUT=5000
CONFIG_ZVFS_POLL_MAX=12
CONFIG_NET_MGMT_EVENT_QUEUE_SIZE=16

# UART and SHELL configurations for large protobuf data (16000 bytes)
CONFIG_SERIAL=y
CONFIG_UART_CONSOLE=y
CONFIG_UART_USE_RUNTIME_CONFIGURE=y
CONFIG_UART_LINE_CTRL=y

# Increase SHELL buffer sizes for large protobuf data
CONFIG_SHELL_BACKEND_SERIAL_RX_RING_BUFFER_SIZE=12000

# Increase SHELL command buffer size for large protobuf data
CONFIG_SHELL_CMD_BUFF_SIZE=12000

# Enable SHELL features for large data handling
CONFIG_SHELL_GETOPT=y
CONFIG_SHELL_HELP=y
CONFIG_SHELL_HELP_ON_WRONG_ARGUMENT_COUNT=y
CONFIG_SHELL_METAKEYS=y
CONFIG_SHELL_TAB=y
CONFIG_SHELL_TAB_AUTOCOMPLETION=y
CONFIG_SHELL_WILDCARD=y
CONFIG_SHELL_CMDS_RESIZE=n

# Enable LTO to save flash memory
CONFIG_LTO=y
CONFIG_ISR_TABLES_LOCAL_DECLARATION=y
```

## src/main.c
```c
/*
 * Copyright (c) 2025 Nordic Semiconductor ASA
 *
 * SPDX-License-Identifier: LicenseRef-Nordic-5-Clause
 */

#include <zephyr/kernel.h>
#include <zephyr/shell/shell.h>
#include <zephyr/logging/log.h>

#include <net/wifi_prov_core/wifi_prov_core.h>

LOG_MODULE_REGISTER(wifi_prov_internal, CONFIG_LOG_DEFAULT_LEVEL);

int main(void)
{
	LOG_INF("WiFi Provisioning Internal Sample");
	LOG_INF("This sample demonstrates the core WiFi provisioning library functionality");

#if defined(CONFIG_WIFI_PROV_CONFIG)
	/* Initialize the WiFi provisioning service */
	int ret;

	ret = wifi_prov_init();
	if (ret < 0) {
		LOG_ERR("Failed to initialize WiFi provisioning service: %d", ret);
		return -1;
	}
	LOG_INF("WiFi provisioning service initialized successfully");
#endif

	return 0;
}
```

## src/prov.c
```c
/*
 * Copyright (c) 2025 Nordic Semiconductor ASA
 *
 * SPDX-License-Identifier: LicenseRef-Nordic-5-Clause
 */

#include <zephyr/kernel.h>
#include <zephyr/shell/shell.h>
#include <zephyr/net_buf.h>
#include <zephyr/logging/log.h>
#include <zephyr/sys/base64.h>
#include <stdlib.h>

#include <net/wifi_prov_core/wifi_prov_core.h>

/* Include nanopb headers */
#include "pb_decode.h"
#include "pb_encode.h"

/* Include generated protobuf headers */
#include "request.pb.h"
#include "response.pb.h"
#include "result.pb.h"
#include "common.pb.h"

LOG_MODULE_REGISTER(prov, CONFIG_WIFI_PROV_INTERNAL_LOG_LEVEL);

/* Generated Wi-Fi configuration data */
static const uint8_t wifi_config_data[] = {
#include "wifi_config.inc"
};

static const size_t wifi_config_data_len = sizeof(wifi_config_data);

/* Static buffer for requests */
static struct net_buf_simple req_buf_static;
static struct net_buf_simple *req_buf;

/**
 * @brief Convert base64 string to binary data using Zephyr's base64_decode
 */
static int base64_decode_string(const char *base64_str, uint8_t **binary, size_t *binary_len)
{
	size_t len = strlen(base64_str);
	size_t decoded_len = 0;
	uint8_t *decoded_data;
	int ret;

	/* Check input length */
	if (len > CONFIG_WIFI_PROV_MAX_BASE64_SIZE) {
		return -EINVAL;
	}

	/* Calculate decoded size (base64 is 4 chars per 3 bytes) */
	decoded_len = (len * 3) / 4;
	if (decoded_len > CONFIG_WIFI_PROV_MAX_DATA_SIZE) {
		return -EINVAL;
	}

	/* Allocate memory for decoded data */
	decoded_data = k_malloc(decoded_len);
	if (!decoded_data) {
		return -ENOMEM;
	}

	/* Use Zephyr's base64_decode function */
	ret = base64_decode(decoded_data, decoded_len, binary_len,
			   (const uint8_t *)base64_str, len);
	if (ret < 0) {
		k_free(decoded_data);
		return ret;
	}

	*binary = decoded_data;
	return 0;
}

/**
 * @brief Decode and log Wi-Fi provisioning request
 */
static void decode_request(const uint8_t *data, size_t len)
{
	Request request = Request_init_zero;
	pb_istream_t stream;

	stream = pb_istream_from_buffer(data, len);

	bool decode_result = pb_decode(&stream, Request_fields, &request);

	if (decode_result) {
		LOG_INF("=== Wi-Fi Provisioning Request ===");
		LOG_INF("Operation: %d", request.op_code);

		switch (request.op_code) {
		case OpCode_GET_STATUS:
			LOG_INF("Type: GET_STATUS");
			break;
		case OpCode_START_SCAN:
			LOG_INF("Type: START_SCAN");
			break;
		case OpCode_STOP_SCAN:
			LOG_INF("Type: STOP_SCAN");
			break;
		case OpCode_SET_CONFIG:
			LOG_INF("Type: SET_CONFIG");
			if (request.has_config) {
				LOG_INF("  SSID: %.*s", (int)request.config.wifi.ssid.size,
					   request.config.wifi.ssid.bytes);
				LOG_INF("  BSSID: %02x:%02x:%02x:%02x:%02x:%02x",
					request.config.wifi.bssid.bytes[0],
					request.config.wifi.bssid.bytes[1],
					request.config.wifi.bssid.bytes[2],
					request.config.wifi.bssid.bytes[3],
					request.config.wifi.bssid.bytes[4],
					request.config.wifi.bssid.bytes[5]);
				LOG_INF("  Channel: %d", request.config.wifi.channel);
				LOG_INF("  Auth mode: %d", request.config.wifi.auth);
				if (request.config.has_passphrase) {
					LOG_INF("  Passphrase length: %d",
						(int)request.config.passphrase.size);
				}
			}
			break;
		case OpCode_FORGET_CONFIG:
			LOG_INF("Type: FORGET_CONFIG");
			break;
		default:
			LOG_INF("Type: UNKNOWN (%d)", request.op_code);
			break;
		}
		LOG_INF("===============================");
	} else {
		LOG_ERR("Failed to decode request: %s", PB_GET_ERROR(&stream));
		LOG_ERR("pb_decode returned: %s", decode_result ? "true" : "false");
		LOG_ERR("Data length: %d bytes", len);
		LOG_HEXDUMP_ERR(data, len, "Raw request data:");
	}
}

/**
 * @brief Decode and display scan results in human-readable format
 */
static void decode_scan_results(const uint8_t *data, size_t len)
{
	/* Try to decode as a single ScanRecord first */
	ScanRecord scan_record = ScanRecord_init_zero;
	pb_istream_t stream;

	stream = pb_istream_from_buffer(data, len);

	bool decode_result = pb_decode(&stream, ScanRecord_fields, &scan_record);

	if (decode_result) {
		LOG_INF("=== Wi-Fi Scan Record ===");

		if (scan_record.has_wifi) {
			const WifiInfo *wifi = &scan_record.wifi;

			/* SSID */
			if (wifi->ssid.size > 0) {
				LOG_INF("SSID: %.*s", (int)wifi->ssid.size,
					wifi->ssid.bytes);
			} else {
				LOG_INF("SSID: <hidden>");
			}

			/* BSSID */
			if (wifi->bssid.size == 6) {
				LOG_INF("BSSID: %02x:%02x:%02x:%02x:%02x:%02x",
					wifi->bssid.bytes[0],
					wifi->bssid.bytes[1],
					wifi->bssid.bytes[2],
					wifi->bssid.bytes[3],
					wifi->bssid.bytes[4],
					wifi->bssid.bytes[5]);
			}

			/* Channel */
			LOG_INF("Channel: %d", wifi->channel);

			/* Band */
			if (wifi->has_band) {
				const char *band_str = "UNKNOWN";

				switch (wifi->band) {
				case Band_BAND_ANY:
					band_str = "ANY";
					break;
				case Band_BAND_2_4_GH:
					band_str = "2.4 GHz";
					break;
				case Band_BAND_5_GH:
					band_str = "5 GHz";
					break;
				}
				LOG_INF("Band: %s", band_str);
			}

			/* Auth Mode */
			if (wifi->has_auth) {
				const char *auth_str = "UNKNOWN";

				switch (wifi->auth) {
				case AuthMode_OPEN:
					auth_str = "OPEN";
					break;
				case AuthMode_WEP:
					auth_str = "WEP";
					break;
				case AuthMode_WPA_PSK:
					auth_str = "WPA_PSK";
					break;
				case AuthMode_WPA2_PSK:
					auth_str = "WPA2_PSK";
					break;
				case AuthMode_WPA_WPA2_PSK:
					auth_str = "WPA_WPA2_PSK";
					break;
				case AuthMode_WPA2_ENTERPRISE:
					auth_str = "WPA2_ENTERPRISE";
					break;
				case AuthMode_WPA3_PSK:
					auth_str = "WPA3_PSK";
					break;
				case AuthMode_NONE:
					auth_str = "NONE";
					break;
				case AuthMode_PSK:
					auth_str = "PSK";
					break;
				case AuthMode_PSK_SHA256:
					auth_str = "PSK_SHA256";
					break;
				case AuthMode_SAE:
					auth_str = "SAE";
					break;
				default:
					auth_str = "UNKNOWN";
					break;
				}
				LOG_INF("Security: %s", auth_str);
			}
		}

		/* RSSI */
		if (scan_record.has_rssi) {
			LOG_INF("RSSI: %d dBm", scan_record.rssi);
		}

		LOG_INF("===============================");
	} else {
		/* Try to decode as a Result message */
		stream = pb_istream_from_buffer(data, len);
		Result result = Result_init_zero;

		decode_result = pb_decode(&stream, Result_fields, &result);

		if (decode_result && result.has_scan_record) {
			LOG_INF("=== Wi-Fi Scan Result ===");

			const ScanRecord *record = &result.scan_record;

			if (record->has_wifi) {
				const WifiInfo *wifi = &record->wifi;

				/* SSID */
				if (wifi->ssid.size > 0) {
					LOG_INF("SSID: %.*s", (int)wifi->ssid.size,
						wifi->ssid.bytes);
				} else {
					LOG_INF("SSID: <hidden>");
				}

				/* BSSID */
				if (wifi->bssid.size == 6) {
					LOG_INF("BSSID: %02x:%02x:%02x:%02x:%02x:%02x",
						wifi->bssid.bytes[0],
						wifi->bssid.bytes[1],
						wifi->bssid.bytes[2],
						wifi->bssid.bytes[3],
						wifi->bssid.bytes[4],
						wifi->bssid.bytes[5]);
				}

				/* Channel */
				LOG_INF("Channel: %d", wifi->channel);

				/* Band */
				if (wifi->has_band) {
					const char *band_str = "UNKNOWN";

					switch (wifi->band) {
					case Band_BAND_ANY:
						band_str = "ANY";
						break;
					case Band_BAND_2_4_GH:
						band_str = "2.4 GHz";
						break;
					case Band_BAND_5_GH:
						band_str = "5 GHz";
						break;
					}
					LOG_INF("Band: %s", band_str);
				}

				/* Auth Mode */
				if (wifi->has_auth) {
					const char *auth_str = "UNKNOWN";

					switch (wifi->auth) {
					case AuthMode_OPEN:
						auth_str = "OPEN";
						break;
					case AuthMode_WEP:
						auth_str = "WEP";
						break;
					case AuthMode_WPA_PSK:
						auth_str = "WPA_PSK";
						break;
					case AuthMode_WPA2_PSK:
						auth_str = "WPA2_PSK";
						break;
					case AuthMode_WPA_WPA2_PSK:
						auth_str = "WPA_WPA2_PSK";
						break;
					case AuthMode_WPA2_ENTERPRISE:
						auth_str = "WPA2_ENTERPRISE";
						break;
					case AuthMode_WPA3_PSK:
						auth_str = "WPA3_PSK";
						break;
					case AuthMode_NONE:
						auth_str = "NONE";
						break;
					case AuthMode_PSK:
						auth_str = "PSK";
						break;
					case AuthMode_PSK_SHA256:
						auth_str = "PSK_SHA256";
						break;
					case AuthMode_SAE:
						auth_str = "SAE";
						break;
					default:
						auth_str = "UNKNOWN";
						break;
					}
					LOG_INF("Security: %s", auth_str);
				}
			}

			/* RSSI */
			if (record->has_rssi) {
				LOG_INF("RSSI: %d dBm", record->rssi);
			}

			/* Connection State */
			if (result.has_state) {
				const char *state_str = "UNKNOWN";

				switch (result.state) {
				case ConnectionState_DISCONNECTED:
					state_str = "DISCONNECTED";
					break;
				case ConnectionState_AUTHENTICATION:
					state_str = "AUTHENTICATION";
					break;
				case ConnectionState_ASSOCIATION:
					state_str = "ASSOCIATION";
					break;
				case ConnectionState_OBTAINING_IP:
					state_str = "OBTAINING_IP";
					break;
				case ConnectionState_CONNECTED:
					state_str = "CONNECTED";
					break;
				case ConnectionState_CONNECTION_FAILED:
					state_str = "CONNECTION_FAILED";
					break;
				}
				LOG_INF("Connection State: %s", state_str);
			}

			/* Failure Reason */
			if (result.has_reason) {
				const char *reason_str = "UNKNOWN";

				switch (result.reason) {
				case ConnectionFailureReason_AUTH_ERROR:
					reason_str = "AUTH_ERROR";
					break;
				case ConnectionFailureReason_NETWORK_NOT_FOUND:
					reason_str = "NETWORK_NOT_FOUND";
					break;
				case ConnectionFailureReason_TIMEOUT:
					reason_str = "TIMEOUT";
					break;
				case ConnectionFailureReason_FAIL_IP:
					reason_str = "FAIL_IP";
					break;
				case ConnectionFailureReason_FAIL_CONN:
					reason_str = "FAIL_CONN";
					break;
				}
				LOG_INF("Failure Reason: %s", reason_str);
			}

			LOG_INF("===============================");
		} else {
			LOG_ERR("Failed to decode scan results: %s", PB_GET_ERROR(&stream));
			LOG_ERR("pb_decode returned: %s", decode_result ? "true" : "false");
			LOG_ERR("Data length: %d bytes", len);
			LOG_HEXDUMP_ERR(data, len, "Raw scan results data:");
		}
	}
}

/**
 * @brief Wi-Fi provisioning shell command handler
 *
 * This command sends the pre-generated Wi-Fi configuration data
 * to the Wi-Fi provisioning service.
 */
static int cmd_wifi_prov(const struct shell *shell, size_t argc, char *argv[])
{
	int ret;

	if (argc != 1) {
		shell_error(shell, "Usage: wifi_prov");
		return -EINVAL;
	}

	shell_info(shell, "Sending Wi-Fi configuration to provisioning service...");

	/* Allocate buffer for the request */
	req_buf = &req_buf_static;
	net_buf_simple_init_with_data(req_buf,
								 (void *)wifi_config_data,
								 wifi_config_data_len);

	/* Decode and log the request being sent */
	decode_request(req_buf->data, req_buf->len);

	/* Send the configuration to the Wi-Fi provisioning service */
	ret = wifi_prov_recv_req(req_buf);
	if (ret < 0) {
		shell_error(shell, "Failed to send Wi-Fi configuration: %d", ret);
		return ret;
	}

	shell_info(shell, "Wi-Fi configuration sent successfully");
	shell_info(shell, "Configuration size: %d bytes", wifi_config_data_len);

	req_buf = NULL;

	return 0;
}

/**
 * @brief Send raw binary data to Wi-Fi provisioning service
 */
static int cmd_wifi_prov_raw(const struct shell *shell, size_t argc, char *argv[])
{
	int ret;
	uint8_t *raw_data = NULL;
	size_t raw_data_len = 0;
	static struct net_buf_simple raw_buf;

	if (argc != 2) {
		shell_error(shell, "Usage: wifi_prov_raw <protobuf_encoded_data>");
		shell_error(shell, "Example: wifi_prov_raw "
				"CARaLgoaCgpTYW1wbGVXaUZpEgYAESIzRFUYAiAAKAMSDnNhbXBsZXBhc3N3b3JkIAA=");
		return -EINVAL;
	}

	shell_info(shell, "Sending protobuf-encoded data to provisioning service...");

	/* Convert protobuf-encoded string to binary */
	ret = base64_decode_string(argv[1], &raw_data, &raw_data_len);
	if (ret < 0) {
		shell_error(shell, "Invalid protobuf-encoded string format: %d", ret);
		return ret;
	}

	shell_info(shell, "Binary data size: %d bytes", raw_data_len);

	/* Initialize buffer with the binary data */
	net_buf_simple_init_with_data(&raw_buf, raw_data, raw_data_len);

	/* Decode and log the request being sent */
	decode_request(raw_buf.data, raw_buf.len);

	/* Send the raw data to the Wi-Fi provisioning service */
	ret = wifi_prov_recv_req(&raw_buf);
	if (ret < 0) {
		shell_error(shell, "Failed to send protobuf data: %d", ret);
		k_free(raw_data);
		return ret;
	}

	shell_info(shell, "Protobuf data sent successfully");

	/* Clean up */
	k_free(raw_data);

	return 0;
}

/**
 * @brief Get Wi-Fi provisioning status
 */
static int cmd_wifi_prov_get_status(const struct shell *shell, size_t argc, char *argv[])
{
	int ret;

	if (argc != 1) {
		shell_error(shell, "Usage: wifi_prov_get_status");
		return -EINVAL;
	}

	shell_info(shell, "Getting Wi-Fi provisioning status...");

	/* Create a simple GET_STATUS request */
	static uint8_t status_req_data[] = {0x08, 0x01}; /* op_code = GET_STATUS */
	static struct net_buf_simple status_req_buf;

	net_buf_simple_init_with_data(&status_req_buf, status_req_data, sizeof(status_req_data));

	/* Decode and log the request being sent */
	decode_request(status_req_buf.data, status_req_buf.len);

	ret = wifi_prov_recv_req(&status_req_buf);
	if (ret < 0) {
		shell_error(shell, "Failed to get Wi-Fi status: %d", ret);
		return ret;
	}

	shell_info(shell, "Wi-Fi status request sent successfully");
	return 0;
}

/**
 * @brief Start Wi-Fi scan
 */
static int cmd_wifi_prov_start_scan(const struct shell *shell, size_t argc, char *argv[])
{
	int ret;

	if (argc != 1) {
		shell_error(shell, "Usage: wifi_prov_start_scan");
		return -EINVAL;
	}

	shell_info(shell, "Starting Wi-Fi scan...");

	/* Create a simple START_SCAN request */
	static uint8_t scan_req_data[] = {0x08, 0x02}; /* op_code = START_SCAN */
	static struct net_buf_simple scan_req_buf;

	net_buf_simple_init_with_data(&scan_req_buf, scan_req_data, sizeof(scan_req_data));

	/* Decode and log the request being sent */
	decode_request(scan_req_buf.data, scan_req_buf.len);

	ret = wifi_prov_recv_req(&scan_req_buf);
	if (ret < 0) {
		shell_error(shell, "Failed to start Wi-Fi scan: %d", ret);
		return ret;
	}

	shell_info(shell, "Wi-Fi scan started successfully");
	return 0;
}

/**
 * @brief Stop Wi-Fi scan
 */
static int cmd_wifi_prov_stop_scan(const struct shell *shell, size_t argc, char *argv[])
{
	int ret;

	if (argc != 1) {
		shell_error(shell, "Usage: wifi_prov_stop_scan");
		return -EINVAL;
	}

	shell_info(shell, "Stopping Wi-Fi scan...");

	/* Create a simple STOP_SCAN request */
	static uint8_t stop_scan_req_data[] = {0x08, 0x03}; /* op_code = STOP_SCAN */
	static struct net_buf_simple stop_scan_req_buf;

	net_buf_simple_init_with_data(&stop_scan_req_buf, stop_scan_req_data,
					sizeof(stop_scan_req_data));

	/* Decode and log the request being sent */
	decode_request(stop_scan_req_buf.data, stop_scan_req_buf.len);

	ret = wifi_prov_recv_req(&stop_scan_req_buf);
	if (ret < 0) {
		shell_error(shell, "Failed to stop Wi-Fi scan: %d", ret);
		return ret;
	}

	shell_info(shell, "Wi-Fi scan stopped successfully");
	return 0;
}

/**
 * @brief Set Wi-Fi configuration
 */
static int cmd_wifi_prov_set_config(const struct shell *shell, size_t argc, char *argv[])
{
	int ret;

	if (argc != 1) {
		shell_error(shell, "Usage: wifi_prov_set_config");
		return -EINVAL;
	}

	shell_info(shell, "Setting Wi-Fi configuration...");

	/* Use the pre-generated Wi-Fi configuration */
	static struct net_buf_simple config_req_buf;

	net_buf_simple_init_with_data(&config_req_buf,
								 (void *)wifi_config_data,
								 wifi_config_data_len);

	/* Decode and log the request being sent */
	decode_request(config_req_buf.data, config_req_buf.len);

	ret = wifi_prov_recv_req(&config_req_buf);
	if (ret < 0) {
		shell_error(shell, "Failed to set Wi-Fi configuration: %d", ret);
		return ret;
	}

	shell_info(shell, "Wi-Fi configuration set successfully");
	return 0;
}

/**
 * @brief Forget Wi-Fi configuration
 */
static int cmd_wifi_prov_forget_config(const struct shell *shell, size_t argc, char *argv[])
{
	int ret;

	if (argc != 1) {
		shell_error(shell, "Usage: wifi_prov_forget_config");
		return -EINVAL;
	}

	shell_info(shell, "Forgetting Wi-Fi configuration...");

	/* Create a simple FORGET_CONFIG request */
	static uint8_t forget_req_data[] = {0x08, 0x05}; /* op_code = FORGET_CONFIG */
	static struct net_buf_simple forget_req_buf;

	net_buf_simple_init_with_data(&forget_req_buf, forget_req_data, sizeof(forget_req_data));

	/* Decode and log the request being sent */
	decode_request(forget_req_buf.data, forget_req_buf.len);

	ret = wifi_prov_recv_req(&forget_req_buf);
	if (ret < 0) {
		shell_error(shell, "Failed to forget Wi-Fi configuration: %d", ret);
		return ret;
	}

	shell_info(shell, "Wi-Fi configuration forgotten successfully");
	return 0;
}

/**
 * @brief Dump scan results in human-readable format
 */
static int cmd_wifi_prov_dump_scan(const struct shell *shell, size_t argc, char *argv[])
{
	int ret;
	uint8_t *scan_data = NULL;
	size_t scan_data_len = 0;

	if (argc != 2) {
		shell_error(shell, "Usage: wifi_prov dump_scan <base64_scan_results>");
		shell_error(shell, "Example: wifi_prov dump_scan "
				"<base64_encoded_scan_results_data>");
		return -EINVAL;
	}

	shell_info(shell, "Decoding scan results...");

	/* Convert base64 string to binary */
	ret = base64_decode_string(argv[1], &scan_data, &scan_data_len);
	if (ret < 0) {
		shell_error(shell, "Invalid base64 format: %d", ret);
		return ret;
	}

	shell_info(shell, "Scan results data size: %d bytes", scan_data_len);

	/* Decode and display scan results */
	decode_scan_results(scan_data, scan_data_len);

	/* Clean up */
	k_free(scan_data);

	return 0;
}

/**
 * @brief Wi-Fi provisioning status shell command handler
 *
 * This command shows information about the generated Wi-Fi configuration.
 */
static int cmd_wifi_prov_info(const struct shell *shell, size_t argc, char *argv[])
{
	ARG_UNUSED(argc);
	ARG_UNUSED(argv);

	shell_info(shell, "Wi-Fi Configuration Information:");
	shell_info(shell, "  Size: %d bytes", wifi_config_data_len);
	shell_info(shell, "  Data: %p", wifi_config_data);

	/* Decode and display using decode_request for consistency */
	shell_info(shell, "=== Decoded Wi-Fi Configuration ===");
	decode_request(wifi_config_data, wifi_config_data_len);

	return 0;
}

SHELL_STATIC_SUBCMD_SET_CREATE(wifi_prov_subcmds,
	SHELL_CMD(info, NULL, "Show Wi-Fi configuration information", cmd_wifi_prov_info),
	SHELL_CMD(get_status, NULL, "Get Wi-Fi provisioning status", cmd_wifi_prov_get_status),
	SHELL_CMD(start_scan, NULL, "Start Wi-Fi scan", cmd_wifi_prov_start_scan),
	SHELL_CMD(stop_scan, NULL, "Stop Wi-Fi scan",
	cmd_wifi_prov_stop_scan),
	SHELL_CMD(set_config, NULL, "Set Wi-Fi configuration", cmd_wifi_prov_set_config),
	SHELL_CMD(forget_config, NULL, "Forget Wi-Fi configuration", cmd_wifi_prov_forget_config),
	SHELL_CMD(raw, NULL, "Send raw binary data (hex format)", cmd_wifi_prov_raw),
	SHELL_CMD(dump_scan, NULL,
	"Decode and display scan results (Base64)", cmd_wifi_prov_dump_scan),
	SHELL_SUBCMD_SET_END
);

SHELL_CMD_REGISTER(wifi_prov, &wifi_prov_subcmds, "Wi-Fi provisioning commands", cmd_wifi_prov);
```

## src/wifi_prov_transport_stub.c
```c
/*
 * Copyright (c) 2025 Nordic Semiconductor ASA
 *
 * SPDX-License-Identifier: LicenseRef-Nordic-5-Clause
 */

#include <zephyr/net_buf.h>
#include <zephyr/logging/log.h>
#include <net/wifi_prov_core/wifi_prov_core.h>

/* Include nanopb headers */
#include "pb_decode.h"
#include "pb_encode.h"

/* Include generated protobuf headers */
#include "request.pb.h"
#include "response.pb.h"
#include "result.pb.h"
#include "common.pb.h"

LOG_MODULE_REGISTER(wifi_prov_transport, CONFIG_WIFI_PROV_INTERNAL_LOG_LEVEL);

/**
 * @brief Decode and log Wi-Fi provisioning response
 */
static void decode_response(const uint8_t *data, size_t len)
{
	Response response = Response_init_zero;
	pb_istream_t stream = pb_istream_from_buffer(data, len);

	bool _decode_result = pb_decode(&stream, Response_fields, &response);

	if (_decode_result) {
		LOG_INF("=== Wi-Fi Provisioning Response ===");

		if (response.has_request_op_code) {
			LOG_INF("Request OpCode: %d", response.request_op_code);
		}

		if (response.has_status) {
			LOG_INF("Status: %d", response.status);
		}

		/* Log simple responses even without device_status */
		LOG_INF("Response decoded successfully");

		if (response.has_device_status) {
			LOG_INF("Device Status:");
			if (response.device_status.has_state) {
				LOG_INF("  Connection State: %d", response.device_status.state);
			}

			if (response.device_status.has_provisioning_info) {
				LOG_INF("  Provisioning Info:");
				LOG_INF("    SSID: %.*s",
					   (int)response.device_status.provisioning_info.ssid.size,
					   response.device_status.provisioning_info.ssid.bytes);
				LOG_INF("    BSSID: %02x:%02x:%02x:%02x:%02x:%02x",
					response.device_status.provisioning_info.bssid.bytes[0],
					response.device_status.provisioning_info.bssid.bytes[1],
					response.device_status.provisioning_info.bssid.bytes[2],
					response.device_status.provisioning_info.bssid.bytes[3],
					response.device_status.provisioning_info.bssid.bytes[4],
					response.device_status.provisioning_info.bssid.bytes[5]);
				LOG_INF("    Channel: %d",
					response.device_status.provisioning_info.channel);
				LOG_INF("    Auth: %d",
					response.device_status.provisioning_info.auth);
			}

			if (response.device_status.has_connection_info) {
				LOG_INF("  Connection Info:");
				LOG_INF("    IP4 Addr: %d.%d.%d.%d",
					response.device_status.connection_info.ip4_addr.bytes[0],
					response.device_status.connection_info.ip4_addr.bytes[1],
					response.device_status.connection_info.ip4_addr.bytes[2],
					response.device_status.connection_info.ip4_addr.bytes[3]);
			}

			if (response.device_status.has_scan_info) {
				LOG_INF("  Scan Info:");
				LOG_INF("    Band: %d", response.device_status.scan_info.band);
				LOG_INF("    Passive: %s",
					response.device_status.scan_info.passive ?
					"true" : "false");
				LOG_INF("    Period (ms): %d",
					response.device_status.scan_info.period_ms);
				LOG_INF("    Group Channels: %d",
					response.device_status.scan_info.group_channels);
		}

		LOG_INF("=================================");
		}
	} else {
		LOG_ERR("Failed to decode response: %s", PB_GET_ERROR(&stream));
		LOG_ERR("pb_decode returned: %s", _decode_result ? "true" : "false");
		LOG_ERR("Data length: %d bytes", len);
		LOG_HEXDUMP_ERR(data, len, "Raw response data:");
	}
}

/**
 * @brief Decode and log Wi-Fi provisioning result
 */
static void decode_result(const uint8_t *data, size_t len)
{
	Result result = Result_init_zero;
	pb_istream_t stream = pb_istream_from_buffer(data, len);

	bool _decode_result = pb_decode(&stream, Result_fields, &result);

	if (_decode_result) {
		LOG_INF("=== Wi-Fi Provisioning Result ===");

		if (result.has_state) {
			LOG_INF("Connection State: %d", result.state);
		}

		if (result.has_reason) {
			LOG_INF("Failure Reason: %d", result.reason);
		}

		if (result.has_scan_record) {
			LOG_INF("Scan Record:");
			if (result.scan_record.has_wifi) {
				LOG_INF("  SSID: %.*s",
					   (int)result.scan_record.wifi.ssid.size,
					   result.scan_record.wifi.ssid.bytes);
				LOG_INF("  BSSID: %02x:%02x:%02x:%02x:%02x:%02x",
					   result.scan_record.wifi.bssid.bytes[0],
					   result.scan_record.wifi.bssid.bytes[1],
					   result.scan_record.wifi.bssid.bytes[2],
					   result.scan_record.wifi.bssid.bytes[3],
					   result.scan_record.wifi.bssid.bytes[4],
					   result.scan_record.wifi.bssid.bytes[5]);
				LOG_INF("  Channel: %d", result.scan_record.wifi.channel);
				LOG_INF("  Auth: %d", result.scan_record.wifi.auth);
			}

			if (result.scan_record.has_rssi) {
				LOG_INF("  RSSI: %d", result.scan_record.rssi);
			}
		}

		LOG_INF("===============================");
	} else {
		LOG_ERR("Failed to decode result: %s", PB_GET_ERROR(&stream));
		LOG_ERR("pb_decode returned: %s", _decode_result ? "true" : "false");
		LOG_ERR("Data length: %d bytes", len);
		LOG_HEXDUMP_ERR(data, len, "Raw result data:");
	}
}

int wifi_prov_send_rsp(struct net_buf_simple *rsp)
{
	LOG_INF("Wi-Fi provisioning response sent (stub): %d bytes", rsp->len);

	if (rsp->len > 0) {
		decode_response(rsp->data, rsp->len);
	}

	return 0;
}

int wifi_prov_send_result(struct net_buf_simple *result)
{
	LOG_INF("Wi-Fi provisioning result sent (stub): %d bytes", result->len);

	if (result->len > 0) {
		decode_result(result->data, result->len);
	}

	return 0;
}
```
