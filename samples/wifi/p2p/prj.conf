## CMakeLists.txt
```
#
# Copyright (c) 2026 Nordic Semiconductor ASA
#
# SPDX-License-Identifier: LicenseRef-Nordic-5-Clause
#

cmake_minimum_required(VERSION 3.20.0)

find_package(Zephyr REQUIRED HINTS $ENV{ZEPHYR_BASE})
project(nrf_wifi_p2p)

target_include_directories(app PUBLIC ${ZEPHYR_BASE}/subsys/net/ip)

target_sources(app PRIVATE src/main.c)
target_sources_ifdef(CONFIG_SAMPLE_P2P_CLI_MODE app PRIVATE src/p2p_cli.c)
target_sources_ifdef(CONFIG_SAMPLE_P2P_GO_MODE app PRIVATE src/p2p_go.c)
target_sources_ifdef(CONFIG_SAMPLE_P2P_GO_PERSISTENT_MODE app PRIVATE src/p2p_go_persistent.c)
```

## Kconfig
```
#
# Copyright (c) 2026 Nordic Semiconductor
#
# SPDX-License-Identifier: LicenseRef-Nordic-5-Clause
#

menu "Nordic P2P sample"

choice SAMPLE_P2P_MODE
	prompt "P2P device mode"
	default SAMPLE_P2P_CLI_MODE

config SAMPLE_P2P_CLI_MODE
	bool "CLI mode (Client: Find peer and connect)"
	help
	  This configuration option enables the device to act as a P2P client.

config SAMPLE_P2P_GO_MODE
	bool "GO mode (Group owner: Group add/remove)"
	help
	  This configuration option enables the device to act as a P2P Group Owner.
	  AP mode is enabled per board in the sample's boards/ configuration files.

endchoice

if SAMPLE_P2P_CLI_MODE

choice SAMPLE_P2P_DISCOVERY_TYPE
	prompt "P2P discovery type"
	default SAMPLE_P2P_DISCOVERY_FULL

config SAMPLE_P2P_DISCOVERY_FULL
	bool "Full discovery"
	help
	  This configuration option enables the device to scan
	  all Wi‑Fi channels while searching for P2P peers.

config SAMPLE_P2P_DISCOVERY_SOCIAL
	bool "Social discovery"
	help
	  This configuration option enables the device to
	  scan only the Wi-Fi Direct social channels (1, 6, 11).

config SAMPLE_P2P_DISCOVERY_PROGRESSIVE
	bool "Progressive discovery"
	help
	  This configuration option enables alternating
	  between social channel scans and full scans.

endchoice

config SAMPLE_P2P_FIND_TIMEOUT_S
	int "P2P discovery timeout (seconds)"
	default 30
	help
	  This configuration option sets the timeout, in seconds,
	  during which the device performs P2P peer discovery.

config SAMPLE_P2P_GO_INTENT_VALUE
	int "GO intent value"
	default 0
	range 0 15
	help
	  This configuration option sets the Group Owner
	  intent value used during P2P negotiation.

config SAMPLE_P2P_FREQUENCY
	int "P2P connection frequency (MHz)"
	default 2462
	help
	  This configuration option sets the frequency used when
	  initiating the P2P connection.

config SAMPLE_P2P_JOIN
	bool "Join an existing P2P group"
	help
	  This configuration option enables the device to join an
	  existing P2P group instead of creating a new one.

config SAMPLE_P2P_PEER_ADDRESS
	string "P2P peer MAC address"
	help
	  This configuration option sets the MAC address of the peer P2P device.

config SAMPLE_P2P_DHCP_TIMEOUT_S
	int "DHCP timeout in seconds"
	default 20

config SAMPLE_P2P_ECHO_CLI_MODE
	bool "Echo client mode"
	help
	  This configuration options helps to start a TCP echo client.
	  Connect to Go IP address and send test strings and validates
	  the echoed response.

if SAMPLE_P2P_ECHO_CLI_MODE

config SAMPLE_P2P_ECHO_SERVER_ADDR
	string "Echo server (P2P GO) IPv4 address"
	default "192.168.1.99"
	help
	  This configuration option sets the IPv4 address of the P2P Group
	  Owner running the echo server. It must match CONFIG_NET_CONFIG_MY_IPV4_ADDR
	  used when building the GO image, since the two are set independently.

config SAMPLE_P2P_ECHO_CLI_PORT
	int "P2P server port for echo client"
	default 4242
	help
	  This configuration option sets the operating port used when creating
	  the P2P Echo Client. It must match CONFIG_SAMPLE_P2P_ECHO_SERVER_PORT on
	  the GO image, since the two are set independently.

config SAMPLE_P2P_ECHO_CLI_COUNT
	int "Number of echo requests to send"
	default 10
	help
	  This configuration option sets how many echo request/response
	  iterations the client performs before returning.

config SAMPLE_P2P_ECHO_CLI_INTERVAL_MS
	int "Delay between echo requests (ms)"
	default 1000
	help
	  This configuration option sets the delay, in milliseconds, between
	  successive echo requests sent by the client.

config SAMPLE_P2P_ECHO_CLI_REPLY_TIMEOUT_MS
	int "Echo reply timeout (ms)"
	default 5000
	help
	  This configuration option sets how long, in milliseconds, the client
	  waits for an echo reply before aborting the echo test.

endif

endif

config SAMPLE_P2P_ECHO_MSG_BUF_SIZE
	int "Echo message buffer size (bytes)"
	depends on SAMPLE_P2P_ECHO_CLI_MODE || SAMPLE_P2P_ECHO_SERVER_MODE
	default 128
	help
	  Size, in bytes, of the TCP buffer used by the echo client (to hold the
	  reply) and the echo server (to receive and echo back). Data larger than
	  this is handled in chunks of this size.

choice SAMPLE_P2P_CONNECTION_METHODS
	prompt "P2P connection methods"
	default SAMPLE_P2P_CONNECTION_METHOD_PIN

config SAMPLE_P2P_CONNECTION_METHOD_PIN
	bool "PIN method"
	help
	  This configuration option enables establishing the P2P connection using a WPS PIN.

config SAMPLE_P2P_CONNECTION_METHOD_PBC
	bool "Push Button Configuration (PBC)"
	help
	  This configuration option enables the device to establish
	  the P2P connection using WPS Push Button Configuration (PBC).

endchoice

if SAMPLE_P2P_CONNECTION_METHOD_PIN

config SAMPLE_P2P_METHOD_DISPLAY
	bool "Display PIN method"
	default y
	help
	  This configuration option enables the device to generate
	  and display a PIN which must be entered on the peer device.

config SAMPLE_P2P_METHOD_KEYPAD
	bool "Keypad PIN method"
	help
	  This configuration option enables the device to
	  use the PIN provided by the peer device.

endif

if SAMPLE_P2P_METHOD_KEYPAD

config SAMPLE_P2P_CONNECTION_METHOD_PIN_VALUE
	string "PIN value"
	help
	  This configuration option sets the PIN value to be
	  used when the keypad method is selected.

endif

if SAMPLE_P2P_GO_MODE

config SAMPLE_P2P_DHCPV4_SERVER
	bool "DHCPv4 server"
	select NET_DHCPV4_SERVER
	default y
	help
	  This configuration option enables DHCPV4 server settings.

config SAMPLE_P2P_DHCPV4_POOL_START
	string "Start address of DHCPv4 pool"
	default "192.168.1.2"
	help
	  This configuration option sets the start IP address of DHCPv4 pool.

config SAMPLE_P2P_GO_FREQ
	int "P2P GO operating frequency (MHz)"
	default 2462
	help
	  This configuration option sets the operating frequency
	  used when creating the P2P Group Owner group.

config SAMPLE_P2P_GO_VHT
	bool "VHT support"
	help
	  This configuration option enables the device to allow
	  Very High Throughput (VHT) capabilities when creating the P2P group.

config SAMPLE_P2P_GO_BSSID
	string "GO BSSID"
	help
	  This configuration option sets the BSSID to be used when creating the P2P group.
	  If left empty, the BSSID is selected automatically.

config SAMPLE_P2P_IFACE_NAME
	string "Interface name"
	default "wlan0"
	help
	  This configuration option sets the interface name used when removing the P2P group.

config SAMPLE_P2P_PEER_DISCONN_TIMEOUT_S
	int "Timeout waiting for peer disconnect (seconds)"
	default 30
	help
	  This configuration option sets the timeout for waiting for a peer to disconnect.

config SAMPLE_P2P_ECHO_SERVER_MODE
	bool "Echo Server mode"
	help
	  This configuration option helps to start a TCP echo server in GO mode.
	  Listen on a fixed port and echo back whatever data is received.

if SAMPLE_P2P_ECHO_SERVER_MODE

config SAMPLE_P2P_ECHO_SERVER_PORT
	int "P2P server port for echo server"
	default 4242
	help
	  This configuration option sets the operating port used when creating
	  the P2P Echo Server. It must match CONFIG_SAMPLE_P2P_ECHO_CLI_PORT on the
	  CLI image, since the two are set independently.

config SAMPLE_P2P_ECHO_POLL_INTERVAL_MS
	int "Echo server poll interval (ms)"
	default 1000
	help
	  This configuration option sets how often, in milliseconds, the echo
	  server re-checks the P2P peer connection state while waiting for a
	  client connection or data. It bounds how long P2P group teardown can
	  be delayed after the peer disconnects.

endif

endif

endmenu

source "Kconfig.zephyr"
```

## sample.yaml
```
sample:
  description: Wi-Fi P2P sample application
  name: Wi-Fi P2P
tests:
  sample.nrf7002.p2p:
    sysbuild: true
    build_only: true
    integration_platforms:
      - nrf7002dk/nrf5340/cpuapp
    platform_allow: nrf7002dk/nrf5340/cpuapp
    tags:
      - ci_build
      - sysbuild
      - ci_samples_wifi
  sample.nrf7002_eks.p2p:
    sysbuild: true
    build_only: true
    extra_args:
      - SHIELD="nrf7002ek"
    integration_platforms:
      - nrf5340dk/nrf5340/cpuapp
    platform_allow:
      - nrf5340dk/nrf5340/cpuapp
    tags:
      - ci_build
      - sysbuild
      - ci_samples_wifi
  sample.54lm20dk.nrf7002eb2.p2p:
    sysbuild: true
    build_only: true
    extra_args:
      - SHIELD="nrf7002eb2"
    integration_platforms:
      - nrf54lm20dk/nrf54lm20a/cpuapp
      - nrf54lm20dk/nrf54lm20b/cpuapp
    platform_allow:
      - nrf54lm20dk/nrf54lm20a/cpuapp
      - nrf54lm20dk/nrf54lm20b/cpuapp
    tags:
      - ci_build
      - sysbuild
      - ci_samples_wifi
  sample.nrf7120.p2p:
    sysbuild: true
    build_only: true
    extra_args:
      - SB_CONFIG_WIFI_NRF70=n
    integration_platforms:
      - nrf7120dk/nrf7120/cpuapp
    platform_allow:
      - nrf7120dk/nrf7120/cpuapp
      - nrf7120dk/nrf7120/cpuapp/ns
    # ns variant fails to link: Wi-Fi patch region overlaps Zephyr build
    platform_exclude:
      - nrf7120dk/nrf7120/cpuapp/ns
    tags:
      - ci_build
      - sysbuild
      - ci_samples_nrf71_wifi
  sample.nrf7002.p2p.echo_cli:
    sysbuild: true
    build_only: true
    extra_args:
      - EXTRA_CONF_FILE="echo-cli.conf"
    integration_platforms:
      - nrf7002dk/nrf5340/cpuapp
    platform_allow: nrf7002dk/nrf5340/cpuapp
    tags:
      - ci_build
      - sysbuild
      - ci_samples_wifi
  sample.nrf7002.p2p.echo_go:
    sysbuild: true
    build_only: true
    extra_args:
      - EXTRA_CONF_FILE="echo-go.conf"
    integration_platforms:
      - nrf7002dk/nrf5340/cpuapp
    platform_allow: nrf7002dk/nrf5340/cpuapp
    tags:
      - ci_build
      - sysbuild
      - ci_samples_wifi
```

## prj.conf
```kconfig
#
# Copyright (c) 2026 Nordic Semiconductor ASA
#
# SPDX-License-Identifier: LicenseRef-Nordic-5-Clause
#
CONFIG_WIFI=y

# WPA supplicant
CONFIG_WIFI_NM_WPA_SUPPLICANT=y
CONFIG_WIFI_NM_WPA_SUPPLICANT_P2P=y
CONFIG_WIFI_NM_WPA_SUPPLICANT_LOG_LEVEL_INF=y

# Networking
CONFIG_NETWORKING=y
CONFIG_NET_SOCKETS=y
CONFIG_NET_LOG=y
CONFIG_NET_IPV4=y
CONFIG_NET_UDP=y
CONFIG_NET_TCP=y
CONFIG_NET_DHCPV4=y

CONFIG_NET_PKT_RX_COUNT=16
CONFIG_NET_PKT_TX_COUNT=16

# Below section is the primary contributor to SRAM and is currently
# tuned for performance, but this will be revisited in the future.
CONFIG_NET_BUF_RX_COUNT=16
CONFIG_NET_BUF_TX_COUNT=32
CONFIG_NET_TC_TX_COUNT=1

CONFIG_NET_IF_UNICAST_IPV4_ADDR_COUNT=1
CONFIG_NET_MAX_CONTEXTS=5
CONFIG_NET_CONTEXT_SYNC_RECV=y

CONFIG_INIT_STACKS=y

CONFIG_NET_L2_ETHERNET=y
CONFIG_NET_L2_ETHERNET_MGMT=y

CONFIG_NET_CONFIG_SETTINGS=y
CONFIG_NET_CONFIG_INIT_TIMEOUT=0

CONFIG_ZVFS_POLL_MAX=10

CONFIG_PSA_WANT_ALG_ECDH=y

# Memories
CONFIG_MAIN_STACK_SIZE=5200
CONFIG_NET_TX_STACK_SIZE=4096
CONFIG_NET_RX_STACK_SIZE=4096

# Debugging
CONFIG_STACK_SENTINEL=y
CONFIG_DEBUG_COREDUMP=y
CONFIG_DEBUG_COREDUMP_BACKEND_LOGGING=y
CONFIG_DEBUG_COREDUMP_MEMORY_DUMP_MIN=y
CONFIG_SHELL_CMDS_RESIZE=n


# Kernel options
CONFIG_ENTROPY_GENERATOR=y

# Logging
CONFIG_LOG=y
CONFIG_LOG_BUFFER_SIZE=2048
CONFIG_POSIX_TIMERS=y

CONFIG_NET_CONFIG_MY_IPV4_ADDR="192.168.1.99"
CONFIG_NET_CONFIG_MY_IPV4_NETMASK="255.255.255.0"
CONFIG_NET_CONFIG_MY_IPV4_GW="192.168.1.1"

CONFIG_NET_MGMT_EVENT_QUEUE_TIMEOUT=5000
```

## echo-cli.conf
```kconfig
# P2P client: join a GO and run the echo client.
# Build: -DEXTRA_CONF_FILE=echo-cli.conf
CONFIG_SAMPLE_P2P_CLI_MODE=y
CONFIG_SAMPLE_P2P_CONNECTION_METHOD_PBC=y
CONFIG_SAMPLE_P2P_JOIN=y
CONFIG_SAMPLE_P2P_ECHO_CLI_MODE=y

# Use the GO's DHCP, not prj.conf's static address (avoids a clash).
CONFIG_NET_CONFIG_MY_IPV4_ADDR=""

# Set to the GO's MAC: CONFIG_SAMPLE_P2P_PEER_ADDRESS="aa:bb:cc:dd:ee:ff"
```

## echo-go.conf
```kconfig
# P2P autonomous Group Owner with echo server.
# Build: -DEXTRA_CONF_FILE=echo-go.conf
CONFIG_SAMPLE_P2P_GO_MODE=y
CONFIG_SAMPLE_P2P_CONNECTION_METHOD_PBC=y
CONFIG_SAMPLE_P2P_ECHO_SERVER_MODE=y

# Serve DHCP without also running a DHCP client on the same interface.
CONFIG_NET_DHCPV4=n
```

## go-persistent.conf
```kconfig
# Persistent GO with in-code persistence verification (GO-only, no peer).
# Build: -DEXTRA_CONF_FILE=go-persistent.conf
CONFIG_SAMPLE_P2P_GO_PERSISTENT_MODE=y
CONFIG_SAMPLE_P2P_GO_PERSISTENT_CYCLES=3
```

## overlay-echo-cli.conf
```kconfig
# P2P client: join a GO and run the echo client.
# Build: -DEXTRA_CONF_FILE=overlay-echo-cli.conf
CONFIG_SAMPLE_P2P_CLI_MODE=y
CONFIG_SAMPLE_P2P_CONNECTION_METHOD_PBC=y
CONFIG_SAMPLE_P2P_JOIN=y
CONFIG_SAMPLE_P2P_ECHO_CLI_MODE=y

# Use the GO's DHCP, not prj.conf's static address (avoids a clash).
CONFIG_NET_CONFIG_MY_IPV4_ADDR=""

# Set to the GO's MAC: CONFIG_SAMPLE_P2P_PEER_ADDRESS="aa:bb:cc:dd:ee:ff"
```

## overlay-echo-go.conf
```kconfig
# P2P autonomous Group Owner with echo server.
# Build: -DEXTRA_CONF_FILE=overlay-echo-go.conf
CONFIG_SAMPLE_P2P_GO_MODE=y
CONFIG_SAMPLE_P2P_CONNECTION_METHOD_PBC=y
CONFIG_SAMPLE_P2P_ECHO_SERVER_MODE=y

# Serve DHCP without also running a DHCP client on the same interface.
CONFIG_NET_DHCPV4=n
```

## overlay-go-persistent.conf
```kconfig
# Persistent GO with in-code persistence verification (GO-only, no peer).
# Build: -DEXTRA_CONF_FILE=overlay-go-persistent.conf
CONFIG_SAMPLE_P2P_GO_PERSISTENT_MODE=y
CONFIG_SAMPLE_P2P_GO_PERSISTENT_CYCLES=3
```

## src/main.c
```c
/*
 * Copyright (c) 2026 Nordic Semiconductor ASA
 *
 * SPDX-License-Identifier: LicenseRef-Nordic-5-Clause
 */

/** @file
 * @brief Wi-Fi P2P sample - CLI (client) or GO (group owner) mode.
 */

#include <zephyr/sys/util.h>
#include "p2p.h"

int main(void)
{

	if (IS_ENABLED(CONFIG_SAMPLE_P2P_CLI_MODE)) {
		p2p_cli_run();
	}

	if (IS_ENABLED(CONFIG_SAMPLE_P2P_GO_MODE)) {
		p2p_go_run();
	}

	if (IS_ENABLED(CONFIG_SAMPLE_P2P_GO_PERSISTENT_MODE)) {
		p2p_go_persistent_run();
	}

	return 0;
}
```

## src/p2p.h
```c
/*
 * Copyright (c) 2026 Nordic Semiconductor ASA
 *
 * SPDX-License-Identifier: LicenseRef-Nordic-5-Clause
 */

#ifndef __P2P_H__
#define __P2P_H__

int p2p_cli_run(void);
int p2p_go_run(void);
int p2p_go_persistent_run(void);

#endif /* __P2P_H__ */
```

## src/p2p_cli.c
```c
/*
 * Copyright (c) 2026 Nordic Semiconductor ASA
 *
 * SPDX-License-Identifier: LicenseRef-Nordic-5-Clause
 */

/** @file
 * @brief P2P client (CLI) mode - find peer and connect.
 * Compiled only when CONFIG_SAMPLE_P2P_CLI_MODE is set.
 */

#include <zephyr/logging/log.h>
LOG_MODULE_REGISTER(p2p_cli, CONFIG_LOG_DEFAULT_LEVEL);

#include <zephyr/kernel.h>
#include <errno.h>
#include <stdio.h>
#include <string.h>

#include <zephyr/net/net_if.h>
#include <zephyr/net/wifi_mgmt.h>
#include <zephyr/net/net_event.h>
#include <zephyr/net/socket.h>

#define WIFI_P2P_CLI_MGMT_EVENTS (NET_EVENT_WIFI_CONNECT_RESULT |\
				  NET_EVENT_WIFI_P2P_DEVICE_FOUND)

static struct {
	const struct shell *sh;
	union {
		struct {
			uint8_t connected	: 1;
			uint8_t _unused		: 7;
		};
		uint8_t all;
	};
} context;

static K_SEM_DEFINE(wifi_p2p_device_found_sem, 0, 1);
static K_SEM_DEFINE(ip_ready_sem, 0, 1);
static struct net_mgmt_event_callback wifi_shell_mgmt_cb;
static struct net_mgmt_event_callback net_shell_mgmt_cb;

static int mac_str_to_bytes(const char *mac_str, uint8_t mac[WIFI_MAC_ADDR_LEN])
{
	return sscanf(mac_str, "%hhx:%hhx:%hhx:%hhx:%hhx:%hhx",
		     &mac[0], &mac[1], &mac[2], &mac[3], &mac[4], &mac[5])
	       == WIFI_MAC_ADDR_LEN ? 0 : -1;
}

static void handle_wifi_connect_result(struct net_mgmt_event_callback *cb)
{
	if (context.connected) {
		return;
	}

	LOG_INF("Connected");
	context.connected = true;
}

static void handle_wifi_p2p_device_found(struct net_mgmt_event_callback *cb)
{
	const struct wifi_p2p_device_info *peer_info =
		(const struct wifi_p2p_device_info *)cb->info;
	uint8_t peer_addr[WIFI_MAC_ADDR_LEN];

	if (!peer_info) {
		return;
	}

	if (mac_str_to_bytes(CONFIG_SAMPLE_P2P_PEER_ADDRESS, peer_addr)) {
		LOG_ERR("Invalid peer MAC in CONFIG_SAMPLE_P2P_PEER_ADDRESS: %s",
			CONFIG_SAMPLE_P2P_PEER_ADDRESS);
		return;
	}

	if (peer_info->mac[0] == peer_addr[0] &&
	    peer_info->mac[1] == peer_addr[1] &&
	    peer_info->mac[2] == peer_addr[2] &&
	    peer_info->mac[3] == peer_addr[3] &&
	    peer_info->mac[4] == peer_addr[4] &&
	    peer_info->mac[5] == peer_addr[5]) {
		k_sem_give(&wifi_p2p_device_found_sem);
	}
}

static void print_dhcp_ip(struct net_mgmt_event_callback *cb)
{
	/* Get DHCP info from struct net_if_dhcpv4 and print */
	const struct net_if_dhcpv4 *dhcpv4 = cb->info;
	const struct in_addr *addr = &dhcpv4->requested_ip;
	char dhcp_info[128];

	net_addr_ntop(AF_INET, addr, dhcp_info, sizeof(dhcp_info));

	LOG_INF("DHCP IP address: %s", dhcp_info);
	k_sem_give(&ip_ready_sem);
}

static void net_mgmt_event_handler(struct net_mgmt_event_callback *cb,
				   uint64_t mgmt_event, struct net_if *iface)
{
	switch (mgmt_event) {
	case NET_EVENT_IPV4_DHCP_BOUND:
		print_dhcp_ip(cb);
		break;
	default:
		break;
	}
}

static void wifi_mgmt_event_handler(struct net_mgmt_event_callback *cb,
				    uint64_t mgmt_event, struct net_if *iface)
{
	ARG_UNUSED(iface);
	switch (mgmt_event) {
	case NET_EVENT_WIFI_CONNECT_RESULT:
		handle_wifi_connect_result(cb);
		break;
	case NET_EVENT_WIFI_P2P_DEVICE_FOUND:
		handle_wifi_p2p_device_found(cb);
		break;
	default:
		break;
	}
}

static void net_mgmt_callback_init(void)
{
	net_mgmt_init_event_callback(&wifi_shell_mgmt_cb,
				     wifi_mgmt_event_handler,
				     WIFI_P2P_CLI_MGMT_EVENTS);
	net_mgmt_add_event_callback(&wifi_shell_mgmt_cb);

	net_mgmt_init_event_callback(&net_shell_mgmt_cb,
				     net_mgmt_event_handler,
				     NET_EVENT_IPV4_DHCP_BOUND);
	net_mgmt_add_event_callback(&net_shell_mgmt_cb);

	LOG_INF("Starting %s with CPU frequency: %d MHz", CONFIG_BOARD, SystemCoreClock/MHZ(1));
	k_sleep(K_SECONDS(1));
}

static int wifi_p2p_find(void)
{
	struct wifi_p2p_params params = { 0 };
	struct net_if *iface = net_if_get_first_wifi();

	if (!iface) {
		LOG_ERR("Failed to get Wi-Fi interface");
		return -1;
	}

	params.oper = WIFI_P2P_FIND;
#ifdef CONFIG_SAMPLE_P2P_DISCOVERY_FULL
	params.discovery_type = WIFI_P2P_FIND_START_WITH_FULL;
#elif defined(CONFIG_SAMPLE_P2P_DISCOVERY_SOCIAL)
	params.discovery_type = WIFI_P2P_FIND_ONLY_SOCIAL;
#elif defined(CONFIG_SAMPLE_P2P_DISCOVERY_PROGRESSIVE)
	params.discovery_type = WIFI_P2P_FIND_PROGRESSIVE;
#endif
	params.timeout = CONFIG_SAMPLE_P2P_FIND_TIMEOUT_S;

	if (net_mgmt(NET_REQUEST_WIFI_P2P_OPER, iface, &params, sizeof(params))) {
		LOG_ERR("P2P find request failed");
		return -1;
	}

	LOG_INF("P2P find started");
	return 0;
}

static int wifi_p2p_connect(void)
{
	struct wifi_p2p_params params = { 0 };
	struct net_if *iface = net_if_get_first_wifi();

	if (!iface) {
		LOG_ERR("Failed to get Wi-Fi interface");
		return -1;
	}

	if (mac_str_to_bytes(CONFIG_SAMPLE_P2P_PEER_ADDRESS, params.peer_addr) != 0) {
		LOG_ERR("Invalid peer address: %s", CONFIG_SAMPLE_P2P_PEER_ADDRESS);
		return -1;
	}

#ifdef CONFIG_SAMPLE_P2P_CONNECTION_METHOD_PBC
	params.connect.method = WIFI_P2P_METHOD_PBC;
#elif defined(CONFIG_SAMPLE_P2P_CONNECTION_METHOD_PIN)
#ifdef CONFIG_SAMPLE_P2P_METHOD_KEYPAD
	params.connect.method = WIFI_P2P_METHOD_KEYPAD;
	strncpy(params.connect.pin,
		CONFIG_SAMPLE_P2P_CONNECTION_METHOD_PIN_VALUE, WIFI_WPS_PIN_MAX_LEN);
	params.connect.pin[WIFI_WPS_PIN_MAX_LEN] = '\0';
#elif defined(CONFIG_SAMPLE_P2P_METHOD_DISPLAY)
	params.connect.method = WIFI_P2P_METHOD_DISPLAY;
	params.connect.pin[0] = '\0';
#endif
#else
	LOG_ERR("Invalid connection method");
	return -1;
#endif
	params.connect.go_intent = CONFIG_SAMPLE_P2P_GO_INTENT_VALUE;
	params.connect.freq = CONFIG_SAMPLE_P2P_FREQUENCY;
#ifdef CONFIG_SAMPLE_P2P_JOIN
	params.connect.join = true;
#else
	params.connect.join = false;
#endif
	params.oper = WIFI_P2P_CONNECT;

	if (net_mgmt(NET_REQUEST_WIFI_P2P_OPER, iface, &params, sizeof(params))) {
		LOG_WRN("P2P connect request failed");
		return -1;
	}

	if (params.connect.method == WIFI_P2P_METHOD_DISPLAY && params.connect.pin[0] != '\0') {
		LOG_INF("PIN: %s", params.connect.pin);
	} else {
		LOG_INF("P2P connection initiated");
	}

	return 0;
}

#ifdef CONFIG_SAMPLE_P2P_ECHO_CLI_MODE
static char echo_cli_rx_buf[CONFIG_SAMPLE_P2P_ECHO_MSG_BUF_SIZE];

/* TCP send() may write fewer bytes than requested; loop until all are sent. */
static int send_all(int sock, const char *data, size_t len)
{
	size_t sent = 0;

	while (sent < len) {
		int ret = zsock_send(sock, data + sent, len - sent, 0);

		if (ret < 0) {
			return -errno;
		}
		sent += ret;
	}

	return 0;
}

static char *wifi_p2p_run_echo_client(char *tx_str)
{
	int sock;
	int ret;
	int tx_len;
	struct sockaddr_in server = { 0 };
	struct zsock_pollfd pfd;

	sock = zsock_socket(AF_INET, SOCK_STREAM, IPPROTO_TCP);
	if (sock < 0) {
		LOG_ERR("Failed to create echo client socket: %d", -errno);
		return NULL;
	}

	server.sin_family = AF_INET;
	server.sin_port = net_htons(CONFIG_SAMPLE_P2P_ECHO_CLI_PORT);

	if (net_addr_pton(AF_INET, CONFIG_SAMPLE_P2P_ECHO_SERVER_ADDR, &server.sin_addr) < 0) {
		LOG_ERR("Invalid echo server address: %s", CONFIG_SAMPLE_P2P_ECHO_SERVER_ADDR);
		zsock_close(sock);
		return NULL;
	}

	if (zsock_connect(sock, (struct sockaddr *)&server, sizeof(server)) < 0) {
		LOG_ERR("Failed to connect to echo server %s: %d",
			CONFIG_SAMPLE_P2P_ECHO_SERVER_ADDR, -errno);
		zsock_close(sock);
		return NULL;
	}

	tx_len = strlen(tx_str);

	if (send_all(sock, tx_str, tx_len) < 0) {
		LOG_ERR("Failed to send echo request: %d", -errno);
		zsock_close(sock);
		return NULL;
	}

	pfd.fd = sock;
	pfd.events = ZSOCK_POLLIN;

	ret = zsock_poll(&pfd, 1, CONFIG_SAMPLE_P2P_ECHO_CLI_REPLY_TIMEOUT_MS);
	if (ret <= 0) {
		LOG_ERR("Timed out waiting for echo reply: %d", ret < 0 ? -errno : -ETIMEDOUT);
		zsock_close(sock);
		return NULL;
	}

	ret = zsock_recv(sock, echo_cli_rx_buf, sizeof(echo_cli_rx_buf) - 1, 0);
	zsock_close(sock);

	if (ret < 0) {
		LOG_ERR("Failed to receive echo reply: %d", -errno);
		return NULL;
	} else if (ret == 0) {
		LOG_WRN("Echo server closed the connection");
		return NULL;
	}

	echo_cli_rx_buf[ret] = '\0';

	if (ret != tx_len || memcmp(tx_str, echo_cli_rx_buf, tx_len) != 0) {
		LOG_ERR("Echo mismatch: sent \"%s\", received \"%s\"", tx_str, echo_cli_rx_buf);
	} else {
		LOG_INF("Echo OK: \"%s\"", echo_cli_rx_buf);
	}

	return echo_cli_rx_buf;
}
#endif /* CONFIG_SAMPLE_P2P_ECHO_CLI_MODE */

int p2p_cli_run(void)
{
	int ret;

	context.connected = false;

	net_mgmt_callback_init();

	while (1) {
		ret = wifi_p2p_find();
		if (ret < 0) {
			return ret;
		}

		ret = k_sem_take(&wifi_p2p_device_found_sem,
				 K_SECONDS(CONFIG_SAMPLE_P2P_FIND_TIMEOUT_S));
		if (ret == 0) {
			LOG_INF("Peer found, initializing connection");

			ret = wifi_p2p_connect();
			if (ret < 0) {
				LOG_ERR("P2P connect failed");
				return ret;
			}

			while (!context.connected) {
				k_sleep(K_MSEC(100));
			}

			ret = k_sem_take(&ip_ready_sem,
					 K_SECONDS(CONFIG_SAMPLE_P2P_DHCP_TIMEOUT_S));
			if (ret) {
				LOG_ERR("DHCP is not successful : %d", ret);
				return ret;
			}

			LOG_INF("Successfully connected to Peer");
#ifdef CONFIG_SAMPLE_P2P_ECHO_CLI_MODE
			{
				char *sample_str = "P2P Hello World";
				char *return_str;

				/* Match the GO's 2s echo-server startup delay. */
				k_sleep(K_SECONDS(2));

				for (int i = 0; i < CONFIG_SAMPLE_P2P_ECHO_CLI_COUNT; i++) {
					return_str = wifi_p2p_run_echo_client(sample_str);
					if (!return_str) {
						LOG_ERR("Echo request %d failed", i);
					}

					k_sleep(K_MSEC(CONFIG_SAMPLE_P2P_ECHO_CLI_INTERVAL_MS));
				}
			}
#endif
			break;
		} else {
			LOG_INF("No peer found, retrying in 10 seconds...");
			k_sleep(K_SECONDS(10));
		}
	}

	return 0;
}
```

## src/p2p_go.c
```c
/*
 * Copyright (c) 2026 Nordic Semiconductor ASA
 *
 * SPDX-License-Identifier: LicenseRef-Nordic-5-Clause
 */

/** @file
 * @brief P2P Group Owner (GO) mode.
 * Compiled only when CONFIG_SAMPLE_P2P_GO_MODE is set.
 */

#include <zephyr/logging/log.h>
LOG_MODULE_REGISTER(p2p_go, CONFIG_LOG_DEFAULT_LEVEL);

#include <zephyr/kernel.h>
#include <errno.h>
#include <zephyr/net/net_if.h>
#include <zephyr/net/wifi_mgmt.h>
#include <zephyr/net/dhcpv4_server.h>
#include <zephyr/net/socket.h>

#include <string.h>

#define WIFI_P2P_GO_MGMT_EVENTS (NET_EVENT_WIFI_AP_STA_CONNECTED |\
			      NET_EVENT_WIFI_AP_STA_DISCONNECTED)
static struct {
	const struct shell *sh;
	union {
		struct {
			uint8_t connected    : 1;
			uint8_t _unused      : 7;
		};
		uint8_t all;
	};
} context;

static struct net_mgmt_event_callback wifi_shell_mgmt_cb;
static K_SEM_DEFINE(wifi_p2p_peer_disconnect_sem, 0, 1);

static void handle_wifi_ap_sta_connected(struct net_mgmt_event_callback *cb)
{
	if (context.connected) {
		return;
	}

	context.connected = true;
}

static void handle_wifi_ap_sta_disconnected(struct net_mgmt_event_callback *cb)
{
	if (!context.connected) {
		return;
	}

	context.connected = false;
	k_sem_give(&wifi_p2p_peer_disconnect_sem);
}

static int configure_dhcp_server(void)
{
	struct net_if *iface;
	struct in_addr pool_start;
	int ret = -1;

	iface = net_if_get_first_wifi();
	if (!iface) {
		LOG_ERR("Failed to get Wi-Fi interface");
		goto out;
	}

	if (net_addr_pton(AF_INET, CONFIG_SAMPLE_P2P_DHCPV4_POOL_START, &pool_start.s_addr)) {
		LOG_ERR("Invalid address: %s", CONFIG_SAMPLE_P2P_DHCPV4_POOL_START);
		goto out;
	}

	ret = net_dhcpv4_server_start(iface, &pool_start);
	if (ret == -EALREADY) {
		LOG_ERR("DHCPv4 server already running on interface");
	} else if (ret < 0) {
		LOG_ERR("DHCPv4 server failed to start and returned %d error", ret);
	} else {
		LOG_INF("DHCPv4 server started and pool address starts from %s",
			CONFIG_SAMPLE_P2P_DHCPV4_POOL_START);
	}
out:
	return ret;
}

static void wifi_mgmt_event_handler(struct net_mgmt_event_callback *cb,
				     uint64_t mgmt_event, struct net_if *iface)
{
	switch (mgmt_event) {
	case NET_EVENT_WIFI_AP_STA_CONNECTED:
		handle_wifi_ap_sta_connected(cb);
		break;
	case NET_EVENT_WIFI_AP_STA_DISCONNECTED:
		handle_wifi_ap_sta_disconnected(cb);
		break;
	default:
		break;
	}
}

static int go_bssid_from_str(const char *mac_str, uint8_t mac[WIFI_MAC_ADDR_LEN])
{
	if (!mac_str || mac_str[0] == '\0') {
		return -1;
	}

	return sscanf(mac_str, "%hhx:%hhx:%hhx:%hhx:%hhx:%hhx",
		      &mac[0], &mac[1], &mac[2], &mac[3], &mac[4], &mac[5])
		      == WIFI_MAC_ADDR_LEN ? 0 : -1;
}

static int wifi_p2p_group_add(void)
{
	struct wifi_p2p_params params = { 0 };
	struct net_if *iface = net_if_get_first_wifi();

	if (!iface) {
		LOG_ERR("Failed to get Wi-Fi interface");
		return -1;
	}

	params.oper = WIFI_P2P_GROUP_ADD;
	params.group_add.freq = CONFIG_SAMPLE_P2P_GO_FREQ;
	params.group_add.persistent = -1;
	params.group_add.vht = IS_ENABLED(CONFIG_SAMPLE_P2P_GO_VHT);
	params.group_add.go_bssid_length = 0;

	if (strlen(CONFIG_SAMPLE_P2P_GO_BSSID) > 0) {
		uint8_t bssid[WIFI_MAC_ADDR_LEN];

		if (go_bssid_from_str(CONFIG_SAMPLE_P2P_GO_BSSID, bssid) == 0) {
			memcpy(params.group_add.go_bssid, bssid, WIFI_MAC_ADDR_LEN);
			params.group_add.go_bssid_length = WIFI_MAC_ADDR_LEN;
		} else {
			LOG_WRN("Invalid P2P_GO_BSSID, using auto");
		}
	}

	if (net_mgmt(NET_REQUEST_WIFI_P2P_OPER, iface, &params, sizeof(params))) {
		LOG_ERR("P2P group add failed");
		return -1;
	}

	LOG_INF("P2P group add initiated (freq=%d persistent=%d)",
		params.group_add.freq, params.group_add.persistent);
	return 0;
}

#ifdef CONFIG_SAMPLE_P2P_CONNECTION_METHOD_PIN
static int wifi_p2p_wps_pin(void)
{
	struct wifi_wps_config_params params = {0};
	struct net_if *iface = net_if_get_first_wifi();

	if (!iface) {
		LOG_ERR("Failed to get Wi-Fi interface");
		return -1;
	}

	params.oper = WIFI_WPS_PIN_GET;

	if (net_mgmt(NET_REQUEST_WIFI_WPS_CONFIG, iface, &params, sizeof(params))) {
		LOG_WRN("Failed to start WPS PIN connection");
		return -1;
	}

	if (params.oper == WIFI_WPS_PIN_GET) {
		LOG_INF("WPS PIN is: %s", params.pin);
	}

	return 0;
}
#endif /* CONFIG_SAMPLE_P2P_CONNECTION_METHOD_PIN */

#ifdef CONFIG_SAMPLE_P2P_CONNECTION_METHOD_PBC
static int wifi_p2p_wps_pbc(void)
{
	struct wifi_wps_config_params params = {0};
	struct net_if *iface = net_if_get_first_wifi();

	if (!iface) {
		LOG_ERR("Failed to get Wi-Fi interface");
		return -1;
	}

	params.oper = WIFI_WPS_PBC;

	if (net_mgmt(NET_REQUEST_WIFI_WPS_CONFIG, iface, &params, sizeof(params))) {
		LOG_WRN("Failed to start WPS PBC connection");
		return -1;
	}

	return 0;
}
#endif /* CONFIG_SAMPLE_P2P_CONNECTION_METHOD_PBC */

static int wifi_p2p_group_remove(void)
{
	struct wifi_p2p_params params = { 0 };
	struct net_if *iface = net_if_get_first_wifi();

	if (!iface) {
		LOG_ERR("Failed to get Wi-Fi interface");
		return -1;
	}

	params.oper = WIFI_P2P_GROUP_REMOVE;
	strncpy(params.group_remove.ifname, CONFIG_SAMPLE_P2P_IFACE_NAME,
		CONFIG_NET_INTERFACE_NAME_LEN);
	params.group_remove.ifname[CONFIG_NET_INTERFACE_NAME_LEN] = '\0';

	if (net_mgmt(NET_REQUEST_WIFI_P2P_OPER, iface, &params, sizeof(params))) {
		LOG_ERR("P2P group remove failed");
		return -1;
	}

	LOG_INF("P2P group remove initiated: %s", params.group_remove.ifname);
	return 0;
}

static void net_mgmt_callback_init(void)
{
	net_mgmt_init_event_callback(&wifi_shell_mgmt_cb,
				     wifi_mgmt_event_handler,
				     WIFI_P2P_GO_MGMT_EVENTS);

	net_mgmt_add_event_callback(&wifi_shell_mgmt_cb);

	LOG_INF("Starting %s with CPU frequency: %d MHz", CONFIG_BOARD, SystemCoreClock/MHZ(1));
	k_sleep(K_SECONDS(1));
}

#ifdef CONFIG_SAMPLE_P2P_ECHO_SERVER_MODE
/* TCP send() may write fewer bytes than requested; loop until all are sent. */
static int send_all(int sock, const char *data, size_t len)
{
	size_t sent = 0;

	while (sent < len) {
		int ret = zsock_send(sock, data + sent, len - sent, 0);

		if (ret < 0) {
			return -errno;
		}
		sent += ret;
	}

	return 0;
}

static int wifi_p2p_run_echo_server(void)
{
	int server_sock;
	int ret;
	struct sockaddr_in addr = { 0 };
	char buf[CONFIG_SAMPLE_P2P_ECHO_MSG_BUF_SIZE];

	server_sock = zsock_socket(AF_INET, SOCK_STREAM, IPPROTO_TCP);
	if (server_sock < 0) {
		LOG_ERR("Failed to create echo server socket: %d", -errno);
		return -errno;
	}

	addr.sin_family = AF_INET;
	addr.sin_port = net_htons(CONFIG_SAMPLE_P2P_ECHO_SERVER_PORT);
	addr.sin_addr.s_addr = INADDR_ANY;

	if (zsock_bind(server_sock, (struct sockaddr *)&addr, sizeof(addr)) < 0) {
		LOG_ERR("Failed to bind echo server socket: %d", -errno);
		zsock_close(server_sock);
		return -errno;
	}

	if (zsock_listen(server_sock, 1) < 0) {
		LOG_ERR("Failed to listen on echo server socket: %d", -errno);
		zsock_close(server_sock);
		return -errno;
	}

	LOG_INF("Echo server listening on port %d", CONFIG_SAMPLE_P2P_ECHO_SERVER_PORT);

	/* Keep accepting clients (the echo client reconnects per request), and
	 * poll with a timeout so a P2P disconnect ends the loop promptly.
	 */
	while (context.connected) {
		struct zsock_pollfd accept_pfd = {
			.fd = server_sock,
			.events = ZSOCK_POLLIN,
		};
		int client_sock;

		ret = zsock_poll(&accept_pfd, 1, CONFIG_SAMPLE_P2P_ECHO_POLL_INTERVAL_MS);
		if (ret < 0) {
			LOG_ERR("Poll failed while waiting for echo client: %d", -errno);
			break;
		} else if (ret == 0) {
			continue;
		}

		client_sock = zsock_accept(server_sock, NULL, NULL);
		if (client_sock < 0) {
			LOG_ERR("Failed to accept echo client: %d", -errno);
			k_sleep(K_MSEC(CONFIG_SAMPLE_P2P_ECHO_POLL_INTERVAL_MS));
			continue;
		}

		LOG_INF("Echo client connected");

		while (context.connected) {
			struct zsock_pollfd recv_pfd = {
				.fd = client_sock,
				.events = ZSOCK_POLLIN,
			};

			ret = zsock_poll(&recv_pfd, 1, CONFIG_SAMPLE_P2P_ECHO_POLL_INTERVAL_MS);
			if (ret < 0) {
				LOG_ERR("Poll failed on echo client socket: %d", -errno);
				break;
			} else if (ret == 0) {
				continue;
			}

			ret = zsock_recv(client_sock, buf, sizeof(buf) - 1, 0);
			if (ret < 0) {
				LOG_ERR("Failed to receive from echo client: %d", -errno);
				break;
			} else if (ret == 0) {
				LOG_INF("Echo client closed the connection");
				break;
			}

			buf[ret] = '\0';
			LOG_INF("Echo server received: \"%s\"", buf);

			if (send_all(client_sock, buf, ret) < 0) {
				LOG_ERR("Failed to send echo reply: %d", -errno);
				break;
			}
		}

		zsock_close(client_sock);
	}

	zsock_close(server_sock);
	LOG_INF("Echo server stopped");

	return 0;
}
#endif

int p2p_go_run(void)
{
	int ret;

	context.connected = false;

	ret = configure_dhcp_server();
	if (ret < 0) {
		LOG_ERR("Aborting: DHCPv4 server did not start");
		return ret;
	}

	net_mgmt_callback_init();

	ret = wifi_p2p_group_add();
	if (ret < 0) {
		return ret;
	}

#ifdef CONFIG_SAMPLE_P2P_CONNECTION_METHOD_PIN
	ret = wifi_p2p_wps_pin();
	if (ret < 0) {
		return ret;
	}
#elif defined(CONFIG_SAMPLE_P2P_CONNECTION_METHOD_PBC)
	ret = wifi_p2p_wps_pbc();
	if (ret < 0) {
		return ret;
	}
#endif

	LOG_INF("Waiting for Peer to connect....");
	while (!context.connected) {
		k_sleep(K_MSEC(100));
	}
	LOG_INF("Peer connected");
	k_sleep(K_SECONDS(2));

#ifdef CONFIG_SAMPLE_P2P_ECHO_SERVER_MODE
	ret = wifi_p2p_run_echo_server();
	if (ret < 0) {
		LOG_ERR("Echo server failed: %d", ret);
	}
#endif

	LOG_INF("Waiting for peer to disconnect...");
	ret = k_sem_take(&wifi_p2p_peer_disconnect_sem,
			 K_SECONDS(CONFIG_SAMPLE_P2P_PEER_DISCONN_TIMEOUT_S));
	if (ret == 0) {
		LOG_INF("Peer disconnected, removing group");
	} else if (ret == -EAGAIN) {
		LOG_WRN("Timeout waiting for disconnect, removing group");
	}

	ret = wifi_p2p_group_remove();
	if (ret < 0) {
		return ret;
	}

	LOG_INF("P2P group removed successfully");
	return 0;
}
```

## src/p2p_go_persistent.c
```c
/*
 * Copyright (c) 2026 Nordic Semiconductor ASA
 *
 * SPDX-License-Identifier: LicenseRef-Nordic-5-Clause
 */

/** @file
 * @brief P2P autonomous persistent group with in-code persistence verification.
 * Creates a persistent group, then re-invokes it by id across cycles and checks
 * the SSID is reused. GO-only (no peer); persistence is RAM-only here.
 */

#include <zephyr/logging/log.h>
LOG_MODULE_REGISTER(p2p_go_persistent, CONFIG_LOG_DEFAULT_LEVEL);

#include <zephyr/kernel.h>
#include <errno.h>
#include <stdio.h>
#include <string.h>

#include <zephyr/net/net_if.h>
#include <zephyr/net/wifi_mgmt.h>

/* Wi-Fi SSID is at most 32 bytes; +1 for the NUL terminator. */
#define SSID_BUF_SIZE 33

/* Time to let a group-add settle before the stored network is read, and to let
 * a group-remove settle before the next cycle's group-add (avoids -EBUSY).
 */
#define SETTLE_MS 2000

static int go_bssid_from_str(const char *mac_str, uint8_t mac[WIFI_MAC_ADDR_LEN])
{
	if (!mac_str || mac_str[0] == '\0') {
		return -1;
	}

	return sscanf(mac_str, "%hhx:%hhx:%hhx:%hhx:%hhx:%hhx",
		      &mac[0], &mac[1], &mac[2], &mac[3], &mac[4], &mac[5])
		      == WIFI_MAC_ADDR_LEN ? 0 : -1;
}

/* persistent_id < 0: create a new persistent group (bare "persistent").
 * persistent_id >= 0: re-invoke the stored persistent group with that id.
 */
static int wifi_p2p_group_add(int persistent_id)
{
	struct wifi_p2p_params params = { 0 };
	struct net_if *iface = net_if_get_first_wifi();

	if (!iface) {
		LOG_ERR("Failed to get Wi-Fi interface");
		return -1;
	}

	params.oper = WIFI_P2P_GROUP_ADD;
	params.group_add.freq = CONFIG_SAMPLE_P2P_GO_FREQ;
	params.group_add.vht = IS_ENABLED(CONFIG_SAMPLE_P2P_GO_VHT);
	params.group_add.go_bssid_length = 0;

	if (persistent_id < 0) {
		params.group_add.persistent = -1;
		params.group_add.persistent_set = true;
	} else {
		params.group_add.persistent = persistent_id;
		params.group_add.persistent_set = false;
	}

	if (strlen(CONFIG_SAMPLE_P2P_GO_BSSID) > 0) {
		uint8_t bssid[WIFI_MAC_ADDR_LEN];

		if (go_bssid_from_str(CONFIG_SAMPLE_P2P_GO_BSSID, bssid) == 0) {
			memcpy(params.group_add.go_bssid, bssid, WIFI_MAC_ADDR_LEN);
			params.group_add.go_bssid_length = WIFI_MAC_ADDR_LEN;
		} else {
			LOG_WRN("Invalid P2P_GO_BSSID, using auto");
		}
	}

	if (net_mgmt(NET_REQUEST_WIFI_P2P_OPER, iface, &params, sizeof(params))) {
		LOG_ERR("P2P group add failed");
		return -1;
	}

	if (persistent_id < 0) {
		LOG_INF("P2P group add initiated (new persistent group)");
	} else {
		LOG_INF("P2P group add initiated (re-invoke persistent id=%d)", persistent_id);
	}
	return 0;
}

static int wifi_p2p_group_remove(void)
{
	struct wifi_p2p_params params = { 0 };
	struct net_if *iface = net_if_get_first_wifi();

	if (!iface) {
		LOG_ERR("Failed to get Wi-Fi interface");
		return -1;
	}

	params.oper = WIFI_P2P_GROUP_REMOVE;
	strncpy(params.group_remove.ifname, CONFIG_SAMPLE_P2P_IFACE_NAME,
		CONFIG_NET_INTERFACE_NAME_LEN);
	params.group_remove.ifname[CONFIG_NET_INTERFACE_NAME_LEN] = '\0';

	if (net_mgmt(NET_REQUEST_WIFI_P2P_OPER, iface, &params, sizeof(params))) {
		LOG_ERR("P2P group remove failed");
		return -1;
	}

	LOG_INF("P2P group remove initiated: %s", params.group_remove.ifname);
	return 0;
}

/* Parse the [P2P-PERSISTENT] entry's id and SSID out of the
 * WIFI_P2P_LIST_NETWORKS text table. Returns 0 on success, negative otherwise.
 */
static int wifi_p2p_get_persistent(int *id_out, char *ssid_out, size_t ssid_size)
{
	static char buf[WIFI_P2P_LIST_NETWORKS_BUF_SIZE];
	struct wifi_p2p_params params = { 0 };
	struct net_if *iface = net_if_get_first_wifi();
	char *line;

	if (!iface) {
		LOG_ERR("Failed to get Wi-Fi interface");
		return -1;
	}

	memset(buf, 0, sizeof(buf));
	params.oper = WIFI_P2P_LIST_NETWORKS;
	params.list_networks.buf = buf;
	params.list_networks.buf_size = sizeof(buf);

	if (net_mgmt(NET_REQUEST_WIFI_P2P_OPER, iface, &params, sizeof(params))) {
		LOG_ERR("P2P list_networks request failed");
		return -1;
	}

	line = buf;
	while (line && *line) {
		char *nl = strchr(line, '\n');

		if (nl) {
			*nl = '\0';
		}

		if (strstr(line, "P2P-PERSISTENT")) {
			int id;
			char ssid[SSID_BUF_SIZE];

			if (sscanf(line, "%d %32s", &id, ssid) == 2) {
				*id_out = id;
				strncpy(ssid_out, ssid, ssid_size - 1);
				ssid_out[ssid_size - 1] = '\0';
				return 0;
			}
		}

		if (!nl) {
			break;
		}
		line = nl + 1;
	}

	return -ENOENT;
}

int p2p_go_persistent_run(void)
{
	int ret;
	int stored_id = -1;
	char stored_ssid[SSID_BUF_SIZE] = { 0 };
	int verified = 0;
	int mismatched = 0;

	LOG_INF("Starting %s with CPU frequency: %d MHz", CONFIG_BOARD, SystemCoreClock/MHZ(1));
	k_sleep(K_SECONDS(1));

	for (int cycle = 1; cycle <= CONFIG_SAMPLE_P2P_GO_PERSISTENT_CYCLES; cycle++) {
		bool reinvoke = (cycle > 1 && stored_id >= 0);
		int cur_id;
		char cur_ssid[SSID_BUF_SIZE];

		LOG_INF("Persistence cycle %d/%d (%s)", cycle,
			CONFIG_SAMPLE_P2P_GO_PERSISTENT_CYCLES,
			reinvoke ? "re-invoke by id" : "create");

		ret = wifi_p2p_group_add(reinvoke ? stored_id : -1);
		if (ret < 0) {
			return ret;
		}

		k_sleep(K_MSEC(SETTLE_MS));

		ret = wifi_p2p_get_persistent(&cur_id, cur_ssid, sizeof(cur_ssid));
		if (ret < 0) {
			mismatched++;
			LOG_ERR("No stored persistent network found after group add");
		} else if (!reinvoke) {
			stored_id = cur_id;
			strncpy(stored_ssid, cur_ssid, sizeof(stored_ssid) - 1);
			stored_ssid[sizeof(stored_ssid) - 1] = '\0';
			LOG_INF("Stored persistent network: id=%d ssid=\"%s\"",
				stored_id, stored_ssid);
		} else if (strcmp(cur_ssid, stored_ssid) == 0) {
			verified++;
			LOG_INF("PERSISTENCE VERIFIED: re-invoked id=%d reused ssid=\"%s\"",
				stored_id, cur_ssid);
		} else {
			mismatched++;
			LOG_ERR("PERSISTENCE MISMATCH: expected ssid=\"%s\" got \"%s\"",
				stored_ssid, cur_ssid);
		}

		ret = wifi_p2p_group_remove();
		if (ret < 0) {
			return ret;
		}

		k_sleep(K_MSEC(SETTLE_MS));
	}

	LOG_INF("Persistence verification done: %d verified, %d mismatched", verified, mismatched);
	return mismatched ? -EIO : 0;
}
```
