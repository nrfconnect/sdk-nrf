## CMakeLists.txt
```
#
# Copyright (c) 2026 Nordic Semiconductor ASA
#
# SPDX-License-Identifier: LicenseRef-Nordic-5-Clause
#

cmake_minimum_required(VERSION 3.20.0)

find_package(Zephyr REQUIRED HINTS $ENV{ZEPHYR_BASE})
project(wifi_recal_monitor_sample)

target_sources(app PRIVATE src/main.c)
target_sources_ifdef(CONFIG_PLATFORM_METRICS_BATTERY_VOLTAGE_MONITOR app PRIVATE src/mock_battery_provider.c)
```

## sample.yaml
```
sample:
  description: Wi-Fi recalibration monitor provider framework sample
  name: Recalibration monitor providers
tests:
  sample.wifi.recal_monitor.nrf7120dk:
    sysbuild: true
    build_only: true
    integration_platforms:
      - nrf7120dk/nrf7120/cpuapp
    platform_allow:
      - nrf7120dk/nrf7120/cpuapp
    tags:
      - ci_build
      - sysbuild
      - ci_samples_wifi
  sample.wifi.recal_monitor.chosen_override.nrf7120dk:
    sysbuild: true
    build_only: true
    extra_dtc_overlay_files:
      - chosen_override.overlay
    integration_platforms:
      - nrf7120dk/nrf7120/cpuapp
    platform_allow:
      - nrf7120dk/nrf7120/cpuapp
    tags:
      - ci_build
      - sysbuild
      - ci_samples_wifi
```

## prj.conf
```kconfig
#
# Copyright (c) 2026 Nordic Semiconductor ASA
#
# SPDX-License-Identifier: LicenseRef-Nordic-5-Clause
#

# Tier 1: built-in, devicetree-selected sensor provider.
CONFIG_PLATFORM_METRICS=y
CONFIG_PLATFORM_METRICS_DIE_TEMP_MONITOR=y

# Tier 2: custom registered provider (mock battery, see
# src/mock_battery_provider.c). PLATFORM_METRICS_BATTERY_VOLTAGE_MONITOR itself
# carries no code in the driver; it gates this sample's own provider.
CONFIG_PLATFORM_METRICS_BATTERY_VOLTAGE_MONITOR=y

# Keep the die-temp sensor's own refresh rate in step with the
# snapshot interval below, otherwise the logged die-temp value only
# changes once every few log lines while battery voltage changes every
# line.
CONFIG_PLATFORM_METRICS_DIE_TEMP_MONITOR_INTERVAL_MS=2000
CONFIG_PLATFORM_METRICS_SNAPSHOT_INTERVAL_MS=2000

CONFIG_LOG=y
CONFIG_PRINTK=y
```

## chosen_override.overlay
```dts
/*
 * Copyright (c) 2026 Nordic Semiconductor ASA
 *
 * SPDX-License-Identifier: LicenseRef-Nordic-5-Clause
 */

/*
 * Demonstrates the tier-1 devicetree override for the die-temperature
 * provider. This DK has no second temperature sensor, so this points
 * back at the SoC's own `temp` node just to prove the override is
 * picked up; on a custom board, point `nordic,platform-metrics-die-temp-sensor` at
 * your own sensor node instead.
 *
 * Pass with: -DEXTRA_DTC_OVERLAY_FILE=chosen_override.overlay
 */

/ {
	chosen {
		nordic,platform-metrics-die-temp-sensor = &temp;
	};
};
```

## src/main.c
```c
/*
 * Copyright (c) 2026 Nordic Semiconductor ASA
 *
 * SPDX-License-Identifier: LicenseRef-Nordic-5-Clause
 */

/** @file
 * @brief Wi-Fi recalibration monitor provider framework sample
 */

#include <stdlib.h>

#include <zephyr/kernel.h>
#include <zephyr/devicetree.h>
#include <zephyr/logging/log.h>

#include <platform_metrics.h>

LOG_MODULE_REGISTER(wifi_recal_sample, CONFIG_LOG_DEFAULT_LEVEL);

/*
 * XO frequency offset is a per-board-design constant, not a live channel:
 * read it straight from the Wi-Fi node's devicetree property, the same way
 * the Wi-Fi driver itself does, instead of adding a platform_metrics
 * channel for something that never changes at runtime.
 */
#define WIFI_NODE DT_CHOSEN(zephyr_wifi)
#define XO_FREQ_OFFSET_PPM DT_PROP(DT_PARENT(WIFI_NODE), nordic_wifi_xo_freq_offset)

int main(void)
{
	while (1) {
		union platform_metrics_sample_value die_temp;
		union platform_metrics_sample_value battery_voltage;

		platform_metrics_sample_get(PLATFORM_METRICS_CH_DIE_TEMP, &die_temp);
		platform_metrics_sample_get(PLATFORM_METRICS_CH_BATTERY_VOLTAGE, &battery_voltage);

		LOG_INF("die temp: %d.%02d C (tier 1, built-in sensor provider) | "
			"battery: %d mV (tier 2, custom mock provider) | "
			"XO offset: %d ppm (board devicetree constant)",
			die_temp.i32 / 100, abs(die_temp.i32 % 100), battery_voltage.i32,
			XO_FREQ_OFFSET_PPM);

		k_sleep(K_MSEC(CONFIG_PLATFORM_METRICS_SNAPSHOT_INTERVAL_MS));
	}
	return 0;
}
```

## src/mock_battery_provider.c
```c
/*
 * Copyright (c) 2026 Nordic Semiconductor ASA
 *
 * SPDX-License-Identifier: LicenseRef-Nordic-5-Clause
 */

/**
 * Tier-2 provider example: no sensor API, no devicetree binding, just
 * a plain init()/sample() pair registered with PLATFORM_METRICS_CHANNEL_DEFINE().
 * Stands in for whatever a customer's own fuel-gauge library or raw
 * register read would do; simulates a battery discharging from 4200
 * to 3300 mV and back, to make the changing value visible in the log.
 */

#include <zephyr/kernel.h>

#include <platform_metrics.h>

#define MOCK_BATTERY_MAX_MV 4200
#define MOCK_BATTERY_MIN_MV 3300
#define MOCK_BATTERY_STEP_MV 20

static int32_t mock_battery_mv = MOCK_BATTERY_MAX_MV;
static int32_t mock_battery_step_mv = -MOCK_BATTERY_STEP_MV;

static int mock_battery_init(void)
{
	return 0;
}

static int mock_battery_sample(struct platform_metrics_sample *out)
{
	mock_battery_mv += mock_battery_step_mv;
	if (mock_battery_mv <= MOCK_BATTERY_MIN_MV || mock_battery_mv >= MOCK_BATTERY_MAX_MV) {
		mock_battery_step_mv = -mock_battery_step_mv;
	}

	out->type = PLATFORM_METRICS_SAMPLE_TYPE_INT;
	out->value.i32 = mock_battery_mv;
	out->timestamp_ms = k_uptime_get();
	out->status = PLATFORM_METRICS_STATUS_OK;
	return 0;
}

PLATFORM_METRICS_CHANNEL_DEFINE(platform_metrics_channel_mock_battery,
				 PLATFORM_METRICS_CH_BATTERY_VOLTAGE, mock_battery_sample,
				 mock_battery_init, PLATFORM_METRICS_SAMPLE_TYPE_INT, i32,
				 MOCK_BATTERY_MAX_MV);
```
