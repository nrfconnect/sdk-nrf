/*
 * Copyright (c) 2026 Nordic Semiconductor ASA
 *
 * SPDX-License-Identifier: LicenseRef-Nordic-5-Clause
 */

/*
 * Demonstrates the tier-1 devicetree override for the die-temperature
 * provider. This DK has no second temperature sensor, so this points
 * back at the SoC's own `temp` node just to prove the override is
 * picked up; on a custom board, point `nordic,wifi-recal-die-temp-sensor` at
 * your own sensor node instead.
 *
 * Pass with: -DEXTRA_DTC_OVERLAY_FILE=chosen_override.overlay
 */

/ {
	chosen {
		nordic,wifi-recal-die-temp-sensor = &temp;
	};
};
