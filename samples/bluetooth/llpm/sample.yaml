## samples/cellular/http_update/modem_full_update/sample.yaml
```yaml
sample:
  name: HTTP full modem update sample
tests:
  sample.cellular.http_update.full_modem_update:
    sysbuild: true
    build_only: true
    integration_platforms:
      - nrf9151dk/nrf9151/ns
    platform_allow:
      - nrf9151dk/nrf9151/ns
    tags:
      - ci_build
      - sysbuild
      - ci_samples_cellular
```

## samples/cellular/lwm2m_client/sample.yaml
```yaml
sample:
  name: Cellular LwM2M client sample
tests:
  sample.cellular.lwm2m_client:
    sysbuild: true
    build_only: true
    integration_platforms:
      - nrf9151dk/nrf9151/ns
    platform_allow:
      - nrf9151dk/nrf9151/ns
      - thingy91x/nrf9151/ns
    tags:
      - ci_build
      - sysbuild
      - ci_samples_cellular
  sample.cellular.lwm2m_client.pgps:
    sysbuild: true
    build_only: true
    extra_args:
      - EXTRA_CONF_FILE="overlay-avsystem.conf;overlay-assist-pgps.conf"
      - EXTRA_DTC_OVERLAY_FILE=overlay-assist-pgps.overlay
    integration_platforms:
      - nrf9151dk/nrf9151/ns
    platform_allow:
      - nrf9151dk/nrf9151/ns
    tags:
      - ci_build
      - sysbuild
      - ci_samples_cellular
```

## samples/cellular/modem_callbacks/sample.yaml
```yaml
sample:
  name: modem callbacks
tests:
  sample.cellular.modem_callbacks:
    sysbuild: true
    build_only: true
    integration_platforms:
      - nrf9151dk/nrf9151/ns
    platform_allow:
      - nrf9151dk/nrf9151/ns
    tags:
      - ci_build
      - sysbuild
      - ci_samples_cellular
```

## samples/cellular/modem_shell/boards/nrf9160dk_nrf9160_ns.conf
```kconfig
#
# Copyright (c) 2026 Nordic Semiconductor ASA
#
# SPDX-License-Identifier: LicenseRef-Nordic-5-Clause
#

# TF-M config
CONFIG_TFM_PROFILE_TYPE_MINIMAL=y
CONFIG_TFM_LOG_LEVEL_SILENCE=n
```

## samples/cellular/modem_trace_flash/sample.yaml
```yaml
sample:
  name: Modem trace external flash backend sample
tests:
  sample.cellular.modem_trace_flash:
    sysbuild: true
    build_only: true
    integration_platforms:
      - nrf9151dk/nrf9151/ns
    platform_allow:
      - nrf9151dk/nrf9151/ns
    tags:
      - ci_build
      - sysbuild
      - ci_samples_cellular
```
