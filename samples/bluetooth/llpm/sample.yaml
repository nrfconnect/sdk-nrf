## samples/bluetooth/llpm/sample.yaml
```yaml
sample:
  description: Buetooth Low Energy LLPM sample
  name: Bluetooth LE LLPM
common:
  sysbuild: true
  tags:
    - bluetooth
    - ci_build
    - sysbuild
    - ci_samples_bluetooth
  harness: console
  harness_config:
    type: multi_line
    ordered: true
    regex:
      - "Starting Bluetooth LLPM sample"
      - "Bluetooth initialized"
  timeout: 15
tests:
  sample.bluetooth.llpm:
    extra_args: EXTRA_CONF_FILE=overlay-bt_ctlr.conf
    integration_platforms:
      - nrf52840dk/nrf52840
      - nrf54l15dk/nrf54l15/cpuapp
    platform_allow:
      - nrf52dk/nrf52832
      - nrf52840dk/nrf52840
      - nrf52840dongle/nrf52840
      - nrf54l15dk/nrf54l05/cpuapp
      - nrf54l15dk/nrf54l10/cpuapp
      - nrf54l15dk/nrf54l15/cpuapp
      - nrf54lm20dk/nrf54lm20a/cpuapp
      - nrf54lm20dk/nrf54lm20b/cpuapp
      - nrf54lv10dk/nrf54lv10a/cpuapp
      - nrf54lv10dk/nrf54lv10a/cpuapp/ns
      - nrf54lc10dk/nrf54lc10a/cpuapp
      - nrf54lc10dk/nrf54lc10a/cpuapp/ns
      - nrf54ls05dk/nrf54ls05b/cpuapp
      - nrf54ls05dk/nrf54ls05a/cpuapp
  # Split off from sample.bluetooth.llpm: this board runs the SoftDevice
  # Controller in the separate ipc_radio image, so the BT_CTLR_* setting in
  # overlay-bt_ctlr.conf has no effect in the application image.
  sample.bluetooth.llpm.ipc_radio:
    integration_platforms:
      - nrf54h20dk/nrf54h20/cpuapp
    platform_allow:
      - nrf54h20dk/nrf54h20/cpuapp
```

## samples/bluetooth/mesh/dfu/distributor/Kconfig
```kconfig
source "Kconfig.zephyr"

source "${ZEPHYR_NRF_MODULE_DIR}/samples/bluetooth/mesh/common/Kconfig"
```

## samples/bluetooth/mesh/light/sample.yaml
```yaml
sample:
  description: Bluetooth Mesh light sample
  name: Bluetooth Mesh light
common:
  tags:
    - bluetooth
    - ci_build
    - sysbuild
    - ci_samples_bluetooth
tests:
  sample.bluetooth.mesh.light:
    sysbuild: true
    build_only: true
    integration_platforms:
      - nrf54l15dk/nrf54l15/cpuapp
    platform_allow:
      - nrf5340dk/nrf5340/cpuapp
      - nrf5340dk/nrf5340/cpuapp/ns
      - nrf54l15dk/nrf54l15/cpuapp
      - nrf54l15dk/nrf54l10/cpuapp
      - nrf54l15dk/nrf54l05/cpuapp
      - nrf54lm20dk/nrf54lm20a/cpuapp
  sample.bluetooth.mesh.light.dfu:
    sysbuild: true
    build_only: true
    integration_platforms:
      - nrf54l15dk/nrf54l15/cpuapp
    platform_allow:
      - nrf54l15dk/nrf54l15/cpuapp
      - nrf54l15dk/nrf54l10/cpuapp
      - nrf54lm20dk/nrf54lm20a/cpuapp
      - nrf5340dk/nrf5340/cpuapp
      - nrf5340dk/nrf5340/cpuapp/ns
    extra_args: FILE_SUFFIX=dfu
  sample.bluetooth.mesh.light.settings_ext_flash:
    sysbuild: true
    build_only: true
    integration_platforms:
      - nrf54l15dk/nrf54l15/cpuapp
    platform_allow:
      - nrf54l15dk/nrf54l15/cpuapp
      - nrf54l15dk/nrf54l10/cpuapp
      - nrf54l15dk/nrf54l05/cpuapp
    extra_args: FILE_SUFFIX=settings_ext_flash
```

## samples/bluetooth/mesh/light_ctrl/sample.yaml
```yaml
sample:
  description: Bluetooth Mesh light fixture sample
  name: Bluetooth Mesh light fixture
common:
  tags:
    - bluetooth
    - ci_build
    - sysbuild
    - ci_samples_bluetooth
tests:
  sample.bluetooth.mesh.light_ctrl:
    sysbuild: true
    build_only: true
    integration_platforms:
      - nrf54l15dk/nrf54l15/cpuapp
    platform_allow:
      - nrf5340dk/nrf5340/cpuapp
      - nrf5340dk/nrf5340/cpuapp/ns
      - nrf54l15dk/nrf54l15/cpuapp
      - nrf54l15dk/nrf54l10/cpuapp
      - nrf54l15dk/nrf54l05/cpuapp
      - nrf54lm20dk/nrf54lm20a/cpuapp
  sample.bluetooth.mesh.light_ctrl.emds:
    sysbuild: true
    build_only: true
    integration_platforms:
      - nrf54l15dk/nrf54l15/cpuapp
    platform_allow:
      - nrf5340dk/nrf5340/cpuapp
      - nrf5340dk/nrf5340/cpuapp/ns
      - nrf54l15dk/nrf54l15/cpuapp
      - nrf54l15dk/nrf54l10/cpuapp
      - nrf54l15dk/nrf54l05/cpuapp
      - nrf54lm20dk/nrf54lm20a/cpuapp
    extra_args: FILE_SUFFIX=emds
  sample.bluetooth.mesh.light_ctrl.settings_ext_flash:
    sysbuild: true
    build_only: true
    integration_platforms:
      - nrf54l15dk/nrf54l15/cpuapp
    platform_allow:
      - nrf54l15dk/nrf54l15/cpuapp
      - nrf54l15dk/nrf54l10/cpuapp
      - nrf54l15dk/nrf54l05/cpuapp
    extra_args: FILE_SUFFIX=settings_ext_flash
```

## samples/bluetooth/mesh/light_dimmer/sample.yaml
```yaml
sample:
  description: Bluetooth Mesh light dimmer sample
  name: Bluetooth Mesh light dimmer
common:
  tags:
    - bluetooth
    - ci_build
    - sysbuild
    - ci_samples_bluetooth
tests:
  sample.bluetooth.mesh.light_dimmer:
    sysbuild: true
    build_only: true
    integration_platforms:
      - nrf54l15dk/nrf54l15/cpuapp
    platform_allow:
      - nrf5340dk/nrf5340/cpuapp
      - nrf5340dk/nrf5340/cpuapp/ns
      - nrf54l15dk/nrf54l15/cpuapp
      - nrf54l15dk/nrf54l10/cpuapp
      - nrf54l15dk/nrf54l05/cpuapp
      - nrf54lm20dk/nrf54lm20a/cpuapp
  sample.bluetooth.mesh.light_dimmer.settings_ext_flash:
    sysbuild: true
    build_only: true
    integration_platforms:
      - nrf54l15dk/nrf54l15/cpuapp
    platform_allow:
      - nrf54l15dk/nrf54l15/cpuapp
      - nrf54l15dk/nrf54l10/cpuapp
      - nrf54l15dk/nrf54l05/cpuapp
    extra_args: FILE_SUFFIX=settings_ext_flash
```

## samples/bluetooth/mesh/light_switch/boards/nrf52833dk_nrf52833.conf
```kconfig
#
# Copyright (c) 2026 Nordic Semiconductor ASA
#
# SPDX-License-Identifier: LicenseRef-Nordic-5-Clause
#
################################################################################
# Application overlay - nrf52833dk_nrf52833

CONFIG_RAM_POWER_DOWN_LIBRARY=y
```

## samples/bluetooth/mesh/light_switch/boards/nrf52840dk_nrf52840.conf
```kconfig
#
# Copyright (c) 2026 Nordic Semiconductor ASA
#
# SPDX-License-Identifier: LicenseRef-Nordic-5-Clause
#
################################################################################
# Application overlay - nrf52840dk_nrf52840

CONFIG_RAM_POWER_DOWN_LIBRARY=y
```

## samples/bluetooth/mesh/sensor_server/sample.yaml
```yaml
sample:
  description: Bluetooth Mesh sensor sample
  name: Bluetooth Mesh sensor
common:
  tags:
    - bluetooth
    - ci_build
    - sysbuild
    - ci_samples_bluetooth
tests:
  sample.bluetooth.mesh.sensor_server:
    sysbuild: true
    build_only: true
    integration_platforms:
      - nrf54l15dk/nrf54l15/cpuapp
    platform_allow:
      - nrf54l15dk/nrf54l15/cpuapp
      - nrf54l15dk/nrf54l10/cpuapp
      - nrf54l15dk/nrf54l05/cpuapp
      - nrf54lm20dk/nrf54lm20a/cpuapp
  sample.bluetooth.mesh.sensor_server.settings_ext_flash:
    sysbuild: true
    build_only: true
    integration_platforms:
      - nrf54l15dk/nrf54l15/cpuapp
    platform_allow:
      - nrf54l15dk/nrf54l15/cpuapp
      - nrf54l15dk/nrf54l10/cpuapp
      - nrf54l15dk/nrf54l05/cpuapp
    extra_args: FILE_SUFFIX=settings_ext_flash
```

## samples/bluetooth/nrf_auraconfig/Kconfig
```kconfig
#
# Copyright (c) 2024 Nordic Semiconductor ASA
#
# SPDX-License-Identifier: LicenseRef-Nordic-5-Clause
#

rsource "$(ZEPHYR_NRF_MODULE_DIR)/applications/nrf_audio/src/audio/Kconfig"
rsource "$(ZEPHYR_NRF_MODULE_DIR)/applications/nrf_audio/src/bluetooth/Kconfig"
rsource "$(ZEPHYR_NRF_MODULE_DIR)/applications/nrf_audio/src/modules/Kconfig"
rsource "$(ZEPHYR_NRF_MODULE_DIR)/applications/nrf_audio/src/utils/Kconfig"

config NRF_AUDIO_TRANSPORT_BIS
	bool "Use BIS (Broadcast Isochronous Stream)"

config NRF_AURACONFIG
	bool "nRF Auraconfig"
	depends on NRF_AUDIO_TRANSPORT_BIS
	select EXPERIMENTAL
	default y

menu "Logging"

module = NRF_AUDIO_MAIN
module-str = main
source "subsys/logging/Kconfig.template.log_config"

config NRF_AUDIO_PRINT_STACK_USAGE_MS
	depends on THREAD_ANALYZER && INIT_STACKS
	int "Print stack usage every x milliseconds"
	default 5000

endmenu # Log levels

source "Kconfig.zephyr"
```

## samples/bluetooth/nrf_dm/sample.yaml
```yaml
sample:
  description: nRF Distance Measurement sample
  name: Distance measurement sample
common:
  tags:
    - bluetooth
    - ci_build
    - sysbuild
    - ci_samples_bluetooth
tests:
  sample.bluetooth.nrf_dm.timeslot:
    sysbuild: true
    build_only: true
    extra_configs:
      - CONFIG_DM_HIGH_PRECISION_CALC=n
    integration_platforms:
      - nrf5340dk/nrf5340/cpuapp
    platform_allow:
      - nrf5340dk/nrf5340/cpuapp
  sample.bluetooth.nrf_dm.timeslot.high_precision:
    sysbuild: true
    build_only: true
    extra_configs:
      - CONFIG_DM_HIGH_PRECISION_CALC=y
    integration_platforms:
      - nrf5340dk/nrf5340/cpuapp
    platform_allow:
      - nrf5340dk/nrf5340/cpuapp
```

## samples/bluetooth/peripheral_power_profiling/Kconfig
```kconfig
#
# Copyright (c) 2022 Nordic Semiconductor
#
# SPDX-License-Identifier: LicenseRef-Nordic-5-Clause
#

source "Kconfig.zephyr"

menu "Nordic Bluetooth power profiling sample"

config BT_POWER_PROFILING_DATA_LENGTH
	int "Notification data length"
	default 20
	range 1 BT_L2CAP_TX_MTU
	help
	  Length of the data sends through notification mechanism.

config BT_POWER_PROFILING_NOTIFICATION_INTERVAL
	int "Notification interval"
	default 500
	help
	  Notification send interval in milliseconds. Notification data is sent on every interval
	  expiration.

config BT_POWER_PROFILING_NOTIFICATION_TIMEOUT
	int "Notification timeout"
	default 10000
	help
	  Notification timeout in milliseconds. When this timeout fires the device will stop
	  sending notifications.

config BT_POWER_PROFILING_CONNECTABLE_ADV_DURATION
	int "Connectable advertising duration"
	default 3000
	help
	  Connectable advertising duration in N*10 milliseconds unit.

config BT_POWER_PROFILING_NON_CONNECTABLE_ADV_DURATION
	int "Non-connectable advertising duration"
	default 6000
	help
	  Non-connectable advertising duration in N*10 milliseconds unit.

config BT_POWER_PROFILING_NFC_ADV_DURATION
	int "Advertising duration when the NFC field is detected"
	default 3000
	help
	  Advertising duration when the NFC field is detected in N*10 milliseconds unit.

config BT_POWER_PROFILING_CONNECTABLE_ADV_INTERVAL_MIN
	int "Connectable advertising minimum interval"
	default 160
	help
	  Connectable advertising minimum interval in 0.625 milliseconds unit.

config BT_POWER_PROFILING_CONNECTABLE_ADV_INTERVAL_MAX
	int "Connectable advertising maximum interval"
	default 240
	help
	  Connectable advertising maximum interval in 0.625 milliseconds unit.

config BT_POWER_PROFILING_NON_CONNECTABLE_ADV_INTERVAL_MIN
	int "Non-connectable advertising minimum interval"
	default 1600
	help
	  Non-connectable advertising minimum interval in 0.625 milliseconds unit.

config BT_POWER_PROFILING_NON_CONNECTABLE_ADV_INTERVAL_MAX
	int "Non-connectable advertising maximum interval"
	default 1920
	help
	  Non-connectable advertising maximum interval in 0.625 milliseconds unit.

config BT_POWER_PROFILING_LED_DISABLED
	bool "Disable LEDs"
	default y
	help
	  Disables the LEDs to reduce power consumption.

config BT_POWER_PROFILING_BUTTONS_DISABLED
	bool "Disable DK buttons"
	help
	  Disables the DK buttons library. Use this on boards where the DK buttons are not
	  usable, for example because they are wired to a GPIO port that cannot be read.

	  The DK buttons library polls the button pins every
	  CONFIG_DK_LIBRARY_BUTTON_SCAN_INTERVAL milliseconds for as long as any button reads
	  as pressed. On a board where a button pin is stuck in the active state, that poll
	  never stops and the periodic wake-ups dominate the measured current consumption.

	  With the buttons disabled, the sample starts connectable advertising right after
	  boot instead of waiting for a button press.

config BT_POWER_PROFILING_NFC_DISABLED
	bool "Disable NFC"
	default y if !HAS_HW_NRF_NFCT
	help
	  Disables the NFC to reduce power consumption.

config SETTINGS
	default y

config ZMS
	default y if (SOC_FLASH_NRF_RRAM || SOC_FLASH_NRF_MRAM)

config NVS
	default y if !(SOC_FLASH_NRF_RRAM || SOC_FLASH_NRF_MRAM)

endmenu
```

## samples/bluetooth/peripheral_power_profiling/boards/nrf7120dk_nrf7120_cpuapp.conf
```kconfig
#
# Copyright (c) 2026 Nordic Semiconductor ASA
#
# SPDX-License-Identifier: LicenseRef-Nordic-5-Clause
#

CONFIG_BT_POWER_PROFILING_BUTTONS_DISABLED=y

# Device power management
CONFIG_PM_DEVICE=y
CONFIG_PM_DEVICE_RUNTIME=y
```

## samples/bluetooth/sap_demo/Kconfig
```kconfig
#
# Copyright (c) 2026 Nordic Semiconductor ASA
#
# SPDX-License-Identifier: LicenseRef-Nordic-5-Clause
#

menu "Secure Application Pairing sample configuration"

choice SAMPLE_BT_SAP_ROLE
	prompt "SAP role"
	default SAMPLE_BT_SAP_ROLE_CENTRAL

config SAMPLE_BT_SAP_ROLE_CENTRAL
	bool "Central"
	select BT_CENTRAL
	select BT_OBSERVER
	select BT_GATT_CLIENT
	select BT_GATT_DM

config SAMPLE_BT_SAP_ROLE_PERIPHERAL
	bool "Peripheral"
	select BT_PERIPHERAL

endchoice

config SAMPLE_BT_SAP_EXPECTED_GROUP_ID
	hex "Expected SAP group identifier"
	default 0x2A
	help
	  Set the group identifier required in the peer's SAP certificate.

config SAMPLE_BT_SAP_ALLOWED_CENTRAL_ID
	int "Allowed central device identifier"
	range 0 255
	default 0
	help
	  Set the device identifier required when authenticating a central.

config SAMPLE_BT_SAP_PERIPHERAL_ID
	int "Hardware peripheral device identifier"
	depends on SAMPLE_BT_SAP_ROLE_PERIPHERAL
	range 1 4
	default 1
	help
	  Select which demo peripheral credential this hardware build should use.
	  The sample contains four provisioned peripheral identities with device
	  IDs 1..4. Build each real peripheral with a different value so the
	  central can authenticate and track them as distinct SAP peers.

config SAMPLE_BT_SAP_USE_CUSTOM_CREDENTIALS
	bool "Use custom SAP credential files"
	help
	  Embed a raw P-256 private key, SAP device certificate, and P-256 CA
	  public key from the files selected below.
	  This option is only for demonstration and testing.

if SAMPLE_BT_SAP_USE_CUSTOM_CREDENTIALS

config SAMPLE_BT_SAP_PRIVATE_KEY_FILE
	string "Raw P-256 private key file"
	help
	  Path to the 32-byte big-endian P-256 private key file.

config SAMPLE_BT_SAP_CERTIFICATE_FILE
	string "Raw SAP device certificate file"
	help
	  Path to the 133-byte serialized SAP device certificate file.

config SAMPLE_BT_SAP_CA_PUBLIC_KEY_FILE
	string "Raw P-256 CA public key file"
	help
	  Path to the 65-byte uncompressed P-256 CA public key file.

endif

endmenu

source "Kconfig.zephyr"
```

## samples/bootloader/sample.yaml
```yaml
sample:
  name: Bootloader Sample
tests:
  sample.bootloader:
    sysbuild: true
    build_only: true
    integration_platforms:
      - nrf9160dk/nrf9160
      - nrf9161dk/nrf9161
      - nrf9151dk/nrf9151
      - nrf54l15dk/nrf54l15/cpuapp
    platform_allow:
      - nrf5340dk/nrf5340/cpuapp
      - nrf9160dk/nrf9160
      - nrf9161dk/nrf9161
      - nrf9151dk/nrf9151
      - nrf54l15dk/nrf54l15/cpuapp
    extra_args:
      - DTC_OVERLAY_FILE="app_test.overlay"
    tags:
      - ci_build
      - sysbuild
      - ci_samples_bootloader
```

## samples/cellular/fmfu_smp_svr/sample.yaml
```yaml
sample:
  name: Full modem firmware update using SMP Server sample
  description: Full modem firmware update using SMP Server sample for cellular devices
tests:
  sample.cellular.fmfu_smp_svr:
    sysbuild: true
    build_only: true
    integration_platforms:
      - nrf9151dk/nrf9151/ns
    platform_allow:
      - nrf9151dk/nrf9151/ns
    tags:
      - ci_build
      - sysbuild
      - ci_samples_cellular
```

## samples/cellular/http_update/modem_delta_update/sample.yaml
```yaml
sample:
  name: HTTP modem delta update sample
tests:
  sample.cellular.http_update.modem_delta_update:
    sysbuild: true
    build_only: true
    integration_platforms:
      - nrf9151dk/nrf9151/ns
    platform_allow:
      - nrf9151dk/nrf9151/ns
    tags:
      - ci_build
      - sysbuild
      - ci_samples_cellular
```
