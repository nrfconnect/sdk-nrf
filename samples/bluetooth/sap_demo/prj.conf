## CMakeLists.txt
```
#
# Copyright (c) 2026 Nordic Semiconductor ASA
#
# SPDX-License-Identifier: LicenseRef-Nordic-5-Clause
#

cmake_minimum_required(VERSION 3.20.0)

find_package(Zephyr REQUIRED HINTS $ENV{ZEPHYR_BASE})
project(sap_demo)

target_sources(app PRIVATE
  src/main.c
  src/demo_credentials.c
)

target_sources_ifdef(CONFIG_SAMPLE_BT_SAP_ROLE_CENTRAL app PRIVATE src/sap_central.c)
target_sources_ifdef(CONFIG_SAMPLE_BT_SAP_ROLE_PERIPHERAL app PRIVATE src/sap_peripheral.c)
target_include_directories(app PRIVATE src)

if(CONFIG_SAMPLE_BT_SAP_USE_CUSTOM_CREDENTIALS)
  set(gen_dir "${ZEPHYR_BINARY_DIR}/include/generated")

  generate_inc_file_for_target(
    app
    "${CONFIG_SAMPLE_BT_SAP_PRIVATE_KEY_FILE}"
    "${gen_dir}/sap_private_key.inc"
  )
  generate_inc_file_for_target(
    app
    "${CONFIG_SAMPLE_BT_SAP_CERTIFICATE_FILE}"
    "${gen_dir}/sap_certificate.inc"
  )
  generate_inc_file_for_target(
    app
    "${CONFIG_SAMPLE_BT_SAP_CA_PUBLIC_KEY_FILE}"
    "${gen_dir}/sap_ca_public_key.inc"
  )

  message(WARNING
    "The SAP sample is embedding raw credential bytes from Kconfig-selected files. "
    "This path is for demos and tests only; production firmware must use "
    "product provisioning and secure credential storage."
  )
else()
  message(WARNING
    "The SAP sample is using preset demonstration credentials. "
    "Do not use these keys in production."
  )
endif()
```

## Kconfig
```
#
# Copyright (c) 2026 Nordic Semiconductor ASA
#
# SPDX-License-Identifier: LicenseRef-Nordic-5-Clause
#

menu "Secure Application Pairing sample configuration"

choice SAMPLE_BT_SAP_ROLE
	prompt "SAP role"
	default SAMPLE_BT_SAP_ROLE_CENTRAL

config SAMPLE_BT_SAP_ROLE_CENTRAL
	bool "Central"
	select BT_CENTRAL
	select BT_OBSERVER
	select BT_GATT_CLIENT
	select BT_GATT_DM

config SAMPLE_BT_SAP_ROLE_PERIPHERAL
	bool "Peripheral"
	select BT_PERIPHERAL

endchoice

config SAMPLE_BT_SAP_EXPECTED_GROUP_ID
	hex "Expected SAP group identifier"
	default 0x2A
	help
	  Set the group identifier required in the peer's SAP certificate.

config SAMPLE_BT_SAP_ALLOWED_CENTRAL_ID
	int "Allowed central device identifier"
	range 0 255
	default 0
	help
	  Set the device identifier required when authenticating a central.

config SAMPLE_BT_SAP_PERIPHERAL_ID
	int "Hardware peripheral device identifier"
	depends on SAMPLE_BT_SAP_ROLE_PERIPHERAL
	range 1 4
	default 1
	help
	  Select which demo peripheral credential this hardware build should use.
	  The sample contains four provisioned peripheral identities with device
	  IDs 1..4. Build each real peripheral with a different value so the
	  central can authenticate and track them as distinct SAP peers.

config SAMPLE_BT_SAP_USE_CUSTOM_CREDENTIALS
	bool "Use custom SAP credential files"
	help
	  Embed a raw P-256 private key, SAP device certificate, and P-256 CA
	  public key from the files selected below.
	  This option is only for demonstration and testing.

if SAMPLE_BT_SAP_USE_CUSTOM_CREDENTIALS

config SAMPLE_BT_SAP_PRIVATE_KEY_FILE
	string "Raw P-256 private key file"
	help
	  Path to the 32-byte big-endian P-256 private key file.

config SAMPLE_BT_SAP_CERTIFICATE_FILE
	string "Raw SAP device certificate file"
	help
	  Path to the 133-byte serialized SAP device certificate file.

config SAMPLE_BT_SAP_CA_PUBLIC_KEY_FILE
	string "Raw P-256 CA public key file"
	help
	  Path to the 65-byte uncompressed P-256 CA public key file.

endif

endmenu

source "Kconfig.zephyr"
```

## sample.yaml
```
#
# Copyright (c) 2026 Nordic Semiconductor ASA
#
# SPDX-License-Identifier: LicenseRef-Nordic-5-Clause
#

sample:
  name: Secure Application Pairing
tests:
  sample.bluetooth.sap.central:
    sysbuild: true
    build_only: true
    extra_args:
      - EXTRA_CONF_FILE=central.conf
    platform_allow: &sap_platforms
      - nrf52dk/nrf52832
      - nrf52840dk/nrf52840
      - nrf5340dk/nrf5340/cpuapp
      - nrf5340dk/nrf5340/cpuapp/ns
      - nrf54l15dk/nrf54l05/cpuapp
      - nrf54l15dk/nrf54l10/cpuapp
      - nrf54l15dk/nrf54l15/cpuapp
      - nrf54l15dk/nrf54l15/cpuapp/ns
    integration_platforms:
      - nrf52840dk/nrf52840
      - nrf54l15dk/nrf54l15/cpuapp
    tags:
      - bluetooth
      - ci_build
      - crypto
      - sysbuild
      - ci_samples_bluetooth
      - ci_tests_subsys_bluetooth_sap
  sample.bluetooth.sap.peripheral:
    sysbuild: true
    build_only: true
    extra_args:
      - EXTRA_CONF_FILE=peripheral.conf
    platform_allow: *sap_platforms
    integration_platforms:
      - nrf52840dk/nrf52840
      - nrf54l15dk/nrf54l15/cpuapp
    tags:
      - bluetooth
      - ci_build
      - crypto
      - sysbuild
      - ci_samples_bluetooth
      - ci_tests_subsys_bluetooth_sap
```

## prj.conf
```kconfig
#
# Copyright (c) 2026 Nordic Semiconductor ASA
#
# SPDX-License-Identifier: LicenseRef-Nordic-5-Clause
#

CONFIG_SYS_CLOCK_TICKS_PER_SEC=1000

CONFIG_BT_SAP=y
CONFIG_BT=y
CONFIG_BT_SMP=y
CONFIG_BT_SMP_ENFORCE_MITM=n
CONFIG_BT_PRIVACY=y
CONFIG_BT_DEVICE_NAME="SAP"
CONFIG_BT_DEVICE_NAME_DYNAMIC=y
CONFIG_BT_MAX_CONN=1
CONFIG_BT_MAX_PAIRED=1
CONFIG_BT_RX_STACK_SIZE=4096
CONFIG_BT_TX_PROCESSOR_STACK_SIZE=2048
CONFIG_BT_LONG_WQ_STACK_SIZE=2048
# SAP_REQUIRED_ATT_MTU is 283 with the default 128-byte app payload.
CONFIG_BT_L2CAP_TX_MTU=283
CONFIG_BT_BUF_ACL_RX_SIZE=287
CONFIG_BT_BUF_ACL_TX_SIZE=287
CONFIG_BT_GATT_DYNAMIC_DB=y
CONFIG_BT_GATT_SERVICE_CHANGED=y

CONFIG_LOG=y
CONFIG_LOG_MODE_IMMEDIATE=y
CONFIG_LOG_DEFAULT_LEVEL=3
CONFIG_BT_SAP_LOG_LEVEL_INF=y

CONFIG_MAIN_STACK_SIZE=4096
CONFIG_SYSTEM_WORKQUEUE_STACK_SIZE=2048
CONFIG_HEAP_MEM_POOL_SIZE=8192

CONFIG_ENTROPY_GENERATOR=y
```

## central.conf
```kconfig
#
# Copyright (c) 2026 Nordic Semiconductor ASA
#
# SPDX-License-Identifier: LicenseRef-Nordic-5-Clause
#

CONFIG_SAMPLE_BT_SAP_ROLE_CENTRAL=y
CONFIG_BT_SAP_MAX_PEERS=1
```

## peripheral.conf
```kconfig
#
# Copyright (c) 2026 Nordic Semiconductor ASA
#
# SPDX-License-Identifier: LicenseRef-Nordic-5-Clause
#

CONFIG_SAMPLE_BT_SAP_ROLE_PERIPHERAL=y
CONFIG_BT_MAX_CONN=1
CONFIG_BT_SAP_MAX_PEERS=1
```

## src/main.c
```c
/*
 * Copyright (c) 2026 Nordic Semiconductor ASA
 *
 * SPDX-License-Identifier: LicenseRef-Nordic-5-Clause
 */

#include <stdio.h>

#include <zephyr/kernel.h>
#include <zephyr/bluetooth/bluetooth.h>
#include <zephyr/bluetooth/conn.h>
#include <zephyr/logging/log.h>
#include <zephyr/sys/printk.h>

#include <bluetooth/services/sap.h>

#include "demo_credentials.h"

LOG_MODULE_REGISTER(sap_main, CONFIG_BT_SAP_LOG_LEVEL);

#if defined(CONFIG_SAMPLE_BT_SAP_ROLE_CENTRAL)
int sap_central_run(const struct bt_sap_policy *policy);
#endif

#if defined(CONFIG_SAMPLE_BT_SAP_ROLE_PERIPHERAL)
int sap_peripheral_run(const struct bt_sap_policy *policy);
#endif

static void set_name(enum sap_role role, const struct bt_sap_device_credential *credential)
{
	char name[24];
	int err;

	snprintk(name, sizeof(name), "SAP-%c-%u", (role == SAP_ROLE_CENTRAL) ? 'C' : 'P',
		 credential->cert.body.device_id);

	err = bt_set_name(name);
	if (err != 0) {
		LOG_WRN("Failed to set dynamic device name (%d)", err);
	}
}

static void pairing_complete(struct bt_conn *conn, bool bonded)
{
	struct bt_conn_info info;
	int err;

	err = bt_conn_get_info(conn, &info);
	if (err == 0) {
		LOG_INF("BLE pairing complete: bonded=%u level=%u key_size=%u", bonded,
			info.security.level, info.security.enc_key_size);
		return;
	}

	LOG_INF("BLE pairing complete: bonded=%u", bonded);
}

static void pairing_failed(struct bt_conn *conn, enum bt_security_err err)
{
	ARG_UNUSED(conn);

	LOG_ERR("BLE pairing failed: %d %s", err, bt_security_err_to_str(err));
}

static struct bt_conn_auth_info_cb auth_info_cb = {
	.pairing_complete = pairing_complete,
	.pairing_failed = pairing_failed,
};

int sap_demo_run(void)
{
	enum sap_role role = IS_ENABLED(CONFIG_SAMPLE_BT_SAP_ROLE_CENTRAL) ? SAP_ROLE_CENTRAL
									   : SAP_ROLE_PERIPHERAL;
	const struct bt_sap_device_credential *local_credential;
	struct bt_sap_policy policy;
	size_t ca_len;
	int err;

	local_credential = demo_credentials_select(role);
	memset(&policy, 0, sizeof(policy));
	policy.local_credential = local_credential;
	policy.ca_public_key = demo_credentials_ca_public_key(&ca_len);
	policy.ca_public_key_len = ca_len;
	policy.expected_group_id = CONFIG_SAMPLE_BT_SAP_EXPECTED_GROUP_ID;
	policy.allowed_central_id = CONFIG_SAMPLE_BT_SAP_ALLOWED_CENTRAL_ID;

	if (policy.local_credential == NULL || policy.ca_public_key == NULL ||
	    policy.ca_public_key_len != SAP_IDENTITY_PUBLIC_KEY_LEN) {
		LOG_ERR("Invalid SAP credential configuration");
		return -EINVAL;
	}

	err = bt_enable(NULL);
	if (err != 0) {
		LOG_ERR("Bluetooth init failed (%d)", err);
		return err;
	}

	err = bt_conn_auth_info_cb_register(&auth_info_cb);
	if (err != 0) {
		LOG_ERR("Failed to register pairing diagnostics (%d)", err);
		return err;
	}

	set_name(role, local_credential);

	LOG_INF("SAP sample starting as %s, local device id %u",
		(role == SAP_ROLE_CENTRAL) ? "central" : "peripheral",
		local_credential->cert.body.device_id);
	LOG_DBG("SAP policy: group=0x%02x allowed_central=%u", policy.expected_group_id,
		policy.allowed_central_id);

#if defined(CONFIG_SAMPLE_BT_SAP_ROLE_CENTRAL)
	return sap_central_run(&policy);
#else
	return sap_peripheral_run(&policy);
#endif
}

int main(void)
{
	return sap_demo_run();
}
```

## src/demo_credentials.c
```c
/*
 * Copyright (c) 2026 Nordic Semiconductor ASA
 *
 * SPDX-License-Identifier: LicenseRef-Nordic-5-Clause
 */

#include <zephyr/kernel.h>

#include "demo_credentials.h"

#if defined(CONFIG_SAMPLE_BT_SAP_USE_CUSTOM_CREDENTIALS)
static const uint8_t custom_private_key[] = {
#include "sap_private_key.inc"
};

static const uint8_t custom_certificate[] = {
#include "sap_certificate.inc"
};

static const uint8_t custom_ca_public_key[] = {
#include "sap_ca_public_key.inc"
};

BUILD_ASSERT(sizeof(custom_private_key) == SAP_IDENTITY_PRIVATE_KEY_LEN,
	     "Custom SAP private key must be 32 bytes");
BUILD_ASSERT(sizeof(custom_certificate) == sizeof(struct sap_certificate),
	     "Custom SAP certificate must be 133 bytes");
BUILD_ASSERT(sizeof(custom_ca_public_key) == SAP_IDENTITY_PUBLIC_KEY_LEN,
	     "Custom SAP CA public key must be 65 bytes");

static struct bt_sap_device_credential custom_credential;
static bool custom_credential_ready;

static const struct bt_sap_device_credential *custom_credentials_select(void)
{
	int err;

	if (custom_credential_ready) {
		return &custom_credential;
	}

	err = bt_sap_credential_from_bytes(&custom_credential, custom_private_key,
					   sizeof(custom_private_key), custom_certificate,
					   sizeof(custom_certificate));
	if (err != 0) {
		return NULL;
	}

	custom_credential_ready = true;

	return &custom_credential;
}
#endif

/*
 * These insecure sample identities use randomly generated P-256 private
 * scalars and matching CA-signed public keys. The values have no special
 * selection criteria beyond being valid P-256 keys. Replace them with
 * provisioned product credentials before using SAP outside this demo.
 */
static const uint8_t insecure_demo_sap_ca_public_key[SAP_IDENTITY_PUBLIC_KEY_LEN] = {
	0x04, 0x8d, 0x3f, 0x73, 0x9d, 0x0b, 0xef, 0x0d, 0xc2, 0x67, 0x6e, 0x47, 0x10,
	0xa9, 0xc8, 0xeb, 0xaf, 0x1b, 0x33, 0xb7, 0xca, 0x73, 0xe9, 0x03, 0x27, 0x84,
	0x01, 0x1a, 0x7b, 0xce, 0x23, 0x65, 0x1e, 0x66, 0xa2, 0xec, 0x87, 0x2f, 0x79,
	0x09, 0x20, 0xc2, 0x9d, 0x9f, 0x76, 0x4c, 0xf1, 0xc7, 0x71, 0x08, 0x55, 0x60,
	0x31, 0xb3, 0xad, 0x71, 0x16, 0x4e, 0xc0, 0xcf, 0x56, 0xe1, 0x68, 0x3a, 0x87,
};

#define INSECURE_DEMO_SAP_GROUP_ID 0x2A

/* clang-format off */
static const struct bt_sap_device_credential insecure_demo_central_credentials[] = {{
	.private_key = {
			0x79, 0xf7, 0x7d, 0x57, 0xf9, 0x6a, 0x0b, 0xd1, 0x1a, 0xf3, 0xc3,
			0x97, 0x9e, 0xe3, 0x37, 0x77, 0xd2, 0x89, 0x73, 0xf7, 0xf1, 0x24,
			0xe0, 0x23, 0xd5, 0x84, 0x45, 0x32, 0x69, 0x50, 0x91, 0xaf,
		},
	.cert = {
			.body = {
					.version = SAP_VERSION,
					.role_mask = 3,
					.device_id = 0,
					.group_id = INSECURE_DEMO_SAP_GROUP_ID,
					.public_key = {
							0x04, 0xf9, 0xb3, 0xf7, 0xcd, 0xe4, 0x8e,
							0x71, 0xc6, 0x02, 0xfc, 0xe9, 0x29, 0x47,
							0x3c, 0x42, 0xe4, 0x5b, 0xd4, 0xb4, 0x7e,
							0xff, 0x85, 0x95, 0x6e, 0xe5, 0x40, 0x45,
							0x8b, 0x9e, 0xc2, 0x0a, 0x8f, 0x29, 0xc8,
							0x8d, 0x70, 0xd1, 0x38, 0x69, 0x69, 0xdc,
							0x3f, 0xb7, 0x48, 0xa0, 0x1c, 0xdf, 0x08,
							0x0e, 0x43, 0xd5, 0xcd, 0x23, 0xc0, 0x26,
							0xf1, 0x46, 0x45, 0xae, 0x25, 0x15, 0x89,
							0xa4, 0x30,
						},
				},
			.ca_signature = {
					0x12, 0x4f, 0xb4, 0x13, 0x6c, 0x58, 0x8d, 0x19, 0x1a, 0x89,
					0xaa, 0x86, 0x98, 0xda, 0x7c, 0x19, 0x89, 0xdb, 0x31, 0x21,
					0xa3, 0xbf, 0x97, 0x36, 0x71, 0xa3, 0x9f, 0x65, 0x95, 0x33,
					0x09, 0x19, 0x7f, 0x0d, 0xf3, 0xc3, 0xa4, 0x3d, 0xce, 0x02,
					0xe1, 0xd4, 0xd5, 0xfe, 0x99, 0x37, 0xb3, 0xea, 0x4c, 0x88,
					0x3b, 0x99, 0xde, 0x35, 0x62, 0xcb, 0x2c, 0x9a, 0xe2, 0xa0,
					0x8a, 0xc4, 0xcb, 0x6b,
				},
		},
	}};

#if defined(CONFIG_SAMPLE_BT_SAP_ROLE_PERIPHERAL)
static const struct bt_sap_device_credential insecure_demo_peripheral_credentials[] = {{
		.private_key = {
				0x03, 0x11, 0x24, 0xa4, 0xbe, 0x9e, 0xf4, 0xea, 0x15, 0xd7, 0xce,
				0x4a, 0x87, 0x45, 0x5a, 0x88, 0x69, 0x65, 0x69, 0x99, 0x85, 0x62,
				0xdc, 0x19, 0x1b, 0xd0, 0x21, 0x3e, 0xb0, 0xc7, 0xea, 0xa6,
			},
		.cert = {
				.body = {
						.version = SAP_VERSION,
						.role_mask = 2,
						.device_id = 1,
						.group_id = INSECURE_DEMO_SAP_GROUP_ID,
						.public_key = {
								0x04, 0x9e, 0x81, 0x2d, 0xb0, 0xa0,
								0xda, 0x17, 0x26, 0x63, 0xe3, 0x6a,
								0x50, 0xd4, 0x92, 0x19, 0x46, 0x45,
								0xf1, 0x1e, 0x31, 0x9e, 0xfe, 0xe3,
								0x38, 0xc3, 0x7d, 0x05, 0xa0, 0x69,
								0x22, 0x7a, 0xf6, 0xfb, 0x8d, 0xe6,
								0x4c, 0xaa, 0x04, 0xa7, 0x28, 0xee,
								0xb3, 0xcd, 0xec, 0x98, 0xfb, 0xed,
								0x2b, 0x91, 0x80, 0x7a, 0xbc, 0xbb,
								0xe0, 0x90, 0x1a, 0xcf, 0x60, 0x20,
								0x4d, 0xa9, 0x52, 0x13, 0x99,
							},
					},
				.ca_signature = {
						0x79, 0x96, 0xb9, 0x70, 0xf9, 0xfc, 0x16, 0x7f,
						0x9f, 0x69, 0x09, 0x43, 0x54, 0x28, 0xca, 0x15,
						0xac, 0x1b, 0xc1, 0x15, 0xa8, 0xf9, 0x35, 0x13,
						0xa1, 0x06, 0x94, 0xd3, 0xbb, 0x96, 0x91, 0x1a,
						0x7b, 0x94, 0x9d, 0x0a, 0x93, 0x13, 0x9b, 0x05,
						0x82, 0x4d, 0x21, 0xae, 0x88, 0x62, 0xb1, 0xa9,
						0x80, 0xa4, 0xb0, 0xcb, 0xdd, 0x9d, 0xa9, 0x45,
						0xe8, 0x45, 0x60, 0xb3, 0xf0, 0x60, 0x29, 0x23,
					},
			},
	}, {
		.private_key = {
				0x4f, 0x8e, 0x5a, 0x97, 0xe7, 0xc6, 0xe5, 0x8c, 0x4f, 0xf0, 0xf8,
				0x58, 0x03, 0x73, 0xdb, 0xfa, 0xd5, 0x95, 0xbf, 0x1f, 0xf2, 0x5a,
				0x4e, 0xdf, 0x97, 0xe3, 0xc4, 0x47, 0x62, 0xeb, 0x17, 0xae,
			},
		.cert = {
				.body = {
						.version = SAP_VERSION,
						.role_mask = 2,
						.device_id = 2,
						.group_id = INSECURE_DEMO_SAP_GROUP_ID,
						.public_key = {
								0x04, 0x12, 0x39, 0x0d, 0xf0, 0x3b,
								0xa4, 0xb9, 0x4f, 0x8a, 0xf0, 0x1b,
								0x3f, 0x65, 0xd0, 0x6e, 0x6c, 0xcd,
								0xed, 0xd2, 0x3a, 0xce, 0x0b, 0xf9,
								0x42, 0x80, 0x87, 0x76, 0x5a, 0x39,
								0x35, 0x2f, 0xda, 0x9a, 0xea, 0x08,
								0xfa, 0xc9, 0x74, 0xba, 0xd8, 0x65,
								0x7b, 0x52, 0x03, 0x2c, 0x91, 0x26,
								0xf5, 0x02, 0x1f, 0x0a, 0xdb, 0xc7,
								0x41, 0x72, 0xbd, 0xde, 0x89, 0x70,
								0xbc, 0xca, 0x22, 0xd6, 0x3f,
							},
					},
				.ca_signature = {
						0xd3, 0xea, 0x56, 0xa6, 0x44, 0xd8, 0xc8, 0x94,
						0x30, 0x8d, 0x08, 0x32, 0x45, 0x40, 0x29, 0x79,
						0xcc, 0xac, 0x91, 0x4c, 0x56, 0xe3, 0xe0, 0x10,
						0x6f, 0xcc, 0x23, 0x84, 0x49, 0x1b, 0x63, 0x8e,
						0xe0, 0x4e, 0xe4, 0xcd, 0x5e, 0x07, 0x9f, 0x30,
						0x05, 0xeb, 0xda, 0x18, 0x7d, 0x78, 0x80, 0xa6,
						0xae, 0xc7, 0xd0, 0x35, 0xd1, 0x54, 0xba, 0xcb,
						0xe8, 0xaa, 0xf8, 0x80, 0xd9, 0xa1, 0x7a, 0x08,
					},
			},
	}, {
		.private_key = {
				0x93, 0xff, 0x23, 0xdc, 0x67, 0xf5, 0xcd, 0x1c, 0xb9, 0xbe, 0x39,
				0xfb, 0xa6, 0xf4, 0xba, 0x49, 0x1b, 0xac, 0xc4, 0x46, 0xae, 0x13,
				0x70, 0xc2, 0x42, 0x87, 0x78, 0x62, 0xad, 0x62, 0x43, 0x27,
			},
		.cert = {
				.body = {
						.version = SAP_VERSION,
						.role_mask = 2,
						.device_id = 3,
						.group_id = INSECURE_DEMO_SAP_GROUP_ID,
						.public_key = {
								0x04, 0x74, 0x82, 0x96, 0x2a, 0x7e,
								0x3a, 0x91, 0x3a, 0xa1, 0x5f, 0xe9,
								0x20, 0x9e, 0x1d, 0x5f, 0xca, 0x1f,
								0x79, 0x20, 0x45, 0x6c, 0x88, 0x95,
								0x71, 0xdb, 0x07, 0x45, 0x74, 0x6c,
								0xa9, 0xff, 0x2a, 0xd3, 0x8e, 0x5a,
								0xd9, 0x28, 0xc8, 0x23, 0x7e, 0x5e,
								0xb4, 0x0a, 0xcd, 0x11, 0xc3, 0x6f,
								0xa3, 0xff, 0x15, 0xfe, 0x94, 0x8f,
								0x6c, 0x16, 0xa2, 0x0f, 0xca, 0xcc,
								0x76, 0xe5, 0xb2, 0x9a, 0x2b,
							},
					},
				.ca_signature = {
						0x2f, 0xf8, 0x52, 0x03, 0x30, 0x93, 0xf8, 0x76,
						0x50, 0x1b, 0xe5, 0x5b, 0x41, 0x43, 0xea, 0xdc,
						0x90, 0x2a, 0xf1, 0xef, 0x7d, 0x16, 0x6c, 0x86,
						0x7c, 0x03, 0x32, 0xf7, 0x97, 0xdf, 0xc9, 0x7d,
						0x3a, 0x56, 0xf8, 0x4c, 0x64, 0xbf, 0x4e, 0xfb,
						0xd2, 0xaf, 0x94, 0x67, 0x89, 0xec, 0x6e, 0x7d,
						0xd8, 0x05, 0x82, 0x28, 0xae, 0x90, 0xc0, 0x3b,
						0x6e, 0x4f, 0x0f, 0x93, 0x88, 0xc2, 0x56, 0xf3,
					},
			},
	}, {
		.private_key = {
				0xdc, 0x8d, 0x04, 0x14, 0xb6, 0x72, 0x68, 0xfe, 0x81, 0xd8, 0x6d,
				0xb7, 0x1f, 0xc6, 0xfd, 0x6e, 0x68, 0xe8, 0x55, 0x6f, 0x7d, 0x3b,
				0x12, 0x64, 0xbb, 0x25, 0xcb, 0x47, 0x28, 0xd4, 0x05, 0x78,
			},
		.cert = {
				.body = {
						.version = SAP_VERSION,
						.role_mask = 2,
						.device_id = 4,
						.group_id = INSECURE_DEMO_SAP_GROUP_ID,
						.public_key = {
								0x04, 0x38, 0x80, 0x27, 0xbd, 0x0c,
								0x79, 0xcd, 0xd3, 0x36, 0xcd, 0xc3,
								0xdf, 0xeb, 0x03, 0xd1, 0x95, 0x50,
								0x38, 0x0c, 0x72, 0x3d, 0x0f, 0xd0,
								0xe9, 0xc1, 0x7d, 0x49, 0xab, 0xf1,
								0xff, 0x51, 0x3c, 0x2c, 0x17, 0x7c,
								0x1d, 0x21, 0xf3, 0xfe, 0x30, 0xe5,
								0x18, 0xb9, 0x0b, 0x29, 0x26, 0x8b,
								0x93, 0x95, 0xd5, 0x1a, 0x92, 0x1f,
								0x34, 0x89, 0x56, 0xb9, 0x66, 0xf3,
								0x35, 0x17, 0xb1, 0x68, 0xd8,
							},
					},
				.ca_signature = {
						0xea, 0x35, 0x6b, 0xcc, 0xca, 0xd7, 0x07, 0x30,
						0xf4, 0xc9, 0x84, 0x23, 0xc0, 0x1a, 0x13, 0xea,
						0x7e, 0xa1, 0x3b, 0x3e, 0x69, 0xf3, 0xd8, 0x30,
						0xc2, 0x97, 0x08, 0x39, 0xb5, 0x89, 0x3d, 0x05,
						0x83, 0x91, 0xe4, 0x34, 0x57, 0x5d, 0x9b, 0x31,
						0xda, 0xa8, 0x73, 0x97, 0x92, 0x3e, 0x05, 0xb2,
						0x7e, 0x0e, 0xb0, 0x52, 0x0c, 0x4f, 0x9e, 0xf1,
						0x9c, 0x0f, 0x4d, 0x76, 0x46, 0x53, 0x81, 0x9e,
					},
			},
	}};
#endif
/* clang-format on */

const struct bt_sap_device_credential *demo_credentials_select(enum sap_role role)
{
#if defined(CONFIG_SAMPLE_BT_SAP_USE_CUSTOM_CREDENTIALS)
	ARG_UNUSED(role);
	return custom_credentials_select();
#endif

#if !defined(CONFIG_SAMPLE_BT_SAP_ROLE_PERIPHERAL)
	ARG_UNUSED(role);
	return &insecure_demo_central_credentials[0];
#else
	size_t i;

	if (role == SAP_ROLE_CENTRAL) {
		return &insecure_demo_central_credentials[0];
	}

	for (i = 0; i < ARRAY_SIZE(insecure_demo_peripheral_credentials); i++) {
		if (insecure_demo_peripheral_credentials[i].cert.body.device_id ==
		    CONFIG_SAMPLE_BT_SAP_PERIPHERAL_ID) {
			return &insecure_demo_peripheral_credentials[i];
		}
	}

	return &insecure_demo_peripheral_credentials[0];
#endif
}

const uint8_t *demo_credentials_ca_public_key(size_t *len)
{
#if defined(CONFIG_SAMPLE_BT_SAP_USE_CUSTOM_CREDENTIALS)
	if (len != NULL) {
		*len = sizeof(custom_ca_public_key);
	}

	return custom_ca_public_key;
#endif

	if (len != NULL) {
		*len = sizeof(insecure_demo_sap_ca_public_key);
	}

	return insecure_demo_sap_ca_public_key;
}
```

## src/demo_credentials.h
```c
/*
 * Copyright (c) 2026 Nordic Semiconductor ASA
 *
 * SPDX-License-Identifier: LicenseRef-Nordic-5-Clause
 */

#ifndef BT_SAP_DEMO_CREDENTIALS_H_
#define BT_SAP_DEMO_CREDENTIALS_H_

#include <zephyr/types.h>

#include <bluetooth/services/sap.h>

const struct bt_sap_device_credential *demo_credentials_select(enum sap_role role);
const uint8_t *demo_credentials_ca_public_key(size_t *len);

#endif /* BT_SAP_DEMO_CREDENTIALS_H_ */
```

## src/demo_protocol.h
```c
/*
 * Copyright (c) 2026 Nordic Semiconductor ASA
 *
 * SPDX-License-Identifier: LicenseRef-Nordic-5-Clause
 */

#ifndef SAP_DEMO_PROTOCOL_H__
#define SAP_DEMO_PROTOCOL_H__

#include <zephyr/bluetooth/uuid.h>

#include <bluetooth/services/sap_protocol.h>

#define BT_UUID_SAP_DEMO_PROTECTED_SERVICE_VAL                                                     \
	BT_UUID_128_ENCODE(0x7a18e2d1, 0x3bd2, 0x4f31, 0x8c4b, 0xb6c5b8f7a101)
#define BT_UUID_SAP_DEMO_PROTECTED_STATUS_VAL                                                      \
	BT_UUID_128_ENCODE(0x7a18e2d1, 0x3bd2, 0x4f31, 0x8c4b, 0xb6c5b8f7a102)

#define BT_UUID_SAP_DEMO_PROTECTED_SERVICE                                                         \
	BT_UUID_DECLARE_128(BT_UUID_SAP_DEMO_PROTECTED_SERVICE_VAL)
#define BT_UUID_SAP_DEMO_PROTECTED_STATUS BT_UUID_DECLARE_128(BT_UUID_SAP_DEMO_PROTECTED_STATUS_VAL)

enum sap_demo_message_type {
	SAP_DEMO_MSG_TEXT = SAP_APP_MSG_TYPE_MIN,
};

#endif /* SAP_DEMO_PROTOCOL_H__ */
```

## src/sap_central.c
```c
/*
 * Copyright (c) 2026 Nordic Semiconductor ASA
 *
 * SPDX-License-Identifier: LicenseRef-Nordic-5-Clause
 */

#include <errno.h>
#include <stddef.h>
#include <string.h>

#include <zephyr/bluetooth/att.h>
#include <zephyr/bluetooth/bluetooth.h>
#include <zephyr/bluetooth/conn.h>
#include <zephyr/bluetooth/gatt.h>
#include <zephyr/kernel.h>
#include <zephyr/logging/log.h>
#include <zephyr/sys/atomic.h>
#include <zephyr/sys/printk.h>

#include <bluetooth/gatt_dm.h>
#include <bluetooth/services/sap.h>

#include "demo_protocol.h"

LOG_MODULE_REGISTER(sap_central, CONFIG_BT_SAP_LOG_LEVEL);

#define SAP_SCAN_RETRY_DELAY	  K_MSEC(500)
#define SAP_PROTECTED_RETRY_DELAY K_MSEC(200)
#define SAP_PROTECTED_RETRY_MAX	  5U
#define SAP_RX_QUEUE_DEPTH	  (CONFIG_BT_SAP_MAX_PEERS * 4U)
#define SAP_RX_THREAD_STACK_SIZE  2048
#define SAP_RX_THREAD_PRIORITY	  7

struct sap_handles {
	uint16_t auth;
	uint16_t auth_ccc;
	uint16_t secure_tx;
	uint16_t secure_tx_ccc;
	uint16_t secure_rx;
};

struct sap_central_peer {
	struct bt_conn *conn;
	struct bt_sap_session *session;
	struct sap_handles handles;
	struct bt_gatt_exchange_params mtu_exchange_params;
	struct bt_gatt_subscribe_params auth_sub_params;
	struct bt_gatt_subscribe_params secure_sub_params;
	struct bt_gatt_read_params protected_read_params;
	struct k_work_delayable protected_work;
	uint16_t protected_status_handle;
	uint8_t protected_attempts;
	uint8_t peer_device_id;
	bool in_use;
	bool mtu_ready;
	bool discovery_ready;
	bool auth_subscribed;
	bool secure_subscribed;
	bool sap_auth_started;
	bool authenticated;
};

struct sap_rx_item {
	struct bt_conn *conn;
	uint8_t data[BT_ATT_MAX_ATTRIBUTE_LEN];
	uint16_t len;
	bool secure;
};

static void scan_work_fn(struct k_work *work);
static void protected_work_fn(struct k_work *work);
static void discover_sap(struct sap_central_peer *peer);
static void device_found(const bt_addr_le_t *addr, int8_t rssi, uint8_t type,
			 struct net_buf_simple *ad);

static struct bt_sap_context *sap_ctx;
static struct sap_central_peer peers[CONFIG_BT_SAP_MAX_PEERS];
static struct k_work_delayable scan_work;
static struct bt_conn *conn_connecting;
static bool scanning_active;

static const uint8_t sap_service_uuid[] = {BT_UUID_SAP_SERVICE_VAL};

K_MSGQ_DEFINE(sap_rx_msgq, sizeof(struct sap_rx_item), SAP_RX_QUEUE_DEPTH, sizeof(void *));

static struct sap_central_peer *peer_from_session(struct bt_sap_session *session)
{
	for (size_t i = 0U; i < ARRAY_SIZE(peers); i++) {
		if (peers[i].in_use && peers[i].session == session) {
			return &peers[i];
		}
	}

	return NULL;
}

static struct sap_central_peer *peer_from_event(const struct bt_sap_event *event)
{
	struct sap_central_peer *peer = event == NULL ? NULL : event->user_data;

	if (peer == NULL || !peer->in_use) {
		return NULL;
	}

	return peer;
}

static struct sap_central_peer *peer_from_conn(struct bt_conn *conn)
{
	for (size_t i = 0U; i < ARRAY_SIZE(peers); i++) {
		if (peers[i].in_use && peers[i].conn == conn) {
			return &peers[i];
		}
	}

	return NULL;
}

static int queue_frame_rx(struct bt_conn *conn, const void *data, uint16_t len, bool secure)
{
	struct sap_rx_item item = {
		.len = len,
		.secure = secure,
	};
	int err;

	if (conn == NULL || data == NULL) {
		return -EINVAL;
	}

	if (len > sizeof(item.data)) {
		return -EMSGSIZE;
	}

	item.conn = bt_conn_ref(conn);
	memcpy(item.data, data, len);

	err = k_msgq_put(&sap_rx_msgq, &item, K_NO_WAIT);
	if (err != 0) {
		bt_conn_unref(item.conn);
	}

	return err;
}

static void sap_rx_thread(void *p1, void *p2, void *p3)
{
	ARG_UNUSED(p1);
	ARG_UNUSED(p2);
	ARG_UNUSED(p3);

	while (true) {
		struct sap_rx_item item;
		struct sap_central_peer *peer;
		int err;

		(void)k_msgq_get(&sap_rx_msgq, &item, K_FOREVER);

		peer = peer_from_conn(item.conn);
		if (peer != NULL && peer->session != NULL) {
			if (item.secure) {
				err = bt_sap_handle_secure_rx(peer->session, item.data, item.len);
			} else {
				err = bt_sap_handle_auth_rx(peer->session, item.data, item.len);
			}

			if (err != 0) {
				LOG_ERR("SAP %s frame rejected (%d)",
					item.secure ? "secure" : "auth", err);
				(void)bt_conn_disconnect(item.conn, BT_HCI_ERR_AUTH_FAIL);
			}
		}

		bt_conn_unref(item.conn);
	}
}

K_THREAD_DEFINE(sap_rx_thread_id, SAP_RX_THREAD_STACK_SIZE, sap_rx_thread, NULL, NULL, NULL,
		SAP_RX_THREAD_PRIORITY, 0, 0);

static size_t active_peer_count(void)
{
	size_t count = 0U;

	for (size_t i = 0U; i < ARRAY_SIZE(peers); i++) {
		if (peers[i].in_use) {
			count++;
		}
	}

	return count;
}

static int central_write_frame(struct sap_central_peer *peer, uint16_t handle, const uint8_t *data,
			       size_t len)
{
	if (peer == NULL || peer->conn == NULL || handle == 0U) {
		return -ENOTCONN;
	}

	if (len > BT_ATT_MAX_ATTRIBUTE_LEN) {
		return -EMSGSIZE;
	}

	return bt_gatt_write_without_response(peer->conn, handle, data, len, false);
}

static int send_auth(struct bt_sap_session *session, uint8_t msg_type, const uint8_t *data,
		     size_t len)
{
	struct sap_central_peer *peer = peer_from_session(session);

	ARG_UNUSED(msg_type);

	if (peer == NULL) {
		return -ENOTCONN;
	}

	return central_write_frame(peer, peer->handles.auth, data, len);
}

static int send_secure(struct bt_sap_session *session, uint8_t msg_type, const uint8_t *data,
		       size_t len)
{
	struct sap_central_peer *peer = peer_from_session(session);

	ARG_UNUSED(msg_type);

	if (peer == NULL) {
		return -ENOTCONN;
	}

	return central_write_frame(peer, peer->handles.secure_rx, data, len);
}

static void secure_payload_received(const struct bt_sap_event *event, uint8_t msg_type,
				    const uint8_t *data, size_t len)
{
	if (msg_type != SAP_DEMO_MSG_TEXT) {
		LOG_INF("Secure payload from peripheral %u type=0x%02x len=%zu",
			event->peer_device_id, msg_type, len);
		return;
	}

	LOG_INF("Secure payload from peripheral %u: %.*s", event->peer_device_id, (int)len,
		(const char *)data);
}

static bool adv_data_matches_sap(struct bt_data *data, void *user_data)
{
	bool *matched = user_data;

	if (data->type != BT_DATA_UUID128_SOME && data->type != BT_DATA_UUID128_ALL) {
		return true;
	}

	for (size_t i = 0U; (i + sizeof(sap_service_uuid)) <= data->data_len;
	     i += sizeof(sap_service_uuid)) {
		if (memcmp(&data->data[i], sap_service_uuid, sizeof(sap_service_uuid)) == 0) {
			*matched = true;
			return false;
		}
	}

	return true;
}

static int assign_char_handle(const struct bt_gatt_dm *dm, const struct bt_uuid *uuid,
			      uint16_t *value_handle, uint16_t *ccc_handle)
{
	const struct bt_gatt_dm_attr *chrc_attr;
	const struct bt_gatt_dm_attr *ccc_attr;
	struct bt_gatt_chrc *chrc;

	chrc_attr = bt_gatt_dm_char_by_uuid(dm, uuid);
	if (chrc_attr == NULL) {
		return -ENOENT;
	}

	chrc = bt_gatt_dm_attr_chrc_val(chrc_attr);
	if (chrc == NULL) {
		return -ENOENT;
	}

	*value_handle = chrc->value_handle;

	if (ccc_handle != NULL) {
		ccc_attr = bt_gatt_dm_desc_by_uuid(dm, chrc_attr, BT_UUID_GATT_CCC);
		if (ccc_attr == NULL) {
			return -ENOENT;
		}

		*ccc_handle = ccc_attr->handle;
	}

	return 0;
}

static int assign_sap_handles(const struct bt_gatt_dm *dm, struct sap_handles *handles)
{
	int err;

	err = assign_char_handle(dm, BT_UUID_SAP_AUTH, &handles->auth, &handles->auth_ccc);
	if (err != 0) {
		return err;
	}

	err = assign_char_handle(dm, BT_UUID_SAP_SECURE_TX, &handles->secure_tx,
				 &handles->secure_tx_ccc);
	if (err != 0) {
		return err;
	}

	return assign_char_handle(dm, BT_UUID_SAP_SECURE_RX, &handles->secure_rx, NULL);
}

static void start_sap_auth_if_ready(struct sap_central_peer *peer)
{
	int err;

	if (peer == NULL || peer->sap_auth_started || peer->session == NULL) {
		return;
	}

	if (!peer->mtu_ready || !peer->discovery_ready || !peer->auth_subscribed ||
	    !peer->secure_subscribed) {
		return;
	}

	peer->sap_auth_started = true;
	err = bt_sap_start(peer->session);
	if (err != 0) {
		LOG_ERR("SAP start failed (%d)", err);
		(void)bt_conn_disconnect(peer->conn, BT_HCI_ERR_REMOTE_USER_TERM_CONN);
	}
}

static void mtu_exchange_cb(struct bt_conn *conn, uint8_t err,
			    struct bt_gatt_exchange_params *params)
{
	struct sap_central_peer *peer =
		CONTAINER_OF(params, struct sap_central_peer, mtu_exchange_params);
	uint16_t mtu;

	if (!peer->in_use || peer->conn != conn) {
		return;
	}

	if (err != 0U) {
		LOG_ERR("MTU exchange failed (%u)", err);
		(void)bt_conn_disconnect(conn, BT_HCI_ERR_REMOTE_USER_TERM_CONN);
		return;
	}

	mtu = bt_gatt_get_mtu(conn);
	if (mtu < SAP_REQUIRED_ATT_MTU) {
		LOG_ERR("SAP requires ATT MTU %u, negotiated %u", SAP_REQUIRED_ATT_MTU, mtu);
		(void)bt_conn_disconnect(conn, BT_HCI_ERR_REMOTE_USER_TERM_CONN);
		return;
	}

	peer->mtu_ready = true;
	LOG_INF("ATT MTU %u ready for SAP", mtu);
	discover_sap(peer);
}

static void start_mtu_exchange(struct sap_central_peer *peer)
{
	uint16_t mtu = bt_gatt_get_mtu(peer->conn);
	int err;

	if (mtu >= SAP_REQUIRED_ATT_MTU) {
		peer->mtu_ready = true;
		discover_sap(peer);
		return;
	}

	peer->mtu_exchange_params.func = mtu_exchange_cb;
	err = bt_gatt_exchange_mtu(peer->conn, &peer->mtu_exchange_params);
	if (err == 0) {
		return;
	}

	if (err == -EALREADY) {
		mtu = bt_gatt_get_mtu(peer->conn);
		if (mtu >= SAP_REQUIRED_ATT_MTU) {
			peer->mtu_ready = true;
			discover_sap(peer);
			return;
		}
	}

	LOG_ERR("Failed to start MTU exchange (%d)", err);
	(void)bt_conn_disconnect(peer->conn, BT_HCI_ERR_REMOTE_USER_TERM_CONN);
}

static uint8_t auth_notify_cb(struct bt_conn *conn, struct bt_gatt_subscribe_params *params,
			      const void *data, uint16_t length)
{
	struct sap_central_peer *peer =
		CONTAINER_OF(params, struct sap_central_peer, auth_sub_params);
	int err;

	if (data == NULL) {
		peer->auth_subscribed = false;
		return BT_GATT_ITER_STOP;
	}

	err = queue_frame_rx(conn, data, length, false);
	if (err != 0) {
		LOG_ERR("Fatal SAP auth RX queue failure (%d)", err);
		(void)bt_conn_disconnect(conn, BT_HCI_ERR_REMOTE_USER_TERM_CONN);
		return BT_GATT_ITER_STOP;
	}

	return BT_GATT_ITER_CONTINUE;
}

static uint8_t secure_notify_cb(struct bt_conn *conn, struct bt_gatt_subscribe_params *params,
				const void *data, uint16_t length)
{
	struct sap_central_peer *peer =
		CONTAINER_OF(params, struct sap_central_peer, secure_sub_params);
	int err;

	if (data == NULL) {
		peer->secure_subscribed = false;
		return BT_GATT_ITER_STOP;
	}

	err = queue_frame_rx(conn, data, length, true);
	if (err != 0) {
		LOG_ERR("Fatal SAP secure RX queue failure (%d)", err);
		(void)bt_conn_disconnect(conn, BT_HCI_ERR_REMOTE_USER_TERM_CONN);
		return BT_GATT_ITER_STOP;
	}

	return BT_GATT_ITER_CONTINUE;
}

static void auth_subscribe_cb(struct bt_conn *conn, uint8_t err,
			      struct bt_gatt_subscribe_params *params)
{
	struct sap_central_peer *peer =
		CONTAINER_OF(params, struct sap_central_peer, auth_sub_params);

	if (err != 0U) {
		LOG_ERR("SAP auth subscription failed (%u)", err);
		(void)bt_conn_disconnect(conn, BT_HCI_ERR_REMOTE_USER_TERM_CONN);
		return;
	}

	peer->auth_subscribed = true;
	start_sap_auth_if_ready(peer);
}

static void secure_subscribe_cb(struct bt_conn *conn, uint8_t err,
				struct bt_gatt_subscribe_params *params)
{
	struct sap_central_peer *peer =
		CONTAINER_OF(params, struct sap_central_peer, secure_sub_params);

	if (err != 0U) {
		LOG_ERR("SAP secure subscription failed (%u)", err);
		(void)bt_conn_disconnect(conn, BT_HCI_ERR_REMOTE_USER_TERM_CONN);
		return;
	}

	peer->secure_subscribed = true;
	start_sap_auth_if_ready(peer);
}

static void sap_discovered(struct bt_gatt_dm *dm, void *context)
{
	struct sap_central_peer *peer = context;
	int err;

	err = assign_sap_handles(dm, &peer->handles);
	if (err != 0) {
		bt_gatt_dm_data_release(dm);
		LOG_ERR("Failed to assign SAP handles (%d)", err);
		(void)bt_conn_disconnect(peer->conn, BT_HCI_ERR_REMOTE_USER_TERM_CONN);
		return;
	}

	bt_gatt_dm_data_release(dm);
	peer->discovery_ready = true;

	peer->auth_sub_params.notify = auth_notify_cb;
	peer->auth_sub_params.subscribe = auth_subscribe_cb;
	peer->auth_sub_params.value = BT_GATT_CCC_NOTIFY;
	peer->auth_sub_params.value_handle = peer->handles.auth;
	peer->auth_sub_params.ccc_handle = peer->handles.auth_ccc;
	atomic_set_bit(peer->auth_sub_params.flags, BT_GATT_SUBSCRIBE_FLAG_VOLATILE);

	err = bt_gatt_subscribe(peer->conn, &peer->auth_sub_params);
	if (err != 0) {
		LOG_ERR("Failed to subscribe to SAP auth (%d)", err);
		(void)bt_conn_disconnect(peer->conn, BT_HCI_ERR_REMOTE_USER_TERM_CONN);
		return;
	}

	peer->secure_sub_params.notify = secure_notify_cb;
	peer->secure_sub_params.subscribe = secure_subscribe_cb;
	peer->secure_sub_params.value = BT_GATT_CCC_NOTIFY;
	peer->secure_sub_params.value_handle = peer->handles.secure_tx;
	peer->secure_sub_params.ccc_handle = peer->handles.secure_tx_ccc;
	atomic_set_bit(peer->secure_sub_params.flags, BT_GATT_SUBSCRIBE_FLAG_VOLATILE);

	err = bt_gatt_subscribe(peer->conn, &peer->secure_sub_params);
	if (err != 0) {
		LOG_ERR("Failed to subscribe to SAP secure TX (%d)", err);
		(void)bt_conn_disconnect(peer->conn, BT_HCI_ERR_REMOTE_USER_TERM_CONN);
	}
}

static void sap_service_not_found(struct bt_conn *conn, void *context)
{
	ARG_UNUSED(context);
	LOG_ERR("SAP service not found");
	(void)bt_conn_disconnect(conn, BT_HCI_ERR_REMOTE_USER_TERM_CONN);
}

static void sap_discovery_error(struct bt_conn *conn, int err, void *context)
{
	ARG_UNUSED(context);
	LOG_ERR("SAP service discovery failed (%d)", err);
	(void)bt_conn_disconnect(conn, BT_HCI_ERR_REMOTE_USER_TERM_CONN);
}

static const struct bt_gatt_dm_cb sap_dm_cb = {
	.completed = sap_discovered,
	.service_not_found = sap_service_not_found,
	.error_found = sap_discovery_error,
};

static uint8_t protected_read_cb(struct bt_conn *conn, uint8_t err,
				 struct bt_gatt_read_params *params, const void *data,
				 uint16_t length)
{
	ARG_UNUSED(params);

	if (err != 0U) {
		LOG_ERR("Protected service read failed (%u)", err);
		return BT_GATT_ITER_STOP;
	}

	if (data == NULL) {
		return BT_GATT_ITER_STOP;
	}

	LOG_INF("Protected service payload: %.*s", length, (const char *)data);

	return BT_GATT_ITER_STOP;
}

static void protected_discovered(struct bt_gatt_dm *dm, void *context)
{
	struct sap_central_peer *peer = context;
	const struct bt_gatt_dm_attr *chrc_attr;
	struct bt_gatt_chrc *chrc;
	int err;

	chrc_attr = bt_gatt_dm_char_by_uuid(dm, BT_UUID_SAP_DEMO_PROTECTED_STATUS);
	if (chrc_attr == NULL) {
		bt_gatt_dm_data_release(dm);
		LOG_ERR("Protected status characteristic not found");
		return;
	}

	chrc = bt_gatt_dm_attr_chrc_val(chrc_attr);
	if (chrc == NULL) {
		bt_gatt_dm_data_release(dm);
		LOG_ERR("Protected status characteristic was malformed");
		return;
	}

	peer->protected_status_handle = chrc->value_handle;
	peer->protected_attempts = 0U;
	bt_gatt_dm_data_release(dm);

	memset(&peer->protected_read_params, 0, sizeof(peer->protected_read_params));
	peer->protected_read_params.func = protected_read_cb;
	peer->protected_read_params.handle_count = 1U;
	peer->protected_read_params.single.handle = peer->protected_status_handle;
	peer->protected_read_params.single.offset = 0U;

	err = bt_gatt_read(peer->conn, &peer->protected_read_params);
	if (err != 0) {
		LOG_ERR("Failed to read protected status (%d)", err);
	}
}

static void protected_service_not_found(struct bt_conn *conn, void *context)
{
	struct sap_central_peer *peer = context;

	ARG_UNUSED(conn);

	if (peer->protected_attempts < SAP_PROTECTED_RETRY_MAX) {
		(void)k_work_reschedule(&peer->protected_work, SAP_PROTECTED_RETRY_DELAY);
		return;
	}

	LOG_WRN("Protected service was not discovered");
}

static void protected_discovery_error(struct bt_conn *conn, int err, void *context)
{
	struct sap_central_peer *peer = context;

	ARG_UNUSED(conn);
	LOG_ERR("Protected service discovery failed (%d)", err);

	if (peer->protected_attempts < SAP_PROTECTED_RETRY_MAX) {
		(void)k_work_reschedule(&peer->protected_work, SAP_PROTECTED_RETRY_DELAY);
	}
}

static const struct bt_gatt_dm_cb protected_dm_cb = {
	.completed = protected_discovered,
	.service_not_found = protected_service_not_found,
	.error_found = protected_discovery_error,
};

static void protected_work_fn(struct k_work *work)
{
	struct sap_central_peer *peer = CONTAINER_OF(k_work_delayable_from_work(work),
						     struct sap_central_peer, protected_work);
	int err;

	if (!peer->in_use || peer->conn == NULL || peer->session == NULL || !peer->authenticated) {
		return;
	}

	peer->protected_attempts++;
	err = bt_gatt_dm_start(peer->conn, BT_UUID_SAP_DEMO_PROTECTED_SERVICE, &protected_dm_cb,
			       peer);
	if (err != 0) {
		LOG_ERR("Failed to start protected service discovery (%d)", err);
		if (peer->protected_attempts < SAP_PROTECTED_RETRY_MAX) {
			(void)k_work_reschedule(&peer->protected_work, SAP_PROTECTED_RETRY_DELAY);
		}
	}
}

static void discover_sap(struct sap_central_peer *peer)
{
	int err;

	err = bt_gatt_dm_start(peer->conn, BT_UUID_SAP_SERVICE, &sap_dm_cb, peer);
	if (err != 0) {
		LOG_ERR("Failed to start SAP discovery (%d)", err);
		(void)bt_conn_disconnect(peer->conn, BT_HCI_ERR_REMOTE_USER_TERM_CONN);
	}
}

static void send_initial_payload(struct sap_central_peer *peer)
{
	char payload[16];
	int len;
	int err;

	len = snprintk(payload, sizeof(payload), "hello-%u", peer->peer_device_id);
	err = bt_sap_send_secure(peer->session, SAP_DEMO_MSG_TEXT, payload, len);
	if (err != 0) {
		LOG_ERR("Failed to send secure payload (%d)", err);
	}
}

static void sap_authenticated(const struct bt_sap_event *event)
{
	struct sap_central_peer *peer = peer_from_event(event);

	if (peer == NULL || !peer->in_use) {
		return;
	}

	peer->authenticated = true;
	peer->peer_device_id = event->peer_device_id;
	LOG_INF("SAP authenticated with peripheral %u", event->peer_device_id);
	send_initial_payload(peer);
	(void)k_work_reschedule(&peer->protected_work, SAP_PROTECTED_RETRY_DELAY);
}

static void sap_failed(const struct bt_sap_event *event)
{
	struct sap_central_peer *peer = peer_from_event(event);

	if (peer == NULL || !peer->in_use) {
		return;
	}

	peer->authenticated = false;
	LOG_ERR("SAP authentication failed for peripheral %u (%d)", event->peer_device_id,
		event->reason);
	if (peer->conn != NULL) {
		(void)bt_conn_disconnect(peer->conn, BT_HCI_ERR_AUTH_FAIL);
	}
}

static void peer_clear(struct sap_central_peer *peer)
{
	struct k_work_sync sync;

	(void)k_work_cancel_delayable_sync(&peer->protected_work, &sync);

	if (peer->conn != NULL) {
		bt_conn_unref(peer->conn);
	}

	memset(peer, 0, sizeof(*peer));
}

static bool conn_is_central(struct bt_conn *conn)
{
	struct bt_conn_info info;

	if (bt_conn_get_info(conn, &info) != 0) {
		return false;
	}

	return info.role == BT_CONN_ROLE_CENTRAL;
}

static void connected(struct bt_conn *conn, uint8_t err)
{
	struct sap_central_peer *peer = NULL;
	bool was_connecting = (conn == conn_connecting);

	if (was_connecting) {
		bt_conn_unref(conn_connecting);
		conn_connecting = NULL;
	}

	if (!was_connecting && !conn_is_central(conn)) {
		return;
	}

	if (err != 0U) {
		LOG_ERR("Connection failed (0x%02x)", err);
		(void)k_work_reschedule(&scan_work, SAP_SCAN_RETRY_DELAY);
		return;
	}

	for (size_t i = 0U; i < ARRAY_SIZE(peers); i++) {
		if (!peers[i].in_use) {
			peer = &peers[i];
			memset(peer, 0, sizeof(*peer));
			peer->in_use = true;
			peer->conn = bt_conn_ref(conn);
			k_work_init_delayable(&peer->protected_work, protected_work_fn);
			break;
		}
	}

	if (peer == NULL) {
		LOG_ERR("No peer slots left");
		(void)bt_conn_disconnect(conn, BT_HCI_ERR_CONN_LIMIT_EXCEEDED);
		return;
	}

	peer->session = bt_sap_on_connected(sap_ctx, conn);
	if (peer->session == NULL) {
		LOG_ERR("No SAP session available");
		peer_clear(peer);
		(void)bt_conn_disconnect(conn, BT_HCI_ERR_CONN_LIMIT_EXCEEDED);
		return;
	}

	bt_sap_session_set_user_data(peer->session, peer);

	LOG_INF("Peripheral connected");

	start_mtu_exchange(peer);
	(void)k_work_reschedule(&scan_work, SAP_SCAN_RETRY_DELAY);
}

static void disconnected(struct bt_conn *conn, uint8_t reason)
{
	struct sap_central_peer *peer = peer_from_conn(conn);

	if (conn == conn_connecting) {
		bt_conn_unref(conn_connecting);
		conn_connecting = NULL;
	}

	if (peer == NULL) {
		(void)k_work_reschedule(&scan_work, SAP_SCAN_RETRY_DELAY);
		return;
	}

	LOG_INF("Peripheral disconnected (reason %u)", reason);

	if (peer->session != NULL) {
		bt_sap_on_disconnected(sap_ctx, conn);
	}

	peer_clear(peer);
	(void)k_work_reschedule(&scan_work, SAP_SCAN_RETRY_DELAY);
}

BT_CONN_CB_DEFINE(conn_callbacks) = {
	.connected = connected,
	.disconnected = disconnected,
};

static void device_found(const bt_addr_le_t *addr, int8_t rssi, uint8_t type,
			 struct net_buf_simple *ad)
{
	struct bt_conn *existing;
	char addr_str[BT_ADDR_LE_STR_LEN];
	bool matched = false;
	int err;

	if (conn_connecting != NULL || active_peer_count() >= CONFIG_BT_SAP_MAX_PEERS) {
		return;
	}

	if (type != BT_GAP_ADV_TYPE_ADV_IND && type != BT_GAP_ADV_TYPE_ADV_DIRECT_IND &&
	    type != BT_GAP_ADV_TYPE_EXT_ADV) {
		return;
	}

	bt_data_parse(ad, adv_data_matches_sap, &matched);
	if (!matched) {
		return;
	}

	existing = bt_conn_lookup_addr_le(BT_ID_DEFAULT, addr);
	if (existing != NULL) {
		bt_conn_unref(existing);
		return;
	}

	bt_addr_le_to_str(addr, addr_str, sizeof(addr_str));
	LOG_INF("Found SAP peripheral %s RSSI %d", addr_str, rssi);

	err = bt_le_scan_stop();
	if (err != 0) {
		LOG_ERR("Failed to stop scanning (%d)", err);
		return;
	}

	scanning_active = false;

	err = bt_conn_le_create(addr, BT_CONN_LE_CREATE_CONN, BT_LE_CONN_PARAM_DEFAULT,
				&conn_connecting);
	if (err != 0) {
		LOG_ERR("Create connection failed (%d)", err);
		conn_connecting = NULL;
		(void)k_work_reschedule(&scan_work, SAP_SCAN_RETRY_DELAY);
	}
}

static void scan_work_fn(struct k_work *work)
{
	struct bt_le_scan_param scan_param = {
		.type = BT_LE_SCAN_TYPE_PASSIVE,
		.options = BT_LE_SCAN_OPT_NONE,
		.interval = BT_GAP_SCAN_FAST_INTERVAL,
		.window = BT_GAP_SCAN_FAST_WINDOW,
	};
	int err;

	ARG_UNUSED(work);

	if (scanning_active || conn_connecting != NULL ||
	    active_peer_count() >= CONFIG_BT_SAP_MAX_PEERS) {
		return;
	}

	err = bt_le_scan_start(&scan_param, device_found);
	if (err == -EALREADY) {
		scanning_active = true;
		return;
	}

	if (err != 0) {
		LOG_ERR("Scan start failed (%d)", err);
		(void)k_work_reschedule(&scan_work, SAP_SCAN_RETRY_DELAY);
		return;
	}

	scanning_active = true;
	LOG_INF("Scanning started");
}

int sap_central_run(const struct bt_sap_policy *policy)
{
	struct bt_sap_cb callbacks = {
		.send_auth = send_auth,
		.send_secure = send_secure,
		.secure_payload_received = secure_payload_received,
		.authenticated = sap_authenticated,
		.failed = sap_failed,
	};
	int err;

	k_work_init_delayable(&scan_work, scan_work_fn);

	err = bt_sap_init(&sap_ctx, SAP_ROLE_CENTRAL, policy, &callbacks);
	if (err != 0) {
		LOG_ERR("SAP init failed (%d)", err);
		return err;
	}

	(void)k_work_reschedule(&scan_work, K_NO_WAIT);

	return 0;
}
```
