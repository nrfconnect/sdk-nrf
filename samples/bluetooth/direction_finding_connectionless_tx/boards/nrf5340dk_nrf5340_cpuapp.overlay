/*
 * Copyright (c) 2022 Nordic Semiconductor ASA
 *
 * SPDX-License-Identifier: LicenseRef-Nordic-5-Clause
 */

/* Enable pin forwarding to the network core. The selected pins will be used by
 * the Radio Direction Finding Extension for antenna switching purposes.
 *
 * Note: Pay attention to assigning the same GPIO pins as those provided in
 * the network core DTS overlay.
 */
&gpio_fwd {
	dfe-gpio-if {
		gpios = <&gpio0 4 0>,
			<&gpio0 5 0>,
			<&gpio0 6 0>,
			<&gpio0 7 0>;
		};
};
