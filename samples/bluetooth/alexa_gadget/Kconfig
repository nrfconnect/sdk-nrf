## samples/bluetooth/alexa_gadget/Kconfig
```kconfig
#
# Copyright (c) 2020 Nordic Semiconductor
#
# SPDX-License-Identifier: LicenseRef-Nordic-5-Clause
#

menu "Zephyr Kernel"
source "Kconfig.zephyr"
endmenu

menu "Alexa Gadget"
rsource "src/gadgets/Kconfig"
endmenu
```

## samples/bluetooth/alexa_gadget/boards/nrf52dk_nrf52810.conf
```kconfig
#
# Copyright (c) 2020 Nordic Semiconductor
#
# SPDX-License-Identifier: LicenseRef-Nordic-5-Clause
#

# Disable logging to reduce memory usage
CONFIG_LOG=n

# Use SW link layer to reduce flash and RAM usage
CONFIG_BT_LL_SW_SPLIT=y

# Set main stack size to a minimum
CONFIG_MAIN_STACK_SIZE=1024

# Disable capabilities not used by this sample to reduce flash usage
CONFIG_BT_ALEXA_GADGETS_CAPABILITY_ALERTS=n
CONFIG_BT_ALEXA_GADGETS_CAPABILITY_NOTIFICATIONS=n
CONFIG_BT_ALEXA_GADGETS_CAPABILITY_MUSICDATA=n
CONFIG_BT_ALEXA_GADGETS_CAPABILITY_SPEECHDATA=n
```

## samples/bluetooth/alexa_gadget/sample.yaml
```yaml
sample:
  description: Sample implementing Alexa Gadgets Service and Profile
  name: Alexa Gadget sample
tests:
  sample.bluetooth.alexa_gadget:
    build_only: true
    integration_platforms:
      - nrf52840dk_nrf52840
      - nrf52dk_nrf52810
    platform_allow: nrf52840dk_nrf52840 nrf52dk_nrf52810
    tags: bluetooth ci_build
```

## samples/bluetooth/alexa_gadget/src/gadgets/Kconfig
```kconfig
#
# Copyright (c) 2020 Nordic Semiconductor
#
# SPDX-License-Identifier: LicenseRef-BSD-5-Clause-Nordic
#

menu "Alexa Gadget Profile"

config GADGETS_PROFILE_ENABLE
	bool "Enable Alexa Gadgets profile"
	select BT_GADGETS
	select BT_SMP
	select HWINFO
	select TINYCRYPT_SHA256
	help
	  Enable Alexa Gadgets profile.

if GADGETS_PROFILE_ENABLE

module = GADGETS_PROFILE
module-str = GADGETS
source "${ZEPHYR_BASE}/subsys/logging/Kconfig.template.log_config"

config GADGETS_MODEL_NAME
	string "Alexa Gadget device model name"
	default "BLE Gadget"
	help
	  Gadget model name. Not a token allocated by Amazon.

config GADGETS_DEVICE_DESCRIPTION
	string "Alexa Gadget device description"
	default "Nordic DK"
	help
	  Short device description.

config GADGETS_AMAZON_ID
	string "Alexa Gadget Amazon ID"
	default "1234567890"
	help
	  Device type identifier allocated by Amazon.

config GADGETS_DEVICE_SECRET
	string "Alexa Gadget device secret"
	default "1234567890"
	help
	  Device secret allocated by Amazon.
	  As this is considered a secret value,
	  enable flash readback protection accordingly.


config GADGETS_TRANSACTION_BUF_SIZE
	int "Gadgets maximum transaction size"
	default 600
	help
	  Maximum size of a single transaction.
	  This should be big enough to cover the Discovery handshake,
	  which is normally the largest transaction.
	  Note that capability count, device name, model name, etc. affects this.

config GADGETS_OTA_ENABLE
	bool "Enable Alexa Gadgets OTA protocol"
	select BOOTLOADER_MCUBOOT
	help
	  Enable Alexa Gadgets OTA protocol.

menu "Gadget capabilities"

config GADGETS_CAPABILITY_ALERTS_ENABLE
	bool "Enable Alerts capability"
	help
	  Enable support for Alerts capability.

config GADGETS_CAPABILITY_NOTIFICATIONS_ENABLE
	bool "Enable Notifications capability"
	help
	  Enable support for Notifications capability.

config GADGETS_CAPABILITY_STATELISTENER_ENABLE
	bool "Enable StateListener capability"
	help
	  Enable support for StateListener capability.

config GADGETS_CAPABILITY_MUSICDATA_ENABLE
	bool "Enable MusicData capability"
	help
	  Enable support for Music Data capability.

config GADGETS_CAPABILITY_SPEECHDATA_ENABLE
	bool "Enable SpeechData capability"
	help
	  Enable support for SpeechData capability.

config GADGETS_CAPABILITY_CUSTOM_ENABLE
	bool "Enable Custom capability"
	help
	  Enable support for SpeechData capability.

config GADGETS_CAPABILITY_CUSTOM_NAMESPACE
	string "Set Custom capability interface name"
	default "Custom.MyCustomInterface"
	depends on GADGETS_CAPABILITY_CUSTOM_ENABLE
	help
	  Specify name of the custom interface.

endmenu

endif # GADGETS_PROFILE_ENABLE

endmenu
```

## samples/bluetooth/broadcast_config_tool/sample.yaml
```yaml
sample:
  name: Bluetooth Low Energy Broadcast Configuration Tool
  description: Bluetooth LE shell configurable broadcast tool
common:
  integration_platforms:
    - nrf5340_audio_dk/nrf5340/cpuapp
  platform_allow: nrf5340_audio_dk/nrf5340/cpuapp
  platform_exclude: nrf5340_audio_dk/nrf5340/cpuapp_ns
  sysbuild: true
  build_only: true
  tags: ci_build sysbuild
tests:
  sample.bluetooth.broadcast_config_tool.build:
    extra_args: []
```

## samples/bluetooth/central_and_peripheral_hr/sample.yaml
```yaml
sample:
  description: Bluetooth Low Energy central and peripheral heart rate relay sample
  name: BLE Central and Peripheral HRS
tests:
  sample.bluetooth.central_and_peripheral_hr.build:
    sysbuild: true
    build_only: true
    integration_platforms:
      - nrf52dk/nrf52832
      - nrf52840dk/nrf52840
      - nrf5340dk/nrf5340/cpuapp
      - nrf5340dk/nrf5340/cpuapp/ns
      - nrf54l15pdk/nrf54l15/cpuapp
      - nrf54h20dk/nrf54h20/cpuapp
    platform_allow: nrf52dk/nrf52832 nrf52840dk/nrf52840 nrf5340dk/nrf5340/cpuapp
      nrf5340dk/nrf5340/cpuapp/ns nrf54l15pdk/nrf54l15/cpuapp
      nrf54h20dk/nrf54h20/cpuapp
    tags: bluetooth ci_build sysbuild
```

## samples/bluetooth/central_and_peripheral_hrs/Kconfig
```kconfig
#
# Copyright (c) 2024 Nordic Semiconductor
#
# SPDX-License-Identifier: LicenseRef-Nordic-5-Clause
#

source "Kconfig.zephyr"

config ZMS
	default y if (SOC_FLASH_NRF_RRAM || SOC_FLASH_NRF_MRAM)

config NVS
	default y if !(SOC_FLASH_NRF_RRAM || SOC_FLASH_NRF_MRAM)
```

## samples/bluetooth/central_and_peripheral_hrs/sample.yaml
```yaml
sample:
  description: Bluetooth Low Energy central and peripheral heart rate relay sample
  name: Bluetooth LE Central and Peripheral HRS
tests:
  sample.bluetooth.central_and_peripheral_hrs:
    sysbuild: true
    integration_platforms:
      - nrf52dk/nrf52832
      - nrf52840dk/nrf52840
      - nrf5340dk/nrf5340/cpuapp
      - nrf5340dk/nrf5340/cpuapp/ns
      - nrf54l15dk/nrf54l05/cpuapp
      - nrf54l15dk/nrf54l10/cpuapp
      - nrf54l15dk/nrf54l15/cpuapp
      - nrf54l15dk/nrf54l15/cpuapp/ns
      - nrf54h20dk/nrf54h20/cpuapp
      - nrf54lm20dk/nrf54lm20a/cpuapp
      - nrf54lm20dk/nrf54lm20a/cpuapp/ns
      - nrf54lv10dk/nrf54lv10a/cpuapp
    platform_allow:
      - nrf52dk/nrf52832
      - nrf52840dk/nrf52840
      - nrf5340dk/nrf5340/cpuapp
      - nrf5340dk/nrf5340/cpuapp/ns
      - nrf54l15dk/nrf54l05/cpuapp
      - nrf54l15dk/nrf54l10/cpuapp
      - nrf54l15dk/nrf54l15/cpuapp
      - nrf54l15dk/nrf54l15/cpuapp/ns
      - nrf54h20dk/nrf54h20/cpuapp
      - nrf54lm20dk/nrf54lm20a/cpuapp
      - nrf54lm20dk/nrf54lm20a/cpuapp/ns
      - nrf54lv10dk/nrf54lv10a/cpuapp
      - nrf54lv10dk/nrf54lv10a/cpuapp/ns
    tags:
      - bluetooth
      - ci_build
      - sysbuild
    harness: console
    harness_config:
      type: multi_line
      ordered: true
      regex:
        - "Starting Bluetooth Central and Peripheral Heart Rate relay sample"
        - "Scanning started"
        - "Advertising successfully started"
    timeout: 15
```

## samples/bluetooth/central_and_pripheral_hr/sample.yaml
```yaml
sample:
  name: BLE Central and Peripheral HRS
  description: Bluetooth Low Energy central and peripheral heart rate relay sample
tests:
  samples.bluetooth.central_bas.build:
    build_only: true
    platform_allow: nrf52dk_nrf52832 nrf52840dk_nrf52840
      nrf5340dk_nrf5340_cpuapp nrf5340dk_nrf5340_cpuapp_ns
    integration_platforms:
      - nrf52dk_nrf52832
      - nrf52840dk_nrf52840
      - nrf5340dk_nrf5340_cpuapp
      - nrf5340dk_nrf5340_cpuapp_ns
    tags: bluetooth ci_build
```

## samples/bluetooth/central_bas/sample.yaml
```yaml
sample:
  description: Bluetooth Low Energy central battery service sample
  name: BLE Central BAS
tests:
  sample.bluetooth.central_bas:
    sysbuild: true
    harness: bluetooth
    integration_platforms:
      - nrf52dk/nrf52832
      - nrf52840dk/nrf52840
    platform_allow: nrf52dk/nrf52832 nrf52840dk/nrf52840
    tags: bluetooth sysbuild
  sample.bluetooth.central_bas.build:
    sysbuild: true
    build_only: true
    integration_platforms:
      - nrf52dk/nrf52832
      - nrf52840dk/nrf52840
      - nrf5340dk/nrf5340/cpuapp
      - nrf5340dk/nrf5340/cpuapp/ns
      - nrf54h20dk/nrf54h20/cpuapp
    platform_allow: nrf52dk/nrf52832 nrf52840dk/nrf52840 nrf5340dk/nrf5340/cpuapp
      nrf5340dk/nrf5340/cpuapp/ns nrf54h20dk/nrf54h20/cpuapp
    tags: bluetooth ci_build sysbuild
```

## samples/bluetooth/central_dfu_smp/sample.yaml
```yaml
sample:
  name: BLE Central DFU SMP
  description: Bluetooth Low Energy Central Device Firmware Update sample
tests:
  samples.bluetooth.central_dfu_smp:
    platform_allow: nrf51dk_nrf51422 nrf52dk_nrf52832 nrf52840dk_nrf52840 nrf52dk_nrf52810
    harness: bluetooth
    tags: bluetooth
  samples.bluetooth.central_dfu_smp.build:
    build_only: true
    build_on_all: true
    platform_allow: nrf51dk_nrf51422 nrf52dk_nrf52832 nrf52840dk_nrf52840 nrf52dk_nrf52810
      nrf5340dk_nrf5340_cpuapp nrf5340dk_nrf5340_cpuappns
    tags: bluetooth ci_build
```

## samples/bluetooth/central_esl/Kconfig
```kconfig
#
# Copyright (c) 2022 Nordic Semiconductor
#
# SPDX-License-Identifier: LicenseRef-Nordic-5-Clause
#

source "Kconfig.zephyr"

menu "Nordic ESL BLE GATT service client sample"

config BT_ESL_CLIENT_THREAD_STACK_SIZE
	int "Thread stack size"
	default 1024
	help
	  Stack size used in each of the two threads

config BT_ESL_SECURITY_ENABLED
	bool "Enable security"
	select BT_SMP
	select BT_BONDABLE
	select BT_BONDING_REQUIRED
	help
	  "Enable BLE security for the ESL service"

config BT_ESL_AP_AUTO_MODE
	bool "AP auto onboarding Tag mode"
	help
	  "When enabled, AP auto scans and configures the tag. When disabled, AP only accepts shell commands"

if BT_ESL_AP_AUTO_MODE
config BT_ESL_AP_AUTO_TAG_PER_GROUP
	int "Tag per group"
	default ESL_CLIENT_MAX_RESPONSE_SLOT_BUFFER
	help
	  "The number of tags to be kept in same group for auto onboarding.
	   Tags exceeding this number are placed in next group.
	   Otherwise, response key is not enough for all tags in same group.
	   How to select this number depends on the desired scenario.
	   Less or equal to ESL_CLIENT_MAX_RESPONSE_SLOT_BUFFER decrypts the response EAD on the fly.
	   Greater than ESL_CLIENT_MAX_RESPONSE_SLOT_BUFFER enables the ESL AP to control large amount of tags at the same time."

config BT_ESL_AP_GROUP_PER_BUTTON
	int "Groups for one button"
	default 3
	help
	  "The number of groups controlled by one button.
	   If this number is greater than 1, an AP can control multiple groups by one button.
	   Otherwise, an AP controls one group by one button."
endif

config BT_ESL_AP_AUTO_PAST_TAG
	bool "AP auto past mode"
	help
	  "When enabled, the AP sends automatic update complete command and PAST to an unsynchronized tag. When disabled, the AP only accepts shell commands."

config BT_ESL_AP_PTS
	bool "ESL access point for PTS test"
	help
	  Enable PTS test for ESL access point

module = CENTRAL_ESL
module-str = central esl
source "${ZEPHYR_BASE}/subsys/logging/Kconfig.template.log_config"
endmenu
```

## samples/bluetooth/central_esl/child_image/mcuboot/boards/nrf52840dk_nrf52840.conf
```kconfig
#
# Copyright (c) 2023 Nordic Semiconductor ASA
#
# SPDX-License-Identifier: LicenseRef-Nordic-5-Clause
#

CONFIG_BOOT_MAX_IMG_SECTORS=256
CONFIG_NORDIC_QSPI_NOR=y
CONFIG_FLASH=y
CONFIG_FLASH_MAP=y
CONFIG_FLASH_PAGE_LAYOUT=y
CONFIG_PM_PARTITION_SIZE_MCUBOOT=0x10000
CONFIG_MULTITHREADING=y
CONFIG_SIZE_OPTIMIZATIONS=y
CONFIG_MAIN_STACK_SIZE=20480
# Change default flash erase size for flexible flash layout
CONFIG_NORDIC_QSPI_NOR_FLASH_LAYOUT_PAGE_SIZE=4096
CONFIG_BOOT_ERASE_PROGRESSIVELY=y
CONFIG_SOC_FLASH_NRF_EMULATE_ONE_BYTE_WRITE_ACCESS=y
CONFIG_FPROTECT=y
CONFIG_PM_EXTERNAL_FLASH_MCUBOOT_SECONDARY=y

# Enable LOG for MCUBOOT
CONFIG_CBPRINTF_NANO=y
CONFIG_CONSOLE=y
CONFIG_LOG=y
CONFIG_UART_NRFX=y
```

## samples/bluetooth/central_esl/sample.yaml
```yaml
sample:
  name: BLE Central ESL
  description: Bluetooth Low Energy central ESL sample
tests:
  samples.bluetooth.central_esl:
    build_only: true
    platform_allow: nrf52840dk_nrf52840 nrf5340dk_nrf5340_cpuapp thingy53_nrf5340_cpuapp
    integration_platforms:
      - nrf52840dk_nrf52840
      - nrf5340dk_nrf5340_cpuapp
      - thingy53_nrf5340_cpuapp
    tags: bluetooth ci_build
```

## samples/bluetooth/central_hids/Kconfig
```kconfig
#
# Copyright (c) 2024 Nordic Semiconductor
#
# SPDX-License-Identifier: LicenseRef-Nordic-5-Clause
#

config SETTINGS
	default y

config ZMS
	default y if (SOC_FLASH_NRF_RRAM || SOC_FLASH_NRF_MRAM)

config NVS
	default y if !(SOC_FLASH_NRF_RRAM || SOC_FLASH_NRF_MRAM)

config SAMPLE_BT_CENTRAL_HIDS_CONTINUOUS_REPORT_RX
	bool "Continuous report receiving"
	default y
	depends on SAMPLE_BT_CENTRAL_HIDS_PERIPHERAL_COUNT = 1
	help
	  Enable the continuous report receiving feature in the central HIDS sample.
	  The sample will automatically enter continuous report receiving mode if it detects
	  a high rate of incoming HID reports.

config SAMPLE_BT_CENTRAL_HIDS_CONTINUOUS_REPORT_RX_STATS_RATE
	int "Continuous RX mode: print statistics every N HID reports"
	depends on SAMPLE_BT_CENTRAL_HIDS_CONTINUOUS_REPORT_RX
	depends on PRINTK
	default 1000
	range 1 1000000
	help
	  While continuous report receiving is active and the sample is in
	  continuous report receiving mode, the sample prints a short summary
	  every CONFIG_SAMPLE_BT_CENTRAL_HIDS_CONTINUOUS_REPORT_RX_STATS_RATE notifications,
	  instead of logging every payload.

config SAMPLE_BT_CENTRAL_HIDS_PERIPHERAL_COUNT
	int "Maximum simultaneous HID peripheral connections"
	range 1 2
	default 1
	help
	  Number of HID GATT server peripherals this central may connect to at the
	  same time. When set to 2, Bluetooth pairing/connection limits are
	  raised accordingly (see default BT_MAX_CONN and BT_MAX_PAIRED in this file).

configdefault BT_MAX_CONN
	default SAMPLE_BT_CENTRAL_HIDS_PERIPHERAL_COUNT

configdefault BT_MAX_PAIRED
	default SAMPLE_BT_CENTRAL_HIDS_PERIPHERAL_COUNT

if BT_HOGP_SCI

rsource "Kconfig.sci"

endif # BT_HOGP_SCI

source "Kconfig.zephyr"
```
