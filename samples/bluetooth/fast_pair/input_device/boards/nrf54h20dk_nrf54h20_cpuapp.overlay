/*
 * Copyright (c) 2024 Nordic Semiconductor ASA
 *
 * SPDX-License-Identifier: LicenseRef-Nordic-5-Clause
 */

/* Define the Fast Pair partition. */
&mram1x {
	partitions {
		/* Align the partition size to 4096 B to avoid gaps. */
		bt_fast_pair_partition: partition@1b0000 {
			reg = <0x1b0000 DT_SIZE_K(4)>;
		};
	};
};
