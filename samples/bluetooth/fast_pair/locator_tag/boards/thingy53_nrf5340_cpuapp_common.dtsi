/*
 * Copyright (c) 2024 Nordic Semiconductor ASA
 *
 * SPDX-License-Identifier: LicenseRef-Nordic-5-Clause
 */

/ {
	aliases {
		pwm-spk = &pwm_spk0;
	};

	pwmspk {
		compatible = "pwm-leds";
		pwm_spk0: pwm-spk-0 {
			pwms = <&pwm1 0 PWM_MSEC(20) PWM_POLARITY_NORMAL>;
		};
	};
};
