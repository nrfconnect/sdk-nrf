## samples/bluetooth/fast_pair/locator_tag/sysbuild/mcuboot/boards/thingy53_nrf5340_cpuapp.conf
```kconfig
#
# Copyright (c) 2024 Nordic Semiconductor
#
# SPDX-License-Identifier: LicenseRef-Nordic-5-Clause
#

CONFIG_BOOT_MAX_IMG_SECTORS=2048

# Disable logs
CONFIG_BOARD_SERIAL_BACKEND_CDC_ACM=n

# Required by QSPI
CONFIG_CLOCK_CONTROL=y
CONFIG_SYS_CLOCK_EXISTS=y
CONFIG_NRF_RTC_TIMER=y
CONFIG_NORDIC_QSPI_NOR=y
CONFIG_NORDIC_QSPI_NOR_FLASH_LAYOUT_PAGE_SIZE=4096
CONFIG_NORDIC_QSPI_NOR_STACK_WRITE_BUFFER_SIZE=16

# The network core cannot access external flash directly. The flash simulator must be used to
# provide a memory region that is used to forward the new firmware to the network core.
CONFIG_FLASH_SIMULATOR=y
CONFIG_FLASH_SIMULATOR_DOUBLE_WRITES=y
CONFIG_FLASH_SIMULATOR_STATS=n
```

## samples/bluetooth/hci_lpuart/boards/thingy91_nrf52840.conf
```kconfig
# Override prj.conf defaults

CONFIG_GPIO=y
CONFIG_SYSTEM_WORKQUEUE_STACK_SIZE=512
CONFIG_BT_WAIT_NOP=y
CONFIG_BT_MAX_CONN=16
CONFIG_BT_CTLR_DTM_HCI=y
CONFIG_BT_CTLR_ASSERT_HANDLER=y

CONFIG_UART_1_ASYNC=y
CONFIG_UART_1_INTERRUPT_DRIVEN=n
CONFIG_UART_1_NRF_HW_ASYNC=y
CONFIG_UART_1_NRF_HW_ASYNC_TIMER=2
CONFIG_NRF_SW_LPUART=y
CONFIG_NRF_SW_LPUART_INT_DRIVEN=y

CONFIG_USE_SEGGER_RTT=y
CONFIG_RTT_CONSOLE=y
CONFIG_UART_CONSOLE=n
```

## samples/bluetooth/hci_lpuart/sample.yaml
```yaml
sample:
  name: Bluetooth HCI low power UART sample
tests:
  sample.bluetooth.hci_lpuart:
    sysbuild: true
    platform_allow: nrf9160dk/nrf52840
    integration_platforms:
      - nrf9160dk/nrf52840
    tags:
      - uart
      - bluetooth
      - sysbuild
      - ci_samples_bluetooth
```

## samples/bluetooth/hids_mouse/sample.yaml
```yaml
sample:
  description: TBD
  name: HIDS mouse sample
tests:
  test:
    harness: bluetooth
    platform_whitelist: qemu_cortex_m3 qemu_x86
    tags: bluetooth
```

## samples/bluetooth/iso_combined_bis_and_cis/boards/nrf54h20dk_nrf54h20_cpuapp.conf
```kconfig
#
# Copyright (c) 2025 Nordic Semiconductor
#
# SPDX-License-Identifier: LicenseRef-Nordic-5-Clause
#

# Enable PSA RNG
CONFIG_PSA_CRYPTO_DRIVER_OBERON=n
CONFIG_PSA_SSF_CRYPTO_CLIENT=y
CONFIG_SSF_PSA_CRYPTO_SERVICE_ENABLED=y
CONFIG_MBEDTLS_PSA_CRYPTO_C=y
CONFIG_NRF_SECURITY=y

CONFIG_SOC_NRF54H20_CPURAD_ENABLE=y
```

## samples/bluetooth/iso_combined_bis_and_cis/sample.yaml
```yaml
sample:
  description: Bluetooth Low Energy combined BIS and CIS sample
  name: Bluetooth LE combined BIS and CIS
tests:
  sample.bluetooth.iso_bis_cis:
    sysbuild: true
    build_only: true
    integration_platforms:
      - nrf52840dk/nrf52840
      - nrf52833dk/nrf52833
      - nrf5340dk/nrf5340/cpuapp
      - nrf54l15dk/nrf54l05/cpuapp
      - nrf54l15dk/nrf54l10/cpuapp
      - nrf54l15dk/nrf54l15/cpuapp
      - nrf54h20dk/nrf54h20/cpuapp
      - nrf54lm20dk/nrf54lm20a/cpuapp
    platform_allow:
      - nrf52840dk/nrf52840
      - nrf52833dk/nrf52833
      - nrf5340dk/nrf5340/cpuapp
      - nrf54l15dk/nrf54l05/cpuapp
      - nrf54l15dk/nrf54l10/cpuapp
      - nrf54l15dk/nrf54l15/cpuapp
      - nrf54h20dk/nrf54h20/cpuapp
      - nrf54lm20dk/nrf54lm20a/cpuapp
    tags:
      - bluetooth
      - ci_build
      - sysbuild
```

## samples/bluetooth/iso_time_sync/Kconfig
```kconfig
#
# Copyright (c) 2024 Nordic Semiconductor
#
# SPDX-License-Identifier: LicenseRef-Nordic-5-Clause
#

menu "Bluetooth ISO time sync sample"

config SDU_INTERVAL_US
	int "SDU interval to be used in microseconds"
	default 10000
	help
	  The SDU interval determines how often the button
	  value will be transmitted to the receiving devices.

config TIMED_LED_PRESENTATION_DELAY_US
	int "The delay of presenting the new value of the LED"
	default 5000
	help
	  The presentation delay of the LED represents the time
	  from the SDU synchronization reference until the value
	  is applied.
	  The application needs to ensure it can process the
	  received SDU within this amount of time.
	  The end-to-end latency will be at least the sum
	  of the configured transport latency and presentation delay

config LED_TOGGLE_IMMEDIATELY_ON_SEND_OR_RECEIVE
	bool "Enable immediate LED toggling upon sending or receiving data"
	help
	  Enable immediate toggling of LED2 when isochronous
	  data is sent or received. This allows for measurment
	  of the mimimum end-to-end latency.

endmenu

source "Kconfig.zephyr"
```

## samples/bluetooth/iso_time_sync/boards/nrf52_bsim.conf
```kconfig
#
# Copyright (c) 2024 Nordic Semiconductor
#
# SPDX-License-Identifier: LicenseRef-Nordic-5-Clause
#

CONFIG_NRFX_TIMER1=y
CONFIG_NRFX_RTC2=y
CONFIG_NRFX_PPI=y
CONFIG_GPIO=y
CONFIG_UART_CONSOLE=y
CONFIG_UART_NATIVE_POSIX=y
CONFIG_SERIAL=y
```

## samples/bluetooth/iso_time_sync/boards/nrf54h20dk_nrf54h20_cpuapp.conf
```kconfig
#
# Copyright (c) 2024 Nordic Semiconductor
#
# SPDX-License-Identifier: LicenseRef-Nordic-5-Clause
#

# Enable PSA RNG
CONFIG_MBEDTLS_PSA_CRYPTO_C=y
CONFIG_NRF_SECURITY=y

CONFIG_SOC_NRF54H20_CPURAD_ENABLE=y
```

## samples/bluetooth/iso_time_sync/boards/nrf54l15pdk_nrf54l15_cpuapp.conf
```kconfig
#
# Copyright (c) 2024 Nordic Semiconductor
#
# SPDX-License-Identifier: LicenseRef-Nordic-5-Clause
#

CONFIG_NRFX_DPPI00=y
CONFIG_NRFX_DPPI10=y
CONFIG_NRFX_DPPI20=y
CONFIG_NRFX_DPPI30=y
CONFIG_BT_RX_STACK_SIZE=2048
```

## samples/bluetooth/iso_time_sync/boards/nrf54lm20dk_nrf54lm20a_cpuapp.conf
```kconfig
#
# Copyright (c) 2025 Nordic Semiconductor
#
# SPDX-License-Identifier: LicenseRef-Nordic-5-Clause
#

CONFIG_NRFX_GPPI=y
CONFIG_BT_RX_STACK_SIZE=2048
```

## samples/bluetooth/iso_time_sync/boards/nrf54lm20dk_nrf54lm20b_cpuapp.conf
```kconfig
#
# Copyright (c) 2026 Nordic Semiconductor
#
# SPDX-License-Identifier: LicenseRef-Nordic-5-Clause
#

CONFIG_NRFX_GPPI=y
```

## samples/bluetooth/iso_time_sync/sysbuild/ipc_radio/boards/nrf54h20dk_nrf54h20_cpurad.conf
```kconfig
# Enable PSA RNG
CONFIG_PSA_CRYPTO_DRIVER_OBERON=n
CONFIG_NRF_IRONSIDE_SE_PSA_SERVICES=y
CONFIG_MBEDTLS_PSA_CRYPTO_C=y
CONFIG_NRF_SECURITY=y
```

## samples/bluetooth/llpm/boards/nrf52840dongle_nrf52840.conf
```kconfig
CONFIG_CDC_ACM_SERIAL_PRODUCT_STRING="LLPM sample console"

CONFIG_LOG=n
CONFIG_UART_CONSOLE=y
CONFIG_UART_LINE_CTRL=y
```

## samples/bluetooth/llpm/boards/nrf54h20dk_nrf54h20_cpuapp.conf
```kconfig
#
# Copyright (c) 2024 Nordic Semiconductor
#
# SPDX-License-Identifier: LicenseRef-Nordic-5-Clause
#

# Application core does not have BLE controller. Disable controller related options.
CONFIG_BT_CTLR_SDC_LLPM=n
CONFIG_BT_LL_SOFTDEVICE=n

# Required to allow use of 1ms connection interval in conn_param argument of bt_conn_le_creat
CONFIG_BT_CONN_PARAM_ANY=y

# Enable PSA RNG
CONFIG_PSA_CRYPTO_DRIVER_OBERON=n
CONFIG_PSA_SSF_CRYPTO_CLIENT=y
CONFIG_SSF_PSA_CRYPTO_SERVICE_ENABLED=y
CONFIG_MBEDTLS_PSA_CRYPTO_C=y
CONFIG_NRF_SECURITY=y
# More receive buffers are needed, possibly due to broken flow control in the HCI over IPC implementation.
CONFIG_BT_BUF_EVT_RX_COUNT=22

CONFIG_SOC_NRF54H20_CPURAD_ENABLE=y
```

## samples/bluetooth/llpm/boards/nrf7120pdk_nrf7120_cpuapp.conf
```kconfig
# Disabled Bluetooth Security Manager while crypto is not supported
CONFIG_BT_SMP=n
```

## samples/bluetooth/llpm/boards/nrf7120pdk_nrf7120_cpuapp_emu.conf
```kconfig
#
# Copyright (c) 2025 Nordic Semiconductor
#
# SPDX-License-Identifier: LicenseRef-Nordic-5-Clause
#

CONFIG_BT_USE_DEBUG_KEYS=y
```

## samples/bluetooth/mesh/ble_peripheral_lbs_coex/sample.yaml
```yaml
sample:
  description: Bluetooth Mesh and Peripheral Coexistence sample
  name: Bluetooth Mesh and Peripheral Coexistence
tests:
  sample.bluetooth.mesh.ble_and_mesh:
    sysbuild: true
    build_only: true
    integration_platforms:
      - nrf52dk/nrf52832
      - nrf52840dk/nrf52840
      - nrf52833dk/nrf52833
      - nrf21540dk/nrf52840
      - nrf54l15dk/nrf54l15/cpuapp
      - nrf54l15dk/nrf54l10/cpuapp
      - nrf54l15dk/nrf54l05/cpuapp
    platform_allow:
      - nrf52dk/nrf52832
      - nrf52840dk/nrf52840
      - nrf52833dk/nrf52833
      - nrf21540dk/nrf52840
      - nrf54l15dk/nrf54l15/cpuapp
      - nrf54l15dk/nrf54l10/cpuapp
      - nrf54l15dk/nrf54l05/cpuapp
    tags:
      - bluetooth
      - ci_build
      - sysbuild
```

## samples/bluetooth/mesh/blob_transfer/Kconfig
```kconfig
#
# Copyright (c) 2024 Junho Lee <tot0roprog@gmail.com>
#
# SPDX-License-Identifier: LicenseRef-Nordic-5-Clause
#

source "Kconfig.zephyr"

menu "Bluetooth Mesh BLOB Transfer Sample"

config BT_MESH_BLOB_TX_MAX_TARGETS
	int "Maximum number of targets to send blob over mesh"
	default 4
	range 1 256
	help
	  When a BLOB Client sends BLOB data to BLOB Servers, the maximum number of
	  unicast addresses to target for BLOB transfers.

endmenu

module = BT_MESH_BLOB_XFER
module-str = BT Mesh BLOB Transfer model
```

## samples/bluetooth/mesh/blob_transfer/sample.yaml
```yaml
sample:
  description: Bluetooth Mesh BLOB Transfer Sample
  name: Bluetooth Mesh BLOB Transfer
tests:
  sample.bluetooth.mesh.blob_xfer:
    build_only: true
    integration_platforms:
      - nrf52840dk_nrf52840
    platform_allow: nrf52840dk_nrf52840
    tags: bluetooth ci_build
```

## samples/bluetooth/mesh/chat/Kconfig
```kconfig
#
# Copyright (c) 2020 Nordic Semiconductor
#
# SPDX-License-Identifier: LicenseRef-Nordic-5-Clause
#

source "Kconfig.zephyr"

menu "Nordic Bluetooth Mesh chat client sample"

config BT_MESH_CHAT_CLI_MESSAGE_LENGTH
	int "Max length of the message to be sent over mesh"
	default 90
	range 0 255
	help
	  Impacts on memory size occupied by the buffer of a message to be
	  published. This does not include null terminator. The message must also
	  fit into the application SDU. Adjust BT_MESH_TX_SEG_MAX and
	  BT_MESH_RX_SEG_MAX to be able to receive the longest messages.

config BT_MESH_CHAT_SAMPLE_PRESENCE_CACHE_SIZE
	int "Presence cache size"
	default 10
	range 0 32767
	help
	  Presence cache stores previously received presence of chat clients.
	  Recommended to be as big as number of chat clients in the mesh network.

endmenu

module = BT_MESH_CHAT_CLI
module-str = BT Mesh Chat Client model
source "${ZEPHYR_BASE}/subsys/logging/Kconfig.template.log_config"
```

## samples/bluetooth/mesh/chat/boards/nrf54l15dk_nrf54l15_cpuapp.conf
```kconfig
#
# Copyright (c) 2024 Nordic Semiconductor ASA
#
# SPDX-License-Identifier: LicenseRef-Nordic-5-Clause
#
################################################################################
# Application overlay - nrf54l15

CONFIG_SOC_FLASH_NRF_PARTIAL_ERASE=n
CONFIG_NVS=n
CONFIG_NVS_LOOKUP_CACHE=n
CONFIG_SETTINGS_NVS_NAME_CACHE=n
CONFIG_ZMS=y
CONFIG_SETTINGS_ZMS_CUSTOM_SECTOR_COUNT=y
CONFIG_SETTINGS_ZMS_SECTOR_COUNT=8
CONFIG_ZMS_LOOKUP_CACHE=y
CONFIG_ZMS_LOOKUP_CACHE_SIZE=512
CONFIG_ZMS_LOOKUP_CACHE_FOR_SETTINGS=y
CONFIG_SYSTEM_WORKQUEUE_STACK_SIZE=4096
CONFIG_BT_RX_STACK_SIZE=5120
CONFIG_SHELL_STACK_SIZE=2500
```

## samples/bluetooth/mesh/chat/sample.yaml
```yaml
sample:
  description: Bluetooth Mesh Chat sample
  name: Bluetooth Mesh Chat
tests:
  sample.bluetooth.mesh.chat:
    sysbuild: true
    build_only: true
    integration_platforms:
      - nrf52dk/nrf52832
      - nrf52840dk/nrf52840
      - nrf21540dk/nrf52840
      - nrf54l15dk/nrf54l15/cpuapp
      - nrf54l15dk/nrf54l10/cpuapp
      - nrf54l15dk/nrf54l05/cpuapp
    platform_allow:
      - nrf52dk/nrf52832
      - nrf52840dk/nrf52840
      - nrf21540dk/nrf52840
      - nrf54l15dk/nrf54l15/cpuapp
      - nrf54l15dk/nrf54l10/cpuapp
      - nrf54l15dk/nrf54l05/cpuapp
    tags:
      - bluetooth
      - ci_build
      - sysbuild
  sample.bluetooth.mesh.chat.ext_flash_settings:
    sysbuild: true
    build_only: true
    integration_platforms:
      - nrf52840dk/nrf52840
    platform_allow:
      - nrf52840dk/nrf52840
    extra_args:
      - FILE_SUFFIX=ext_flash
      - EXTRA_CONF_FILE=boards/nrf52840dk_nrf52840/ext_flash_settings.conf
    tags:
      - bluetooth
      - ci_build
      - sysbuild
```

## samples/bluetooth/mesh/common/Kconfig
```kconfig
#
# Copyright (c) 2026 Nordic Semiconductor
#
# SPDX-License-Identifier: LicenseRef-Nordic-5-Clause
#

config NCS_SAMPLE_MESH_COMMON_SMP_BT_DEDICATED_ADV_SET
	bool "When enabled, create a separate BT ID and advertising set broadcasting SMP DFU availability"
	depends on MCUMGR_TRANSPORT_BT
	default n if BT_SMP
	default y
```

## samples/bluetooth/mesh/dfu/distributor/boards/nrf52840dk_nrf52840_settings_ext_flash.conf
```kconfig
#
# Copyright (c) 2025 Nordic Semiconductor ASA
#
# SPDX-License-Identifier: LicenseRef-Nordic-5-Clause
#

# External flash support for nRF52840 DK
CONFIG_NORDIC_QSPI_NOR=y

# Relocate settings partition to external flash
CONFIG_PM_PARTITION_REGION_SETTINGS_STORAGE_EXTERNAL=y
CONFIG_PM_PARTITION_SIZE_SETTINGS_STORAGE=0x8000
```
