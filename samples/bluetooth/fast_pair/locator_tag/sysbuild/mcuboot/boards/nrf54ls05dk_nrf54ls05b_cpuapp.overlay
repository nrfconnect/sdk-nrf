/*
 * Copyright (c) 2026 Nordic Semiconductor ASA
 *
 * SPDX-License-Identifier: LicenseRef-Nordic-5-Clause
 */

#include "../../../configuration/boards/nrf54ls05dk_nrf54ls05b_cpuapp_release.overlay"

/ {
	chosen {
		zephyr,code-partition = &boot_partition;
	};
};
