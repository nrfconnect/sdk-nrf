/*
 * Copyright (c) 2026 Nordic Semiconductor ASA
 *
 * SPDX-License-Identifier: LicenseRef-Nordic-5-Clause
 */

#include "../../../configuration/boards/nrf52dk_nrf52832_release.overlay"

/ {
	chosen {
		zephyr,code-partition = &boot_partition;
	};
};
