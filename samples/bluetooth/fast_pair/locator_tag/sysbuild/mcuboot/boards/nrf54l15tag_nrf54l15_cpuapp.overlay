/*
 * Copyright (c) 2026 Nordic Semiconductor ASA
 *
 * SPDX-License-Identifier: LicenseRef-Nordic-5-Clause
 */

#include "../../../configuration/boards/nrf54l15tag_nrf54l15_cpuapp.overlay"

/ {
	chosen {
		zephyr,code-partition = &boot_partition;
	};
};
