/*
 * Copyright (c) 2026 Nordic Semiconductor ASA
 *
 * SPDX-License-Identifier: LicenseRef-Nordic-5-Clause
 */

#include "../../../configuration/boards/nrf54lm20dk_nrf54lm20b_cpuapp.overlay"

/ {
	chosen {
		zephyr,code-partition = &boot_partition;
	};
};
