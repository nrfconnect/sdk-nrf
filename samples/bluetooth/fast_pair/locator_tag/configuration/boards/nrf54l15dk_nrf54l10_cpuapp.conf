## samples/bluetooth/fast_pair/locator_tag/configuration/boards/nrf54l15dk_nrf54l10_cpuapp.conf
```kconfig
#
# Copyright (c) 2025 Nordic Semiconductor ASA
#
# SPDX-License-Identifier: LicenseRef-Nordic-5-Clause
#

CONFIG_SYSTEM_WORKQUEUE_STACK_SIZE=3584

# Align the TX power encoded in the Fast Pair advertising set and
# the Read Beacon Parameters response with Fast Pair expectations.
CONFIG_BT_ADV_PROV_TX_POWER_CORRECTION_VAL=-11
CONFIG_BT_FAST_PAIR_FMDN_TX_POWER_CORRECTION_VAL=-11
```

## samples/bluetooth/fast_pair/locator_tag/configuration/boards/nrf54l15dk_nrf54l15_cpuapp.conf
```kconfig
#
# Copyright (c) 2024 Nordic Semiconductor ASA
#
# SPDX-License-Identifier: LicenseRef-Nordic-5-Clause
#

# Align the TX power encoded in the Fast Pair advertising set and
# the Read Beacon Parameters response with Fast Pair expectations.
# The value has been tailored for following DKs:
#   * nrf54l15dk/nrf54l15/cpuapp
CONFIG_BT_ADV_PROV_TX_POWER_CORRECTION_VAL=-11
CONFIG_BT_FAST_PAIR_FMDN_TX_POWER_CORRECTION_VAL=-11
```

## samples/bluetooth/fast_pair/locator_tag/configuration/boards/nrf54l15tag_nrf54l15_cpuapp_release.conf
```kconfig
#
# Copyright (c) 2026 Nordic Semiconductor ASA
#
# SPDX-License-Identifier: LicenseRef-Nordic-5-Clause
#

CONFIG_SYSTEM_WORKQUEUE_STACK_SIZE=4096

# Enable the Zephyr drivers required by the battery module and motion detector module.
CONFIG_I2C=y
CONFIG_SENSOR=y
CONFIG_BME680=n
CONFIG_ADXL367=y

# Enable the Zephyr drivers required by the battery monitoring module.
CONFIG_ADC=y
CONFIG_VOLTAGE_DIVIDER=y
CONFIG_FUEL_GAUGE=y
CONFIG_FUEL_GAUGE_COMPOSITE=y
CONFIG_PM_DEVICE=y
CONFIG_PM_DEVICE_RUNTIME=y

CONFIG_ADXL367_TRIGGER_OWN_THREAD=y
# The inactivity detection in dynamic environments using ADXL367 interrupts
# is buggy and not reliable.
CONFIG_ADXL367_ACTIVITY_DETECTION_MODE=n
CONFIG_ADXL367_INACTIVITY_DETECTION_MODE=n

# Enable accelerometer to angle conversion for the motion detection module.
CONFIG_ACCEL_TO_ANGLE=y

# Adjust the FHN ringing configuration to align it with the platform`s capabilities.
CONFIG_BT_FAST_PAIR_FHN_RING_COMP_ONE=y
CONFIG_BT_FAST_PAIR_FHN_RING_VOLUME=n

# Align the advertised TX power with Fast Pair expectations.
CONFIG_BT_ADV_PROV_TX_POWER_CORRECTION_VAL=-13
CONFIG_BT_FAST_PAIR_FHN_TX_POWER_CORRECTION_VAL=-13

# Enable code partitioning with DTS
CONFIG_USE_DT_CODE_PARTITION=y
```

## samples/bluetooth/fast_pair/locator_tag/configuration/boards/nrf54lm20dk_nrf54lm20a_cpuapp.conf
```kconfig
#
# Copyright (c) 2025 Nordic Semiconductor ASA
#
# SPDX-License-Identifier: LicenseRef-Nordic-5-Clause
#

# START of workaround for issue NCSDK-33313
# Disable CRACEN for all but RNG and switch to software crypto.
CONFIG_PSA_CRYPTO_DRIVER_OBERON=y
CONFIG_PSA_CRYPTO_DRIVER_CRACEN=y

CONFIG_PSA_USE_CRACEN_CIPHER_DRIVER=n
CONFIG_PSA_USE_CRACEN_AEAD_DRIVER=n
CONFIG_PSA_USE_CRACEN_HASH_DRIVER=n
CONFIG_PSA_USE_CRACEN_MAC_DRIVER=n
CONFIG_PSA_USE_CRACEN_KEY_AGREEMENT_DRIVER=n
CONFIG_PSA_USE_CRACEN_ASYMMETRIC_ENCRYPTION_DRIVER=n
CONFIG_PSA_USE_CRACEN_KEY_MANAGEMENT_DRIVER=n
CONFIG_PSA_USE_CRACEN_KEY_DERIVATION_DRIVER=n
CONFIG_PSA_USE_CRACEN_PAKE_DRIVER=n
CONFIG_PSA_USE_CRACEN_ASYMMETRIC_SIGNATURE_DRIVER=n
# END of workaround for issue NCSDK-33313
```

## samples/bluetooth/fast_pair/locator_tag/configuration/boards/nrf54ls05dk_nrf54ls05a_cpuapp.conf
```kconfig
#
# Copyright (c) 2026 Nordic Semiconductor ASA
#
# SPDX-License-Identifier: LicenseRef-Nordic-5-Clause
#

# Align the TX power encoded in the Fast Pair advertising set and
# the Read Beacon Parameters response with Fast Pair expectations.
CONFIG_BT_ADV_PROV_TX_POWER_CORRECTION_VAL=-13
CONFIG_BT_FAST_PAIR_FHN_TX_POWER_CORRECTION_VAL=-13

# Enable code partitioning with DTS
CONFIG_USE_DT_CODE_PARTITION=y
```

## samples/bluetooth/fast_pair/locator_tag/configuration/boards/thingy53_nrf5340_cpuapp_ns.conf
```kconfig
#
# Copyright (c) 2024 Nordic Semiconductor ASA
#
# SPDX-License-Identifier: LicenseRef-Nordic-5-Clause
#

CONFIG_SYSTEM_WORKQUEUE_STACK_SIZE=4096

# Use deferred logging
CONFIG_NCS_SAMPLES_DEFAULTS=n
CONFIG_LOG=y
CONFIG_ASSERT=y
CONFIG_ASSERT_NO_COND_INFO=y
CONFIG_ASSERT_NO_MSG_INFO=y
CONFIG_HW_STACK_PROTECTION=y

# Enable the Zephyr drivers required by the speaker, battery module and motion detector module.
CONFIG_PWM=y
CONFIG_ADC=y
CONFIG_SENSOR=y
CONFIG_SPI=y
CONFIG_BMI270=y

# Adjust the FMDN ringing configuration to align it with the platform`s capabilities.
CONFIG_BT_FAST_PAIR_FMDN_RING_COMP_ONE=y
CONFIG_BT_FAST_PAIR_FMDN_RING_VOLUME=n

# Adjust the DULT configuration to align it with the platform`s capabilities.
CONFIG_DULT_BATTERY_TYPE_RECHARGEABLE=y

# Align the TX power encoded in the Fast Pair advertising set and
# the Read Beacon Parameters response with Fast Pair expectations.
# The value has been tailored for the following targets:
#   * thingy53/nrf5340/cpuapp(/ns)
CONFIG_BT_ADV_PROV_TX_POWER_CORRECTION_VAL=-12
CONFIG_BT_FAST_PAIR_FMDN_TX_POWER_CORRECTION_VAL=-12

# TF-M profile has to be properly configured to be able to run
# the Bluetooth stack which uses PSA crypto API.
# The following configuration is a minimal set of options required.
CONFIG_TFM_PROFILE_TYPE_NOT_SET=y

CONFIG_TFM_PARTITION_PLATFORM=y
CONFIG_TFM_PARTITION_CRYPTO=y
CONFIG_TFM_PARTITION_INTERNAL_TRUSTED_STORAGE=y
CONFIG_TFM_PARTITION_PROTECTED_STORAGE=n
CONFIG_TFM_PARTITION_INITIAL_ATTESTATION=n
```

## samples/bluetooth/fast_pair/locator_tag/configuration/boards/thingy53_nrf5340_cpuapp_ns_release.conf
```kconfig
#
# Copyright (c) 2024 Nordic Semiconductor ASA
#
# SPDX-License-Identifier: LicenseRef-Nordic-5-Clause
#

CONFIG_SYSTEM_WORKQUEUE_STACK_SIZE=4096

# Disable logging in the release configuration
CONFIG_BOARD_SERIAL_BACKEND_CDC_ACM=n

# Enable the Zephyr drivers required by the speaker, battery module and motion detector module.
CONFIG_PWM=y
CONFIG_ADC=y
CONFIG_SENSOR=y
CONFIG_SPI=y
CONFIG_BMI270=y

# Adjust the FMDN ringing configuration to align it with the platform`s capabilities.
CONFIG_BT_FAST_PAIR_FMDN_RING_COMP_ONE=y
CONFIG_BT_FAST_PAIR_FMDN_RING_VOLUME=n

# Adjust the DULT configuration to align it with the platform`s capabilities.
CONFIG_DULT_BATTERY_TYPE_RECHARGEABLE=y

# Align the TX power encoded in the Fast Pair advertising set and
# the Read Beacon Parameters response with Fast Pair expectations.
# The value has been tailored for the following targets:
#   * thingy53/nrf5340/cpuapp(/ns)
CONFIG_BT_ADV_PROV_TX_POWER_CORRECTION_VAL=-12
CONFIG_BT_FAST_PAIR_FMDN_TX_POWER_CORRECTION_VAL=-12
```

## samples/bluetooth/fast_pair/locator_tag/configuration/boards/thingy53_nrf5340_cpuapp_release.conf
```kconfig
#
# Copyright (c) 2024-2026 Nordic Semiconductor ASA
#
# SPDX-License-Identifier: LicenseRef-Nordic-5-Clause
#

CONFIG_SYSTEM_WORKQUEUE_STACK_SIZE=4096

# Disable logging in the release configuration
CONFIG_BOARD_SERIAL_BACKEND_CDC_ACM=n

# Enable the Zephyr drivers required by the speaker, battery module and motion detector module.
CONFIG_PWM=y
CONFIG_ADC=y
CONFIG_SENSOR=y
CONFIG_SPI=y
CONFIG_ADXL362=y

# ADXL362 accelerometer sensor configuration used by motion detection module
# Range set to +/-2g (sensitivity is 1mg/LSB)
CONFIG_ADXL362_ACCEL_RANGE_2G=y
CONFIG_ADXL362_ACCEL_ODR_25=y
CONFIG_ADXL362_TRIGGER_OWN_THREAD=y
# Use default mode for independent activity and inactivity detection.
CONFIG_ADXL362_INTERRUPT_MODE=0
# Use referenced mode for motion detection
CONFIG_ADXL362_ABS_REF_MODE=1
# Activity threshold set to above 250mg (250 mg / 1mg/LSB = 250 LSB)
# for at least 200ms (200ms * 25Hz = 5 samples)
CONFIG_ADXL362_ACTIVITY_THRESHOLD=250
CONFIG_ADXL362_ACTIVITY_TIME=5
# Inactivity threshold set to below 100mg (100 mg / 1mg/LSB = 100 LSB)
# for 5 seconds (5s * 25Hz = 125 samples)
CONFIG_ADXL362_INACTIVITY_THRESHOLD=100
CONFIG_ADXL362_INACTIVITY_TIME=125

# Enable accelerometer to angle conversion for the motion detection module.
CONFIG_ACCEL_TO_ANGLE=y

# Adjust the FMDN ringing configuration to align it with the platform`s capabilities.
CONFIG_BT_FAST_PAIR_FMDN_RING_COMP_ONE=y
CONFIG_BT_FAST_PAIR_FMDN_RING_VOLUME=n

# Adjust the DULT configuration to align it with the platform`s capabilities.
CONFIG_DULT_BATTERY_TYPE_RECHARGEABLE=y

# Align the TX power encoded in the Fast Pair advertising set and
# the Read Beacon Parameters response with Fast Pair expectations.
# The value has been tailored for the following targets:
#   * thingy53/nrf5340/cpuapp(/ns)
CONFIG_BT_ADV_PROV_TX_POWER_CORRECTION_VAL=-12
CONFIG_BT_FAST_PAIR_FMDN_TX_POWER_CORRECTION_VAL=-12
```

## samples/bluetooth/fast_pair/locator_tag/sample.yaml
```yaml
sample:
  name: Fast Pair locator tag
  description: Bluetooth Fast Pair Provider sample setup for the locator tag use case
common:
  tags:
    - bluetooth
    - ci_build
    - sysbuild
    - ci_samples_bluetooth
tests:
  sample.bluetooth.fast_pair.locator_tag:
    sysbuild: true
    build_only: true
    integration_platforms:
      - nrf54l15dk/nrf54l10/cpuapp
      - nrf54l15tag/nrf54l15/cpuapp
      - nrf54lm20dk/nrf54lm20a/cpuapp
      - nrf54lm20dk/nrf54lm20b/cpuapp
      - nrf54ls05dk/nrf54ls05b/cpuapp
    platform_allow:
      - nrf54l15dk/nrf54l05/cpuapp
      - nrf54l15dk/nrf54l10/cpuapp
      - nrf54l15dk/nrf54l15/cpuapp
      - nrf54l15tag/nrf54l15/cpuapp
      - nrf54lm20dk/nrf54lm20a/cpuapp
      - nrf54lm20dk/nrf54lm20b/cpuapp
      - nrf54ls05dk/nrf54ls05b/cpuapp
  sample.bluetooth.fast_pair.locator_tag.release:
    sysbuild: true
    build_only: true
    integration_platforms:
      - nrf54l15dk/nrf54l05/cpuapp
      - nrf54l15tag/nrf54l15/cpuapp
      - nrf54lm20dk/nrf54lm20a/cpuapp
      - nrf54lm20dk/nrf54lm20b/cpuapp
      - nrf54ls05dk/nrf54ls05b/cpuapp
    platform_allow:
      - nrf54l15dk/nrf54l05/cpuapp
      - nrf54l15dk/nrf54l10/cpuapp
      - nrf54l15dk/nrf54l15/cpuapp
      - nrf54l15tag/nrf54l15/cpuapp
      - nrf54lm20dk/nrf54lm20a/cpuapp
      - nrf54lm20dk/nrf54lm20b/cpuapp
      - nrf54ls05dk/nrf54ls05b/cpuapp
    extra_args: FILE_SUFFIX=release
```

## samples/bluetooth/fast_pair/locator_tag/src/Kconfig.dfu
```kconfig
#
# Copyright (c) 2024 Nordic Semiconductor
#
# SPDX-License-Identifier: LicenseRef-Nordic-5-Clause
#

config APP_DFU
	bool "Enable MCUmgr OTA DFU over Bluetooth"
	select NCS_SAMPLE_MCUMGR_BT_OTA_DFU
	depends on BOOTLOADER_MCUBOOT || SUIT
	help
	  Enable support for Device Firmware Update (DFU) over MCUmgr & SMP BT.

if APP_DFU

config MCUMGR_TRANSPORT_BT_DYNAMIC_SVC_REGISTRATION
	default n

# Do not allow for settings erase through MCUmgr. */
config MCUMGR_GRP_ZBASIC
	default n

config MCUMGR_GRP_ZBASIC_STORAGE_ERASE
	default n

endif # APP_DFU
```

## samples/bluetooth/fast_pair/locator_tag/src/Kconfig.ranging
```kconfig
#
# Copyright (c) 2026 Nordic Semiconductor
#
# SPDX-License-Identifier: LicenseRef-Nordic-5-Clause
#

config APP_RANGING
	bool "Enable the application ranging module"
	default y
	select BT_CHANNEL_SOUNDING
	select BT_FAST_PAIR_FMDN_PF
	select BT_RAS
	select BT_RAS_RRSP
	depends on HAS_HW_NRF_RADIO_CS
	help
	  Enable the application ranging using the Precision Finding feature
	  for the Find My Device Network (FMDN) extension.

	  The module is only available for targets that support the Bluetooth
	  Low Energy (BLE) Channel Sounding (CS) as the ranging technology.

if APP_RANGING

# Override the default Bluetooth configuration that is required by this ranging module.
config BT_TRANSMIT_POWER_CONTROL
	default y
	help
	  Enable the transmit power control to allow CS and ACL to use different PHYs.

config BT_CTLR_CHANNEL_SOUNDING_TEST
	default n
	help
	  Disable the Channel Sounding test command to optimize memory usage.

choice BT_CTLR_SDC_CS_ROLE
	default BT_CTLR_SDC_CS_ROLE_REFLECTOR_ONLY
	help
	Enable the Reflector role only to optimize memory usage.

endchoice

config BT_CTLR_SDC_CS_MAX_ANTENNA_PATHS
	default 2
	help
	  Support the ranging with 2 antennas in the case the Initiator has 2 antennas.

config BT_RAS_MAX_ANTENNA_PATHS
	default 2
	help
	  Support the ranging with 2 antennas in the case the Initiator has 2 antennas.

config BT_RAS_MODE_3_SUPPORTED
	default n
	help
	  Disable unnecessary features to optimize memor usage.

endif # APP_RANGING
```

## samples/bluetooth/fast_pair/locator_tag/src/battery/Kconfig.battery
```kconfig
#
# Copyright (c) 2024 Nordic Semiconductor
#
# SPDX-License-Identifier: LicenseRef-Nordic-5-Clause
#

config APP_BATTERY_POLL_INTERVAL
	int "Battery measurement polling interval [s]"
	depends on APP_PLATFORM_THINGY
	default 60

config APP_BATTERY_LEVEL_DECREMENT
	int "Battery level decrement [%] used to simulate battery level on the DK"
	depends on APP_PLATFORM_DK
	range 0 100
	default 10
```

## samples/bluetooth/fast_pair/locator_tag/src/ui/Kconfig.ui
```kconfig
#
# Copyright (c) 2024 Nordic Semiconductor
#
# SPDX-License-Identifier: LicenseRef-Nordic-5-Clause
#

config APP_UI_SPEAKER_FREQ
	int "Speaker frequency [Hz]"
	default 4000
	depends on APP_PLATFORM_THINGY
	help
	  Frequency of every sound generated by the speaker.
```

## samples/bluetooth/fast_pair/locator_tag/sysbuild/hci_ipc/boards/thingy53_nrf5340_cpunet.conf
```kconfig
#
# Copyright (c) 2024 Nordic Semiconductor
#
# SPDX-License-Identifier: LicenseRef-Nordic-5-Clause
#

# The FEM TX gain must be changed to achieve the 0 dBm TX power on the
# Bluetooth controller side.
CONFIG_MPSL_FEM_NRF21540_TX_GAIN_DB=20
```

## samples/bluetooth/fast_pair/locator_tag/sysbuild/ipc_radio/boards/nrf54h20dk_nrf54h20_cpurad.conf
```kconfig
#
# Copyright (c) 2025 Nordic Semiconductor ASA
#
# SPDX-License-Identifier: LicenseRef-Nordic-5-Clause
#

# nRF54H-specific power management configuration
CONFIG_PM=y
```

## samples/bluetooth/fast_pair/locator_tag/sysbuild/ipc_radio/boards/thingy53_nrf5340_cpunet.conf
```kconfig
#
# Copyright (c) 2024 Nordic Semiconductor
#
# SPDX-License-Identifier: LicenseRef-Nordic-5-Clause
#

# The FEM TX gain must be changed to achieve the 0 dBm TX power on the
# Bluetooth controller side.
CONFIG_MPSL_FEM_NRF21540_TX_GAIN_DB=20

# Disable logging (only logs from cpuapp are provided using the USB CDC ACM)
CONFIG_SERIAL=n
CONFIG_UART_CONSOLE=n
CONFIG_LOG=n
CONFIG_LOG_MODE_MINIMAL=n
```

## samples/bluetooth/fast_pair/locator_tag/sysbuild/mcuboot/boards/nrf52dk_nrf52832.conf
```kconfig
#
# Copyright (c) 2026 Nordic Semiconductor
#
# SPDX-License-Identifier: LicenseRef-Nordic-5-Clause
#

# Use FPROTECT region protection on nRF52 targets.
CONFIG_FPROTECT=y
```

## samples/bluetooth/fast_pair/locator_tag/sysbuild/mcuboot/boards/nrf5340dk_nrf5340_cpuapp.conf
```kconfig
#
# Copyright (c) 2024-2026 Nordic Semiconductor ASA
#
# SPDX-License-Identifier: LicenseRef-Nordic-5-Clause
#

# Set the maximum number of sectors per image slot explicitly. The auto-compute
# (CONFIG_BOOT_MAX_IMG_SECTORS_AUTO) cannot determine the erase block size of
# slot1_partition / slot3_partition because the nordic,qspi-nor binding does
# not declare erase-block-size (the driver discovers it from SFDP at runtime).
# 956 KiB slot / 4 KiB sector = 239 sectors.
CONFIG_BOOT_MAX_IMG_SECTORS_AUTO=n
CONFIG_BOOT_MAX_IMG_SECTORS=239

# Required by QSPI
CONFIG_CLOCK_CONTROL=y
CONFIG_SYS_CLOCK_EXISTS=y
CONFIG_NRF_RTC_TIMER=y
CONFIG_NORDIC_QSPI_NOR=y
CONFIG_NORDIC_QSPI_NOR_FLASH_LAYOUT_PAGE_SIZE=4096
CONFIG_NORDIC_QSPI_NOR_STACK_WRITE_BUFFER_SIZE=16

# Use the image header load address (instead of the reset vector) to verify
# that the image in the secondary slot targets the correct primary slot.
# Required for the network core image slot, where the load address must match
# the NETCPU_APP_SLOT range derived from the b0n s0_partition DTS node.
# CONFIG_MCUBOOT_VERIFY_IMG_ADDRESS is the deprecated predecessor of this
# option and must be disabled explicitly because it otherwise auto-defaults
# to y in the overwrite-only mode (CONFIG_BOOT_UPGRADE_ONLY=y).
CONFIG_MCUBOOT_CHECK_HEADER_LOAD_ADDRESS=y
CONFIG_MCUBOOT_VERIFY_IMG_ADDRESS=n

# Use FPROTECT region protection on nRF53 targets.
CONFIG_FPROTECT=y
```
