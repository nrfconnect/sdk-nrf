## samples/bluetooth/fast_pair/locator_tag/sysbuild/mcuboot/boards/nrf54l15dk_nrf54l10_cpuapp.conf
```kconfig
#
# Copyright (c) 2025 Nordic Semiconductor
#
# SPDX-License-Identifier: LicenseRef-Nordic-5-Clause
#

# Disable the unused SPI NOR driver that causes build failures due to missing DTS configuration.
CONFIG_SPI_NOR=n

# Optimize memory usage (Locator tag disables system clock for MCUboot image).
CONFIG_NRF_GRTC_TIMER=n
CONFIG_NRF_GRTC_START_SYSCOUNTER=n
```

## samples/bluetooth/fast_pair/locator_tag/sysbuild/mcuboot/boards/nrf54l15dk_nrf54l15_cpuapp.conf
```kconfig
#
# Copyright (c) 2024 Nordic Semiconductor
#
# SPDX-License-Identifier: LicenseRef-Nordic-5-Clause
#

CONFIG_BOOT_MAX_IMG_SECTORS=256

# Disable the unused SPI NOR driver that causes build failures due to missing DTS configuration.
CONFIG_SPI_NOR=n

# Optimize memory usage (Locator tag disables system clock for MCUboot image).
CONFIG_NRF_GRTC_TIMER=n
CONFIG_NRF_GRTC_START_SYSCOUNTER=n
```

## samples/bluetooth/fast_pair/locator_tag/sysbuild/mcuboot/boards/nrf54l15pdk_nrf54l15_cpuapp.conf
```kconfig
#
# Copyright (c) 2024 Nordic Semiconductor
#
# SPDX-License-Identifier: LicenseRef-Nordic-5-Clause
#

CONFIG_BOOT_MAX_IMG_SECTORS=256

# Optimize memory usage (Locator tag disables system clock for MCUboot image)
CONFIG_NRF_GRTC_TIMER=n
CONFIG_NRF_GRTC_START_SYSCOUNTER=n

# Fprotect is currently not supported.
CONFIG_FPROTECT=n
```

## samples/bluetooth/fast_pair/locator_tag/sysbuild/mcuboot/boards/nrf54l15tag_nrf54l15_cpuapp.conf
```kconfig
#
# Copyright (c) 2026 Nordic Semiconductor
#
# SPDX-License-Identifier: LicenseRef-Nordic-5-Clause
#

CONFIG_USE_DT_CODE_PARTITION=y

# Disable the unused SPI NOR driver that causes build failures due to missing DTS configuration.
CONFIG_SPI_NOR=n

# Optimize memory usage (Locator tag disables system clock for MCUboot image).
CONFIG_NRF_GRTC_TIMER=n
CONFIG_NRF_GRTC_START_SYSCOUNTER=n
```

## samples/bluetooth/fast_pair/locator_tag/sysbuild/mcuboot/boards/nrf54lm20dk_nrf54lm20a_cpuapp.conf
```kconfig
#
# Copyright (c) 2025 Nordic Semiconductor
#
# SPDX-License-Identifier: LicenseRef-Nordic-5-Clause
#

CONFIG_BOOT_MAX_IMG_SECTORS=256

# Disable the unused SPI NOR driver that causes build failures due to missing DTS configuration.
CONFIG_SPI_NOR=n

# Optimize memory usage (Locator tag disables system clock for MCUboot image).
CONFIG_NRF_GRTC_TIMER=n
CONFIG_NRF_GRTC_START_SYSCOUNTER=n

# Temporarily replace the HW crypto driver with SW driver until the HW driver is available.
CONFIG_PSA_CRYPTO_DRIVER_CRACEN=n
CONFIG_PSA_CRYPTO_DRIVER_OBERON=y
```

## samples/bluetooth/fast_pair/locator_tag/sysbuild/mcuboot/boards/nrf54lv10dk_nrf54lv10a_cpuapp.conf
```kconfig
#
# Copyright (c) 2025 Nordic Semiconductor
#
# SPDX-License-Identifier: LicenseRef-Nordic-5-Clause
#

# Optimize memory usage (Locator tag disables system clock for MCUboot image).
CONFIG_NRF_GRTC_TIMER=n
CONFIG_NRF_GRTC_START_SYSCOUNTER=n
```

## samples/bluetooth/fast_pair/locator_tag/sysbuild/mcuboot/boards/nrf7120dk_nrf7120_cpuapp.conf
```kconfig
#
# Copyright (c) 2026 Nordic Semiconductor
#
# SPDX-License-Identifier: LicenseRef-Nordic-5-Clause
#

# Optimize memory usage (Locator tag disables system clock for MCUboot image).
CONFIG_NRF_GRTC_TIMER=n
CONFIG_NRF_GRTC_START_SYSCOUNTER=n

# Use MRAM region protection on nRF71 targets.
CONFIG_NCS_MCUBOOT_DISABLE_SELF_RWX=y
```
