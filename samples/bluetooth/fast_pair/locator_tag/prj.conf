## CMakeLists.txt
```
#
# Copyright (c) 2024-2026 Nordic Semiconductor
#
# SPDX-License-Identifier: LicenseRef-Nordic-5-Clause
#
cmake_minimum_required(VERSION 3.20.0)

# The sample uses a separate directory for configuration files.
set(APPLICATION_CONFIG_DIR "${CMAKE_CURRENT_LIST_DIR}/configuration")

find_package(Zephyr REQUIRED HINTS $ENV{ZEPHYR_BASE})
project(locator_tag)

# NORDIC SDK APP START
target_sources(app PRIVATE
  src/main.c
  src/factory_reset.c
)

zephyr_linker_sources(SECTIONS src/factory_reset_callbacks.ld)

if(CONFIG_APP_DFU)
  target_sources(app PRIVATE src/dfu.c)
endif()

if(CONFIG_APP_RANGING)
  target_sources(app PRIVATE src/ranging.c)
endif()

if(NOT CONFIG_BT_FAST_PAIR_FHN_RING_COMP_NONE)
  target_sources(app PRIVATE src/ring.c)
endif()

target_include_directories(app PRIVATE include)

add_subdirectory(src/ui)
add_subdirectory(src/battery)

if(CONFIG_BT_FAST_PAIR_FHN_DULT_MOTION_DETECTOR)
  add_subdirectory(src/motion_detector)
endif()
# NORDIC SDK APP END
```

## Kconfig
```
#
# Copyright (c) 2024-2026 Nordic Semiconductor
#
# SPDX-License-Identifier: LicenseRef-Nordic-5-Clause
#

menu "Nordic Fast Pair Locator tag sample"

config APP_PLATFORM_DK
	bool
	default y
	depends on !APP_PLATFORM_REF

config APP_PLATFORM_REF
	bool
	default y
	depends on BOARD_NRF54L15TAG

rsource "Kconfig.battery"
rsource "Kconfig.dfu"
rsource "Kconfig.motion_detector"
rsource "Kconfig.ranging"
rsource "Kconfig.ui"

config SETTINGS
	default y

config ZMS
	default y if (SOC_FLASH_NRF_RRAM || SOC_FLASH_NRF_MRAM)

config NVS
	default y if !(SOC_FLASH_NRF_RRAM || SOC_FLASH_NRF_MRAM)

endmenu

source "Kconfig.zephyr"
```

## Kconfig.battery
```
#
# Copyright (c) 2024-2026 Nordic Semiconductor
#
# SPDX-License-Identifier: LicenseRef-Nordic-5-Clause
#

config APP_BATTERY_POLL_INTERVAL
	int "Battery measurement polling interval [s]"
	depends on APP_PLATFORM_REF
	default 60

config APP_BATTERY_LEVEL_DECREMENT
	int "Battery level decrement [%] used to simulate battery level on the DK"
	depends on APP_PLATFORM_DK
	range 0 100
	default 10
```

## Kconfig.dfu
```
#
# Copyright (c) 2024-2026 Nordic Semiconductor
#
# SPDX-License-Identifier: LicenseRef-Nordic-5-Clause
#

config APP_DFU
	bool "Enable MCUmgr OTA DFU over Bluetooth"
	select NCS_SAMPLE_MCUMGR_BT_OTA_DFU
	depends on BOOTLOADER_MCUBOOT
	help
	  Enable support for Device Firmware Update (DFU) over MCUmgr & SMP BT.

if APP_DFU

config MCUMGR_TRANSPORT_BT_DYNAMIC_SVC_REGISTRATION
	default n

# Do not allow for settings erase through MCUmgr. */
config MCUMGR_GRP_ZBASIC
	default n

config MCUMGR_GRP_ZBASIC_STORAGE_ERASE
	default n

endif # APP_DFU
```

## Kconfig.motion_detector
```
#
# Copyright (c) 2026 Nordic Semiconductor
#
# SPDX-License-Identifier: LicenseRef-Nordic-5-Clause
#

config APP_MOTION_DETECTOR_ACT_INACT_DETECTION_SUPPORTED
	bool
	default y
	depends on DT_HAS_ADI_ADXL362_ENABLED && ADXL362_TRIGGER
	help
	  Indicates whether the motion detector supports activity/inactivity detection.
	  This is only supported on the ADXL362 when the trigger feature is enabled.
	  The activity/inactivity detection usage can decrease power consumption
	  by allowing the system to enter a low power state when no motion is detected.
```

## sysbuild.conf
```
#
# Copyright (c) 2024 Nordic Semiconductor
#
# SPDX-License-Identifier: LicenseRef-Nordic-5-Clause
#

SB_CONFIG_BT_FAST_PAIR=y
```

## prj.conf
```kconfig
#
# Copyright (c) 2024 Nordic Semiconductor
#
# SPDX-License-Identifier: LicenseRef-Nordic-5-Clause
#

CONFIG_NCS_SAMPLES_DEFAULTS=y

CONFIG_MAIN_STACK_SIZE=2048
CONFIG_SYSTEM_WORKQUEUE_PRIORITY=-1

CONFIG_DK_LIBRARY=y

CONFIG_LOG=y

# Error handling configuration
CONFIG_RESET_ON_FATAL_ERROR=n

# Enable settings to store data in non-volatile memory
CONFIG_FLASH=y
CONFIG_FLASH_MAP=y
CONFIG_NVS=y
CONFIG_SETTINGS_NVS=y
CONFIG_SETTINGS=y
CONFIG_BT_SETTINGS=y

CONFIG_BT=y
CONFIG_BT_DEVICE_NAME="NCS locator tag"
CONFIG_BT_PERIPHERAL=y
CONFIG_BT_PERIPHERAL_PREF_MIN_INT=24
CONFIG_BT_PERIPHERAL_PREF_MAX_INT=40
CONFIG_BT_PERIPHERAL_PREF_LATENCY=0
CONFIG_BT_PERIPHERAL_PREF_TIMEOUT=100
CONFIG_BT_CONN_PARAM_UPDATE_TIMEOUT=500

CONFIG_BT_ADV_PROV=y
CONFIG_BT_ADV_PROV_FLAGS=y
CONFIG_BT_ADV_PROV_TX_POWER=y
CONFIG_BT_ADV_PROV_FAST_PAIR=y
CONFIG_BT_ADV_PROV_DEVICE_NAME=y
CONFIG_BT_ADV_PROV_DEVICE_NAME_SD=y

# Disable automatic initiation of PHY updates.
# Workaround to prevent disconnection with reason 42 (BT_HCI_ERR_DIFF_TRANS_COLLISION).
# Some Android phones reply to the LL_PHY_REQ and at the same time initiate a connection
# update which triggers an invalid procedure collision.
CONFIG_BT_AUTO_PHY_UPDATE=n

CONFIG_BT_ID_MAX=2
CONFIG_BT_MAX_PAIRED=8
CONFIG_BT_SMP=y
CONFIG_BT_PRIVACY=y
CONFIG_BT_GATT_AUTHORIZATION_CUSTOM=y
CONFIG_BT_RPA_TIMEOUT_DYNAMIC=y
CONFIG_BT_MAX_CONN=3
CONFIG_BT_EXT_ADV_MAX_ADV_SET=2

CONFIG_BT_FAST_PAIR=y
CONFIG_BT_FAST_PAIR_USE_CASE_LOCATOR_TAG=y
CONFIG_BT_FAST_PAIR_REQ_PAIRING=n
CONFIG_BT_FAST_PAIR_LOG_LEVEL_DBG=y
CONFIG_BT_FAST_PAIR_STORAGE_USER_RESET_ACTION=y
CONFIG_BT_FAST_PAIR_FMDN_BATTERY_DULT=y
CONFIG_BT_FAST_PAIR_FMDN_RING_COMP_THREE=y
CONFIG_BT_FAST_PAIR_FMDN_RING_VOLUME=y
CONFIG_BT_FAST_PAIR_FMDN_CLOCK_NVM_UPDATE_TIME=10

CONFIG_BT_FAST_PAIR_FMDN_DULT_MANUFACTURER_NAME="Nordic Semiconductor ASA"
CONFIG_BT_FAST_PAIR_FMDN_DULT_MODEL_NAME="NCS locator tag"
# Set Location Tracker Accessory Category.
CONFIG_BT_FAST_PAIR_FMDN_DULT_ACCESSORY_CATEGORY=1

CONFIG_DULT_LOG_LEVEL_DBG=y

# Firmware versions should be aligned.
# Major.Minor.Revision value of 0.0.0 is not supported by the Fast Pair Validator
# Android app.
CONFIG_BT_FAST_PAIR_FMDN_DULT_FIRMWARE_VERSION_MAJOR=1
CONFIG_BT_FAST_PAIR_FMDN_DULT_FIRMWARE_VERSION_MINOR=0
CONFIG_BT_FAST_PAIR_FMDN_DULT_FIRMWARE_VERSION_REVISION=0

# Align the TX power encoded in the Fast Pair advertising set and
# the Read Beacon Parameters response with Fast Pair expectations.
# The value has been tailored for following DKs:
#   * nrf52dk/nrf52832
#   * nrf52833dk/nrf52833
#   * nrf52840dk/nrf52840
#   * nrf5340dk/nrf5340/cpuapp(/ns)
CONFIG_BT_ADV_PROV_TX_POWER_CORRECTION_VAL=-15
CONFIG_BT_FAST_PAIR_FMDN_TX_POWER_CORRECTION_VAL=-15
```

## prj_release.conf
```kconfig
#
# Copyright (c) 2024 Nordic Semiconductor
#
# SPDX-License-Identifier: LicenseRef-Nordic-5-Clause
#

CONFIG_MAIN_STACK_SIZE=2048
CONFIG_SYSTEM_WORKQUEUE_PRIORITY=-1

CONFIG_DK_LIBRARY=y

# Error handling configuration
CONFIG_RESET_ON_FATAL_ERROR=y

# Activate LTO
CONFIG_LTO=y
CONFIG_ISR_TABLES_LOCAL_DECLARATION=y

# Memory optimization
CONFIG_SERIAL=n
CONFIG_CONSOLE=n
CONFIG_PRINTK=n
CONFIG_UART_CONSOLE=n
CONFIG_USE_SEGGER_RTT=n
CONFIG_BOOT_BANNER=n
CONFIG_NCS_BOOT_BANNER=n
CONFIG_BT_ASSERT=n
CONFIG_ASSERT_VERBOSE=n
CONFIG_HW_STACK_PROTECTION=n
CONFIG_SETTINGS_DYNAMIC_HANDLERS=n

# Enable settings to store data in non-volatile memory
CONFIG_FLASH=y
CONFIG_FLASH_MAP=y
CONFIG_NVS=y
CONFIG_SETTINGS_NVS=y
CONFIG_SETTINGS=y
CONFIG_BT_SETTINGS=y

CONFIG_BT=y
CONFIG_BT_DEVICE_NAME="NCS locator tag"
CONFIG_BT_PERIPHERAL=y
CONFIG_BT_PERIPHERAL_PREF_MIN_INT=24
CONFIG_BT_PERIPHERAL_PREF_MAX_INT=40
CONFIG_BT_PERIPHERAL_PREF_LATENCY=0
CONFIG_BT_PERIPHERAL_PREF_TIMEOUT=100
CONFIG_BT_CONN_PARAM_UPDATE_TIMEOUT=500

CONFIG_BT_ADV_PROV=y
CONFIG_BT_ADV_PROV_FLAGS=y
CONFIG_BT_ADV_PROV_TX_POWER=y
CONFIG_BT_ADV_PROV_FAST_PAIR=y
CONFIG_BT_ADV_PROV_DEVICE_NAME=y
CONFIG_BT_ADV_PROV_DEVICE_NAME_SD=y

# Disable automatic initiation of PHY updates.
# Workaround to prevent disconnection with reason 42 (BT_HCI_ERR_DIFF_TRANS_COLLISION).
# Some Android phones reply to the LL_PHY_REQ and at the same time initiate a connection
# update which triggers an invalid procedure collision.
CONFIG_BT_AUTO_PHY_UPDATE=n

CONFIG_BT_ID_MAX=2
CONFIG_BT_MAX_PAIRED=8
CONFIG_BT_SMP=y
CONFIG_BT_PRIVACY=y
CONFIG_BT_GATT_AUTHORIZATION_CUSTOM=y
CONFIG_BT_RPA_TIMEOUT_DYNAMIC=y
CONFIG_BT_MAX_CONN=3
CONFIG_BT_EXT_ADV_MAX_ADV_SET=2

CONFIG_BT_FAST_PAIR=y
CONFIG_BT_FAST_PAIR_REQ_PAIRING=n
CONFIG_BT_FAST_PAIR_STORAGE_USER_RESET_ACTION=y
CONFIG_BT_FAST_PAIR_FMDN=y
CONFIG_BT_FAST_PAIR_FMDN_BATTERY_DULT=y
CONFIG_BT_FAST_PAIR_FMDN_RING_COMP_THREE=y
CONFIG_BT_FAST_PAIR_FMDN_RING_VOLUME=y
CONFIG_BT_FAST_PAIR_FMDN_CLOCK_NVM_UPDATE_TIME=10

CONFIG_BT_FAST_PAIR_FMDN_DULT_MANUFACTURER_NAME="Nordic Semiconductor ASA"
CONFIG_BT_FAST_PAIR_FMDN_DULT_MODEL_NAME="NCS locator tag"
# Set Location Tracker Accessory Category.
CONFIG_BT_FAST_PAIR_FMDN_DULT_ACCESSORY_CATEGORY=1

# Firmware versions should be aligned.
# Major.Minor.Revision value of 0.0.0 is not supported by the Fast Pair Validator
# Android app.
CONFIG_BT_FAST_PAIR_FMDN_DULT_FIRMWARE_VERSION_MAJOR=1
CONFIG_BT_FAST_PAIR_FMDN_DULT_FIRMWARE_VERSION_MINOR=0
CONFIG_BT_FAST_PAIR_FMDN_DULT_FIRMWARE_VERSION_REVISION=0

# Align the TX power encoded in the Fast Pair advertising set and
# the Read Beacon Parameters response with Fast Pair expectations.
# The value has been tailored for following DKs:
#   * nrf52dk/nrf52832
#   * nrf52833dk/nrf52833
#   * nrf52840dk/nrf52840
#   * nrf5340dk/nrf5340/cpuapp(/ns)
CONFIG_BT_ADV_PROV_TX_POWER_CORRECTION_VAL=-15
CONFIG_BT_FAST_PAIR_FMDN_TX_POWER_CORRECTION_VAL=-15
```

## boards/nrf54l15pdk_nrf54l15_cpuapp.conf
```kconfig
#
# Copyright (c) 2024 Nordic Semiconductor ASA
#
# SPDX-License-Identifier: LicenseRef-Nordic-5-Clause
#

# Align the TX power encoded in the Fast Pair advertising set and
# the Read Beacon Parameters response with Fast Pair expectations.
# The value has been tailored for following DKs:
#   * nrf54l15pdk/nrf54l15/cpuapp
CONFIG_BT_ADV_PROV_TX_POWER_CORRECTION_VAL=-17
CONFIG_BT_FAST_PAIR_FMDN_TX_POWER_CORRECTION_VAL=-17
```

## boards/thingy53_nrf5340_cpuapp.conf
```kconfig
#
# Copyright (c) 2024 Nordic Semiconductor ASA
#
# SPDX-License-Identifier: LicenseRef-Nordic-5-Clause
#

CONFIG_SYSTEM_WORKQUEUE_STACK_SIZE=4096

# Use deferred logging
CONFIG_NCS_SAMPLES_DEFAULTS=n
CONFIG_LOG=y
CONFIG_ASSERT=y
CONFIG_ASSERT_NO_COND_INFO=y
CONFIG_ASSERT_NO_MSG_INFO=y
CONFIG_HW_STACK_PROTECTION=y

# Enable the Zephyr drivers required by the speaker and battery module.
CONFIG_PWM=y
CONFIG_ADC=y

# Adjust the FMDN ringing configuration to align it with the platform`s capabilities.
CONFIG_BT_FAST_PAIR_FMDN_RING_COMP_ONE=y
CONFIG_BT_FAST_PAIR_FMDN_RING_VOLUME=n

# Adjust the DULT configuration to align it with the platform`s capabilities.
CONFIG_DULT_BATTERY_TYPE_RECHARGEABLE=y

# Align the TX power encoded in the Fast Pair advertising set and
# the Read Beacon Parameters response with Fast Pair expectations.
# The value has been tailored for the following targets:
#   * thingy53/nrf5340/cpuapp(/ns)
CONFIG_BT_ADV_PROV_TX_POWER_CORRECTION_VAL=-10
CONFIG_BT_FAST_PAIR_FMDN_TX_POWER_CORRECTION_VAL=-10
```

## boards/thingy53_nrf5340_cpuapp_ns_release.conf
```kconfig
#
# Copyright (c) 2024 Nordic Semiconductor ASA
#
# SPDX-License-Identifier: LicenseRef-Nordic-5-Clause
#

CONFIG_SYSTEM_WORKQUEUE_STACK_SIZE=4096

# Disable logging in the release configuration
CONFIG_BOARD_SERIAL_BACKEND_CDC_ACM=n

# Enable the Zephyr drivers required by the speaker and battery module.
CONFIG_PWM=y
CONFIG_ADC=y

# Adjust the FMDN ringing configuration to align it with the platform`s capabilities.
CONFIG_BT_FAST_PAIR_FMDN_RING_COMP_ONE=y
CONFIG_BT_FAST_PAIR_FMDN_RING_VOLUME=n

# Adjust the DULT configuration to align it with the platform`s capabilities.
CONFIG_DULT_BATTERY_TYPE_RECHARGEABLE=y

# Align the TX power encoded in the Fast Pair advertising set and
# the Read Beacon Parameters response with Fast Pair expectations.
# The value has been tailored for the following targets:
#   * thingy53/nrf5340/cpuapp(/ns)
CONFIG_BT_ADV_PROV_TX_POWER_CORRECTION_VAL=-10
CONFIG_BT_FAST_PAIR_FMDN_TX_POWER_CORRECTION_VAL=-10
```

## boards/thingy53_nrf5340_cpuapp.overlay
```dts
/*
 * Copyright (c) 2024 Nordic Semiconductor ASA
 *
 * SPDX-License-Identifier: LicenseRef-Nordic-5-Clause
 */

 / {
	aliases {
		pwm-spk = &pwm_spk0;
	};

	pwmspk {
		compatible = "pwm-leds";
		pwm_spk0: pwm-spk-0 {
			pwms = <&pwm1 0 PWM_MSEC(20) PWM_POLARITY_NORMAL>;
		};
	};
};
```

## boards/thingy53_nrf5340_cpuapp_common.dtsi
```dts
/*
 * Copyright (c) 2024 Nordic Semiconductor ASA
 *
 * SPDX-License-Identifier: LicenseRef-Nordic-5-Clause
 */

/ {
	aliases {
		pwm-spk = &pwm_spk0;
	};

	pwmspk {
		compatible = "pwm-leds";
		pwm_spk0: pwm-spk-0 {
			pwms = <&pwm1 0 PWM_MSEC(20) PWM_POLARITY_NORMAL>;
		};
	};
};
```

## boards/thingy53_nrf5340_cpuapp_ns.overlay
```dts
/*
 * Copyright (c) 2024 Nordic Semiconductor ASA
 *
 * SPDX-License-Identifier: LicenseRef-Nordic-5-Clause
 */

#include "thingy53_nrf5340_cpuapp_common.dtsi"
```

## src/main.c
```c
/*
 * Copyright (c) 2024-2026 Nordic Semiconductor ASA
 *
 * SPDX-License-Identifier: LicenseRef-Nordic-5-Clause
 */

#include <zephyr/settings/settings.h>
#include <zephyr/kernel.h>

#include <zephyr/bluetooth/conn.h>
#include <zephyr/bluetooth/gatt.h>
#include <zephyr/bluetooth/uuid.h>

#include <bluetooth/fast_pair/adv_manager.h>
#include <bluetooth/fast_pair/fast_pair.h>
#include <bluetooth/fast_pair/fhn/fhn.h>

#include "app_battery.h"
#include "app_dfu.h"
#include "app_factory_reset.h"
#include "app_ring.h"
#include "app_ui.h"

#ifdef CONFIG_BT_FAST_PAIR_FHN_DULT_MOTION_DETECTOR
#include "app_motion_detector.h"
#endif

#include <zephyr/logging/log.h>
LOG_MODULE_REGISTER(fp_fhn, LOG_LEVEL_INF);

/* Bluetooth identity used by the Fast Pair and FHN modules.*/
#define APP_BT_ID 1

/* Semaphore timeout in seconds. */
#define INIT_SEM_TIMEOUT (60)

/* Factory reset delay in seconds since the trigger operation. */
#define FACTORY_RESET_DELAY (3)

/* FHN provisioning timeout in minutes as recommended by the specification. */
#define FHN_PROVISIONING_TIMEOUT (5)

/* FHN recovery mode timeout in minutes. */
#define FHN_RECOVERY_MODE_TIMEOUT (CONFIG_BT_FAST_PAIR_FHN_READ_MODE_FHN_RECOVERY_TIMEOUT)

/* FHN identification mode timeout in minutes. */
#define FHN_ID_MODE_TIMEOUT (CONFIG_DULT_ID_READ_STATE_TIMEOUT)

/* Minimum button hold time in milliseconds to trigger the FHN recovery mode. */
#define FHN_RECOVERY_MODE_BTN_MIN_HOLD_TIME_MS (3000)

/* FHN advertising interval 2s (0x0C80 in hex). */
#define FHN_ADV_INTERVAL (0x0C80)

/* Factory reset reason. */
enum factory_reset_trigger {
	FACTORY_RESET_TRIGGER_NONE,
	FACTORY_RESET_TRIGGER_KEY_STATE_MISMATCH,
	FACTORY_RESET_TRIGGER_PROVISIONING_TIMEOUT,
};

static bool fhn_provisioned;
static bool fhn_recovery_mode;
static bool fhn_id_mode;
static bool fp_account_key_present;
static bool fp_adv_pairing_mode_request;

/* Bitmask of connections authenticated by the FHN extension. */
static uint32_t fhn_conn_auth_bm;

/* Size in bits of the authenticated connection bitmask. */
#define FHN_CONN_AUTH_BM_BIT_SIZE (__CHAR_BIT__ * sizeof(fhn_conn_auth_bm))

/* Used to manually request the FP advertising by the user.
 * Enabled by default on bootup if not provisioned.
 */
BT_FAST_PAIR_ADV_MANAGER_TRIGGER_REGISTER(
	fp_adv_trigger_pairing_mode,
	"pairing_mode",
	(&(const struct bt_fast_pair_adv_manager_trigger_config) {
		.pairing_mode = true,
		.suspend_rpa = true,
	}));

static enum factory_reset_trigger factory_reset_trigger;

static void init_work_handle(struct k_work *w);

static K_SEM_DEFINE(init_work_sem, 0, 1);
static K_WORK_DEFINE(init_work, init_work_handle);

static void fhn_provisioning_state_set(bool provisioned)
{
	__ASSERT_NO_MSG(bt_fast_pair_is_ready());
	__ASSERT_NO_MSG(bt_fast_pair_fhn_is_provisioned() == provisioned);

	if (fhn_provisioned == provisioned) {
		return;
	}

	LOG_INF("FHN: state changed to %s",
		provisioned ? "provisioned" : "unprovisioned");

	app_ui_state_change_indicate(APP_UI_STATE_PROVISIONED, provisioned);
	fhn_provisioned = provisioned;
}

static void fhn_factory_reset_executed(void)
{
	if (factory_reset_trigger != FACTORY_RESET_TRIGGER_NONE) {
		LOG_INF("The device has been reset to factory settings");
		LOG_INF("Please press a button to put the device in the Fast Pair discoverable "
			"advertising mode");
	}

	/* Clear the trigger state for the scheduled factory reset operations. */
	factory_reset_trigger = FACTORY_RESET_TRIGGER_NONE;

	if (bt_fast_pair_is_ready()) {
		fp_account_key_present = bt_fast_pair_has_account_key();
	}
	__ASSERT_NO_MSG(!fp_account_key_present);

	__ASSERT_NO_MSG(!fhn_provisioned);
}

APP_FACTORY_RESET_CALLBACKS_REGISTER(factory_reset_cbs, NULL, fhn_factory_reset_executed);

static void fhn_factory_reset_schedule(enum factory_reset_trigger trigger, k_timeout_t delay)
{
	app_factory_reset_schedule(delay);
	factory_reset_trigger = trigger;
}

static void fhn_factory_reset_cancel(void)
{
	app_factory_reset_cancel();
	factory_reset_trigger = FACTORY_RESET_TRIGGER_NONE;
}

static enum bt_security_err pairing_accept(struct bt_conn *conn,
					   const struct bt_conn_pairing_feat *const feat)
{
	ARG_UNUSED(conn);
	ARG_UNUSED(feat);

	/* Fast Pair Implementation Guidelines for the locator tag use case:
	 * Provider should reject normal Bluetooth pairing attempts. It should
	 * only accept Fast Pair pairing.
	 */

	LOG_WRN("Normal Bluetooth pairing not allowed");

	return BT_SECURITY_ERR_PAIR_NOT_ALLOWED;
}

static const struct bt_conn_auth_cb conn_auth_callbacks = {
	.pairing_accept = pairing_accept,
};

static void fhn_conn_auth_bm_conn_status_set(const struct bt_conn *conn, bool auth_flag)
{
	uint8_t index;

	BUILD_ASSERT(CONFIG_BT_MAX_CONN <= FHN_CONN_AUTH_BM_BIT_SIZE);

	index = bt_conn_index(conn);
	__ASSERT_NO_MSG(index < FHN_CONN_AUTH_BM_BIT_SIZE);

	WRITE_BIT(fhn_conn_auth_bm, index, auth_flag);
}

static bool fhn_conn_auth_bm_conn_status_get(const struct bt_conn *conn)
{
	uint8_t index;

	index = bt_conn_index(conn);
	__ASSERT_NO_MSG(index < FHN_CONN_AUTH_BM_BIT_SIZE);

	return (fhn_conn_auth_bm & BIT(index));
}

static bool identifying_info_allow(struct bt_conn *conn, const struct bt_uuid *uuid)
{
	const struct bt_uuid *uuid_block_list[] = {
		/* Device Information service characteristics */
		BT_UUID_DIS_FIRMWARE_REVISION,
		/* GAP service characteristics */
		BT_UUID_GAP_DEVICE_NAME,
	};
	bool uuid_match = false;

	if (!fhn_provisioned) {
		return true;
	}

	if (fhn_conn_auth_bm_conn_status_get(conn)) {
		return true;
	}

	if (fhn_id_mode) {
		return true;
	}

	for (size_t i = 0; i < ARRAY_SIZE(uuid_block_list); i++) {
		if (bt_uuid_cmp(uuid, uuid_block_list[i]) == 0) {
			uuid_match = true;
			break;
		}
	}

	if (!uuid_match) {
		return true;
	}

	LOG_INF("Rejecting operation on the identifying information");

	return false;
}

static void gatt_authorized_operation_indicate(struct bt_conn *conn,
					       const struct bt_gatt_attr *attr)
{
	/* This function can be used to indicate important GATT operations to the user. */
	if (!bt_uuid_cmp(attr->uuid, BT_UUID_DIS_FIRMWARE_REVISION)) {
		LOG_INF("DIS Firmware Revision characteristic is being read");
	}
}

static bool gatt_authorize(struct bt_conn *conn, const struct bt_gatt_attr *attr)
{
	bool authorized = true;

	/* Fast Pair Implementation Guidelines for the locator tag use case:
	 * The Provider shouldn't expose any identifying information
	 * in an unauthenticated manner (e.g. names or identifiers).
	 */

	if (IS_ENABLED(CONFIG_APP_DFU)) {
		authorized = authorized && app_dfu_bt_gatt_operation_allow(attr->uuid);
	}

	authorized = authorized && identifying_info_allow(conn, attr->uuid);

	if (authorized) {
		gatt_authorized_operation_indicate(conn, attr);
	}

	return authorized;
}

static const struct bt_gatt_authorization_cb gatt_authorization_callbacks = {
	.read_authorize = gatt_authorize,
	.write_authorize = gatt_authorize,
};

static void fp_account_key_written(struct bt_conn *conn)
{
	LOG_INF("Fast Pair: Account Key write");

	/* The first and only Account Key write starts the FHN provisioning. */
	if (!fp_account_key_present) {
		/* The advertising trigger for the FHN provisioning process is handled by the
		 * locator tag add-on for the Fast Pair Advertising Manager module. If you want to
		 * replace this behavior with your custom implementation, disable the add-on with
		 * the CONFIG_BT_FAST_PAIR_ADV_MANAGER_USE_CASE_LOCATOR_TAG Kconfig option. Please
		 * note that, in this case, you need to define and manage the advertising triggers
		 * for the FHN provisioning process and the FHN clock synchronization process by
		 * yourself.
		 */

		/* Disable the advertising trigger for the pairing mode. */
		fp_adv_pairing_mode_request = false;
		bt_fast_pair_adv_manager_request(&fp_adv_trigger_pairing_mode,
						 fp_adv_pairing_mode_request);

		/* Fast Pair Implementation Guidelines for the locator tag use case:
		 * trigger the reset to factory settings if there is no FHN
		 * provisioning operation within 5 minutes.
		 */
		fhn_factory_reset_schedule(
			FACTORY_RESET_TRIGGER_PROVISIONING_TIMEOUT,
			K_MINUTES(FHN_PROVISIONING_TIMEOUT));
	}

	fp_account_key_present = bt_fast_pair_has_account_key();
}

static struct bt_fast_pair_info_cb fp_info_callbacks = {
	.account_key_written = fp_account_key_written,
};

static void fhn_recovery_mode_exited(void)
{
	LOG_INF("FHN: recovery mode exited");

	fhn_recovery_mode = false;
	app_ui_state_change_indicate(APP_UI_STATE_RECOVERY_MODE, fhn_recovery_mode);
}

static void fhn_id_mode_exited(void)
{
	LOG_INF("FHN: identification mode exited");

	fhn_id_mode = false;
	app_ui_state_change_indicate(APP_UI_STATE_ID_MODE, fhn_id_mode);
}

static void fhn_read_mode_exited(enum bt_fast_pair_fhn_read_mode mode)
{
	switch (mode) {
	case BT_FAST_PAIR_FHN_READ_MODE_FHN_RECOVERY:
		fhn_recovery_mode_exited();
		break;
	case BT_FAST_PAIR_FHN_READ_MODE_DULT_ID:
		fhn_id_mode_exited();
		break;
	default:
		/* Unsupported mode: should not happen. */
		__ASSERT_NO_MSG(0);
		break;
	}
}

static const struct bt_fast_pair_fhn_read_mode_cb fhn_read_mode_cb = {
	.exited = fhn_read_mode_exited,
};

static void fhn_recovery_mode_action_handle(void)
{
	int err;

	if (!fhn_provisioned) {
		LOG_INF("FHN: the recovery mode is not available in the "
			"unprovisioned state");
		return;
	}

	if (fhn_recovery_mode) {
		LOG_INF("FHN: refreshing the recovery mode timeout");
	} else {
		LOG_INF("FHN: entering the recovery mode for %d minute(s)",
			FHN_RECOVERY_MODE_TIMEOUT);
	}

	err = bt_fast_pair_fhn_read_mode_enter(BT_FAST_PAIR_FHN_READ_MODE_FHN_RECOVERY);
	if (err) {
		LOG_ERR("FHN: failed to enter the recovery mode: err=%d", err);
		return;
	}

	fhn_recovery_mode = true;
	app_ui_state_change_indicate(APP_UI_STATE_RECOVERY_MODE, fhn_recovery_mode);
}

static void fhn_id_mode_action_handle(void)
{
	int err;

	if (!fhn_provisioned) {
		LOG_INF("FHN: the identification mode is not available in the "
			"unprovisioned state. "
			"Identifying info can always be read in this state.");
		return;
	}

	if (fhn_id_mode) {
		LOG_INF("FHN: refreshing the identification mode timeout");
	} else {
		LOG_INF("FHN: entering the identification mode for %d minute(s)",
			FHN_ID_MODE_TIMEOUT);
	}

	err = bt_fast_pair_fhn_read_mode_enter(BT_FAST_PAIR_FHN_READ_MODE_DULT_ID);
	if (err) {
		LOG_ERR("FHN: failed to enter the identification mode: err=%d", err);
		return;
	}

	/* Fast Pair Implementation Guidelines for the locator tag use case:
	 * The Provider shouldn't expose any identifying information
	 * in an unauthenticated manner (e.g. names or identifiers).
	 *
	 * The DULT identification mode is also used to allow reading of Bluetooth
	 * characteristics with identifying information for a limited time in the
	 * provisioned state.
	 */
	fhn_id_mode = true;
	app_ui_state_change_indicate(APP_UI_STATE_ID_MODE, fhn_id_mode);
}

static void fp_adv_pairing_mode_action_handle(void)
{
	if (!bt_fast_pair_adv_manager_is_ready()) {
		LOG_INF("Fast Pair: pairing mode change is not available when the FP Advertising "
			"Manager module is disabled");
		return;
	}

	if (fp_account_key_present) {
		LOG_INF("Fast Pair: pairing mode change is not available when the Account Key "
			"is in the NVM storage");
		return;
	}

	fp_adv_pairing_mode_request = !fp_adv_pairing_mode_request;
	bt_fast_pair_adv_manager_request(&fp_adv_trigger_pairing_mode,
					 fp_adv_pairing_mode_request);
}

static void ui_request_handle(enum app_ui_request request)
{
	/* It is assumed that the callback executes in the cooperative
	 * thread context as it interacts with the FHN API.
	 */
	__ASSERT_NO_MSG(!k_is_preempt_thread());
	__ASSERT_NO_MSG(!k_is_in_isr());

	if (request == APP_UI_REQUEST_RECOVERY_MODE_ENTER) {
		fhn_recovery_mode_action_handle();
	} else if (request == APP_UI_REQUEST_ID_MODE_ENTER) {
		fhn_id_mode_action_handle();
	} else if (request == APP_UI_REQUEST_FP_ADV_PAIRING_MODE_CHANGE) {
		fp_adv_pairing_mode_action_handle();
	}
}

static void security_changed(struct bt_conn *conn, bt_security_t level, enum bt_security_err err)
{
	if ((err != BT_SECURITY_ERR_SUCCESS) || (level < BT_SECURITY_L2)) {
		return;
	}

	LOG_INF("FHN: connection authenticated using the Bluetooth bond: %p", (void *)conn);

	/* Connection authentication flow #1 to allow read operation of the DIS Firmware Revision
	 * characteristic according to the Firmware updates section from the FHN Accessory
	 * specification:
	 * The connection is validated using the previously established Bluetooth bond (available
	 * only for locator tags that create a Bluetooth bond during the Fast Pair procedure).
	 */
	fhn_conn_auth_bm_conn_status_set(conn, true);
}

static void disconnected(struct bt_conn *conn, uint8_t reason)
{
	fhn_conn_auth_bm_conn_status_set(conn, false);
}

BT_CONN_CB_DEFINE(conn_callbacks) = {
	.security_changed = security_changed,
	.disconnected = disconnected,
};

static void fhn_clock_synced(void)
{
	LOG_INF("FHN: clock information synchronized with the authenticated Bluetooth peer");

	/* The advertising trigger for the FHN clock synchronization process is handled by the
	 * locator tag add-on for the Fast Pair Advertising Manager module. If you want to replace
	 * this behavior with your custom implementation, disable one of the following Kconfigs:
	 * - CONFIG_BT_FAST_PAIR_ADV_MANAGER_USE_CASE_LOCATOR_TAG_CLOCK_SYNC_TRIGGER: to turn off
	 *   only the clock synchronization trigger.
	 * - CONFIG_BT_FAST_PAIR_ADV_MANAGER_USE_CASE_LOCATOR_TAG: to turn off the locator tag
	 *   add-on for the Fast Pair Advertising Manager module. This variant also disables the
	 *   advertising trigger for handling the FHN provisioning process.
	 */
}

static void fhn_conn_authenticated(struct bt_conn *conn)
{
	LOG_INF("FHN: connection authenticated using Beacon Actions command: %p", (void *)conn);

	/* Connection authentication flow #2 to allow read operation of the DIS Firmware Revision
	 * characteristic according to the Firmware updates section from the FHN Accessory
	 * specification:
	 * The connection is validated by the FHN module using the authentication mechanism for
	 * commands sent over the Beacon Actions characteristic and the Fast Pair service
	 * (available only for locator tags that do not create a Bluetooth bond during the Fast
	 * Pair procedure).
	 */
	fhn_conn_auth_bm_conn_status_set(conn, true);
}

static void fhn_provisioning_state_changed(bool provisioned)
{
	fhn_provisioning_state_set(provisioned);
	if (provisioned) {
		/* Fast Pair Implementation Guidelines for the locator tag use case:
		 * cancel the provisioning timeout.
		 */
		if (factory_reset_trigger == FACTORY_RESET_TRIGGER_PROVISIONING_TIMEOUT) {
			fhn_factory_reset_cancel();
		}

		fp_adv_pairing_mode_request = false;
		bt_fast_pair_adv_manager_request(&fp_adv_trigger_pairing_mode,
						 fp_adv_pairing_mode_request);
	} else {
		/* Fast Pair Implementation Guidelines for the locator tag use case:
		 * trigger the reset to factory settings on the unprovisioning operation.
		 *
		 * Delay the factory reset operation to allow the local device
		 * to send a response to the unprovisioning command and give
		 * the connected peer necessary time to finalize its operations
		 * and shutdown the connection.
		 */
		fhn_factory_reset_schedule(FACTORY_RESET_TRIGGER_KEY_STATE_MISMATCH,
					   K_SECONDS(FACTORY_RESET_DELAY));
	}
}

static struct bt_fast_pair_fhn_info_cb fhn_info_cb = {
	.clock_synced = fhn_clock_synced,
	.conn_authenticated = fhn_conn_authenticated,
	.provisioning_state_changed = fhn_provisioning_state_changed,
};

static void fhn_provisioning_state_init(void)
{
	bool provisioned;

	provisioned = bt_fast_pair_fhn_is_provisioned();
	fhn_provisioning_state_set(provisioned);

	/* Fast Pair Implementation Guidelines for the locator tag use case:
	 * trigger the reset to factory settings on the mismatch between the
	 * Owner Account Key and the FHN provisioning state.
	 */
	fp_account_key_present = bt_fast_pair_has_account_key();
	if (fp_account_key_present != provisioned) {
		fhn_factory_reset_schedule(FACTORY_RESET_TRIGGER_KEY_STATE_MISMATCH, K_NO_WAIT);
		return;
	}

	fp_adv_pairing_mode_request = !provisioned;
	bt_fast_pair_adv_manager_request(&fp_adv_trigger_pairing_mode,
					 fp_adv_pairing_mode_request);
}

static void fp_adv_state_changed(bool active)
{
	app_ui_state_change_indicate(APP_UI_STATE_FP_ADV, active);
}

static struct bt_fast_pair_adv_manager_info_cb fp_adv_info_cb = {
	.adv_state_changed = fp_adv_state_changed,
};

static int fast_pair_prepare(void)
{
	int err;

	err = bt_fast_pair_adv_manager_id_set(APP_BT_ID);
	if (err) {
		LOG_ERR("Fast Pair: bt_fast_pair_adv_manager_id_set failed (err %d)", err);
		return err;
	}

	err = bt_fast_pair_adv_manager_info_cb_register(&fp_adv_info_cb);
	if (err) {
		LOG_ERR("Fast Pair: bt_fast_pair_adv_manager_info_cb_register "
			"failed (err %d)", err);
		return err;
	}

	return 0;
}

static int fhn_prepare(void)
{
	int err;
	const struct bt_fast_pair_fhn_adv_param fhn_adv_param =
		BT_FAST_PAIR_FHN_ADV_PARAM_INIT(
			FHN_ADV_INTERVAL, FHN_ADV_INTERVAL);

	err = bt_fast_pair_fhn_id_set(APP_BT_ID);
	if (err) {
		LOG_ERR("FHN: bt_fast_pair_fhn_id_set failed (err %d)", err);
		return err;
	}

	/* Application configuration of the advertising interval is equal to
	 * the default value that is defined in the FHN module. This API
	 * call is only for demonstration purposes.
	 */
	err = bt_fast_pair_fhn_adv_param_set(&fhn_adv_param);
	if (err) {
		LOG_ERR("FHN: bt_fast_pair_fhn_adv_param_set failed (err %d)", err);
		return err;
	}

	err = bt_fast_pair_fhn_info_cb_register(&fhn_info_cb);
	if (err) {
		LOG_ERR("FHN: bt_fast_pair_fhn_info_cb_register failed (err %d)", err);
		return err;
	}

	err = bt_fast_pair_fhn_read_mode_cb_register(&fhn_read_mode_cb);
	if (err) {
		LOG_ERR("FHN: bt_fast_pair_fhn_read_mode_cb_register failed (err %d)", err);
		return err;
	}

	if (IS_ENABLED(CONFIG_BT_FAST_PAIR_FHN_DULT_MOTION_DETECTOR)) {
		err = app_motion_detector_init();
		if (err) {
			LOG_ERR("FHN: app_motion_detector_init failed (err %d)", err);
			return err;
		}
	}

	err = bt_fast_pair_info_cb_register(&fp_info_callbacks);
	if (err) {
		LOG_ERR("FHN: bt_fast_pair_info_cb_register failed (err %d)", err);
		return err;
	}

	return 0;
}

static int app_id_create(void)
{
	int ret;
	size_t count;

	BUILD_ASSERT(CONFIG_BT_ID_MAX > APP_BT_ID);

	/* Check if application identity wasn't already created. */
	bt_id_get(NULL, &count);
	if (count > APP_BT_ID) {
		return 0;
	}

	/* Create the application identity. */
	do {
		ret = bt_id_create(NULL, NULL);
		if (ret < 0) {
			return ret;
		}
	} while (ret != APP_BT_ID);

	return 0;
}

static void init_work_handle(struct k_work *w)
{
	int err;

	err = app_ui_init();
	if (err) {
		LOG_ERR("UI module init failed (err %d)", err);
		return;
	}

	err = bt_conn_auth_cb_register(&conn_auth_callbacks);
	if (err) {
		LOG_ERR("Registering authentication callbacks failed (err %d)", err);
		return;
	}

	err = bt_gatt_authorization_cb_register(&gatt_authorization_callbacks);
	if (err) {
		LOG_ERR("Registering GATT authorization callbacks failed (err %d)", err);
		return;
	}

	err = bt_enable(NULL);
	if (err) {
		LOG_ERR("Bluetooth init failed (err %d)", err);
		return;
	}
	LOG_INF("Bluetooth initialized");

	err = settings_load();
	if (err) {
		LOG_ERR("Settings load failed (err: %d)", err);
		return;
	}
	LOG_INF("Settings loaded");

	err = app_id_create();
	if (err) {
		LOG_ERR("Application identity failed to create (err %d)", err);
		return;
	}

	err = app_battery_init();
	if (err) {
		LOG_ERR("FHN: app_battery_init failed (err %d)", err);
		return;
	}

	if (!IS_ENABLED(CONFIG_BT_FAST_PAIR_FHN_RING_COMP_NONE)) {
		err = app_ring_init();
		if (err) {
			LOG_ERR("FHN: app_ring_init failed (err %d)", err);
			return;
		}
	}

	err = fast_pair_prepare();
	if (err) {
		LOG_ERR("FHN: fast_pair_prepare failed (err %d)", err);
		return;
	}

	err = fhn_prepare();
	if (err) {
		LOG_ERR("FHN: fhn_prepare failed (err %d)", err);
		return;
	}

	err = app_factory_reset_init();
	if (err) {
		LOG_ERR("FHN: app_factory_reset_init failed (err %d)", err);
		return;
	}

	err = bt_fast_pair_enable();
	if (err) {
		LOG_ERR("FHN: bt_fast_pair_enable failed (err %d)", err);
		return;
	}

	err = bt_fast_pair_adv_manager_enable();
	if (err) {
		LOG_ERR("FHN: bt_fast_pair_adv_manager_enable failed (err %d)", err);
		return;
	}

	fhn_provisioning_state_init();

	k_sem_give(&init_work_sem);
}

int main(void)
{
	int err;

	LOG_INF("Starting Bluetooth Fast Pair locator tag sample");

	if (IS_ENABLED(CONFIG_APP_DFU)) {
		app_dfu_fw_version_log();
	}

	/* Switch to the cooperative thread context before interaction
	 * with the Fast Pair and FHN API.
	 */
	(void) k_work_submit(&init_work);
	err = k_sem_take(&init_work_sem, K_SECONDS(INIT_SEM_TIMEOUT));
	if (err) {
		k_panic();
		return 0;
	}

	LOG_INF("Sample has started");

	app_ui_state_change_indicate(APP_UI_STATE_APP_RUNNING, true);

	return 0;
}

APP_UI_REQUEST_LISTENER_REGISTER(ui_request_handler, ui_request_handle);
```

## include/app_battery.h
```c
/*
 * Copyright (c) 2024-2026 Nordic Semiconductor ASA
 *
 * SPDX-License-Identifier: LicenseRef-Nordic-5-Clause
 */

#ifndef APP_BATTERY_H_
#define APP_BATTERY_H_

#include <stdint.h>

/**
 * @defgroup fhn_sample_battery Locator Tag sample battery module
 * @brief Locator Tag sample battery module
 *
 * @{
 */

#ifdef __cplusplus
extern "C" {
#endif

/** Initialize the battery module.
 *
 * @return 0 if the operation was successful. Otherwise, a (negative) error code is returned.
 */
int app_battery_init(void);

#ifdef __cplusplus
}
#endif

/**
 * @}
 */

#endif /* APP_BATTERY_H_ */
```

## include/app_dfu.h
```c
/*
 * Copyright (c) 2024-2026 Nordic Semiconductor ASA
 *
 * SPDX-License-Identifier: LicenseRef-Nordic-5-Clause
 */

#ifndef APP_DFU_H_
#define APP_DFU_H_

#include <stdint.h>
#include <stdbool.h>

#include <zephyr/bluetooth/uuid.h>

/**
 * @defgroup fhn_sample_dfu  Locator Tag sample Device Firmware Update (DFU) module
 * @brief Locator Tag sample Device Firmware Update (DFU) module
 *
 * @{
 */

#ifdef __cplusplus
extern "C" {
#endif

/** Check if the GATT operations on the DFU GATT service are allowed.
 *
 *  When the DFU Kconfig is enabled, the sample statically registers the proprietary
 *  DFU GATT service and characteristics (SMP).
 *  Access to this service is allowed only when the device is in DFU mode.
 *
 *  The DFU mode timeout will be refreshed each time the device receives an
 *  authorized DFU GATT service operation.
 *
 *  @param uuid GATT characteristic UUID
 *  @return true if allowed, otherwise false
 */
bool app_dfu_bt_gatt_operation_allow(const struct bt_uuid *uuid);

/** Log the current firmware version. */
void app_dfu_fw_version_log(void);

#ifdef __cplusplus
}
#endif

/**
 * @}
 */

#endif /* APP_DFU_H_ */
```

## include/app_factory_reset.h
```c
/*
 * Copyright (c) 2024-2026 Nordic Semiconductor ASA
 *
 * SPDX-License-Identifier: LicenseRef-Nordic-5-Clause
 */

#ifndef APP_FACTORY_RESET_H_
#define APP_FACTORY_RESET_H_

#include <zephyr/kernel.h>

/**
 * @defgroup fhn_sample_factory_reset Locator Tag sample factory reset module
 * @brief Locator Tag sample factory reset module
 *
 * @{
 */

#ifdef __cplusplus
extern "C" {
#endif

/** Factory reset callback descriptor. */
struct app_factory_reset_callbacks {
	/** Callback used to allow the user to prepare for the factory reset. */
	void (*prepare)(void);

	/** Callback used to notify the user that the factory reset has been executed. */
	void (*executed)(void);
};

/** Register a factory reset callback descriptor.
 *
 *  @param _name Factory reset callbacks descriptor name.
 *  @param _prepare Callback to define actions before the factory reset.
 *  @param _executed Callback to define actions after the factory reset.
 */
#define APP_FACTORY_RESET_CALLBACKS_REGISTER(_name, _prepare, _executed)		\
	static const STRUCT_SECTION_ITERABLE(app_factory_reset_callbacks, _name) = {	\
		.prepare = _prepare,							\
		.executed = _executed,							\
	}

/** Schedule the factory reset action.
 *
 * @param delay Time to wait before the factory reset action is performed.
 */
void app_factory_reset_schedule(k_timeout_t delay);

/** Cancel the scheduled factory reset action. */
void app_factory_reset_cancel(void);

/** Initialize the factory reset module.
 *
 * @return 0 if the operation was successful. Otherwise, a (negative) error code is returned.
 */
int app_factory_reset_init(void);

#ifdef __cplusplus
}
#endif

/**
 * @}
 */

#endif /* APP_FACTORY_RESET_H_ */
```

## include/app_fp_adv.h
```c
/*
 * Copyright (c) 2024 Nordic Semiconductor ASA
 *
 * SPDX-License-Identifier: LicenseRef-Nordic-5-Clause
 */

#ifndef APP_FP_ADV_H_
#define APP_FP_ADV_H_

#include <stdint.h>

/**
 * @defgroup fmdn_sample_fp_adv Locator Tag sample Fast Pair advertising module
 * @brief Locator Tag sample Fast Pair advertising module
 *
 * @{
 */

#ifdef __cplusplus
extern "C" {
#endif

/** Fast Pair advertising mode. */
enum app_fp_adv_mode {
	/* Turned off mode. */
	APP_FP_ADV_MODE_OFF,

	/* Discoverable mode. */
	APP_FP_ADV_MODE_DISCOVERABLE,

	/* Not Discoverable mode. */
	APP_FP_ADV_MODE_NOT_DISCOVERABLE,
};

/** Fast Pair advertising trigger. */
struct app_fp_adv_trigger {
	/* Identifier. */
	const char *id;
};

/** Register a trigger for Fast Pair advertising.
 *
 *  @param _name Trigger structure name.
 *  @param _id Trigger identifier.
 */
#define APP_FP_ADV_TRIGGER_REGISTER(_name, _id)				\
	BUILD_ASSERT(_id != NULL);					\
	static STRUCT_SECTION_ITERABLE(app_fp_adv_trigger, _name) = {	\
		.id = _id,						\
	}

/** Request turning on the Fast Pair advertising.
 *
 *  The Fast Pair advertising will be turned off only when no
 *  trigger has requested to keep the Fast Pair advertising on.
 *
 *  If the current Fast Pair advertising mode is the same as the requested mode,
 *  the Fast Pair advertising payload will not be refreshed.
 *  Use the @ref app_fp_adv_payload_refresh function to manually refresh
 *  the Fast Pair advertising payload.
 *
 *  @param trigger Trigger identifier.
 *  @param enable true to request to turn on the Fast Pair advertising.
 *		  false to remove request to turn on the Fast Pair advertising.
 */
void app_fp_adv_request(struct app_fp_adv_trigger *trigger, bool enable);

/** Refresh the Fast Pair advertising payload.
 *
 *  This function is used to manually trigger the refreshing of the Fast Pair
 *  advertising data to ensure that the advertising data is up to date.
 *
 *  Use with caution, as it updates the Fast Pair advertising payload asynchronously
 *  to the RPA address rotation and to the update of the FMDN advertising payload.
 */
void app_fp_adv_payload_refresh(void);

/** Get the current Fast Pair advertising mode.
 *
 *  @return Current Fast Pair advertising mode.
 */
enum app_fp_adv_mode app_fp_adv_mode_get(void);

/** Set the Bluetooth identity for the Fast Pair advertising.
 *
 *  This identity shall be created with the @ref bt_id_create function
 *  that is available in the Bluetooth API.
 *  You can only set the Bluetooth identity when the Fast Pair advertising
 *  module is uninitialized. If you do not explicitly set the identity with
 *  this API call, the @ref BT_ID_DEFAULT identity is used.
 *
 *  @param id Bluetooth identity for the Fast Pair advertising.
 *
 *  @return 0 if the operation was successful. Otherwise, a (negative) error code is returned.
 */
int app_fp_adv_id_set(uint8_t id);

/** Get the Bluetooth identity used for the Fast Pair advertising.
 *
 *  @return Bluetooth identity for the Fast Pair advertising.
 */
uint8_t app_fp_adv_id_get(void);

/** Fast Pair advertising information callback descriptor. */
struct app_fp_adv_info_cb {
	/** Notify that the advertising state has changed.
	 *
	 * This information callback is used to track the state of the Fast Pair advertising set.
	 * The current state can be used to signal the application mode in the user interface
	 * (for example, on LEDs).
	 *
	 *  @param enable True:  Fast Pair advertising is enabled.
	 *                False: Fast Pair advertising is disabled.
	 */
	void (*state_changed)(bool enabled);
};

/** Register Fast Pair advertising information callbacks.
 *
 *  This function registers an instance of information callbacks. The registered instance needs to
 *  persist in the memory after this function exits, as it is used directly without the copy
 *  operation. It is possible to register only one instance of callbacks with this API.
 *
 *  This function can only be called before enabling Fast Pair with the @ref app_fp_adv_enable
 *  API.
 *
 *  This function must be called in the cooperative thread context.
 *
 *  @param cb Callback struct.
 *
 *  @return Zero on success or negative error code otherwise
 */
int app_fp_adv_info_cb_register(const struct app_fp_adv_info_cb *cb);

/** Initialize the Fast Pair advertising module.
 *
 * @return 0 if the operation was successful. Otherwise, a (negative) error code is returned.
 */
int app_fp_adv_init(void);

/** Enable the Fast Pair advertising module.
 *
 *  Can be called after the Fast Pair advertising module has been initialized using the
 *  @ref app_fp_adv_init function.
 *  Must be called after enabling the Fast Pair subsystem using the @ref bt_fast_pair_enable
 *  function.
 *
 *  @return 0 if the operation was successful. Otherwise, a (negative) error code is returned.
 */
int app_fp_adv_enable(void);

/** Disable the Fast Pair advertising module.
 *
 *  Can be called after the Fast Pair advertising module has been initialized using the
 *  @ref app_fp_adv_init function.
 *  Should be called before disabling the Fast Pair subsystem using the @ref bt_fast_pair_disable
 *  function.
 *
 *  @return 0 if the operation was successful. Otherwise, a (negative) error code is returned.
 */
int app_fp_adv_disable(void);

/** Check if the Fast Pair advertising module is ready.
 *
 *  @return true when the module is ready, false otherwise.
 */
bool app_fp_adv_is_ready(void);

#ifdef __cplusplus
}
#endif

/**
 * @}
 */

#endif /* APP_FP_ADV_H_ */
```

## include/app_motion_detector.h
```c
/*
 * Copyright (c) 2024-2026 Nordic Semiconductor ASA
 *
 * SPDX-License-Identifier: LicenseRef-Nordic-5-Clause
 */

#ifndef APP_MOTION_DETECTOR_H_
#define APP_MOTION_DETECTOR_H_

/**
 * @defgroup fhn_sample_motion_detector Locator Tag sample motion detector module
 * @brief Locator Tag sample motion detector module
 *
 * @{
 */

#ifdef __cplusplus
extern "C" {
#endif

/** Initialize the motion detector module.
 *
 * @return 0 if the operation was successful. Otherwise, a (negative) error code is returned.
 */
int app_motion_detector_init(void);

#ifdef __cplusplus
}
#endif

/**
 * @}
 */

#endif /* APP_MOTION_DETECTOR_H_ */
```

## include/app_ring.h
```c
/*
 * Copyright (c) 2024-2026 Nordic Semiconductor ASA
 *
 * SPDX-License-Identifier: LicenseRef-Nordic-5-Clause
 */

#ifndef APP_RING_H_
#define APP_RING_H_

#include <stdint.h>

/**
 * @defgroup fhn_sample_ring Locator Tag sample ringing module
 * @brief Locator Tag sample ringing module
 *
 * @{
 */

#ifdef __cplusplus
extern "C" {
#endif

/** Initialize the ringing module.
 *
 * @return 0 if the operation was successful. Otherwise, a (negative) error code is returned.
 */
int app_ring_init(void);

#ifdef __cplusplus
}
#endif

/**
 * @}
 */

#endif /* APP_RING_H_ */
```

## include/app_ui.h
```c
/*
 * Copyright (c) 2024-2026 Nordic Semiconductor ASA
 *
 * SPDX-License-Identifier: LicenseRef-Nordic-5-Clause
 */

#ifndef APP_UI_H_
#define APP_UI_H_

#include <stdint.h>

/**
 * @defgroup fhn_sample_ui Locator Tag sample UI module
 * @brief Locator Tag sample UI module
 *
 * @{
 */

#ifdef __cplusplus
extern "C" {
#endif

/** @brief Application states passed to the UI module.
 *
 *  These states are independent of each other and the application can be
 *  in several of them at the same time.
 */
enum app_ui_state {
	APP_UI_STATE_APP_RUNNING,
	APP_UI_STATE_RINGING,
	APP_UI_STATE_RECOVERY_MODE,
	APP_UI_STATE_ID_MODE,
	APP_UI_STATE_PROVISIONED,
	APP_UI_STATE_FP_ADV,
	APP_UI_STATE_DFU_MODE,
	APP_UI_STATE_MOTION_DETECTOR_ACTIVE,

	APP_UI_STATE_COUNT,
};

/** Indicate the current application state to the UI module.
 *
 * The UI module reacts to the current application state by properly driving the
 * dependent peripherals, such as LEDs or speakers.
 * This function should be implemented depending on the chosen platform and peripherals.
 *
 * @param state Current application state to be handled by the UI module
 * @param active Marks if the application enters ( @ref true ) or leaves ( @ref false )
 *               the current state.
 *
 * @return 0 if the operation was successful. Otherwise, a (negative) error code is returned.
 */
int app_ui_state_change_indicate(enum app_ui_state state, bool active);

/** @brief Available UI module requests to be handled by the application. */
enum app_ui_request {
	APP_UI_REQUEST_RINGING_STOP,
	APP_UI_REQUEST_RECOVERY_MODE_ENTER,
	APP_UI_REQUEST_ID_MODE_ENTER,
	APP_UI_REQUEST_SIMULATED_BATTERY_CHANGE,
	APP_UI_REQUEST_FP_ADV_PAIRING_MODE_CHANGE,
	APP_UI_REQUEST_FACTORY_RESET,
	APP_UI_REQUEST_DFU_MODE_ENTER,
	APP_UI_REQUEST_MOTION_INDICATE,

	APP_UI_REQUEST_COUNT,
};

/** @brief Listener for the UI module requests. */
struct app_ui_request_listener {
	/** UI module request handler.
	 *
	 * @param request UI module generated request to be handled by the application.
	 */
	void (*handler)(enum app_ui_request request);
};

/** Register a listener for the UI module requests.
 *
 * @param _name UI module request listener name.
 * @param _handler UI module request handler.
 */
#define APP_UI_REQUEST_LISTENER_REGISTER(_name, _handler)				\
	BUILD_ASSERT(_handler != NULL);							\
	static const STRUCT_SECTION_ITERABLE(app_ui_request_listener, _name) = {	\
		.handler = _handler,							\
	}

/** Initialize the UI module.
 *
 * This function should be implemented depending on the chosen platform and peripherals.
 *
 * @return 0 if the operation was successful. Otherwise, a (negative) error code is returned.
 */
int app_ui_init(void);

#ifdef __cplusplus
}
#endif

/**
 * @}
 */

#endif /* APP_UI_H_ */
```
