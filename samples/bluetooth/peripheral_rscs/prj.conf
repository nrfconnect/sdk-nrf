## CMakeLists.txt
```
#
# Copyright (c) 2021 Nordic Semiconductor ASA
#
# SPDX-License-Identifier: LicenseRef-Nordic-5-Clause
#
cmake_minimum_required(VERSION 3.20)

find_package(Zephyr REQUIRED HINTS $ENV{ZEPHYR_BASE})
project(NONE)

# NORDIC SDK APP START
target_sources(app PRIVATE
  src/main.c
  src/my_periphconf.c
)
# NORDIC SDK APP END
```

## Kconfig
```
#
# Copyright (c) 2021 Nordic Semiconductor
#
# SPDX-License-Identifier: LicenseRef-Nordic-5-Clause
#

source "Kconfig.zephyr"

menu "Nordic Running Speed and Cadence Service sample"

config BT_RSCS_SECURITY_ENABLED
	bool "Enable security"
	default y
	select BT_SMP
	select BT_SETTINGS
	select FLASH
	select FLASH_PAGE_LAYOUT
	select FLASH_MAP
	select ZMS if (SOC_FLASH_NRF_RRAM || SOC_FLASH_NRF_MRAM)
	select NVS if !(SOC_FLASH_NRF_RRAM || SOC_FLASH_NRF_MRAM)
	select SETTINGS
	help
	  "Enable Bluetooth LE security for the Running Speed and Cadence Service"

endmenu
```

## Kconfig.sysbuild
```
#
# Copyright (c) 2023 Nordic Semiconductor
#
# SPDX-License-Identifier: LicenseRef-Nordic-5-Clause
#

config PARTITION_MANAGER
	default n if !BOARD_IS_NON_SECURE

config NRF_DEFAULT_IPC_RADIO
	default y

config NETCORE_IPC_RADIO_BT_HCI_IPC
	default y

source "share/sysbuild/Kconfig"
```

## sample.yaml
```
sample:
  description: Bluetooth Low Energy Running Speed and Cadence Service sample
  name: Bluetooth LE RSCS sample
tests:
  sample.bluetooth.peripheral_rscs:
    sysbuild: true
    integration_platforms:
      - nrf54l15dk/nrf54l15/cpuapp
    platform_allow:
      - nrf5340dk/nrf5340/cpuapp
      - nrf5340dk/nrf5340/cpuapp/ns
      - nrf54l15dk/nrf54l05/cpuapp
      - nrf54l15dk/nrf54l10/cpuapp
      - nrf54l15dk/nrf54l15/cpuapp
      - nrf54h20dk/nrf54h20/cpuapp
      - nrf54lm20dk/nrf54lm20a/cpuapp
      - nrf54lm20dk/nrf54lm20a/cpuapp/ns
      - nrf54lm20dk/nrf54lm20b/cpuapp
      - nrf54lm20dk/nrf54lm20b/cpuapp/ns
      - nrf54lv10dk/nrf54lv10a/cpuapp
      - nrf54lv10dk/nrf54lv10a/cpuapp/ns
      - nrf54lc10dk/nrf54lc10a/cpuapp
      - nrf54lc10dk/nrf54lc10a/cpuapp/ns
    tags:
      - bluetooth
      - ci_build
      - sysbuild
      - ci_samples_bluetooth
    harness: console
    harness_config:
      type: multi_line
      ordered: true
      regex:
        - "Starting Running Speed and Cadence peripheral sample"
        - "Bluetooth initialized"
        - "Advertising successfully started"
    timeout: 15
```

## prj.conf
```kconfig
#
# Copyright (c) 2021 Nordic Semiconductor ASA
#
# SPDX-License-Identifier: LicenseRef-Nordic-5-Clause
#

CONFIG_NCS_SAMPLES_DEFAULTS=y

CONFIG_BT=y
CONFIG_BT_PERIPHERAL=y
CONFIG_BT_DEVICE_NAME="Nordic_RSCS"
CONFIG_BT_RSCS=y

CONFIG_DK_LIBRARY=y

# To simulate sensor measurements.
# This is not used for cryptographic purposes.
CONFIG_TEST_RANDOM_GENERATOR=y
CONFIG_TIMER_RANDOM_GENERATOR=y

CONFIG_SYSTEM_WORKQUEUE_STACK_SIZE=2048
```

## boards/nrf54h20dk_nrf54h20_cpuapp.conf
```kconfig
#
# Copyright (c) 2025 Nordic Semiconductor ASA
#
# SPDX-License-Identifier: LicenseRef-Nordic-5-Clause
#

CONFIG_SOC_NRF54H20_CPURAD_ENABLE=y
CONFIG_SYSTEM_WORKQUEUE_STACK_SIZE=2048
```

## boards/nrf54lm20dk_nrf54lm20b_cpuapp_ns.conf
```kconfig
#
# Copyright (c) 2026 Nordic Semiconductor
#
# SPDX-License-Identifier: LicenseRef-Nordic-5-Clause
#

CONFIG_MPSL_FORCE_RRAM_ON_ALL_THE_TIME=n
```

## boards/nrf54h20dk_nrf54h20_cpuapp.overlay
```dts
/*
 * Copyright (c) 2024 Nordic Semiconductor ASA
 *
 * SPDX-License-Identifier: LicenseRef-Nordic-5-Clause
 */

/delete-node/ &canpll;
/delete-node/ &can120;

/ {
	chosen {
		/delete-property/ zephyr,canbus;
	};
};
```

## src/main.c
```c
/*
 * Copyright (c) 2021 Nordic Semiconductor ASA
 *
 * SPDX-License-Identifier: LicenseRef-Nordic-5-Clause
 */

#include <zephyr/types.h>
#include <stddef.h>
#include <string.h>
#include <errno.h>
#include <zephyr/sys/printk.h>
#include <zephyr/random/random.h>
#include <zephyr/kernel.h>

#include <zephyr/bluetooth/bluetooth.h>
#include <zephyr/bluetooth/conn.h>
#include <zephyr/bluetooth/uuid.h>
#include <zephyr/bluetooth/gatt.h>
#include <zephyr/bluetooth/hci.h>

#include <bluetooth/services/rscs.h>

#include <zephyr/settings/settings.h>

#include <dk_buttons_and_leds.h>

#define RUN_STATUS_LED          DK_LED1
#define CON_STATUS_LED          DK_LED2
#define RUN_LED_BLINK_INTERVAL  1000

static struct bt_rscs_measurement measurement;
static struct bt_conn *current_conn;
static struct k_work adv_work;

static const struct bt_data ad[] = {
	BT_DATA_BYTES(BT_DATA_FLAGS, (BT_LE_AD_GENERAL | BT_LE_AD_NO_BREDR)),
	BT_DATA_BYTES(BT_DATA_UUID16_ALL, BT_UUID_16_ENCODE(BT_UUID_RSCS_VAL)),
	BT_DATA(BT_DATA_NAME_COMPLETE, CONFIG_BT_DEVICE_NAME, sizeof(CONFIG_BT_DEVICE_NAME) - 1)
};

static const char *const sensor_location[] = {
	"Other",
	"Top of shoe",
	"In shoe",
	"Hip",
	"Front Wheel",
	"Left Crank",
	"Right Crank",
	"Left Pedal",
	"Right Pedal",
	"Front Hub",
	"Rear Dropout",
	"Chainstay",
	"Rear Wheel",
	"Rear Hub",
	"Chest",
	"Spider",
	"Chain Ring"
};

static void rsc_simulation(struct bt_rscs_measurement *measurement)
{
	static uint8_t i;
	uint32_t rand = sys_rand32_get();

	measurement->inst_speed = 256*1 + rand % (256*11);	/* 1-10 m/s */
	measurement->inst_cadence = 150 + rand % 31;		/* 150-180 1/min */
	measurement->is_inst_stride_len = false;
	measurement->is_total_distance = false;
	measurement->is_running = false;

	if (measurement->inst_speed > 3*256) {
		measurement->is_running = true;
	}

	if (!(i%2)) {
		measurement->is_inst_stride_len = true;
		measurement->inst_stride_length = 50 + rand % 101;	/* 50-150 cm */
	}
	if (!(i%3)) {
		measurement->is_total_distance = true;
		measurement->total_distance += 10 + rand % 50;
	}

	i++;
}

int set_cumulative(uint32_t total_distance)
{
	printk("Set total distance: %d\n", total_distance);
	measurement.total_distance = total_distance;
	return 0;
}

int calibration(void)
{
	printk("Start the calibration procedure\n");
	return 0;
}

void update_loc(uint8_t location)
{
	__ASSERT_NO_MSG(location < ARRAY_SIZE(sensor_location));

	printk("Update sensor location: %u - %s\n", location, sensor_location[location]);
}

void evt_handler(enum bt_rscs_evt evt)
{
	switch (evt) {
	case RSCS_EVT_MEAS_NOTIFY_ENABLE:
		printk("Measurement notify enable\n");
		break;
	case RSCS_EVT_MEAS_NOTIFY_DISABLE:
		printk("Measurement notify disable\n");
	default:
		break;
	}
}

static const struct bt_rscs_cp_cb control_point_cb = {
	.set_cumulative = set_cumulative,
	.calibration = calibration,
	.update_loc = update_loc,
};

static void adv_work_handler(struct k_work *work)
{
	int err = bt_le_adv_start(BT_LE_ADV_CONN_FAST_2, ad, ARRAY_SIZE(ad), NULL, 0);

	if (err) {
		printk("Advertising failed to start (err %d)\n", err);
		return;
	}

	printk("Advertising successfully started\n");
}

static void advertising_start(void)
{
	k_work_submit(&adv_work);
}

static void connected(struct bt_conn *conn, uint8_t err)
{
	if (err) {
		printk("Connection failed, err 0x%02x %s\n", err, bt_hci_err_to_str(err));
		return;
	} else {
		printk("Connected\n");
	}

	current_conn = bt_conn_ref(conn);

	dk_set_led_on(CON_STATUS_LED);
}

static void disconnected(struct bt_conn *conn, uint8_t reason)
{
	printk("Disconnected, reason 0x%02x %s\n", reason, bt_hci_err_to_str(reason));

	if (current_conn) {
		bt_conn_unref(current_conn);
		current_conn = NULL;
	}

	dk_set_led_off(CON_STATUS_LED);
}

static void recycled_cb(void)
{
	printk("Connection object available from previous conn. Disconnect is complete!\n");
	advertising_start();
}

#ifdef CONFIG_BT_RSCS_SECURITY_ENABLED
static void security_changed(struct bt_conn *conn, bt_security_t level, enum bt_security_err err)
{
	char addr[BT_ADDR_LE_STR_LEN];

	bt_addr_le_to_str(bt_conn_get_dst(conn), addr, sizeof(addr));

	if (!err) {
		printk("Security changed: %s level %u\n", addr, level);
	} else {
		printk("Security failed: %s level %u err %d %s\n", addr, level, err,
		       bt_security_err_to_str(err));
	}
}
#endif

BT_CONN_CB_DEFINE(conn_callbacks) = {
	.connected        = connected,
	.disconnected     = disconnected,
	.recycled         = recycled_cb,
#ifdef CONFIG_BT_RSCS_SECURITY_ENABLED
	.security_changed = security_changed,
#endif
};

#if defined(CONFIG_BT_RSCS_SECURITY_ENABLED)
static void auth_passkey_display(struct bt_conn *conn, unsigned int passkey)
{
	char addr[BT_ADDR_LE_STR_LEN];

	bt_addr_le_to_str(bt_conn_get_dst(conn), addr, sizeof(addr));

	printk("Passkey for %s: %06u\n", addr, passkey);
}

static void auth_cancel(struct bt_conn *conn)
{
	char addr[BT_ADDR_LE_STR_LEN];

	bt_addr_le_to_str(bt_conn_get_dst(conn), addr, sizeof(addr));

	printk("Pairing cancelled: %s\n", addr);
}

static void pairing_complete(struct bt_conn *conn, bool bonded)
{
	char addr[BT_ADDR_LE_STR_LEN];

	bt_addr_le_to_str(bt_conn_get_dst(conn), addr, sizeof(addr));

	printk("Pairing completed: %s, bonded: %d\n", addr, bonded);
}

static void pairing_failed(struct bt_conn *conn, enum bt_security_err reason)
{
	char addr[BT_ADDR_LE_STR_LEN];

	bt_addr_le_to_str(bt_conn_get_dst(conn), addr, sizeof(addr));

	printk("Pairing failed conn: %s, reason %d %s\n", addr, reason,
	       bt_security_err_to_str(reason));
}

static struct bt_conn_auth_cb conn_auth_callbacks = {
	.passkey_display = auth_passkey_display,
	.cancel = auth_cancel,
};

static struct bt_conn_auth_info_cb conn_auth_info_callbacks = {
	.pairing_complete = pairing_complete,
	.pairing_failed = pairing_failed
};
#else
static struct bt_conn_auth_cb conn_auth_callbacks;
static struct bt_conn_auth_info_cb conn_auth_info_callbacks;
#endif

int main(void)
{
	int err;
	uint32_t blink_status = 0;

	printk("Starting Running Speed and Cadence peripheral sample\n");

	err = dk_leds_init();
	if (err) {
		printk("LEDs init failed (err %d)\n", err);
		return 0;
	}

	if (IS_ENABLED(CONFIG_BT_RSCS_SECURITY_ENABLED)) {
		err = bt_conn_auth_cb_register(&conn_auth_callbacks);
		if (err) {
			printk("Failed to register authorization callbacks.\n");
			return 0;
		}

		err = bt_conn_auth_info_cb_register(&conn_auth_info_callbacks);
		if (err) {
			printk("Failed to register authorization info callbacks.\n");
			return 0;
		}
	}

	err = bt_enable(NULL);
	if (err) {
		printk("Bluetooth init failed (err %d)\n", err);
		return 0;
	}

	printk("Bluetooth initialized\n");

	if (IS_ENABLED(CONFIG_SETTINGS)) {
		settings_load();
	}

	struct bt_rscs_init_params rscs_init = {0};

	rscs_init.features.inst_stride_len = 1;
	rscs_init.features.multi_sensor_loc = 1;
	rscs_init.features.sensor_calib_proc = 1;
	rscs_init.features.total_distance = 1;
	rscs_init.features.walking_or_running = 1;

	rscs_init.supported_locations.other = 1;
	rscs_init.supported_locations.top_of_shoe = 1;
	rscs_init.supported_locations.in_shoe = 1;
	rscs_init.supported_locations.hip = 1;

	rscs_init.location = RSC_LOC_HIP;

	rscs_init.cp_cb = &control_point_cb;
	rscs_init.evt_handler = evt_handler;

	err = bt_rscs_init(&rscs_init);
	if (err) {
		printk("Failed to init RSCS (err %d)\n", err);
		return 0;
	}

	k_work_init(&adv_work, adv_work_handler);
	advertising_start();

	for (;;) {
		dk_set_led(RUN_STATUS_LED, (++blink_status) % 2);
		k_sleep(K_MSEC(RUN_LED_BLINK_INTERVAL));

		rsc_simulation(&measurement);
		bt_rscs_measurement_send(current_conn, &measurement);
	}
}
```

## src/my_periphconf.c
```c
#include <uicr/uicr.h>

/* gpio6 pin 0: CTRLSEL = 4*/
UICR_GPIO_PIN_CNF_CTRLSEL_SET(0x5f938c00UL, 0, 4);
/* gpio6 pin 2: CTRLSEL = 4*/
UICR_GPIO_PIN_CNF_CTRLSEL_SET(0x5f938c00UL, 2, 4);
/* gpio6 pin 3: CTRLSEL = 4*/
UICR_GPIO_PIN_CNF_CTRLSEL_SET(0x5f938c00UL, 3, 4);
/* gpio6 pin 4: CTRLSEL = 4*/
UICR_GPIO_PIN_CNF_CTRLSEL_SET(0x5f938c00UL, 4, 4);
/* gpio6 pin 5: CTRLSEL = 4*/
UICR_GPIO_PIN_CNF_CTRLSEL_SET(0x5f938c00UL, 5, 4);
/* gpio6 pin 6: CTRLSEL = 4*/
UICR_GPIO_PIN_CNF_CTRLSEL_SET(0x5f938c00UL, 6, 4);
/* gpio6 pin 7: CTRLSEL = 4*/
UICR_GPIO_PIN_CNF_CTRLSEL_SET(0x5f938c00UL, 7, 4);
/* gpio6 pin 8: CTRLSEL = 4*/
UICR_GPIO_PIN_CNF_CTRLSEL_SET(0x5f938c00UL, 8, 4);
/* gpio6 pin 9: CTRLSEL = 4*/
UICR_GPIO_PIN_CNF_CTRLSEL_SET(0x5f938c00UL, 9, 4);
/* gpio6 pin 10: CTRLSEL = 4*/
UICR_GPIO_PIN_CNF_CTRLSEL_SET(0x5f938c00UL, 10, 4);
/* gpio6 pin 11: CTRLSEL = 4*/
UICR_GPIO_PIN_CNF_CTRLSEL_SET(0x5f938c00UL, 11, 4);
/* gpio9 pin 0: CTRLSEL = 0*/
UICR_GPIO_PIN_CNF_CTRLSEL_SET(0x5f939200UL, 0, 0);
/* gpio9 pin 1: CTRLSEL = 0*/
UICR_GPIO_PIN_CNF_CTRLSEL_SET(0x5f939200UL, 1, 0);
/* gpio9 pin 2: CTRLSEL = 2*/
UICR_GPIO_PIN_CNF_CTRLSEL_SET(0x5f939200UL, 2, 2);
/* gpio9 pin 3: CTRLSEL = 0*/
UICR_GPIO_PIN_CNF_CTRLSEL_SET(0x5f939200UL, 3, 0);
/* gpio2 pin 4: CTRLSEL = 0*/
UICR_GPIO_PIN_CNF_CTRLSEL_SET(0x5f938400UL, 4, 0);
/* gpio2 pin 5: CTRLSEL = 0*/
UICR_GPIO_PIN_CNF_CTRLSEL_SET(0x5f938400UL, 5, 0);
/* gpio2 pin 6: CTRLSEL = 0*/
UICR_GPIO_PIN_CNF_CTRLSEL_SET(0x5f938400UL, 6, 0);
/* gpio2 pin 7: CTRLSEL = 0*/
UICR_GPIO_PIN_CNF_CTRLSEL_SET(0x5f938400UL, 7, 0);
/* gpio0 pin 8: CTRLSEL = 0*/
UICR_GPIO_PIN_CNF_CTRLSEL_SET(0x5f938000UL, 8, 0);
/* gpio0 pin 9: CTRLSEL = 0*/
UICR_GPIO_PIN_CNF_CTRLSEL_SET(0x5f938000UL, 9, 0);
/* gpio0 pin 10: CTRLSEL = 0*/
UICR_GPIO_PIN_CNF_CTRLSEL_SET(0x5f938000UL, 10, 0);
/* gpio0 pin 11: CTRLSEL = 0*/
UICR_GPIO_PIN_CNF_CTRLSEL_SET(0x5f938000UL, 11, 0);
/* gpio1 pin 7: CTRLSEL = 0*/
UICR_GPIO_PIN_CNF_CTRLSEL_SET(0x5f938200UL, 7, 0);
/* gpio1 pin 9: CTRLSEL = 0*/
UICR_GPIO_PIN_CNF_CTRLSEL_SET(0x5f938200UL, 9, 0);
/* gpio1 pin 10: CTRLSEL = 0*/
UICR_GPIO_PIN_CNF_CTRLSEL_SET(0x5f938200UL, 10, 0);
/* gpio1 pin 11: CTRLSEL = 0*/
UICR_GPIO_PIN_CNF_CTRLSEL_SET(0x5f938200UL, 11, 0);
/* usbhs IRQ => APPLICATION */
UICR_IRQMAP_IRQ_SINK_SET(NRFX_IRQ_NUMBER_GET(0x5f086000UL), NRF_PROCESSOR_APPLICATION);
/* exmif IRQ => APPLICATION */
UICR_IRQMAP_IRQ_SINK_SET(NRFX_IRQ_NUMBER_GET(0x5f095000UL), NRF_PROCESSOR_APPLICATION);
/* adc IRQ => APPLICATION */
UICR_IRQMAP_IRQ_SINK_SET(NRFX_IRQ_NUMBER_GET(0x5f982000UL), NRF_PROCESSOR_APPLICATION);
/* nfct IRQ => APPLICATION */
UICR_IRQMAP_IRQ_SINK_SET(NRFX_IRQ_NUMBER_GET(0x5f985000UL), NRF_PROCESSOR_APPLICATION);
/* pwm130 IRQ => APPLICATION */
UICR_IRQMAP_IRQ_SINK_SET(NRFX_IRQ_NUMBER_GET(0x5f9a4000UL), NRF_PROCESSOR_APPLICATION);
/* uart136 IRQ => APPLICATION */
UICR_IRQMAP_IRQ_SINK_SET(NRFX_IRQ_NUMBER_GET(0x5f9d5000UL), NRF_PROCESSOR_APPLICATION);
/* uart135 IRQ => RADIOCORE */
UICR_IRQMAP_IRQ_SINK_SET(NRFX_IRQ_NUMBER_GET(0x5f9c6000UL), NRF_PROCESSOR_RADIOCORE);
/* RADIOCORE IPCT ch. 2 => GLOBALSLOW IPCT ch. 2 */
UICR_IPCMAP_CHANNEL_CFG(0, NRF_DOMAIN_RADIOCORE, 2, NRF_DOMAIN_GLOBALSLOW, 2);
/* GLOBALSLOW IPCT ch. 0 => RADIOCORE IPCT ch. 0 */
UICR_IPCMAP_CHANNEL_CFG(1, NRF_DOMAIN_GLOBALSLOW, 0, NRF_DOMAIN_RADIOCORE, 0);
/* GLOBALSLOW IPCT ch. 2 => RADIOCORE IPCT ch. 2 */
UICR_IPCMAP_CHANNEL_CFG(2, NRF_DOMAIN_GLOBALSLOW, 2, NRF_DOMAIN_RADIOCORE, 2);
/* PPIB133 ch. 0 => PPIB130 ch. 8 */
UICR_PPIB_SUBSCRIBE_SEND_ENABLE(0x5f99d000UL, 0);
UICR_PPIB_PUBLISH_RECEIVE_ENABLE(0x5f925000UL, 8);
/* PPIB133 ch. 2 => PPIB130 ch. 10 */
UICR_PPIB_SUBSCRIBE_SEND_ENABLE(0x5f99d000UL, 2);
UICR_PPIB_PUBLISH_RECEIVE_ENABLE(0x5f925000UL, 10);
/* PPIB130 ch. 11 => PPIB133 ch. 3 */
UICR_PPIB_SUBSCRIBE_SEND_ENABLE(0x5f925000UL, 11);
UICR_PPIB_PUBLISH_RECEIVE_ENABLE(0x5f99d000UL, 3);
```
