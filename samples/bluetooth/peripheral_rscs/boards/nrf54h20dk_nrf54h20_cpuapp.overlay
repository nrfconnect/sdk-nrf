/*
 * Copyright (c) 2024 Nordic Semiconductor ASA
 *
 * SPDX-License-Identifier: LicenseRef-Nordic-5-Clause
 */

/delete-node/ &canpll;
/delete-node/ &can120;

/ {
	chosen {
		/delete-property/ zephyr,canbus;
	};
};
