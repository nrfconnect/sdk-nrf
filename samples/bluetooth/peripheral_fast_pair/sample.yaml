## samples/bluetooth/peripheral_fast_pair/sample.yaml
```yaml
sample:
  name: Fast Pair Provider
  description: Bluetooth Fast Pair Provider sample
tests:
  sample.bluetooth.fast_pair:
    build_only: true
    integration_platforms:
      - nrf52dk_nrf52832
      - nrf52840dk_nrf52840
      - nrf5340dk_nrf5340_cpuapp
      - nrf5340dk_nrf5340_cpuapp_ns
    tags: bluetooth ci_build
    platform_allow: nrf52dk_nrf52832 nrf52840dk_nrf52840 nrf5340dk_nrf5340_cpuapp
      nrf5340dk_nrf5340_cpuapp_ns
```

## samples/bluetooth/peripheral_gatt_dm/sample.yaml
```yaml
sample:
  description: Bluetooth Low Energy Gatt client discovery manager sample
  name: Bluetooth LE Gatt Discovery
tests:
  sample.bluetooth.peripheral_gatt_dm:
    sysbuild: true
    integration_platforms:
      - nrf52dk/nrf52832
      - nrf52840dk/nrf52840
      - nrf5340dk/nrf5340/cpuapp
      - nrf5340dk/nrf5340/cpuapp/ns
      - nrf54l15dk/nrf54l05/cpuapp
      - nrf54l15dk/nrf54l10/cpuapp
      - nrf54l15dk/nrf54l15/cpuapp
      - nrf54lv10dk/nrf54lv10a/cpuapp
      - nrf54h20dk/nrf54h20/cpuapp
      - nrf54lm20dk/nrf54lm20a/cpuapp
      - nrf54lm20dk/nrf54lm20a/cpuapp/ns
    platform_allow:
      - nrf52dk/nrf52832
      - nrf52840dk/nrf52840
      - nrf5340dk/nrf5340/cpuapp
      - nrf5340dk/nrf5340/cpuapp/ns
      - nrf54l15dk/nrf54l05/cpuapp
      - nrf54l15dk/nrf54l10/cpuapp
      - nrf54l15dk/nrf54l15/cpuapp
      - nrf54lv10dk/nrf54lv10a/cpuapp
      - nrf54lv10dk/nrf54lv10a/cpuapp/ns
      - nrf54h20dk/nrf54h20/cpuapp
      - nrf54lm20dk/nrf54lm20a/cpuapp
      - nrf54lm20dk/nrf54lm20a/cpuapp/ns
    tags:
      - bluetooth
      - ci_build
      - sysbuild
    harness: console
    harness_config:
      type: multi_line
      ordered: true
      regex:
        - "Starting GATT Discovery Manager sample"
        - "Advertising successfully started"
    timeout: 15
```

## samples/bluetooth/peripheral_hids_keyboard/Kconfig
```kconfig
#
# Copyright (c) 2018 Nordic Semiconductor
#
# SPDX-License-Identifier: LicenseRef-Nordic-5-Clause
#

source "Kconfig.zephyr"

menu "Nordic BLE HIDS Keyboard sample"

config NFC_OOB_PAIRING
	bool "Enable NFC OOB pairing"
	depends on HAS_HW_NRF_NFCT
	default y
	select NFC_T2T_NRFXLIB
	select NFC_NDEF
	select NFC_NDEF_MSG
	select NFC_NDEF_RECORD
	select NFC_NDEF_LE_OOB_REC

config SETTINGS
	default y

config ZMS
	default y if (SOC_FLASH_NRF_RRAM || SOC_FLASH_NRF_MRAM)

config NVS
	default y if !(SOC_FLASH_NRF_RRAM || SOC_FLASH_NRF_MRAM)

endmenu
```

## samples/bluetooth/peripheral_hids_keyboard/boards/nrf5340dk_nrf5340_cpuapp_hid_sci.conf
```kconfig
#
# Copyright (c) 2026 Nordic Semiconductor ASA
#
# SPDX-License-Identifier: LicenseRef-Nordic-5-Clause
#

# The radio notification connection callbacks are not available
# from the nRF5340 application core.
CONFIG_BT_RADIO_NOTIFICATION_CONN_CB=n

# 1000 us minimum connection interval - local controller minimum for nRF5340
CONFIG_BT_HIDS_SCI_FAST_INTERVAL_MIN_125US=8
CONFIG_BT_HIDS_SCI_FULL_RANGE_INTERVAL_MIN_125US=8
```

## samples/bluetooth/peripheral_hids_keyboard/boards/nrf54l15pdk_nrf54l15_cpuapp.conf
```kconfig
#
# Copyright (c) 2024 Nordic Semiconductor
#
# SPDX-License-Identifier: LicenseRef-Nordic-5-Clause
#

# Workaround:
# The nRF54L15 PDK (PCA10156) revisions v0.2.0 AA0-ES2, v0.2.0 AA0-ES3,
# and v0.2.1 AB0-ES5 have Buttons 3 and 4 connected to the GPIO port
# which does not support interrupts.
CONFIG_DK_LIBRARY_BUTTON_NO_ISR=y
```

## samples/bluetooth/peripheral_hids_keyboard/boards/nrf54lv10dk_nrf54lv10a_cpuapp_ns.conf
```kconfig
#
# Copyright (c) 2025 Nordic Semiconductor ASA
#
# SPDX-License-Identifier: LicenseRef-Nordic-5-Clause
#

CONFIG_MAIN_STACK_SIZE=3584
```

## samples/bluetooth/peripheral_hids_keyboard/sample.yaml
```yaml
sample:
  description: Bluetooth Low Energy Human Interface Device keyboard sample
  name: Bluetooth LE HIDS keyboard
common:
  sysbuild: true
  harness_config:
    type: multi_line
    ordered: true
    regex:
      - "Starting Bluetooth Peripheral HIDS keyboard sample"
      - "Bluetooth initialized"
  timeout: 15
  tags:
    - bluetooth
    - ci_build
    - sysbuild
    - ci_samples_bluetooth
tests:
  sample.bluetooth.peripheral_hids_keyboard:
    harness: console
    integration_platforms:
      - nrf52dk/nrf52832
      - nrf5340dk/nrf5340/cpuapp/ns
      - nrf54h20dk/nrf54h20/cpuapp
      - nrf54l15dk/nrf54l05/cpuapp
      - nrf54lm20dk/nrf54lm20a/cpuapp
      - nrf54lm20dk/nrf54lm20b/cpuapp
      - nrf54lv10dk/nrf54lv10a/cpuapp
      - nrf54lc10dk/nrf54lc10a/cpuapp
    platform_allow:
      - nrf52dk/nrf52832
      - nrf52840dk/nrf52840
      - nrf5340dk/nrf5340/cpuapp
      - nrf5340dk/nrf5340/cpuapp/ns
      - nrf54l15dk/nrf54l05/cpuapp
      - nrf54l15dk/nrf54l10/cpuapp
      - nrf54l15dk/nrf54l15/cpuapp
      - nrf54lm20dk/nrf54lm20a/cpuapp
      - nrf54lm20dk/nrf54lm20b/cpuapp
      - nrf54ls05dk/nrf54ls05b/cpuapp
      - nrf54lv10dk/nrf54lv10a/cpuapp
      - nrf54lv10dk/nrf54lv10a/cpuapp/ns
      - nrf54lc10dk/nrf54lc10a/cpuapp
      - nrf54lc10dk/nrf54lc10a/cpuapp/ns
      - nrf54h20dk/nrf54h20/cpuapp
  sample.bluetooth.peripheral_hids_keyboard.hid_sci:
    harness: console
    extra_args: FILE_SUFFIX=hid_sci
    integration_platforms:
      - nrf54l15dk/nrf54l05/cpuapp
      - nrf54lm20dk/nrf54lm20a/cpuapp
      - nrf54lm20dk/nrf54lm20b/cpuapp
      - nrf54lv10dk/nrf54lv10a/cpuapp
      - nrf54lc10dk/nrf54lc10a/cpuapp
    platform_allow:
      - nrf54l15dk/nrf54l05/cpuapp
      - nrf54lm20dk/nrf54lm20a/cpuapp
      - nrf54lm20dk/nrf54lm20b/cpuapp
      - nrf54lv10dk/nrf54lv10a/cpuapp
      - nrf54lc10dk/nrf54lc10a/cpuapp
      - nrf54lc10dk/nrf54lc10a/cpuapp
```

## samples/bluetooth/peripheral_hids_mouse/Kconfig
```kconfig
#
# Copyright (c) 2018 Nordic Semiconductor
#
# SPDX-License-Identifier: LicenseRef-Nordic-5-Clause
#

menu "Nordic HIDS BLE GATT mouse service sample"

config SAMPLE_BT_HIDS_SECURITY
	bool "Bluetooth LE security"
	default y
	imply BT_PRIVACY
	select BT_SMP
	select BT_SETTINGS
	select FLASH
	select FLASH_PAGE_LAYOUT
	select FLASH_MAP
	select SETTINGS
	imply ZMS if (SOC_FLASH_NRF_RRAM || SOC_FLASH_NRF_MRAM)
	imply NVS if !(SOC_FLASH_NRF_RRAM || SOC_FLASH_NRF_MRAM)
	help
	  Enable Bluetooth LE security support.

config SAMPLE_BT_HIDS_SECURITY_MITM
	bool "Passkey display MITM protection"
	depends on SAMPLE_BT_HIDS_SECURITY
	depends on PRINTK
	default y
	help
	  Enable displaying passkey for Man-In-The-Middle (MITM) protection.
	  Implementation uses the "printk" function to display the passkey.

config SAMPLE_BT_DIRECTED_ADVERTISING
	bool "Directed advertising"
	default y
	depends on SAMPLE_BT_HIDS_SECURITY

config SAMPLE_BT_HIDS_CONTINUOUS_REPORT_SENDING
	bool "Continuous report sending"
	depends on BT_ATT_SENT_CB_AFTER_TX
	help
	  Enable the continuous report sending feature in the peripheral HIDS sample.
	  Hold down a button for more than 2 seconds to enable continuous report sending.

config SAMPLE_BT_HIDS_CONTINUOUS_REPORT_SENDING_PREPARE_DISTANCE_US
	int "Prepare distance for continuous report sending"
	depends on SAMPLE_BT_HIDS_CONTINUOUS_REPORT_SENDING
	depends on BT_RADIO_NOTIFICATION_CONN_CB
	default 400
	help
	  The time before the next Bluetooth LE connection event when the report should be prepared.
	  Only supported if the platform supports radio notification connection callbacks.
	  The default value 400 us was arbitrarily chosen, so that the preparation fits
	  in short intervals below 500 us.

endmenu

source "Kconfig.zephyr"
```

## samples/bluetooth/peripheral_hids_mouse/boards/nrf5340dk_nrf5340_cpuapp.conf
```kconfig
#
# Copyright (c) 2026 Nordic Semiconductor ASA
#
# SPDX-License-Identifier: LicenseRef-Nordic-5-Clause
#

# The radio notification connection callbacks are not available
# from the nRF5340 application core.
CONFIG_BT_RADIO_NOTIFICATION_CONN_CB=n
```

## samples/bluetooth/peripheral_hids_mouse/boards/nrf5340dk_nrf5340_cpuapp_ns.conf
```kconfig
#
# Copyright (c) 2025 Nordic Semiconductor ASA
#
# SPDX-License-Identifier: LicenseRef-Nordic-5-Clause
#

# TF-M profile has to be properly configured to be able to run
# the Bluetooth stack which uses PSA crypto API as minimal TF-M
# profile cannot be used.
CONFIG_TFM_PROFILE_TYPE_SMALL=y
```

## samples/bluetooth/peripheral_hids_mouse/boards/nrf5340dk_nrf5340_cpuapp_ns_hid_sci.conf
```kconfig
#
# Copyright (c) 2026 Nordic Semiconductor ASA
#
# SPDX-License-Identifier: LicenseRef-Nordic-5-Clause
#

# TF-M profile has to be properly configured to be able to run
# the Bluetooth stack which uses PSA crypto API as minimal TF-M
# profile cannot be used.
CONFIG_TFM_PROFILE_TYPE_SMALL=y

# The radio notification connection callbacks are not available
# from the nRF5340 application core.
CONFIG_BT_RADIO_NOTIFICATION_CONN_CB=n

# 1000 us minimum connection interval - local controller minimum for nRF5340
CONFIG_BT_HIDS_SCI_FAST_INTERVAL_MIN_125US=8
CONFIG_BT_HIDS_SCI_FULL_RANGE_INTERVAL_MIN_125US=8
```

## samples/bluetooth/peripheral_hids_mouse/sample.yaml
```yaml
sample:
  description: Bluetooth Low Energy Human Interface Device mouse sample
  name: Bluetooth LE HIDS mouse
common:
  sysbuild: true
  harness_config:
    type: multi_line
    ordered: true
    regex:
      - "Starting Bluetooth Peripheral HIDS mouse sample"
      - "Bluetooth initialized"
      - "Regular advertising started"
  timeout: 15
  tags:
    - bluetooth
    - ci_build
    - sysbuild
    - ci_samples_bluetooth
tests:
  sample.bluetooth.peripheral_hids_mouse:
    harness: console
    integration_platforms:
      - nrf52dk/nrf52832
      - nrf5340dk/nrf5340/cpuapp/ns
      - nrf54h20dk/nrf54h20/cpuapp
      - nrf54l15dk/nrf54l05/cpuapp
      - nrf54lm20dk/nrf54lm20a/cpuapp
      - nrf54lm20dk/nrf54lm20b/cpuapp
      - nrf54ls05dk/nrf54ls05b/cpuapp
      - nrf54lv10dk/nrf54lv10a/cpuapp
    platform_allow:
      - nrf52dk/nrf52832
      - nrf52840dk/nrf52840
      - nrf5340dk/nrf5340/cpuapp
      - nrf5340dk/nrf5340/cpuapp/ns
      - nrf54l15dk/nrf54l05/cpuapp
      - nrf54l15dk/nrf54l10/cpuapp
      - nrf54l15dk/nrf54l15/cpuapp
      - nrf54lm20dk/nrf54lm20a/cpuapp
      - nrf54lm20dk/nrf54lm20b/cpuapp
      - nrf54ls05dk/nrf54ls05b/cpuapp
      - nrf54lv10dk/nrf54lv10a/cpuapp
      - nrf54lv10dk/nrf54lv10a/cpuapp/ns
      - nrf54h20dk/nrf54h20/cpuapp
  sample.bluetooth.peripheral_hids_mouse.no_mitm:
    harness: console
    extra_configs:
      - CONFIG_SAMPLE_BT_HIDS_SECURITY_MITM=n
    integration_platforms:
      - nrf52dk/nrf52832
      - nrf54h20dk/nrf54h20/cpuapp
      - nrf54ls05dk/nrf54ls05b/cpuapp
    platform_allow:
      - nrf52dk/nrf52832
      - nrf52840dk/nrf52840
      - nrf5340dk/nrf5340/cpuapp
      - nrf5340dk/nrf5340/cpuapp/ns
      - nrf54l15dk/nrf54l05/cpuapp
      - nrf54l15dk/nrf54l10/cpuapp
      - nrf54l15dk/nrf54l15/cpuapp
      - nrf54lm20dk/nrf54lm20a/cpuapp
      - nrf54lm20dk/nrf54lm20b/cpuapp
      - nrf54ls05dk/nrf54ls05b/cpuapp
      - nrf54lv10dk/nrf54lv10a/cpuapp
      - nrf54lv10dk/nrf54lv10a/cpuapp/ns
      - nrf54h20dk/nrf54h20/cpuapp
  sample.bluetooth.peripheral_hids_mouse.release:
    build_only: true
    extra_args: FILE_SUFFIX=release
    integration_platforms:
      - nrf52dk/nrf52832
      - nrf5340dk/nrf5340/cpuapp/ns
      - nrf54h20dk/nrf54h20/cpuapp
      - nrf54ls05dk/nrf54ls05b/cpuapp
    platform_allow:
      - nrf52dk/nrf52832
      - nrf52840dk/nrf52840
      - nrf5340dk/nrf5340/cpuapp
      - nrf5340dk/nrf5340/cpuapp/ns
      - nrf54l15dk/nrf54l05/cpuapp
      - nrf54l15dk/nrf54l10/cpuapp
      - nrf54l15dk/nrf54l15/cpuapp
      - nrf54lm20dk/nrf54lm20a/cpuapp
      - nrf54lm20dk/nrf54lm20b/cpuapp
      - nrf54ls05dk/nrf54ls05b/cpuapp
      - nrf54lv10dk/nrf54lv10a/cpuapp
      - nrf54lv10dk/nrf54lv10a/cpuapp/ns
      - nrf54h20dk/nrf54h20/cpuapp
  sample.bluetooth.peripheral_hids_mouse.ble_rpc:
    harness: console
    extra_args:
      - SNIPPET=nordic-bt-rpc
      - FILE_SUFFIX=bt_rpc
    integration_platforms:
      - nrf54h20dk/nrf54h20/cpuapp
    platform_allow:
      - nrf5340dk/nrf5340/cpuapp
      - nrf54h20dk/nrf54h20/cpuapp
  sample.bluetooth.peripheral_hids_mouse.no_sec:
    harness: console
    extra_configs:
      - CONFIG_SAMPLE_BT_HIDS_SECURITY=n
      - CONFIG_BT_HIDS_DEFAULT_PERM_RW=y
    integration_platforms:
      - nrf5340dk/nrf5340/cpuapp
    platform_allow:
      - nrf52dk/nrf52832
      - nrf52840dk/nrf52840
      - nrf5340dk/nrf5340/cpuapp
```

## samples/bluetooth/peripheral_hr_coded/boards/nrf5340dk_nrf5340_cpuapp.conf
```kconfig
#
# Copyright (c) 2022 Nordic Semiconductor
#
# SPDX-License-Identifier: LicenseRef-Nordic-5-Clause
#

# Application core does not have BLE controller. Disable controller related options.
CONFIG_BT_CTLR_PHY_CODED=n
CONFIG_BT_CTLR_ADV_EXT=n
```

## samples/bluetooth/peripheral_hr_coded/boards/nrf54h20dk_nrf54h20_cpuapp.conf
```kconfig
#
# Copyright (c) 2024 Nordic Semiconductor
#
# SPDX-License-Identifier: LicenseRef-Nordic-5-Clause
#

# Application core does not have BLE controller. Disable controller related options.
CONFIG_BT_CTLR_PHY_CODED=n
CONFIG_BT_CTLR_ADV_EXT=n

CONFIG_SOC_NRF54H20_CPURAD_ENABLE=y
```

## samples/bluetooth/peripheral_hr_coded/sample.yaml
```yaml
sample:
  description: Bluetooth Low Energy peripheral heart rate service connecting on LE
    Coded PHY
  name: Bluetooth LE peripheral HR Coded
tests:
  sample.bluetooth.peripheral_hr_coded:
    sysbuild: true
    integration_platforms:
      - nrf52840dk/nrf52840
      - nrf5340dk/nrf5340/cpuapp
      - nrf54l15dk/nrf54l05/cpuapp
      - nrf54l15dk/nrf54l10/cpuapp
      - nrf54l15dk/nrf54l15/cpuapp
      - nrf54h20dk/nrf54h20/cpuapp
      - nrf54lm20dk/nrf54lm20a/cpuapp
      - nrf54lm20dk/nrf54lm20a/cpuapp/ns
      - nrf54lv10dk/nrf54lv10a/cpuapp
    platform_allow:
      - nrf52840dk/nrf52840
      - nrf5340dk/nrf5340/cpuapp
      - nrf54l15dk/nrf54l05/cpuapp
      - nrf54l15dk/nrf54l10/cpuapp
      - nrf54l15dk/nrf54l15/cpuapp
      - nrf54h20dk/nrf54h20/cpuapp
      - nrf54lm20dk/nrf54lm20a/cpuapp
      - nrf54lm20dk/nrf54lm20a/cpuapp/ns
      - nrf54lv10dk/nrf54lv10a/cpuapp
      - nrf54lv10dk/nrf54lv10a/cpuapp/ns
    tags:
      - bluetooth
      - ci_build
      - sysbuild
    harness: console
    harness_config:
      type: multi_line
      ordered: true
      regex:
        - "Starting Bluetooth Peripheral HR coded sample"
        - "Bluetooth initialized"
    timeout: 15
```

## samples/bluetooth/peripheral_lbs/Kconfig
```kconfig
#
# Copyright (c) 2018 Nordic Semiconductor
#
# SPDX-License-Identifier: LicenseRef-Nordic-5-Clause
#

source "Kconfig.zephyr"

menu "Nordic LED-Button BLE GATT service sample"

config BT_LBS_SECURITY_ENABLED
	bool "Enable security"
	default y
	select BT_SMP
	select BT_SETTINGS
	select FLASH
	select FLASH_PAGE_LAYOUT
	select FLASH_MAP
	select ZMS if (SOC_FLASH_NRF_RRAM || SOC_FLASH_NRF_MRAM)
	select NVS if !(SOC_FLASH_NRF_RRAM || SOC_FLASH_NRF_MRAM)
	select SETTINGS
	help
	  "Enable BLE security for the LED-Button service"

endmenu
```

## samples/bluetooth/peripheral_lbs/Kconfig.sysbuild
```kconfig
#
# Copyright (c) 2023 Nordic Semiconductor
#
# SPDX-License-Identifier: LicenseRef-Nordic-5-Clause
#

config PARTITION_MANAGER
	default y if BOARD_THINGY53

config NRF_RADIO_LOADER
	default y if SOC_NRF54H20

config NRF_DEFAULT_IPC_RADIO
	default y

config NETCORE_IPC_RADIO_BT_HCI_IPC
	default y

source "share/sysbuild/Kconfig"
```

## samples/bluetooth/peripheral_lbs/boards/nrf54lm20pdk_nrf54lm20a_cpuapp.conf
```kconfig
#
# Copyright (c) 2025 Nordic Semiconductor ASA
#
# SPDX-License-Identifier: LicenseRef-Nordic-5-Clause
#

# Workaround for issue NCSDK-33313

# Disable Cracken for all but RNG, and switch to software crypto.


CONFIG_PSA_CRYPTO_DRIVER_CRACEN=y



# END of Workaround for issue NCSDK-33313
```
