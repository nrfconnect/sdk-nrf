## samples/bluetooth/peripheral_lbs/boards/thingy53_nrf5340_cpuapp.conf
```kconfig
#
# Copyright (c) 2021 Nordic Semiconductor ASA
#
# SPDX-License-Identifier: LicenseRef-Nordic-5-Clause
#
################################################################################
# Application overlay - Thingy:53 DFU

CONFIG_NCS_SAMPLE_MCUMGR_BT_OTA_DFU=y
CONFIG_MCUBOOT_IMAGE_VERSION="2.3.0+0"

CONFIG_SYSTEM_WORKQUEUE_STACK_SIZE=4096

# Use deferred logging
CONFIG_NCS_SAMPLES_DEFAULTS=n
CONFIG_LOG=y
CONFIG_ASSERT=y
CONFIG_ASSERT_NO_COND_INFO=y
CONFIG_ASSERT_NO_MSG_INFO=y
CONFIG_HW_STACK_PROTECTION=y
```

## samples/bluetooth/peripheral_lbs/sample.yaml
```yaml
sample:
  description: Bluetooth Low Energy LED Button service sample
  name: Bluetooth LE LED Button service

common:
  sysbuild: true
  build_only: true
  tags:
    - bluetooth
    - ci_build
    - sysbuild
    - ci_samples_bluetooth

tests:
  sample.bluetooth.peripheral_lbs:
    build_only: false
    platform_allow: &peripheral_lbs_platforms
      - nrf52dk/nrf52832
      - nrf52840dk/nrf52840
      - nrf5340dk/nrf5340/cpuapp
      - nrf5340dk/nrf5340/cpuapp/ns
      - thingy53/nrf5340/cpuapp
      - nrf54h20dk/nrf54h20/cpuapp
      - nrf54l15dk/nrf54l05/cpuapp
      - nrf54l15dk/nrf54l10/cpuapp
      - nrf54l15dk/nrf54l15/cpuapp
      - nrf54l15dk/nrf54l15/cpuapp/ns
      - nrf54lm20dk/nrf54lm20a/cpuapp
      - nrf54lm20dk/nrf54lm20a/cpuapp/ns
      - nrf54lm20dk/nrf54lm20b/cpuapp
      - nrf54lm20dk/nrf54lm20b/cpuapp/ns
      - nrf54lv10dk/nrf54lv10a/cpuapp
      - nrf54lv10dk/nrf54lv10a/cpuapp/ns
      - nrf54ls05dk/nrf54ls05a/cpuapp
      - nrf54ls05dk/nrf54ls05b/cpuapp
    integration_platforms: *peripheral_lbs_platforms
    harness: console
    harness_config:
      type: multi_line
      ordered: true
      regex:
        - "Starting Bluetooth Peripheral LBS sample"
        - "Bluetooth initialized"
        - "Advertising successfully started"
    timeout: 15

  sample.bluetooth.peripheral_lbs_minimal:
    platform_allow:
      - nrf52dk/nrf52805
      - nrf52dk/nrf52810
      - nrf52840dk/nrf52811
      - nrf52833dk/nrf52820
      - nrf54ls05dk/nrf54ls05a/cpuapp
    integration_platforms:
      - nrf52dk/nrf52805
      - nrf52840dk/nrf52811
      - nrf54ls05dk/nrf54ls05a/cpuapp
    extra_args: FILE_SUFFIX=minimal

  sample.bluetooth.peripheral_lbs_no_security:
    platform_allow: *peripheral_lbs_platforms
    integration_platforms:
      - nrf52840dk/nrf52840
      - nrf54l15dk/nrf54l15/cpuapp
    extra_args: CONFIG_BT_LBS_SECURITY_ENABLED=n

  sample.bluetooth.peripheral_lbs_bt_ota_dfu:
    build_only: true
    platform_allow:
      - nrf52dk/nrf52832
      - nrf52840dk/nrf52840
      - nrf5340dk/nrf5340/cpuapp
      - nrf5340dk/nrf5340/cpuapp/ns
    integration_platforms:
      - nrf52dk/nrf52832
      - nrf52840dk/nrf52840
      - nrf5340dk/nrf5340/cpuapp
    extra_configs:
      - CONFIG_BOOTLOADER_MCUBOOT=y
      - CONFIG_NCS_SAMPLE_MCUMGR_BT_OTA_DFU=y

  sample.bluetooth.peripheral_lbs_bt_ota_dfu.direct_xip:
    build_only: true
    platform_allow:
      - nrf52840dk/nrf52840
    integration_platforms:
      - nrf52840dk/nrf52840
    extra_args: mcuboot_CONFIG_BOOT_DIRECT_XIP=y
    extra_configs:
      - CONFIG_BOOTLOADER_MCUBOOT=y
      - CONFIG_NCS_SAMPLE_MCUMGR_BT_OTA_DFU=y
      - CONFIG_MCUBOOT_BOOTLOADER_MODE_DIRECT_XIP=y

  sample.bluetooth.peripheral_lbs_bt_ota_dfu.direct_xip.revert:
    build_only: true
    platform_allow:
      - nrf52840dk/nrf52840
    integration_platforms:
      - nrf52840dk/nrf52840
    extra_args:
      - mcuboot_CONFIG_BOOT_DIRECT_XIP=y
      - mcuboot_CONFIG_BOOT_DIRECT_XIP_REVERT=y
    extra_configs:
      - CONFIG_BOOTLOADER_MCUBOOT=y
      - CONFIG_NCS_SAMPLE_MCUMGR_BT_OTA_DFU=y
      - CONFIG_MCUBOOT_BOOTLOADER_MODE_DIRECT_XIP_WITH_REVERT=y

  sample.bluetooth.peripheral_lbs.llvm:
    toolchain_allow: llvm
    platform_allow:
      - nrf54l15dk/nrf54l15/cpuapp
      - nrf54l15dk/nrf54l15/cpuapp/ns
      - nrf54lm20dk/nrf54lm20a/cpuapp
      - nrf54lm20dk/nrf54lm20a/cpuapp/ns
      - nrf54lm20dk/nrf54lm20b/cpuapp
      - nrf54lm20dk/nrf54lm20b/cpuapp/ns
      - nrf54lv10dk/nrf54lv10a/cpuapp
      - nrf54ls05dk/nrf54ls05a/cpuapp
      - nrf54ls05dk/nrf54ls05b/cpuapp
    integration_platforms:
      - nrf54l15dk/nrf54l15/cpuapp
      - nrf54l15dk/nrf54l15/cpuapp/ns
      - nrf54lm20dk/nrf54lm20a/cpuapp
      - nrf54lm20dk/nrf54lm20a/cpuapp/ns
      - nrf54lm20dk/nrf54lm20b/cpuapp
      - nrf54lm20dk/nrf54lm20b/cpuapp/ns
      - nrf54lv10dk/nrf54lv10a/cpuapp
      - nrf54ls05dk/nrf54ls05a/cpuapp
      - nrf54ls05dk/nrf54ls05b/cpuapp
    tags:
      - bluetooth
      - ci_build
      - sysbuild

  sample.bluetooth.peripheral_lbs.l15_tag:
    integration_platforms:
      - nrf54l15tag/nrf54l15/cpuapp
    platform_allow:
      - nrf54l15tag/nrf54l15/cpuapp
    extra_configs:
      - CONFIG_NCS_SAMPLE_MCUMGR_BT_OTA_DFU=y
      - CONFIG_LOG_BACKEND_UART=n
      - CONFIG_UART_CONSOLE=n
      - CONFIG_USE_SEGGER_RTT=y
      - CONFIG_LOG_BACKEND_RTT=y
      - CONFIG_LOG_MODE_DEFERRED=y
      - CONFIG_LOG_BACKEND_UART=n
      - CONFIG_SEGGER_RTT_MAX_NUM_UP_BUFFERS=5
      - CONFIG_SEGGER_RTT_MAX_NUM_DOWN_BUFFERS=5
      - CONFIG_SEGGER_RTT_BUFFER_SIZE_UP=2048
      - CONFIG_SEGGER_RTT_BUFFER_SIZE_DOWN=32
      - CONFIG_SEGGER_RTT_PRINTF_BUFFER_SIZE=128
    extra_args:
      - SB_CONFIG_BOOTLOADER_MCUBOOT=y
      - mcuboot_CONFIG_LOG_BACKEND_UART=n
      - mcuboot_CONFIG_UART_CONSOLE=n
      - mcuboot_CONFIG_USE_SEGGER_RTT=y
      - mcuboot_CONFIG_LOG_BACKEND_RTT=y
      - mcuboot_CONFIG_LOG_MODE_IMMEDIATE=y
      - mcuboot_CONFIG_LOG_BACKEND_UART=n
```

## samples/bluetooth/peripheral_lbs/sysbuild/ipc_radio/boards/nrf54h20dk_nrf54h20_cpurad.conf
```kconfig
#
# Copyright (c) 2026 Nordic Semiconductor ASA
#
# SPDX-License-Identifier: LicenseRef-Nordic-5-Clause
#

CONFIG_BT_PERIPHERAL=y
CONFIG_BT_CENTRAL=n
CONFIG_BT_CTLR_PHY_CODED=n

CONFIG_PSA_CRYPTO_DRIVER_OBERON=n
CONFIG_PSA_SSF_CRYPTO_CLIENT=y
CONFIG_MBEDTLS_PSA_CRYPTO_C=y
CONFIG_NRF_SECURITY=y
```

## samples/bluetooth/peripheral_mds/boards/nrf5340dk_nrf5340_cpuapp.conf
```kconfig
#
# Copyright (c) 2023 Nordic Semiconductor
#
# SPDX-License-Identifier: LicenseRef-Nordic-5-Clause
#

# Heap memory is required for the memfault_demo_cli.c and bt_rpmsg.
CONFIG_HEAP_MEM_POOL_SIZE=4096
```

## samples/bluetooth/peripheral_mds/boards/nrf54l15dk_nrf54l15_cpuapp.conf
```kconfig
#
# Copyright (c) 2026 Nordic Semiconductor
#
# SPDX-License-Identifier: LicenseRef-Nordic-5-Clause
#

CONFIG_BT_DIS_HW_REV_STR="nrf54l15dk"
```

## samples/bluetooth/peripheral_mds/sample.yaml
```yaml
sample:
  description: Bluetooth Low Energy Memfault Diagnostic service sample
  name: Bluetooth LE MDS service
tests:
  sample.bluetooth.peripheral_mds:
    sysbuild: true
    extra_configs:
      - CONFIG_MEMFAULT_NCS_PROJECT_KEY="dummy-key"
      - CONFIG_MEMFAULT_NCS_DEVICE_ID="dummy-device-id"
    integration_platforms:
      - nrf52dk/nrf52832
      - nrf52833dk/nrf52833
      - nrf52840dk/nrf52840
      - nrf5340dk/nrf5340/cpuapp
      - nrf5340dk/nrf5340/cpuapp/ns
      - nrf54l15dk/nrf54l05/cpuapp
      - nrf54l15dk/nrf54l10/cpuapp
      - nrf54l15dk/nrf54l15/cpuapp
      - nrf54lm20dk/nrf54lm20a/cpuapp
      - nrf54lv10dk/nrf54lv10a/cpuapp
    platform_allow:
      - nrf52dk/nrf52832
      - nrf52833dk/nrf52833
      - nrf52840dk/nrf52840
      - nrf5340dk/nrf5340/cpuapp
      - nrf5340dk/nrf5340/cpuapp/ns
      - nrf54l15dk/nrf54l05/cpuapp
      - nrf54l15dk/nrf54l10/cpuapp
      - nrf54l15dk/nrf54l15/cpuapp
      - nrf54lm20dk/nrf54lm20a/cpuapp
      - nrf54lv10dk/nrf54lv10a/cpuapp
    tags:
      - bluetooth
      - ci_build
      - sysbuild
    harness: console
    harness_config:
      type: multi_line
      ordered: true
      regex:
        - "Starting Bluetooth Memfault sample"
        - "Bluetooth initialized"
        - "Advertising successfully started"
    timeout: 15
```

## samples/bluetooth/peripheral_nfc_pairing/Kconfig
```kconfig
#
# Copyright (c) 2020 Nordic Semiconductor
#
# SPDX-License-Identifier: LicenseRef-Nordic-5-Clause
#

menu "NFC Paring configuration"

choice NFC_TAG_CONNECTION_HANDOVER_ROLE
	prompt "Connection Handover Tag role"
	default NFC_TAG_CH_SELECTOR

config NFC_TAG_CH_SELECTOR
	bool "Connection Handover selector role"
	help
	  NFC Tag is Connection Handover selector device. The Handover Selector
	  is an NFC Forum Device that constructs and replies to a
	  Handover Select Message as a result of a previously received
	  Handover Request Message, or an NFC Tag Device that provides a
	  pre-set Handover Select Message for reading.For more details
	  check NFC Forum Connection Handover 1.5 2.2

config NFC_TAG_CH_REQUESTER
	bool "Connection Handover requester role"
	help
	  NFC Tag is Connection Handover requester device. The Handover Requester
	  is an NFC Forum Device that begins the Handover Protocol by issuing
	  a Handover Request Message to another NFC Forum Device. For more
	  details check NFC Forum Connection Handover 1.5 2.2.

endchoice

config SETTINGS
	default y

config ZMS
	default y if (SOC_FLASH_NRF_RRAM || SOC_FLASH_NRF_MRAM)

config NVS
	default y if !(SOC_FLASH_NRF_RRAM || SOC_FLASH_NRF_MRAM)

endmenu

menu "Zephyr Kernel"
source "Kconfig.zephyr"
endmenu
```
