/*
 * Copyright (c) 2026 Nordic Semiconductor ASA
 *
 * SPDX-License-Identifier: LicenseRef-Nordic-5-Clause
 */

/* Carried over from app.overlay, which this overlay replaces: the sample
 * only uses two buttons.
 */
/ {
	aliases {
		/delete-property/ sw2;
		/delete-property/ sw3;
	};
};

/delete-node/ &button2;
/delete-node/ &button3;
