## samples/bluetooth/central_usb_nus/sample.yaml
```yaml
sample:
  name: BLE NUS Central USB
  description: Buetooth Low Energy NUS Central USB sample
tests:
  samples.bluetooth.central_usb_nus:
    build_only: true
    platform_allow: nrf52840dongle_nrf52840 nrf52840dk_nrf52840
    integration_platforms:
      - nrf52840dongle_nrf52840
      - nrf52840dk_nrf52840
    tags: bluetooth ci_build
```

## samples/bluetooth/channel_map_updates/boards/nrf54l15bsim_nrf54l15_cpuapp.conf
```kconfig
#
# Board overrides for nrf54l15bsim/nrf54l15/cpuapp to enable LLPM sample in BabbleSim
#
# SPDX-License-Identifier: LicenseRef-Nordic-5-Clause
#

# Increase host buffer count – needed when the controller and host share the same core in simulation.
CONFIG_BT_BUF_EVT_RX_COUNT=22

# Disable cryptographic and console features that are not available in BabbleSim environment
CONFIG_NRF_SECURITY=n 

# Disable security for Bsim
CONFIG_BT_SMP=n

# Disable 2M-PHY for Bsim
CONFIG_BT_CTLR_PHY_2M=n
CONFIG_BT_CTLR_PHY_CODED=n 
```

## samples/bluetooth/channel_map_updates/sample.yaml
```yaml
sample:
  description: Buetooth Low Energy Channel Map Update Sample
  name: Bluetooth LE Channel Map Update
tests:
  sample.bluetooth.chmap_update:
    sysbuild: true
    build_only: true
    integration_platforms:
      - nrf54l15dk/nrf54l05/cpuapp
      - nrf54l15dk/nrf54l10/cpuapp
      - nrf54l15dk/nrf54l15/cpuapp
      - nrf54l15bsim/nrf54l15/cpuapp
    platform_allow:
      - nrf54l15dk/nrf54l05/cpuapp
      - nrf54l15dk/nrf54l10/cpuapp
      - nrf54l15dk/nrf54l15/cpuapp
      - nrf54l15bsim/nrf54l15/cpuapp
    tags:
      - bluetooth
      - ci_build
```

## samples/bluetooth/channel_sounding/ipt_initiator/sample.yaml
```yaml
sample:
  description: Bluetooth Low Energy Channel Sounding Initiator with Inline PCT Transfer
  name: Bluetooth LE Channel Sounding Initiator with IPT
tests:
  sample.bluetooth.channel_sounding_ipt_initiator:
    sysbuild: true
    build_only: true
    integration_platforms:
      - nrf54l15dk/nrf54l15/cpuapp
    platform_allow:
      - nrf54l15dk/nrf54l05/cpuapp
      - nrf54l15dk/nrf54l10/cpuapp
      - nrf54l15dk/nrf54l15/cpuapp
      - nrf54lm20dk/nrf54lm20a/cpuapp
      - nrf54lm20dk/nrf54lm20b/cpuapp
      - nrf54lv10dk/nrf54lv10a/cpuapp
      - nrf54lv10dk/nrf54lv10a/cpuapp/ns
    tags:
      - bluetooth
      - ci_build
      - sysbuild
      - ci_samples_bluetooth
```

## samples/bluetooth/channel_sounding/ras_initiator/Kconfig
```kconfig
#
# Copyright (c) 2026 Nordic Semiconductor ASA
#
# SPDX-License-Identifier: LicenseRef-Nordic-5-Clause
#

menu "Channel Sounding RAS Initiator sample"

choice SAMPLE_RAS_INITIATOR_STEP_MODE
	prompt "Channel Sounding Step Modes selection"
	default SAMPLE_RAS_INITIATOR_STEP_MODE_2_SUB_MODE_1

config SAMPLE_RAS_INITIATOR_STEP_MODE_2_SUB_MODE_1
	bool "Main: 2, Sub: 1."
	help
	  This option enables CS with main mode 2 and submode 1.
	  Mode 2 steps are used for PBR and mode 1 steps are used for RTT.

config SAMPLE_RAS_INITIATOR_STEP_MODE_1
	bool "Main: 1, Sub: unused."
	help
	  This option enables CS with main mode 1 and submode unused.
	  Mode 1 steps are used for RTT.

config SAMPLE_RAS_INITIATOR_STEP_MODE_2
	bool "Main: 2, Sub: unused."
	help
	  This option enables CS with main mode 2 and submode unused.
	  Mode 2 steps are used for PBR.

config SAMPLE_RAS_INITIATOR_STEP_MODE_3
	bool "Main: 3, Sub: unused."
	select BT_RAS_MODE_3_SUPPORTED
	select BT_CTLR_SDC_CS_STEP_MODE3
	help
	  This option enables CS with main mode 3 and submode unused.
	  Mode 3 steps are used for PBR and RTT.

endchoice

endmenu

source "Kconfig.zephyr"
```

## samples/bluetooth/channel_sounding/ras_initiator/Kconfig.antenna_conf
```kconfig
#
# Copyright (c) 2024 Nordic Semiconductor ASA
#
# SPDX-License-Identifier: LicenseRef-Nordic-5-Clause
#
choice CS_TONE_ANTENNA_CONFIGURATION
	prompt "Tone antenna configuration selection"
	default CS_TONE_ANTENNA_CONFIGURATION_A1_B1
	help
	  Select the tone antenna configuration for channel sounding procedures.
	  The configuration determines how many antenna paths are used on each side
	  (initiator and reflector). The format is A<initiator_antennas>_B<reflector_antennas>.

config CS_TONE_ANTENNA_CONFIGURATION_A1_B1
	bool "A1_B1 (1 antenna path per side)"
	help
	  Use A1_B1 configuration with 1 antenna path on each side.
	  This requires BT_CTLR_SDC_CS_MAX_ANTENNA_PATHS >= 1.

config CS_TONE_ANTENNA_CONFIGURATION_A2_B1
	bool "A2_B1 (2 initiator, 1 reflector antenna paths)"
	help
	  Use A2_B1 configuration with 2 antenna paths on initiator side and
	  1 antenna path on reflector side.
	  This requires BT_CTLR_SDC_CS_MAX_ANTENNA_PATHS >= 2.

config CS_TONE_ANTENNA_CONFIGURATION_A3_B1
	bool "A3_B1 (3 initiator, 1 reflector antenna paths)"
	help
	  Use A3_B1 configuration with 3 antenna paths on initiator side and
	  1 antenna path on reflector side.
	  This requires BT_CTLR_SDC_CS_MAX_ANTENNA_PATHS >= 3.

config CS_TONE_ANTENNA_CONFIGURATION_A4_B1
	bool "A4_B1 (4 initiator, 1 reflector antenna paths)"
	help
	  Use A4_B1 configuration with 4 antenna paths on initiator side and
	  1 antenna path on reflector side.
	  This requires BT_CTLR_SDC_CS_MAX_ANTENNA_PATHS >= 4.

config CS_TONE_ANTENNA_CONFIGURATION_A1_B2
	bool "A1_B2 (1 initiator, 2 reflector antenna paths)"
	help
	  Use A1_B2 configuration with 1 antenna path on initiator side and
	  2 antenna paths on reflector side.
	  This requires BT_CTLR_SDC_CS_MAX_ANTENNA_PATHS >= 2.

config CS_TONE_ANTENNA_CONFIGURATION_A1_B3
	bool "A1_B3 (1 initiator, 3 reflector antenna paths)"
	help
	  Use A1_B3 configuration with 1 antenna path on initiator side and
	  3 antenna paths on reflector side.
	  This requires BT_CTLR_SDC_CS_MAX_ANTENNA_PATHS >= 3.

config CS_TONE_ANTENNA_CONFIGURATION_A1_B4
	bool "A1_B4 (1 initiator, 4 reflector antenna paths)"
	help
	  Use A1_B4 configuration with 1 antenna path on initiator side and
	  4 antenna paths on reflector side.
	  This requires BT_CTLR_SDC_CS_MAX_ANTENNA_PATHS >= 4.

config CS_TONE_ANTENNA_CONFIGURATION_A2_B2
	bool "A2_B2 (2 antenna paths per side)"
	help
	  Use A2_B2 configuration with 2 antenna paths on each side (4 total).
	  This requires BT_CTLR_SDC_CS_MAX_ANTENNA_PATHS >= 4.

endchoice

config CS_TONE_ANTENNA_CONFIGURATION_VALUE
	int
	default 0 if CS_TONE_ANTENNA_CONFIGURATION_A1_B1
	default 1 if CS_TONE_ANTENNA_CONFIGURATION_A2_B1
	default 2 if CS_TONE_ANTENNA_CONFIGURATION_A3_B1
	default 3 if CS_TONE_ANTENNA_CONFIGURATION_A4_B1
	default 4 if CS_TONE_ANTENNA_CONFIGURATION_A1_B2
	default 5 if CS_TONE_ANTENNA_CONFIGURATION_A1_B3
	default 6 if CS_TONE_ANTENNA_CONFIGURATION_A1_B4
	default 7 if CS_TONE_ANTENNA_CONFIGURATION_A2_B2
	help
	  Internal config value mapping to BT_LE_CS_TONE_ANTENNA_CONFIGURATION enum.
	  Not intended for direct use.

# Intermediate config: number of antenna paths required for the selected configuration
# This is the maximum number of antenna paths needed on either the initiator or reflector side
config CS_TONE_ANTENNA_CONFIGURATION_NUM_ANTENNA_PATHS
	int
	default 1 if CS_TONE_ANTENNA_CONFIGURATION_A1_B1
	default 2 if CS_TONE_ANTENNA_CONFIGURATION_A2_B1 || CS_TONE_ANTENNA_CONFIGURATION_A1_B2
	default 3 if CS_TONE_ANTENNA_CONFIGURATION_A3_B1 || CS_TONE_ANTENNA_CONFIGURATION_A1_B3
	default 4 if CS_TONE_ANTENNA_CONFIGURATION_A4_B1 || CS_TONE_ANTENNA_CONFIGURATION_A1_B4 || CS_TONE_ANTENNA_CONFIGURATION_A2_B2
	help
	  Number of antenna paths required for the selected tone antenna configuration.
	  This is calculated as the maximum number of antenna paths needed on either
	  the initiator or reflector side.

# Set default value for BT_CTLR_SDC_CS_MAX_ANTENNA_PATHS based on the required number of antenna paths
# This ensures the controller is configured with sufficient antenna paths for the selected configuration
if BT_CTLR_CHANNEL_SOUNDING
config BT_CTLR_SDC_CS_MAX_ANTENNA_PATHS
	default CS_TONE_ANTENNA_CONFIGURATION_NUM_ANTENNA_PATHS
# TODO: Fix this to depend on role.
config BT_CTLR_SDC_CS_NUM_ANTENNAS
	default CS_TONE_ANTENNA_CONFIGURATION_NUM_ANTENNA_PATHS
endif

if BT_RAS
config BT_RAS_MAX_ANTENNA_PATHS
	default CS_TONE_ANTENNA_CONFIGURATION_NUM_ANTENNA_PATHS
endif

source "Kconfig.zephyr"
```

## samples/bluetooth/channel_sounding/ras_initiator/boards/nrf54l15tag_nrf54l15_cpuapp.conf
```kconfig
#
# Copyright (c) 2026 Nordic Semiconductor ASA
#
# SPDX-License-Identifier: LicenseRef-Nordic-5-Clause
#

# Overwriting antenna settings to use the additional antennas on the tag
CONFIG_BT_CS_DE_MAX_NUM_ANTENNA_PATHS=4
CONFIG_BT_CTLR_SDC_CS_MAX_ANTENNA_PATHS=4
CONFIG_BT_CTLR_SDC_CS_NUM_ANTENNAS=2
```

## samples/bluetooth/channel_sounding/ras_reflector/Kconfig
```kconfig
mainmenu "Nordic Channel Sounding RAS Reflector sample"

rsource "../ras_initiator/Kconfig.antenna_conf"

# source "Kconfig.zephyr"
```

## samples/bluetooth/channel_sounding_ras_initiator/sample.yaml
```yaml
sample:
  description: Bluetooth Low Energy Channel Sounding Initiator with Ranging Service
    Requestor
  name: Bluetooth LE Channel Sounding Initiator with RREQ
tests:
  sample.bluetooth.channel_sounding_ras_initiator:
    sysbuild: true
    build_only: true
    integration_platforms:
      - nrf54l15dk/nrf54l05/cpuapp
      - nrf54l15dk/nrf54l10/cpuapp
      - nrf54l15dk/nrf54l15/cpuapp
      - nrf54h20dk/nrf54h20/cpuapp
      - nrf54lm20dk/nrf54lm20a/cpuapp
    platform_allow:
      - nrf54l15dk/nrf54l05/cpuapp
      - nrf54l15dk/nrf54l10/cpuapp
      - nrf54l15dk/nrf54l15/cpuapp
      - nrf54h20dk/nrf54h20/cpuapp
      - nrf54lm20dk/nrf54lm20a/cpuapp
    tags:
      - bluetooth
      - ci_build
      - sysbuild
```

## samples/bluetooth/channel_sounding_ras_reflector/boards/nrf54h20dk_nrf54h20_cpuapp.conf
```kconfig
#
# Copyright (c) 2025 Nordic Semiconductor
#
# SPDX-License-Identifier: LicenseRef-Nordic-5-Clause
#

# Enable PSA RNG
CONFIG_PSA_CRYPTO_DRIVER_OBERON=n
CONFIG_NRF_IRONSIDE_SE_PSA_SERVICES=y
CONFIG_MBEDTLS_PSA_CRYPTO_C=y
CONFIG_NRF_SECURITY=y

CONFIG_SOC_NRF54H20_CPURAD_ENABLE=y
```

## samples/bluetooth/channel_sounding_ras_reflector/sample.yaml
```yaml
sample:
  description: Bluetooth Low Energy Channel Sounding Reflector with Ranging Service
    Responder
  name: Bluetooth LE Channel Sounding Reflector with RRSP
tests:
  sample.bluetooth.channel_sounding_ras_reflector:
    sysbuild: true
    build_only: true
    integration_platforms:
      - nrf54l15dk/nrf54l05/cpuapp
      - nrf54l15dk/nrf54l10/cpuapp
      - nrf54l15dk/nrf54l15/cpuapp
      - nrf54h20dk/nrf54h20/cpuapp
      - nrf54lm20dk/nrf54lm20a/cpuapp
      - nrf54lv10dk/nrf54lv10a/cpuapp
    platform_allow:
      - nrf54l15dk/nrf54l05/cpuapp
      - nrf54l15dk/nrf54l10/cpuapp
      - nrf54l15dk/nrf54l15/cpuapp
      - nrf54h20dk/nrf54h20/cpuapp
      - nrf54lm20dk/nrf54lm20a/cpuapp
      - nrf54lv10dk/nrf54lv10a/cpuapp
    tags:
      - bluetooth
      - ci_build
      - sysbuild
```

## samples/bluetooth/channel_survey/boards/nrf52840dongle_nrf52840.conf
```kconfig
CONFIG_USB_DEVICE_STACK=y
CONFIG_USB_DEVICE_REMOTE_WAKEUP=n
CONFIG_USB_DEVICE_PRODUCT="LLPM sample console"
CONFIG_USB_CDC_ACM_LOG_LEVEL_OFF=y

CONFIG_UART_CONSOLE=y
CONFIG_UART_INTERRUPT_DRIVEN=y
CONFIG_UART_LINE_CTRL=y

# Since the default LOG_MODE_MINIMAL is synchronous, it will mess with the USB
# driver/subsys. Use the deferred mode instead.
CONFIG_LOG_MODE_DEFERRED=y
```

## samples/bluetooth/channel_survey/sample.yaml
```yaml
sample:
  description: Buetooth Channel Survey sample
  name: BLE Channel Survey
tests:
  sample.bluetooth.llpm:
    build_only: true
    integration_platforms:
      - nrf52840dk_nrf52840
    platform_allow: nrf52dk_nrf52832
    tags: bluetooth ci_build
```

## samples/bluetooth/conn_time_sync/boards/nrf52840dk_nrf52840.conf
```kconfig
#
# Copyright (c) 2024 Nordic Semiconductor
#
# SPDX-License-Identifier: LicenseRef-Nordic-5-Clause
#

CONFIG_NRFX_TIMER1=y
CONFIG_NRFX_RTC2=y
CONFIG_NRFX_PPI=y
```

## samples/bluetooth/conn_time_sync/boards/nrf5340_audio_dk_nrf5340_cpuapp.conf
```kconfig
#
# Copyright (c) 2024 Nordic Semiconductor
#
# SPDX-License-Identifier: LicenseRef-Nordic-5-Clause
#

CONFIG_NRFX_TIMER=y
CONFIG_NRFX_RTC=y
CONFIG_NRFX_GPPI=y
```

## samples/bluetooth/conn_time_sync/boards/nrf5340dk_nrf5340_cpuapp.conf
```kconfig
#
# Copyright (c) 2024 Nordic Semiconductor
#
# SPDX-License-Identifier: LicenseRef-Nordic-5-Clause
#

CONFIG_NRFX_TIMER0=y
CONFIG_NRFX_RTC0=y
CONFIG_NRFX_GPPI=y
```

## samples/bluetooth/conn_time_sync/sample.yaml
```yaml
sample:
  description: Bluetooth Connection time synchronization sample
  name: Bluetooth Connection time synchronization
tests:
  sample.bluetooth.conn_time_sync:
    sysbuild: true
    build_only: true
    integration_platforms:
      - nrf52840dk/nrf52840
      - nrf52833dk/nrf52833
      - nrf5340dk/nrf5340/cpuapp
      - nrf54l15dk/nrf54l15/cpuapp
      - nrf54l15pdk/nrf54l15/cpuapp
    platform_allow:
      - nrf52840dk/nrf52840
      - nrf52833dk/nrf52833
      - nrf5340dk/nrf5340/cpuapp
      - nrf54l15dk/nrf54l15/cpuapp
      - nrf54l15pdk/nrf54l15/cpuapp
    tags: bluetooth ci_build sysbuild
```

## samples/bluetooth/connection_event_trigger/sample.yaml
```yaml
sample:
  description: Buetooth Low Energy Event Trigger sample
  name: BLE Event Trigger
tests:
  sample.bluetooth.connection_event_trigger:
    sysbuild: true
    build_only: true
    integration_platforms:
      - nrf52dk/nrf52832
      - nrf52840dk/nrf52840
      - nrf5340dk/nrf5340/cpunet
    platform_allow: nrf52dk/nrf52832 nrf52840dk/nrf52840 nrf5340dk/nrf5340/cpunet
    tags: bluetooth ci_build sysbuild
```

## samples/bluetooth/direct_test_mode/Kconfig
```kconfig
#
# Copyright (c) 2026 Nordic Semiconductor
#
# SPDX-License-Identifier: LicenseRef-Nordic-5-Clause
#

mainmenu "Nordic DTM sample"

module = DTM_TW_TRANSPORT
module-str = "DTM 2-wire transport"
source "subsys/logging/Kconfig.template.log_config"

source "Kconfig.zephyr"
```

## samples/bluetooth/direct_test_mode/Kconfig.sysbuild
```kconfig
#
# Copyright (c) 2026 Nordic Semiconductor
#
# SPDX-License-Identifier: LicenseRef-Nordic-5-Clause
#

choice APPCORE
	default APPCORE_EMPTY if SOC_NRF5340_CPUNET
	depends on SUPPORT_APPCORE

endchoice

source "share/sysbuild/Kconfig"
```

## samples/bluetooth/direct_test_mode/boards/nrf5340dk_nrf5340_cpunet_hci.conf
```kconfig
#
# Copyright (c) 2021 Nordic Semiconductor
#
# SPDX-License-Identifier: LicenseRef-Nordic-5-Clause
#

CONFIG_IPC_SERVICE=y
CONFIG_IPC_SERVICE_BACKEND_RPMSG=y
CONFIG_MBOX=y

CONFIG_NRFX_DPPI=y

CONFIG_HEAP_MEM_POOL_SIZE=4096

# Do not build Remote shell APP Core sample for the application core in hci mode
CONFIG_NCS_SAMPLE_REMOTE_SHELL_CHILD_IMAGE=n

CONFIG_NCS_SAMPLE_DTM_REMOTE_HCI_CHILD_IMAGE=y
CONFIG_NRF_RPC=y
CONFIG_NRF_RPC_CBOR=y

CONFIG_DTM_TRANSPORT_HCI=y
CONFIG_NET_BUF=y
```

## samples/bluetooth/direct_test_mode/boards/nrf54h20dk_nrf54h20_cpurad.conf
```kconfig
#
# Copyright (c) 2024 Nordic Semiconductor
#
# SPDX-License-Identifier: LicenseRef-Nordic-5-Clause
#

# Use necessary peripherals
CONFIG_NRFX_TIMER=y

CONFIG_MAIN_STACK_SIZE=2048
CONFIG_SYSTEM_WORKQUEUE_STACK_SIZE=2048
```

## samples/bluetooth/direct_test_mode/boards/nrf54l15dk_nrf54l15_cpuapp.conf
```kconfig
#
# Copyright (c) 2024 Nordic Semiconductor
#
# SPDX-License-Identifier: LicenseRef-Nordic-5-Clause
#

# Use necessary peripherals
CONFIG_NRFX_TIMER=y
```

## samples/bluetooth/direct_test_mode/boards/nrf54lm20dk_nrf54lm20a_cpuapp.conf
```kconfig
#
# Copyright (c) 2025 Nordic Semiconductor
#
# SPDX-License-Identifier: LicenseRef-Nordic-5-Clause
#

# Use necessary peripherals
CONFIG_NRFX_TIMER=y
```
