## CMakeLists.txt
```
#
# Copyright (c) 2024 Nordic Semiconductor
#
# SPDX-License-Identifier: LicenseRef-Nordic-5-Clause
#

cmake_minimum_required(VERSION 3.20.0)
find_package(Zephyr REQUIRED HINTS $ENV{ZEPHYR_BASE})
project(iso_time_sync)

target_include_directories(app PRIVATE include)
target_sources(app PRIVATE src/main.c)
target_sources(app PRIVATE src/combined_bis_cis.c)
target_sources(app PRIVATE src/iso_tx.c)
target_sources(app PRIVATE src/iso_rx.c)
```

## Kconfig.sysbuild
```
#
# Copyright (c) 2023 Nordic Semiconductor
#
# SPDX-License-Identifier: LicenseRef-Nordic-5-Clause
#

source "share/sysbuild/Kconfig"

config NRF_DEFAULT_BLUETOOTH
	default y
```

## sample.yaml
```
sample:
  description: Bluetooth Low Energy combined BIS and CIS sample
  name: Bluetooth LE combined BIS and CIS
common:
  sysbuild: true
  build_only: true
  tags:
    - bluetooth
    - ci_build
    - sysbuild
    - ci_samples_bluetooth
tests:
  sample.bluetooth.iso_bis_cis:
    extra_args: EXTRA_CONF_FILE=overlay-bt_ctlr.conf
    integration_platforms:
      - nrf54l15dk/nrf54l15/cpuapp
    platform_allow:
      - nrf54l15dk/nrf54l05/cpuapp
      - nrf54l15dk/nrf54l10/cpuapp
      - nrf54l15dk/nrf54l15/cpuapp
      - nrf54lm20dk/nrf54lm20a/cpuapp
      - nrf54lm20dk/nrf54lm20b/cpuapp
      - nrf54lv10dk/nrf54lv10a/cpuapp
      - nrf54lv10dk/nrf54lv10a/cpuapp/ns
      - nrf54lc10dk/nrf54lc10a/cpuapp
      - nrf54lc10dk/nrf54lc10a/cpuapp/ns
      - nrf54ls05dk/nrf54ls05b/cpuapp
      - nrf54ls05dk/nrf54ls05a/cpuapp
  # Split off from sample.bluetooth.iso_bis_cis: these boards run the
  # SoftDevice Controller in the separate ipc_radio image, so the BT_CTLR_*
  # settings in overlay-bt_ctlr.conf have no effect in the application image.
  sample.bluetooth.iso_bis_cis.ipc_radio:
    integration_platforms:
      - nrf5340dk/nrf5340/cpuapp
      - nrf54h20dk/nrf54h20/cpuapp
    platform_allow:
      - nrf5340dk/nrf5340/cpuapp
      - nrf54h20dk/nrf54h20/cpuapp
```

## prj.conf
```kconfig
CONFIG_LOG=y
CONFIG_LOG_BUFFER_SIZE=2048

CONFIG_ASSERT=y
CONFIG_RING_BUFFER=y

CONFIG_BT=y
CONFIG_BT_ISO_BROADCASTER=y
CONFIG_BT_ISO_CENTRAL=y
CONFIG_BT_CENTRAL=y
CONFIG_BT_PERIPHERAL=y

CONFIG_BT_DEVICE_NAME="Nordic_ISO"

CONFIG_BT_MAX_CONN=1
CONFIG_BT_EXT_ADV_MAX_ADV_SET=1
CONFIG_BT_ISO_MAX_CHAN=2
CONFIG_BT_ISO_MAX_CIG=1
CONFIG_BT_ISO_MAX_BIG=1

CONFIG_BT_ISO_TX_BUF_COUNT=3
CONFIG_BT_ISO_RX_BUF_COUNT=1

CONFIG_BT_ISO_TX_MTU=5

# Ineffective here: unsatisfied dependency BT_LL_SOFTDEVICE, so
# BT_CTLR_SDC_CENTRAL_ACL_EVENT_SPACING_DEFAULT stays unset; moved to overlay-bt_ctlr.conf, which is
# applied only where the controller is part of this image.
# CONFIG_BT_CTLR_SDC_CENTRAL_ACL_EVENT_SPACING_DEFAULT=10000
# Ineffective here: unsatisfied dependency BT_LL_SOFTDEVICE, so
# BT_CTLR_SDC_MAX_CONN_EVENT_LEN_DEFAULT stays unset; moved to overlay-bt_ctlr.conf, which is
# applied only where the controller is part of this image.
# CONFIG_BT_CTLR_SDC_MAX_CONN_EVENT_LEN_DEFAULT=2500
# Ineffective here: unsatisfied dependencies BT_CTLR_ADV_ISO, BT_LL_SOFTDEVICE, so
# BT_CTLR_SDC_BIG_RESERVED_TIME_US stays unset; moved to overlay-bt_ctlr.conf, which is applied only
# where the controller is part of this image.
# CONFIG_BT_CTLR_SDC_BIG_RESERVED_TIME_US=5000
# Ineffective here: unsatisfied dependencies BT_CTLR_CENTRAL_ISO, BT_LL_SOFTDEVICE, so
# BT_CTLR_SDC_CIG_RESERVED_TIME_US stays unset; moved to overlay-bt_ctlr.conf, which is applied only
# where the controller is part of this image.
# CONFIG_BT_CTLR_SDC_CIG_RESERVED_TIME_US=5000
```

## overlay-bt_ctlr.conf
```kconfig
#
# Copyright (c) 2026 Nordic Semiconductor
#
# SPDX-License-Identifier: LicenseRef-Nordic-5-Clause
#

# Controller settings for boards that build the SoftDevice Controller into this
# image. Boards with a dedicated radio core run the controller in the ipc_radio
# image instead, so BT_LL_SOFTDEVICE and the BT_CTLR_* symbols do not exist in
# the application image and these lines have no effect there.
CONFIG_BT_CTLR_SDC_CENTRAL_ACL_EVENT_SPACING_DEFAULT=10000
CONFIG_BT_CTLR_SDC_MAX_CONN_EVENT_LEN_DEFAULT=2500
CONFIG_BT_CTLR_SDC_BIG_RESERVED_TIME_US=5000
CONFIG_BT_CTLR_SDC_CIG_RESERVED_TIME_US=5000
```

## boards/nrf54h20dk_nrf54h20_cpuapp.conf
```kconfig
#
# Copyright (c) 2025 Nordic Semiconductor
#
# SPDX-License-Identifier: LicenseRef-Nordic-5-Clause
#

# Enable PSA RNG
CONFIG_PSA_CRYPTO_DRIVER_OBERON=n
CONFIG_PSA_SSF_CRYPTO_CLIENT=y
CONFIG_SSF_PSA_CRYPTO_SERVICE_ENABLED=y
CONFIG_MBEDTLS_PSA_CRYPTO_C=y
CONFIG_NRF_SECURITY=y

CONFIG_SOC_NRF54H20_CPURAD_ENABLE=y
```

## boards/nrf54l15dk_nrf54l15_cpuapp.conf
```kconfig
CONFIG_BT_RX_STACK_SIZE=2048
```

## src/main.c
```c
/*
 * Copyright (c) 2024 Nordic Semiconductor ASA
 *
 * SPDX-License-Identifier: LicenseRef-Nordic-5-Clause
 */

#include <stdlib.h>
#include <ctype.h>
#include <zephyr/kernel.h>
#include <zephyr/bluetooth/bluetooth.h>
#include <zephyr/bluetooth/hci.h>
#include <zephyr/console/console.h>
#include <sdc_hci_vs.h>
#include "iso_combined_bis_and_cis.h"

#include <zephyr/logging/log.h>
LOG_MODULE_REGISTER(app_main, LOG_LEVEL_INF);

void print_intro(void)
{
	LOG_INF("\r\nBluetooth ISO Combined BIS and CIS sample\r\n\r\n"
		"The sample demonstrates data transfer over Bluetooth ISO\r\n"
		"CIS and BIS using the following topology:\r\n\r\n"
		"┌------┐     ┌-------┐      ┌--------┐\r\n"
		"|      |ISO  |  CIS  | ISO  |        |\r\n"
		"| CIS  ├----►|Central├-----►|BIS Sink|\r\n"
		"|Periph|CIS  |+ BIS  | BIS  |        |\r\n"
		"|      |     |Source |      |        |\r\n"
		"└------┘     └-------┘      └--------┘\r\n"
		"  (1)           (2)            (3)   \r\n"
		"The sample only operates as a device 2: Combined CIS Central + BIS Source\r\n"
		"Please, use other samples as a CIS Peripheral (TX) and BIS Sink (RX) "
		"devices.\r\n\r\n");
}

int main(void)
{
	int err;

	/* Initialize the Bluetooth Subsystem */
	err = bt_enable(NULL);
	if (err) {
		LOG_ERR("Bluetooth init failed (err %d)", err);
		return 0;
	}

	print_intro();

	LOG_INF("Starting combined CIS Central + BIS Source");
	combined_cis_bis_start();

	return 0;
}
```

## include/iso_combined_bis_and_cis.h
```c
/*
 * Copyright (c) 2022 Nordic Semiconductor ASA
 *
 * SPDX-License-Identifier: LicenseRef-Nordic-5-Clause
 */

#ifndef ISO_COMBINED_BIS_AND_CIS_H_
#define ISO_COMBINED_BIS_AND_CIS_H_

/** Type definition for a callback to set SDU data to be transmitted
 *
 */
typedef void (*iso_tx_set_sdu_data_cb_t)(struct net_buf *);

/** Type definition for a callback to process received SDU data
 *
 */
typedef void (*iso_rx_process_sdu_data_cb_t)(struct net_buf *);

/** Start combined CIS Central + BIS source
 *
 */
void combined_cis_bis_start(void);

/** Initialize RX path channel
 *
 * @param retransmission_number Requested retransmission number (if central)
 * @param process_sdu_data_cb   Callback to process received SDU
 */
void iso_rx_init(uint8_t retransmission_number, iso_rx_process_sdu_data_cb_t process_sdu_data_cb);

/** Obtain pointer to RX channel
 *
 * @retval Pointer to the RX channel
 */
struct bt_iso_chan **iso_rx_channels_get(void);

/** Initialize TX path channels
 *
 * @param retransmission_number Requested retransmission number (if central or broadcaster)
 * @param set_sdu_data_cb       Callback to set SDU data to be transmitted
 */
void iso_tx_init(uint8_t retransmission_number, iso_tx_set_sdu_data_cb_t set_sdu_data_cb);

/** Obtain pointer to TX channel
 *
 * @retval Pointer to the TX channel
 */
struct bt_iso_chan **iso_tx_channels_get(void);
#endif /* ISO_COMBINED_BIS_AND_CIS_H_ */
```

## src/combined_bis_cis.c
```c
/*
 * Copyright (c) 2024 Nordic Semiconductor ASA
 *
 * SPDX-License-Identifier: LicenseRef-Nordic-5-Clause
 */

/** CIS central implementation for the time sync sample
 *
 * This file implements a device that acts as a CIS central.
 * The central can either be configured as a transmitter or a receiver.
 *
 * It connects to as many peripherals as it has available ISO channels.
 */

#include <zephyr/kernel.h>
#include <zephyr/bluetooth/bluetooth.h>
#include <zephyr/bluetooth/conn.h>
#include <zephyr/bluetooth/iso.h>
#include <zephyr/bluetooth/hci.h>
#include <zephyr/sys/ring_buffer.h>

#include "iso_combined_bis_and_cis.h"

#include <zephyr/logging/log.h>
LOG_MODULE_REGISTER(app_bis_cis, LOG_LEVEL_INF);

#define ADV_NAME_STR_LEN (sizeof(CONFIG_BT_DEVICE_NAME))

#define SDU_INTERVAL_US			(10000u) /* 10 ms */
#define ACL_INTERVAL_BLE_UNITS		(16u)	 /* 20 ms in 1.25 ms BLE units*/
#define PERIODIC_ADV_INTERVAL_BLE_UNITS (16u)	 /* 20 ms in 1.25 ms BLE units*/
#define RETRANSMISSION_NUMBER		(10u)
#define MAX_TRANSPORT_LATENCY_MS	(20u)
#define SDU_RING_BUFFER_SIZE		(4u)

/* Ring buffer contains length of SDU before each SDU, so allocate 1 additional byte */
#define RING_BUF_ELEMENT_SIZE (1 + CONFIG_BT_ISO_TX_MTU)
RING_BUF_DECLARE(sdu_rb, SDU_RING_BUFFER_SIZE * (RING_BUF_ELEMENT_SIZE));
static uint8_t rcvd_sdu_cnt;

static void scan_start(void)
{
	int err;

	err = bt_le_scan_start(
		BT_LE_SCAN_PARAM(BT_LE_SCAN_TYPE_ACTIVE, BT_LE_SCAN_OPT_FILTER_DUPLICATE,
				 BT_GAP_SCAN_FAST_INTERVAL, BT_GAP_SCAN_FAST_INTERVAL),
		NULL);
	if (err) {
		LOG_ERR("Scanning failed to start (err %d)", err);
		return;
	}
}

static struct bt_iso_chan *free_iso_chan_get(void)
{
	struct bt_iso_chan **iso_channels;

	iso_channels = iso_rx_channels_get();

	struct bt_iso_chan *iso_chan = NULL;

	if (iso_channels[0]->state == BT_ISO_STATE_DISCONNECTED) {
		iso_chan = iso_channels[0];
	}

	return iso_chan;
}

static bool adv_data_parse_cb(struct bt_data *data, void *user_data)
{
	char *name = user_data;
	uint8_t len;

	switch (data->type) {
	case BT_DATA_NAME_SHORTENED:
	case BT_DATA_NAME_COMPLETE:
		len = MIN(data->data_len, ADV_NAME_STR_LEN - 1);
		memcpy(name, data->data, len);
		name[len] = '\0';
		return false;
	default:
		return true;
	}
}

static void scan_recv(const struct bt_le_scan_recv_info *info, struct net_buf_simple *buf)
{
	char name_str[ADV_NAME_STR_LEN] = {0};

	bt_data_parse(buf, adv_data_parse_cb, name_str);

	if (strncmp(name_str, CONFIG_BT_DEVICE_NAME, ADV_NAME_STR_LEN) != 0) {
		return;
	}

	if (bt_le_scan_stop()) {
		return;
	}

	const struct bt_le_conn_param *conn_param =
		BT_LE_CONN_PARAM(ACL_INTERVAL_BLE_UNITS, ACL_INTERVAL_BLE_UNITS, 0, 400);

	struct bt_conn *conn = NULL;
	int err = bt_conn_le_create(info->addr, BT_CONN_LE_CREATE_CONN, conn_param, &conn);

	if (err) {
		LOG_ERR("Create conn to %s failed (%d)", name_str, err);
	} else {
		bt_conn_unref(conn);
	}
}

static struct bt_le_scan_cb scan_callbacks = {
	.recv = scan_recv,
};

static void process_rcvd_sdu_cb(struct net_buf *buf)
{
	uint8_t sdu_buffer[CONFIG_BT_ISO_TX_MTU];
	uint8_t sdu_len = (uint8_t)buf->len;

	memcpy(sdu_buffer, buf->data, sdu_len);

	/* write length of SDU to ring-buffer */
	uint32_t wrote = ring_buf_put(&sdu_rb, &sdu_len, 1);

	__ASSERT_NO_MSG(wrote == 1);
	/* write SDU content to ring-buffer */
	wrote = ring_buf_put(&sdu_rb, sdu_buffer, sdu_len);
	__ASSERT_NO_MSG(wrote == sdu_len);
	if (rcvd_sdu_cnt < SDU_RING_BUFFER_SIZE)
		rcvd_sdu_cnt++;
}

static void set_sdu_data_cb(struct net_buf *buf)
{
   /* Start forwarding data when ring buffer is full.
    * It is needed to avoid possible packets loss due to
    * transport latency of CIS stream
    */
	if (rcvd_sdu_cnt >= SDU_RING_BUFFER_SIZE) {
		uint8_t sdu_len;
		uint8_t sdu_buffer[CONFIG_BT_ISO_TX_MTU];

		/* read length of SDU from ring-buffer */
		ring_buf_get(&sdu_rb, &sdu_len, 1);
		/* read SDU content from ring-buffer */
		ring_buf_get(&sdu_rb, sdu_buffer, sdu_len);
		memcpy(buf->data, sdu_buffer, sdu_len);
		buf->len = sdu_len;
	}
}

static const struct bt_data ad[] = {
	BT_DATA(BT_DATA_NAME_COMPLETE, CONFIG_BT_DEVICE_NAME, sizeof(CONFIG_BT_DEVICE_NAME) - 1),
};

void bis_transmitter_start(void)
{
	int err;
	struct bt_le_ext_adv *adv;
	struct bt_iso_big *big;

	/* Create a non-connectable non-scannable advertising set */
	err = bt_le_ext_adv_create(BT_LE_EXT_ADV_NCONN, NULL, &adv);
	if (err) {
		LOG_INF("Failed to create advertising set (err %d)", err);
		return;
	}

	/* Set the advertising data */
	err = bt_le_ext_adv_set_data(adv, ad, ARRAY_SIZE(ad), NULL, 0);
	if (err) {
		LOG_INF("failed to set advertising data (err %d)", err);
		return;
	}

	/* Set periodic advertising parameters */
	err = bt_le_per_adv_set_param(adv, BT_LE_PER_ADV_PARAM(PERIODIC_ADV_INTERVAL_BLE_UNITS,
							       PERIODIC_ADV_INTERVAL_BLE_UNITS,
							       BT_LE_PER_ADV_OPT_NONE));
	if (err) {
		LOG_INF("Failed to set periodic advertising parameters"
			" (err %d)",
			err);
		return;
	}

	/* Start extended advertising */
	err = bt_le_ext_adv_start(adv, BT_LE_EXT_ADV_START_DEFAULT);
	if (err) {
		LOG_INF("Failed to start extended advertising (err %d)", err);
		return;
	}

	/* Enable Periodic Advertising */
	err = bt_le_per_adv_start(adv);
	if (err) {
		LOG_INF("Failed to enable periodic advertising (err %d)", err);
		return;
	}

	struct bt_iso_big_create_param big_create_param = {
		.num_bis = 1,
		.bis_channels = iso_tx_channels_get(),
		.interval = SDU_INTERVAL_US,
		.latency = MAX_TRANSPORT_LATENCY_MS,
		.packing = 0, /* 0 - sequential, 1 - interleaved */
		.framing = 0, /* 0 - unframed, 1 - framed */
	};

	/* Create BIG */
	err = bt_iso_big_create(adv, &big_create_param, &big);
	if (err) {
		LOG_INF("Failed to create BIG (err %d)", err);
		return;
	}

	LOG_INF("BIS transmitter started");
}

static void connected(struct bt_conn *conn, uint8_t err)
{
	char addr[BT_ADDR_LE_STR_LEN];

	bt_addr_le_to_str(bt_conn_get_dst(conn), addr, sizeof(addr));

	if (err) {
		LOG_INF("Failed to connect to %s, 0x%02x %s", addr, err, bt_hci_err_to_str(err));

		scan_start();
		return;
	}

	LOG_INF("Connected: %s", addr);

	/* Find a free ISO channel */
	struct bt_iso_chan *iso_chan = free_iso_chan_get();

	if (iso_chan == NULL) {
		LOG_INF("No ISO channel available");
		return;
	}

	struct bt_iso_connect_param connect_param;

	connect_param.acl = conn;
	connect_param.iso_chan = iso_chan;

	LOG_INF("Connecting ISO channel");
	err = bt_iso_chan_connect(&connect_param, 1);
	if (err) {
		LOG_ERR("Failed to connect iso (%d)", err);
		return;
	}

	bis_transmitter_start();
}

static void disconnected(struct bt_conn *conn, uint8_t reason)
{
	char addr[BT_ADDR_LE_STR_LEN];

	bt_addr_le_to_str(bt_conn_get_dst(conn), addr, sizeof(addr));

	LOG_INF("Disconnected: %s, reason 0x%02x %s", addr, reason, bt_hci_err_to_str(reason));

	scan_start();
}

/* Always reject connection parameter update requests in order to keep ACL interval aligned with CIS
 * and BIS ISO-interval
 */
static bool le_param_req_reject(struct bt_conn *conn, struct bt_le_conn_param *param)
{
	return false;
}

static struct bt_conn_cb conn_callbacks = {
	.connected = connected,
	.disconnected = disconnected,
	.le_param_req = le_param_req_reject,
};

void combined_cis_bis_start(void)
{
	struct bt_iso_cig_param param;
	struct bt_iso_cig *cig;
	int err;

	iso_rx_init(RETRANSMISSION_NUMBER, process_rcvd_sdu_cb);
	iso_tx_init(RETRANSMISSION_NUMBER, set_sdu_data_cb);

	bt_le_scan_cb_register(&scan_callbacks);
	bt_conn_cb_register(&conn_callbacks);

	memset(&param, 0, sizeof(param));
	param.cis_channels = iso_rx_channels_get();
	param.num_cis = 1;
	param.sca = BT_GAP_SCA_UNKNOWN;
	param.packing = 0;
	param.framing = 0;
	param.c_to_p_latency = MAX_TRANSPORT_LATENCY_MS;
	param.p_to_c_latency = MAX_TRANSPORT_LATENCY_MS;
	param.c_to_p_interval = SDU_INTERVAL_US;
	param.p_to_c_interval = SDU_INTERVAL_US;

	err = bt_iso_cig_create(&param, &cig);
	if (err != 0) {
		LOG_ERR("Failed to create CIG (%d)", err);
		return;
	}

	scan_start();

	LOG_INF("CIS central started scanning for peripheral(s)");
}
```

## src/iso_rx.c
```c
/*
 * Copyright (c) 2024 Nordic Semiconductor ASA
 *
 * SPDX-License-Identifier: LicenseRef-Nordic-5-Clause
 */


#include <zephyr/kernel.h>
#include <zephyr/bluetooth/iso.h>
#include <zephyr/device.h>
#include "iso_combined_bis_and_cis.h"

#include <zephyr/logging/log.h>
LOG_MODULE_REGISTER(app_iso_rx, LOG_LEVEL_INF);

static iso_rx_process_sdu_data_cb_t process_rcvd_sdu;

static uint32_t rcvd_sdu_cnt;
static uint32_t missed_sdu_cnt;
static uint32_t empty_sdu_cnt;

static void iso_recv(struct bt_iso_chan *chan, const struct bt_iso_recv_info *info,
		     struct net_buf *buf);
static void iso_connected(struct bt_iso_chan *chan);
static void iso_disconnected(struct bt_iso_chan *chan, uint8_t reason);

static struct bt_iso_chan_ops iso_ops = {
	.recv = iso_recv,
	.connected = iso_connected,
	.disconnected = iso_disconnected,
};

static struct bt_iso_chan_io_qos iso_rx_qos = {
	.sdu = CONFIG_BT_ISO_TX_MTU,
	.phy = BT_GAP_LE_PHY_2M,
};

static struct bt_iso_chan_qos iso_qos = {
	.rx = &iso_rx_qos,
};

static struct bt_iso_chan iso_chan[] = {
	{
		.ops = &iso_ops,
		.qos = &iso_qos,
	},
};

static struct bt_iso_chan *iso_channels[] = {
	&iso_chan[0],
};

static void iso_recv(struct bt_iso_chan *chan, const struct bt_iso_recv_info *info,
		     struct net_buf *buf)
{
	if (info->flags & BT_ISO_FLAGS_VALID) {
		if (process_rcvd_sdu) {
			process_rcvd_sdu(buf);
		}
		rcvd_sdu_cnt++;
		if (buf->len == 0) {
			empty_sdu_cnt++;
		}
	} else {
		missed_sdu_cnt++;
	}

	uint32_t total_sdu_count = rcvd_sdu_cnt + missed_sdu_cnt;

	if (total_sdu_count % 100 == 0) {
		LOG_INF("Received SDU: %d, empty SDU: %d, missed SDU: %d", rcvd_sdu_cnt,
			empty_sdu_cnt, missed_sdu_cnt);
	}
}

static void iso_connected(struct bt_iso_chan *chan)
{
	const struct bt_iso_chan_path hci_path = {
		.pid = BT_ISO_DATA_PATH_HCI,
		.format = BT_HCI_CODING_FORMAT_TRANSPARENT,
	};

	int err;
	struct bt_conn_info conn_info;
	struct bt_iso_info iso_info;

	err = bt_iso_chan_get_info(chan, &iso_info);
	if (err) {
		LOG_ERR("Failed obtaining ISO info");
		return;
	}

	err = bt_conn_get_info(chan->iso, &conn_info);
	if (err) {
		LOG_ERR("Failed obtaining conn info");
		return;
	}

	LOG_INF("ISO RX Channel connected");

	err = bt_iso_setup_data_path(chan, BT_HCI_DATAPATH_DIR_CTLR_TO_HOST, &hci_path);
	if (err != 0) {
		LOG_ERR("Failed to setup ISO RX data path: %d", err);
	}
}

static void iso_disconnected(struct bt_iso_chan *chan, uint8_t reason)
{
	LOG_INF("ISO Channel disconnected with reason 0x%02x", reason);
}

void iso_rx_init(uint8_t retransmission_number, iso_rx_process_sdu_data_cb_t process_sdu_data_cb)
{
	iso_rx_qos.rtn = retransmission_number;
	process_rcvd_sdu = process_sdu_data_cb;
}

struct bt_iso_chan **iso_rx_channels_get(void)
{
	return iso_channels;
}
```

## src/iso_tx.c
```c
/*
 * Copyright (c) 2024 Nordic Semiconductor ASA
 *
 * SPDX-License-Identifier: LicenseRef-Nordic-5-Clause
 */

#include <zephyr/kernel.h>
#include <zephyr/device.h>
#include <zephyr/bluetooth/iso.h>
#include <sdc_hci_vs.h>
#include <sdc_hci.h>

#include "iso_combined_bis_and_cis.h"

#include <zephyr/logging/log.h>
LOG_MODULE_REGISTER(app_iso_tx, LOG_LEVEL_INF);

static void iso_sent(struct bt_iso_chan *chan);
static void iso_connected(struct bt_iso_chan *chan);
static void iso_disconnected(struct bt_iso_chan *chan, uint8_t reason);

NET_BUF_POOL_FIXED_DEFINE(tx_pool, 1, BT_ISO_SDU_BUF_SIZE(CONFIG_BT_ISO_TX_MTU),
			  CONFIG_BT_CONN_TX_USER_DATA_SIZE, NULL);

static uint32_t num_sdus_sent;
static iso_tx_set_sdu_data_cb_t set_sdu_data;

static struct bt_iso_chan_ops iso_ops = {
	.connected = iso_connected,
	.sent = iso_sent,
	.disconnected = iso_disconnected,
};

static struct bt_iso_chan_io_qos iso_tx_qos = {
	.sdu = CONFIG_BT_ISO_TX_MTU,
	.phy = BT_GAP_LE_PHY_2M,
};

static struct bt_iso_chan_qos iso_qos = {
	.tx = &iso_tx_qos,
};

/* Create lists of ISO channels and pointers to ISO channels. */
static struct bt_iso_chan iso_channels[] = {{.ops = &iso_ops, .qos = &iso_qos}};

static struct bt_iso_chan *iso_channel_pointers[] = {&iso_channels[0]};

/* Store info about the ISO channels in use. */
static uint8_t roles[1];
static struct bt_iso_info iso_infos[1];

static int send_next_sdu(struct bt_iso_chan *chan)
{
	struct net_buf *buf;
	int ret = 0;

	buf = net_buf_alloc(&tx_pool, K_FOREVER);
	if (!buf) {
		LOG_ERR("Data buffer allocate timeout");
		ret = -ENOMEM;
	}

	if (set_sdu_data && !ret) {
		net_buf_reserve(buf, BT_ISO_CHAN_SEND_RESERVE);
		set_sdu_data(buf);
		ret = bt_iso_chan_send(chan, buf, 0);
		if (ret < 0) {
			LOG_ERR("Unable to send data");
			net_buf_unref(buf);
		}
	}

	return ret;
}

static void send_next_sdu_on_a_channel(void)
{
	int err;

	if (iso_channels[0].state != BT_ISO_STATE_CONNECTED) {
		LOG_ERR("Failed sending SDU, stream is not connected");
		return;
	}

	err = send_next_sdu(&iso_channels[0]);
	if (err) {
		LOG_ERR("Failed sending SDU, counter %d", num_sdus_sent);
		return;
	}
}

static void iso_connected(struct bt_iso_chan *chan)
{
	const struct bt_iso_chan_path hci_path = {
		.pid = BT_ISO_DATA_PATH_HCI,
		.format = BT_HCI_CODING_FORMAT_TRANSPARENT,
	};

	int err;
	struct bt_conn_info conn_info;
	uint8_t chan_index = ARRAY_INDEX(iso_channels, chan);

	err = bt_iso_chan_get_info(chan, &iso_infos[chan_index]);
	if (err) {
		LOG_ERR("Failed obtaining ISO info");
		return;
	}

	err = bt_conn_get_info(chan->iso, &conn_info);
	if (err) {
		LOG_ERR("Failed obtaining conn info");
		return;
	}

	roles[chan_index] = conn_info.role;

	/* Send the first SDU immediately.
	 */
	send_next_sdu_on_a_channel();
	LOG_INF("ISO TX Channel connected");

	err = bt_iso_setup_data_path(chan, BT_HCI_DATAPATH_DIR_HOST_TO_CTLR, &hci_path);
	if (err != 0) {
		LOG_ERR("Failed to setup ISO TX data path: %d", err);
	}
}

static void iso_disconnected(struct bt_iso_chan *chan, uint8_t reason)
{
	LOG_INF("ISO Channel index %d disconnected with reason 0x%02x",
		ARRAY_INDEX(iso_channels, chan), reason);
}

static void iso_sent(struct bt_iso_chan *chan)
{
	if (num_sdus_sent % 100 == 0) {
		LOG_INF("Sent SDU, counter: %d", num_sdus_sent);
	}

	num_sdus_sent++;

	send_next_sdu_on_a_channel();
}

void iso_tx_init(uint8_t retransmission_number, iso_tx_set_sdu_data_cb_t set_sdu_data_cb)
{
	iso_tx_qos.rtn = retransmission_number;
	set_sdu_data = set_sdu_data_cb;
}

struct bt_iso_chan **iso_tx_channels_get(void)
{
	return iso_channel_pointers;
}
```
