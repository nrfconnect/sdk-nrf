## samples/bluetooth/peripheral_power_profiling/sample.yaml
```yaml
sample:
  description: Bluetooth Low Energy Power Profiling sample
  name: Bluetooth LE Power Profiling
common:
  sysbuild: true
  tags:
    - bluetooth
    - ci_build
    - sysbuild
    - ppk_power_measure
    - ci_samples_bluetooth
  harness: pytest
  harness_config:
    fixture: ppk_power_measure
    pytest_root:
      - "${CUSTOM_ROOT_TEST_DIR}/test_measure_power_consumption.py::test_measure_and_data_dump_power_54L_ble_power_profiling"
  timeout: 150
tests:
  sample.bluetooth.peripheral_power_profiling:
    build_only: true
    integration_platforms:
      - nrf54l15dk/nrf54l15/cpuapp
      - nrf54ls05dk/nrf54ls05b/cpuapp
    platform_allow:
      - nrf52dk/nrf52832
      - nrf52833dk/nrf52833
      - nrf52840dk/nrf52840
      - nrf5340dk/nrf5340/cpuapp
      - nrf5340dk/nrf5340/cpuapp/ns
      - nrf54l15dk/nrf54l05/cpuapp
      - nrf54l15dk/nrf54l10/cpuapp
      - nrf54l15dk/nrf54l10/cpuapp/ns
      - nrf54l15dk/nrf54l15/cpuapp
      - nrf54l15dk/nrf54l15/cpuapp/ns
      - nrf54lm20dk/nrf54lm20a/cpuapp
      - nrf54lv10dk/nrf54lv10a/cpuapp
      - nrf54lv10dk/nrf54lv10a/cpuapp/ns
      - nrf54ls05dk/nrf54ls05b/cpuapp
      - nrf54h20dk/nrf54h20/cpuapp

  sample.bluetooth.peripheral_power_profiling.auto_conn_advert_lfrc_0dBm_100ms:
    integration_platforms: &ppk_power_measure_integration_platforms
      - nrf54l15dk/nrf54l15/cpuapp
      - nrf54ls05dk/nrf54ls05b/cpuapp
    platform_allow: &ppk_power_measure_platform_allow
      - nrf54l15dk/nrf54l15/cpuapp
      - nrf54ls05dk/nrf54ls05b/cpuapp
      - nrf54l15dk/nrf54l15/cpuapp/ns
      - nrf54lm20dk/nrf54lm20a/cpuapp
      - nrf54lm20dk/nrf54lm20a/cpuapp/ns
      - nrf54lv10dk/nrf54lv10a/cpuapp
      - nrf54lv10dk/nrf54lv10a/cpuapp/ns
    extra_args:
      - platform:nrf54l15dk/nrf54l15/cpuapp:"EXTRA_DTC_OVERLAY_FILE=boards/nrf54l15dk_nrf54l15_cpuapp_auto_conn_advert.overlay"
      - platform:nrf54lm20dk/nrf54lm20a/cpuapp:"EXTRA_DTC_OVERLAY_FILE=boards/nrf54lm20dk_nrf54lm20a_cpuapp_auto_conn_advert.overlay"
      - platform:nrf54lv10dk/nrf54lv10a/cpuapp:"EXTRA_DTC_OVERLAY_FILE=boards/nrf54lv10dk_nrf54lv10a_cpuapp_auto_conn_advert.overlay"
      - platform:nrf54lv10dk/nrf54lv10a/cpuapp/ns:"EXTRA_DTC_OVERLAY_FILE=boards/nrf54lv10dk_nrf54lv10a_cpuapp_auto_conn_advert.overlay"
      - platform:nrf54lv10dk@0.7.0/nrf54lv10a/cpuapp:"EXTRA_DTC_OVERLAY_FILE=boards/nrf54lv10dk_nrf54lv10a_cpuapp_auto_conn_advert.overlay"
      - platform:nrf54lv10dk@0.7.0/nrf54lv10a/cpuapp/ns:"EXTRA_DTC_OVERLAY_FILE=boards/nrf54lv10dk_nrf54lv10a_cpuapp_auto_conn_advert.overlay"
      - platform:nrf54ls05dk/nrf54ls05b/cpuapp:"EXTRA_DTC_OVERLAY_FILE=boards/nrf54ls05dk_nrf54ls05b_cpuapp_auto_conn_advert.overlay"
      - CONFIG_CLOCK_CONTROL_NRF_K32SRC_RC=y
      - CONFIG_BT_CTLR_TX_PWR_0=y
      - CONFIG_BT_POWER_PROFILING_DATA_LENGTH=31
      - CONFIG_BT_POWER_PROFILING_NOTIFICATION_INTERVAL=100

  sample.bluetooth.peripheral_power_profiling.auto_conn_advert_lfrc_0dBm_30ms:
    integration_platforms: *ppk_power_measure_integration_platforms
    platform_allow: *ppk_power_measure_platform_allow
    extra_args:
      - platform:nrf54l15dk/nrf54l15/cpuapp:"EXTRA_DTC_OVERLAY_FILE=boards/nrf54l15dk_nrf54l15_cpuapp_auto_conn_advert.overlay"
      - platform:nrf54lm20dk/nrf54lm20a/cpuapp:"EXTRA_DTC_OVERLAY_FILE=boards/nrf54lm20dk_nrf54lm20a_cpuapp_auto_conn_advert.overlay"
      - platform:nrf54lv10dk/nrf54lv10a/cpuapp:"EXTRA_DTC_OVERLAY_FILE=boards/nrf54lv10dk_nrf54lv10a_cpuapp_auto_conn_advert.overlay"
      - platform:nrf54lv10dk/nrf54lv10a/cpuapp/ns:"EXTRA_DTC_OVERLAY_FILE=boards/nrf54lv10dk_nrf54lv10a_cpuapp_auto_conn_advert.overlay"
      - platform:nrf54lv10dk@0.7.0/nrf54lv10a/cpuapp:"EXTRA_DTC_OVERLAY_FILE=boards/nrf54lv10dk_nrf54lv10a_cpuapp_auto_conn_advert.overlay"
      - platform:nrf54lv10dk@0.7.0/nrf54lv10a/cpuapp/ns:"EXTRA_DTC_OVERLAY_FILE=boards/nrf54lv10dk_nrf54lv10a_cpuapp_auto_conn_advert.overlay"
      - platform:nrf54ls05dk/nrf54ls05b/cpuapp:"EXTRA_DTC_OVERLAY_FILE=boards/nrf54ls05dk_nrf54ls05b_cpuapp_auto_conn_advert.overlay"
      - CONFIG_CLOCK_CONTROL_NRF_K32SRC_RC=y
      - CONFIG_BT_CTLR_TX_PWR_0=y
      - CONFIG_BT_POWER_PROFILING_DATA_LENGTH=27
      - CONFIG_BT_POWER_PROFILING_NOTIFICATION_INTERVAL=30

  sample.bluetooth.peripheral_power_profiling.auto_conn_advert_lfrc_8dBm_100ms:
    integration_platforms: *ppk_power_measure_integration_platforms
    platform_allow: *ppk_power_measure_platform_allow
    extra_args:
      - platform:nrf54l15dk/nrf54l15/cpuapp:"EXTRA_DTC_OVERLAY_FILE=boards/nrf54l15dk_nrf54l15_cpuapp_auto_conn_advert.overlay"
      - platform:nrf54lm20dk/nrf54lm20a/cpuapp:"EXTRA_DTC_OVERLAY_FILE=boards/nrf54lm20dk_nrf54lm20a_cpuapp_auto_conn_advert.overlay"
      - platform:nrf54lv10dk/nrf54lv10a/cpuapp:"EXTRA_DTC_OVERLAY_FILE=boards/nrf54lv10dk_nrf54lv10a_cpuapp_auto_conn_advert.overlay"
      - platform:nrf54lv10dk/nrf54lv10a/cpuapp/ns:"EXTRA_DTC_OVERLAY_FILE=boards/nrf54lv10dk_nrf54lv10a_cpuapp_auto_conn_advert.overlay"
      - platform:nrf54lv10dk@0.7.0/nrf54lv10a/cpuapp:"EXTRA_DTC_OVERLAY_FILE=boards/nrf54lv10dk_nrf54lv10a_cpuapp_auto_conn_advert.overlay"
      - platform:nrf54lv10dk@0.7.0/nrf54lv10a/cpuapp/ns:"EXTRA_DTC_OVERLAY_FILE=boards/nrf54lv10dk_nrf54lv10a_cpuapp_auto_conn_advert.overlay"
      - platform:nrf54ls05dk/nrf54ls05b/cpuapp:"EXTRA_DTC_OVERLAY_FILE=boards/nrf54ls05dk_nrf54ls05b_cpuapp_auto_conn_advert.overlay"
      - CONFIG_CLOCK_CONTROL_NRF_K32SRC_RC=y
      - CONFIG_BT_CTLR_TX_PWR_PLUS_8=y
      - CONFIG_BT_POWER_PROFILING_DATA_LENGTH=31
      - CONFIG_BT_POWER_PROFILING_NOTIFICATION_INTERVAL=100

  sample.bluetooth.peripheral_power_profiling.auto_conn_advert_lfrc_8dBm_30ms:
    integration_platforms: *ppk_power_measure_integration_platforms
    platform_allow: *ppk_power_measure_platform_allow
    extra_args:
      - platform:nrf54l15dk/nrf54l15/cpuapp:"EXTRA_DTC_OVERLAY_FILE=boards/nrf54l15dk_nrf54l15_cpuapp_auto_conn_advert.overlay"
      - platform:nrf54lm20dk/nrf54lm20a/cpuapp:"EXTRA_DTC_OVERLAY_FILE=boards/nrf54lm20dk_nrf54lm20a_cpuapp_auto_conn_advert.overlay"
      - platform:nrf54lv10dk/nrf54lv10a/cpuapp:"EXTRA_DTC_OVERLAY_FILE=boards/nrf54lv10dk_nrf54lv10a_cpuapp_auto_conn_advert.overlay"
      - platform:nrf54lv10dk/nrf54lv10a/cpuapp/ns:"EXTRA_DTC_OVERLAY_FILE=boards/nrf54lv10dk_nrf54lv10a_cpuapp_auto_conn_advert.overlay"
      - platform:nrf54lv10dk@0.7.0/nrf54lv10a/cpuapp:"EXTRA_DTC_OVERLAY_FILE=boards/nrf54lv10dk_nrf54lv10a_cpuapp_auto_conn_advert.overlay"
      - platform:nrf54lv10dk@0.7.0/nrf54lv10a/cpuapp/ns:"EXTRA_DTC_OVERLAY_FILE=boards/nrf54lv10dk_nrf54lv10a_cpuapp_auto_conn_advert.overlay"
      - platform:nrf54ls05dk/nrf54ls05b/cpuapp:"EXTRA_DTC_OVERLAY_FILE=boards/nrf54ls05dk_nrf54ls05b_cpuapp_auto_conn_advert.overlay"
      - CONFIG_CLOCK_CONTROL_NRF_K32SRC_RC=y
      - CONFIG_BT_CTLR_TX_PWR_PLUS_8=y
      - CONFIG_BT_POWER_PROFILING_DATA_LENGTH=27
      - CONFIG_BT_POWER_PROFILING_NOTIFICATION_INTERVAL=30

  sample.bluetooth.peripheral_power_profiling.auto_conn_advert_lfxo_0dBm_100ms:
    integration_platforms: *ppk_power_measure_integration_platforms
    platform_allow: *ppk_power_measure_platform_allow
    extra_args:
      - platform:nrf54l15dk/nrf54l15/cpuapp:"EXTRA_DTC_OVERLAY_FILE=boards/nrf54l15dk_nrf54l15_cpuapp_auto_conn_advert.overlay"
      - platform:nrf54lm20dk/nrf54lm20a/cpuapp:"EXTRA_DTC_OVERLAY_FILE=boards/nrf54lm20dk_nrf54lm20a_cpuapp_auto_conn_advert.overlay"
      - platform:nrf54lv10dk/nrf54lv10a/cpuapp:"EXTRA_DTC_OVERLAY_FILE=boards/nrf54lv10dk_nrf54lv10a_cpuapp_auto_conn_advert.overlay"
      - platform:nrf54lv10dk/nrf54lv10a/cpuapp/ns:"EXTRA_DTC_OVERLAY_FILE=boards/nrf54lv10dk_nrf54lv10a_cpuapp_auto_conn_advert.overlay"
      - platform:nrf54lv10dk@0.7.0/nrf54lv10a/cpuapp:"EXTRA_DTC_OVERLAY_FILE=boards/nrf54lv10dk_nrf54lv10a_cpuapp_auto_conn_advert.overlay"
      - platform:nrf54lv10dk@0.7.0/nrf54lv10a/cpuapp/ns:"EXTRA_DTC_OVERLAY_FILE=boards/nrf54lv10dk_nrf54lv10a_cpuapp_auto_conn_advert.overlay"
      - platform:nrf54ls05dk/nrf54ls05b/cpuapp:"EXTRA_DTC_OVERLAY_FILE=boards/nrf54ls05dk_nrf54ls05b_cpuapp_auto_conn_advert.overlay"
      - CONFIG_CLOCK_CONTROL_NRF_K32SRC_XTAL=y
      - CONFIG_BT_CTLR_TX_PWR_0=y
      - CONFIG_BT_POWER_PROFILING_DATA_LENGTH=31
      - CONFIG_BT_POWER_PROFILING_NOTIFICATION_INTERVAL=100

  sample.bluetooth.peripheral_power_profiling.auto_conn_advert_lfxo_0dBm_30ms:
    integration_platforms: *ppk_power_measure_integration_platforms
    platform_allow: *ppk_power_measure_platform_allow
    extra_args:
      - platform:nrf54l15dk/nrf54l15/cpuapp:"EXTRA_DTC_OVERLAY_FILE=boards/nrf54l15dk_nrf54l15_cpuapp_auto_conn_advert.overlay"
      - platform:nrf54lm20dk/nrf54lm20a/cpuapp:"EXTRA_DTC_OVERLAY_FILE=boards/nrf54lm20dk_nrf54lm20a_cpuapp_auto_conn_advert.overlay"
      - platform:nrf54lv10dk/nrf54lv10a/cpuapp:"EXTRA_DTC_OVERLAY_FILE=boards/nrf54lv10dk_nrf54lv10a_cpuapp_auto_conn_advert.overlay"
      - platform:nrf54lv10dk/nrf54lv10a/cpuapp/ns:"EXTRA_DTC_OVERLAY_FILE=boards/nrf54lv10dk_nrf54lv10a_cpuapp_auto_conn_advert.overlay"
      - platform:nrf54lv10dk@0.7.0/nrf54lv10a/cpuapp:"EXTRA_DTC_OVERLAY_FILE=boards/nrf54lv10dk_nrf54lv10a_cpuapp_auto_conn_advert.overlay"
      - platform:nrf54lv10dk@0.7.0/nrf54lv10a/cpuapp/ns:"EXTRA_DTC_OVERLAY_FILE=boards/nrf54lv10dk_nrf54lv10a_cpuapp_auto_conn_advert.overlay"
      - platform:nrf54ls05dk/nrf54ls05b/cpuapp:"EXTRA_DTC_OVERLAY_FILE=boards/nrf54ls05dk_nrf54ls05b_cpuapp_auto_conn_advert.overlay"
      - CONFIG_CLOCK_CONTROL_NRF_K32SRC_XTAL=y
      - CONFIG_BT_CTLR_TX_PWR_0=y
      - CONFIG_BT_POWER_PROFILING_DATA_LENGTH=27
      - CONFIG_BT_POWER_PROFILING_NOTIFICATION_INTERVAL=30

  sample.bluetooth.peripheral_power_profiling.auto_conn_advert_lfxo_8dBm_100ms:
    integration_platforms: *ppk_power_measure_integration_platforms
    platform_allow: *ppk_power_measure_platform_allow
    extra_args:
      - platform:nrf54l15dk/nrf54l15/cpuapp:"EXTRA_DTC_OVERLAY_FILE=boards/nrf54l15dk_nrf54l15_cpuapp_auto_conn_advert.overlay"
      - platform:nrf54lm20dk/nrf54lm20a/cpuapp:"EXTRA_DTC_OVERLAY_FILE=boards/nrf54lm20dk_nrf54lm20a_cpuapp_auto_conn_advert.overlay"
      - platform:nrf54lv10dk/nrf54lv10a/cpuapp:"EXTRA_DTC_OVERLAY_FILE=boards/nrf54lv10dk_nrf54lv10a_cpuapp_auto_conn_advert.overlay"
      - platform:nrf54lv10dk/nrf54lv10a/cpuapp/ns:"EXTRA_DTC_OVERLAY_FILE=boards/nrf54lv10dk_nrf54lv10a_cpuapp_auto_conn_advert.overlay"
      - platform:nrf54lv10dk@0.7.0/nrf54lv10a/cpuapp:"EXTRA_DTC_OVERLAY_FILE=boards/nrf54lv10dk_nrf54lv10a_cpuapp_auto_conn_advert.overlay"
      - platform:nrf54lv10dk@0.7.0/nrf54lv10a/cpuapp/ns:"EXTRA_DTC_OVERLAY_FILE=boards/nrf54lv10dk_nrf54lv10a_cpuapp_auto_conn_advert.overlay"
      - platform:nrf54ls05dk/nrf54ls05b/cpuapp:"EXTRA_DTC_OVERLAY_FILE=boards/nrf54ls05dk_nrf54ls05b_cpuapp_auto_conn_advert.overlay"
      - CONFIG_CLOCK_CONTROL_NRF_K32SRC_XTAL=y
      - CONFIG_BT_CTLR_TX_PWR_PLUS_8=y
      - CONFIG_BT_POWER_PROFILING_DATA_LENGTH=31
      - CONFIG_BT_POWER_PROFILING_NOTIFICATION_INTERVAL=100

  sample.bluetooth.peripheral_power_profiling.auto_conn_advert_lfxo_8dBm_30ms:
    integration_platforms: *ppk_power_measure_integration_platforms
    platform_allow: *ppk_power_measure_platform_allow
    extra_args:
      - platform:nrf54l15dk/nrf54l15/cpuapp:"EXTRA_DTC_OVERLAY_FILE=boards/nrf54l15dk_nrf54l15_cpuapp_auto_conn_advert.overlay"
      - platform:nrf54lm20dk/nrf54lm20a/cpuapp:"EXTRA_DTC_OVERLAY_FILE=boards/nrf54lm20dk_nrf54lm20a_cpuapp_auto_conn_advert.overlay"
      - platform:nrf54lv10dk/nrf54lv10a/cpuapp:"EXTRA_DTC_OVERLAY_FILE=boards/nrf54lv10dk_nrf54lv10a_cpuapp_auto_conn_advert.overlay"
      - platform:nrf54lv10dk/nrf54lv10a/cpuapp/ns:"EXTRA_DTC_OVERLAY_FILE=boards/nrf54lv10dk_nrf54lv10a_cpuapp_auto_conn_advert.overlay"
      - platform:nrf54lv10dk@0.7.0/nrf54lv10a/cpuapp:"EXTRA_DTC_OVERLAY_FILE=boards/nrf54lv10dk_nrf54lv10a_cpuapp_auto_conn_advert.overlay"
      - platform:nrf54lv10dk@0.7.0/nrf54lv10a/cpuapp/ns:"EXTRA_DTC_OVERLAY_FILE=boards/nrf54lv10dk_nrf54lv10a_cpuapp_auto_conn_advert.overlay"
      - platform:nrf54ls05dk/nrf54ls05b/cpuapp:"EXTRA_DTC_OVERLAY_FILE=boards/nrf54ls05dk_nrf54ls05b_cpuapp_auto_conn_advert.overlay"
      - CONFIG_CLOCK_CONTROL_NRF_K32SRC_XTAL=y
      - CONFIG_BT_CTLR_TX_PWR_PLUS_8=y
      - CONFIG_BT_POWER_PROFILING_DATA_LENGTH=27
      - CONFIG_BT_POWER_PROFILING_NOTIFICATION_INTERVAL=30

  sample.bluetooth.peripheral_power_profiling.auto_non_conn_advert_lfxo_0dbm_100ms:
    integration_platforms: *ppk_power_measure_integration_platforms
    platform_allow: *ppk_power_measure_platform_allow
    extra_args:
      - platform:nrf54l15dk/nrf54l15/cpuapp:"EXTRA_DTC_OVERLAY_FILE=boards/nrf54l15dk_nrf54l15_cpuapp_auto_non_conn_advert.overlay"
      - platform:nrf54lm20dk/nrf54lm20a/cpuapp:"EXTRA_DTC_OVERLAY_FILE=boards/nrf54lm20dk_nrf54lm20a_cpuapp_non_conn_advert.overlay"
      - platform:nrf54lv10dk/nrf54lv10a/cpuapp:"EXTRA_DTC_OVERLAY_FILE=boards/nrf54lv10dk_nrf54lv10a_cpuapp_non_conn_advert.overlay"
      - platform:nrf54lv10dk/nrf54lv10a/cpuapp/ns:"EXTRA_DTC_OVERLAY_FILE=boards/nrf54lv10dk_nrf54lv10a_cpuapp_non_conn_advert.overlay"
      - platform:nrf54lv10dk@0.7.0/nrf54lv10a/cpuapp:"EXTRA_DTC_OVERLAY_FILE=boards/nrf54lv10dk_nrf54lv10a_cpuapp_non_conn_advert.overlay"
      - platform:nrf54lv10dk@0.7.0/nrf54lv10a/cpuapp/ns:"EXTRA_DTC_OVERLAY_FILE=boards/nrf54lv10dk_nrf54lv10a_cpuapp_non_conn_advert.overlay"
      - platform:nrf54ls05dk/nrf54ls05b/cpuapp:"EXTRA_DTC_OVERLAY_FILE=boards/nrf54ls05dk_nrf54ls05b_cpuapp_auto_non_conn_advert.overlay"
      - CONFIG_CLOCK_CONTROL_NRF_K32SRC_XTAL=y
      - CONFIG_BT_CTLR_TX_PWR_0=y
      - CONFIG_BT_POWER_PROFILING_DATA_LENGTH=31
      - CONFIG_BT_POWER_PROFILING_NOTIFICATION_INTERVAL=100

  sample.bluetooth.peripheral_power_profiling.auto_non_conn_advert_lfxo_0dbm_30ms:
    integration_platforms: *ppk_power_measure_integration_platforms
    platform_allow: *ppk_power_measure_platform_allow
    extra_args:
      - platform:nrf54l15dk/nrf54l15/cpuapp:"EXTRA_DTC_OVERLAY_FILE=boards/nrf54l15dk_nrf54l15_cpuapp_auto_non_conn_advert.overlay"
      - platform:nrf54lm20dk/nrf54lm20a/cpuapp:"EXTRA_DTC_OVERLAY_FILE=boards/nrf54lm20dk_nrf54lm20a_cpuapp_non_conn_advert.overlay"
      - platform:nrf54lv10dk/nrf54lv10a/cpuapp:"EXTRA_DTC_OVERLAY_FILE=boards/nrf54lv10dk_nrf54lv10a_cpuapp_non_conn_advert.overlay"
      - platform:nrf54lv10dk/nrf54lv10a/cpuapp/ns:"EXTRA_DTC_OVERLAY_FILE=boards/nrf54lv10dk_nrf54lv10a_cpuapp_non_conn_advert.overlay"
      - platform:nrf54lv10dk@0.7.0/nrf54lv10a/cpuapp:"EXTRA_DTC_OVERLAY_FILE=boards/nrf54lv10dk_nrf54lv10a_cpuapp_non_conn_advert.overlay"
      - platform:nrf54lv10dk@0.7.0/nrf54lv10a/cpuapp/ns:"EXTRA_DTC_OVERLAY_FILE=boards/nrf54lv10dk_nrf54lv10a_cpuapp_non_conn_advert.overlay"
      - platform:nrf54ls05dk/nrf54ls05b/cpuapp:"EXTRA_DTC_OVERLAY_FILE=boards/nrf54ls05dk_nrf54ls05b_cpuapp_auto_non_conn_advert.overlay"
      - CONFIG_CLOCK_CONTROL_NRF_K32SRC_XTAL=y
      - CONFIG_BT_CTLR_TX_PWR_0=y
      - CONFIG_BT_POWER_PROFILING_DATA_LENGTH=27
      - CONFIG_BT_POWER_PROFILING_NOTIFICATION_INTERVAL=30

  sample.bluetooth.peripheral_power_profiling.llvm:
    toolchain_allow: llvm
    integration_platforms:
      - nrf54l15dk/nrf54l15/cpuapp
      - nrf54lm20dk/nrf54lm20a/cpuapp
      - nrf54lv10dk/nrf54lv10a/cpuapp
      - nrf54ls05dk/nrf54ls05b/cpuapp
    platform_allow:
      - nrf54l15dk/nrf54l15/cpuapp
      - nrf54l15dk/nrf54l15/cpuapp/ns
      - nrf54lm20dk/nrf54lm20a/cpuapp
      - nrf54lm20dk/nrf54lm20a/cpuapp/ns
      - nrf54lv10dk/nrf54lv10a/cpuapp
      - nrf54ls05dk/nrf54ls05b/cpuapp
```
