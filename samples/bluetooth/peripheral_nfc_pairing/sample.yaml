## samples/bluetooth/peripheral_nfc_pairing/sample.yaml
```yaml
sample:
  description: Bluetooth Low Energy Peripheral NFC Pairing reference sample
  name: Bluetooth Low Energy Peripheral NFC Pairing reference
tests:
  sample.bluetooth.peripheral_nfc_pairing:
    sysbuild: true
    build_only: true
    integration_platforms:
      - nrf52840dk/nrf52840
      - nrf52dk/nrf52832
      - nrf5340dk/nrf5340/cpuapp
      - nrf5340dk/nrf5340/cpuapp/ns
      - nrf54l15dk/nrf54l05/cpuapp
      - nrf54l15dk/nrf54l10/cpuapp
      - nrf54l15dk/nrf54l15/cpuapp
      - nrf54h20dk/nrf54h20/cpuapp
      - nrf54lm20dk/nrf54lm20a/cpuapp
    platform_allow:
      - nrf52840dk/nrf52840
      - nrf52dk/nrf52832
      - nrf5340dk/nrf5340/cpuapp
      - nrf5340dk/nrf5340/cpuapp/ns
      - nrf54l15dk/nrf54l05/cpuapp
      - nrf54l15dk/nrf54l10/cpuapp
      - nrf54l15dk/nrf54l15/cpuapp
      - nrf54h20dk/nrf54h20/cpuapp
      - nrf54lm20dk/nrf54lm20a/cpuapp
    tags:
      - bluetooth
      - ci_build
      - sysbuild
```

## samples/bluetooth/peripheral_power_profiling/Kconfig.sysbuild
```kconfig
#
# Copyright (c) 2023 Nordic Semiconductor
#
# SPDX-License-Identifier: LicenseRef-Nordic-5-Clause
#

config PARTITION_MANAGER
	default n if !BOARD_IS_NON_SECURE

# User-assignable (sysbuild_tcm.conf): gates NETCORE_REMOTE without creating a Kconfig loop with
# NRF_DEFAULT_IPC_RADIO (which has no prompt and cannot be set from .conf).
config PPP_IPC_RADIO_TCM
	bool "ipc_radio in cpurad TCM (radio_loader, no MCUboot)"
	depends on SOC_NRF54H20_CPUAPP
	default n
	help
	  ipc_radio runs from TCM; default cpuapp flash layout; CPURAD slots split for
	  radio_loader + stored firmware. No MCUboot. Use FILE_SUFFIX=tcm.

# Merges with the Nordic sysbuild NETCORE choice: ipc_radio in MRAM (default) or
# ipc_radio relocated to cpurad TCM (PPP_IPC_RADIO_TCM + FILE_SUFFIX=tcm).
choice NETCORE
	default NETCORE_REMOTE if PPP_IPC_RADIO_TCM

config NETCORE_REMOTE
	bool "ipc_radio relocated to TCM (nRF54H20 radio_loader)"
	depends on SOC_NRF54H20_CPUAPP
	help
	  Build ipc_radio for cpurad from TCM using radio_loader and static devicetree
	  partitions. Use west build ... -- -DFILE_SUFFIX=tcm (no MCUboot).

endchoice

config NETCORE_IMAGE_NAME
	default "remote" if NETCORE_REMOTE

config NETCORE_IMAGE_PATH
	default "$(ZEPHYR_NRF_MODULE_DIR)/applications/ipc_radio" if NETCORE_REMOTE

config NRF_DEFAULT_IPC_RADIO
	default n if PPP_IPC_RADIO_TCM
	default y

source "share/sysbuild/Kconfig"
```

## samples/bluetooth/peripheral_power_profiling/boards/nrf5340dk_nrf5340_cpuapp.conf
```kconfig
#
# Copyright (c) 2022 Nordic Semiconductor ASA
#
# SPDX-License-Identifier: LicenseRef-Nordic-5-Clause
#

CONFIG_BT_CTLR_PHY_CODED=n

# Device power management
CONFIG_PM_DEVICE=y
CONFIG_PM_DEVICE_RUNTIME=y
```

## samples/bluetooth/peripheral_power_profiling/boards/nrf54h20dk_nrf54h20_cpuapp.conf
```kconfig
#
# Copyright (c) 2025 Nordic Semiconductor ASA
#
# SPDX-License-Identifier: LicenseRef-Nordic-5-Clause
#

# Enable device power management
CONFIG_PM_DEVICE=y
CONFIG_PM_DEVICE_RUNTIME=y

# Enable system power management
CONFIG_PM=y

# Enable power off state
CONFIG_POWEROFF=y

# Enable cpurad for sysbuild
CONFIG_SOC_NRF54H20_CPURAD_ENABLE=y

# MRAM latency optimization - allow MRAM to power off when idle
# This reduces power consumption by allowing MRAM power gating
# CONFIG_MRAM_LATENCY defaults to n, which allows MRAM power gating
CONFIG_MRAM_LATENCY_AUTO_REQ=n

# Peak Current Management
CONFIG_MPSL_FORCE_RRAM_ON_ALL_THE_TIME=n

# For peripheral only softdevice variant, disable Coded PHY support
CONFIG_BT_CTLR_PHY_CODED=n

# PHY update callback not used on this target
CONFIG_BT_USER_PHY_UPDATE=n

# ipc_radio in cpurad TCM: legacy advertising (no extended advertising sets).
CONFIG_BT_EXT_ADV=n
```

## samples/bluetooth/peripheral_power_profiling/boards/nrf54l15dk_nrf54l10_cpuapp_ns.conf
```kconfig
#
# Copyright (c) 2026 Nordic Semiconductor ASA
#
# SPDX-License-Identifier: LicenseRef-Nordic-5-Clause
#

CONFIG_PM_DEVICE=y
CONFIG_PM_DEVICE_RUNTIME=y

CONFIG_TFM_SFN=y
CONFIG_TFM_NRF_SYSTEM_OFF_SERVICE=y
```

## samples/bluetooth/peripheral_power_profiling/boards/nrf54l15dk_nrf54l15_cpuapp.conf
```kconfig
#
# Copyright (c) 2024 Nordic Semiconductor
#
# SPDX-License-Identifier: LicenseRef-Nordic-5-Clause
#

# Disable bonding
CONFIG_BT_SETTINGS=n
CONFIG_FLASH=n
CONFIG_FLASH_PAGE_LAYOUT=n
CONFIG_FLASH_MAP=n
CONFIG_NVS=n
CONFIG_SETTINGS=n
```

## samples/bluetooth/peripheral_power_profiling/boards/nrf54lm20pdk_nrf54lm20a_cpuapp.conf
```kconfig
#
# Copyright (c) 2025 Nordic Semiconductor ASA
#
# SPDX-License-Identifier: LicenseRef-Nordic-5-Clause
#

CONFIG_PM_DEVICE=y
CONFIG_PM_DEVICE_RUNTIME=y

# Workaround for issue NCSDK-33313

# Disable Cracken for all but RNG, and switch to software crypto.

CONFIG_PSA_CRYPTO_DRIVER_OBERON=y
CONFIG_PSA_CRYPTO_DRIVER_CRACEN=y

CONFIG_PSA_USE_CRACEN_CIPHER_DRIVER=n
CONFIG_PSA_USE_CRACEN_AEAD_DRIVER=n
CONFIG_PSA_USE_CRACEN_HASH_DRIVER=n
CONFIG_PSA_USE_CRACEN_MAC_DRIVER=n
CONFIG_PSA_USE_CRACEN_KEY_AGREEMENT_DRIVER=n
CONFIG_PSA_USE_CRACEN_ASYMMETRIC_ENCRYPTION_DRIVER=n
CONFIG_PSA_USE_CRACEN_KEY_MANAGEMENT_DRIVER=n
CONFIG_PSA_USE_CRACEN_KEY_DERIVATION_DRIVER=n
CONFIG_PSA_USE_CRACEN_PAKE_DRIVER=n
CONFIG_PSA_USE_CRACEN_ASYMMETRIC_SIGNATURE_DRIVER=n

# END of Workaround for issue NCSDK-33313
```

## samples/bluetooth/peripheral_power_profiling/boards/nrf54lv10dk_nrf54lv10a_cpuapp.conf
```kconfig
#
# Copyright (c) 2025 Nordic Semiconductor
#
# SPDX-License-Identifier: LicenseRef-Nordic-5-Clause
#

CONFIG_NFC_T2T_NRFXLIB=n

CONFIG_NFC_NDEF=n
CONFIG_NFC_NDEF_MSG=n
CONFIG_NFC_NDEF_RECORD=n
CONFIG_NFC_NDEF_LE_OOB_REC=n
CONFIG_NFC_NDEF_CH_MSG=n

CONFIG_PM_DEVICE=y
CONFIG_PM_DEVICE_RUNTIME=y
```
