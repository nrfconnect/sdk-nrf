## CMakeLists.txt
```
#
# Copyright (c) 2024 Junho Lee <tot0roprog@gmail.com>
#
# SPDX-License-Identifier: LicenseRef-Nordic-5-Clause
#
cmake_minimum_required(VERSION 3.20.0)

find_package(Zephyr REQUIRED HINTS $ENV{ZEPHYR_BASE})
project(mesh_blob_transfer)

target_sources(app PRIVATE
	src/main.c
	src/model_handler.c
	src/blob_shell.c
	src/blob_xfer.c)
target_include_directories(app PRIVATE include)
```

## Kconfig
```
#
# Copyright (c) 2024 Junho Lee <tot0roprog@gmail.com>
#
# SPDX-License-Identifier: LicenseRef-Nordic-5-Clause
#

source "Kconfig.zephyr"

menu "Bluetooth Mesh BLOB Transfer Sample"

config BT_MESH_BLOB_TX_MAX_TARGETS
	int "Maximum number of targets to send blob over mesh"
	default 4
	range 1 256
	help
	  When a BLOB Client sends BLOB data to BLOB Servers, the maximum number of
	  unicast addresses to target for BLOB transfers.

endmenu

module = BT_MESH_BLOB_XFER
module-str = BT Mesh BLOB Transfer model
```

## sample.yaml
```
sample:
  description: Bluetooth Mesh BLOB Transfer Sample
  name: Bluetooth Mesh BLOB Transfer
tests:
  sample.bluetooth.mesh.blob_xfer:
    build_only: true
    integration_platforms:
      - nrf52840dk_nrf52840
    platform_allow: nrf52840dk_nrf52840
    tags: bluetooth ci_build
```

## prj.conf
```kconfig
#
# Copyright (c) 2024 Junho Lee <tot0roprog@gmail.com>
#
# SPDX-License-Identifier: LicenseRef-Nordic-5-Clause
#

# General configuration
CONFIG_SYSTEM_WORKQUEUE_STACK_SIZE=2048
CONFIG_FLASH=y
CONFIG_FLASH_MAP=y
CONFIG_NVS=y
CONFIG_NVS_LOOKUP_CACHE=y
CONFIG_SETTINGS=y
CONFIG_SETTINGS_NVS_NAME_CACHE=y
CONFIG_HWINFO=y
CONFIG_DK_LIBRARY=y
CONFIG_PM_SINGLE_IMAGE=y
CONFIG_PM_PARTITION_SIZE_SETTINGS_STORAGE=0x8000
CONFIG_SOC_FLASH_NRF_PARTIAL_ERASE=y

# Bluetooth configuration
CONFIG_BT=y
CONFIG_BT_DEVICE_NAME="Mesh BLOB Transfer"
CONFIG_BT_L2CAP_TX_BUF_COUNT=8
CONFIG_BT_OBSERVER=y
CONFIG_BT_PERIPHERAL=y
CONFIG_BT_SETTINGS=y

# Bluetooth Mesh configuration
CONFIG_BT_MESH=y
CONFIG_BT_MESH_RELAY=y
CONFIG_BT_MESH_FRIEND=y
CONFIG_BT_MESH_RX_SEG_MAX=10
CONFIG_BT_MESH_TX_SEG_MAX=10
CONFIG_BT_MESH_PB_GATT=y
CONFIG_BT_MESH_GATT_PROXY=y
CONFIG_BT_MESH_DK_PROV=y

# Enable Shell module and use UART as a backend
CONFIG_SHELL=y
CONFIG_SHELL_BACKEND_SERIAL=y

# Bluetooth Mesh models
CONFIG_BT_MESH_BLOB_SRV=y
CONFIG_BT_MESH_BLOB_IO_FLASH=y
CONFIG_BT_MESH_BLOB_CLI=y

# Debug configuration
CONFIG_LOG=y
CONFIG_BT_MESH_LOG_LEVEL_DBG=y
CONFIG_BT_MESH_MODEL_LOG_LEVEL_DBG=y
CONFIG_BT_MESH_DFU_LOG_LEVEL_DBG=y
CONFIG_LOG_PRINTK=n

# Hash function for read flash data
CONFIG_SYS_HASH_FUNC32=y
CONFIG_SYS_HASH_FUNC32_MURMUR3=y
CONFIG_SYS_HASH_FUNC32_CHOICE_MURMUR3=y

# BLOB Transfer
CONFIG_BT_MESH_BLOB_TX_MAX_TARGETS=4
```

## src/main.c
```c
/*
 * Copyright (c) 2019 Nordic Semiconductor ASA
 *
 * SPDX-License-Identifier: LicenseRef-Nordic-5-Clause
 */

/** @file
 *  @brief Nordic Mesh Blob Transfer sample
 */

#include <zephyr/bluetooth/bluetooth.h>
#include <bluetooth/mesh/models.h>
#include <bluetooth/mesh/dk_prov.h>
#include <dk_buttons_and_leds.h>

#include "model_handler.h"
#include "blob_shell.h"

static void bt_ready(int err)
{
	if (err) {
		printk("Bluetooth init failed (err %d)\n", err);
		return;
	}

	printk("Bluetooth initialized\n");

	dk_leds_init();
	dk_buttons_init(NULL);

	err = bt_mesh_init(bt_mesh_dk_prov_init(), model_handler_init());
	if (err) {
		printk("Initializing mesh failed (err %d)\n", err);
		return;
	}

	if (IS_ENABLED(CONFIG_SETTINGS)) {
		settings_load();
	}

	/* This will be a no-op if settings_load() loaded provisioning info */
	bt_mesh_prov_enable(BT_MESH_PROV_ADV | BT_MESH_PROV_GATT);

	printk("Mesh initialized\n");
}

int main(void)
{
	int err;

	printk("Initializing...\n");

	blob_shell_init();

	err = bt_enable(bt_ready);
	if (err) {
		printk("Bluetooth init failed (err %d)\n", err);
	}

	return 0;
}
```

## include/blob_shell.h
```c
/*
 * Copyright (c) 2024 Junho Lee <tot0roprog@gmail.com>
 *
 * SPDX-License-Identifier: LicenseRef-Nordic-5-Clause
 */

/**
 * @file
 * @brief Blob Shell
 */

#ifndef BLOB_SHELL_H__
#define BLOB_SHELL_H__

#include <zephyr/bluetooth/mesh.h>

#ifdef __cplusplus
extern "C" {
#endif

void blob_shell_init(void);

#ifdef __cplusplus
}
#endif

#endif /* BLOB_SHELL_H__ */
```

## include/blob_xfer.h
```c
/*
 * Copyright (c) 2024 Junho Lee <tot0roprog@gmail.com>
 *
 * SPDX-License-Identifier: LicenseRef-Nordic-5-Clause
 */

/**
 * @file
 * @brief Blob Transfer
 */

#ifndef BLOB_XFER_H__
#define BLOB_XFER_H__

#include <zephyr/bluetooth/mesh.h>

#ifdef __cplusplus
extern "C" {
#endif

#define MAX_TARGET_NODES CONFIG_BT_MESH_BLOB_TX_MAX_TARGETS

#define STORAGE_START 0x0000
#define STORAGE_END 0x8000
#define STORAGE_ALIGN 0x1000

/* FLASH APIs */
typedef void (*blob_cb)(uint8_t, off_t, size_t);
void write_flash_area(uint8_t id, off_t offset, size_t size);
void read_flash_area(uint8_t id, off_t offset, size_t size);
void hash_flash_area(uint8_t id, off_t offset, size_t size);
uint8_t get_flash_area_id(void);

/* BLOB sender/receiver APIs */
int blob_tx_flash_init(off_t offset, size_t size);
int blob_tx_flash_is_init(void);
void blob_tx_targets_init(int targets[], int target_count);
int blob_tx_start(uint64_t blob_id, uint16_t base_timeout, uint16_t group, uint16_t appkey_index,
                  uint8_t ttl, enum bt_mesh_blob_xfer_mode mode);
int blob_tx_cancel(void);
int blob_tx_suspend(void);
int blob_tx_resume(void);
int blob_rx_flash_init(off_t offset);
int blob_rx_flash_is_init(void);
int blob_rx_start(uint64_t blob_id, uint16_t base_timeout, uint8_t ttl);
int blob_rx_cancel(void);
int blob_rx_progress(void);

/* BLOB Transfer Client/Server models initialization */
void blob_xfer_srv_init(struct bt_mesh_blob_srv *srv);
void blob_xfer_cli_init(struct bt_mesh_blob_cli *cli);

#ifdef __cplusplus
}
#endif

#endif /* BLOB_XFER_H__ */
```

## include/model_handler.h
```c
/*
 * Copyright (c) 2020 Nordic Semiconductor ASA
 *
 * SPDX-License-Identifier: LicenseRef-Nordic-5-Clause
 */

/**
 * @file
 * @brief Model handler
 */

#ifndef MODEL_HANDLER_H__
#define MODEL_HANDLER_H__

#include <zephyr/bluetooth/mesh.h>

#ifdef __cplusplus
extern "C" {
#endif

const struct bt_mesh_comp *model_handler_init();

#ifdef __cplusplus
}
#endif

#endif /* MODEL_HANDLER_H__ */
```

## src/blob_shell.c
```c
/*
 * Copyright (c) 2024 Junho Lee <tot0roprog@gmail.com>
 *
 * SPDX-License-Identifier: LicenseRef-Nordic-5-Clause
 */
#include <zephyr/shell/shell.h>
#include <zephyr/shell/shell_uart.h>

#include "blob_shell.h"
#include "blob_xfer.h"

static const struct shell *blob_shell;
static int targets[MAX_TARGET_NODES];
static int target_count;

static bool contained_target(uint16_t addr)
{
	int i;
	for (i = 0; i < target_count; i++) {
		if (targets[i] == addr)
			return true;
	}
	return false;
}

static int cmd_send_add_targets(const struct shell *shell, size_t argc, char *argv[])
{
	int err = 0;
	int i;
	uint16_t addr;

	if (argc == 1) {
		shell_help(shell);
		/* shell returns 1 when help is printed */
		return 1;
	}

	if (ARRAY_SIZE(targets) - target_count < argc - 1) {
		shell_error(shell, "No more room");
		return -1;
	}

	for (i = 1; i < argc; i++) {
		addr = shell_strtoul(argv[i], 16, &err);
		if (err) {
			shell_error(shell, "Unable to parse input string argument");
			return err;
		} else if (addr == 0 || addr >= 0xC000) {
			shell_error(shell, "Only unicast addresses are allowed");
			return -1;
		}

		if (contained_target(addr))
			continue;

		targets[target_count++] = addr;
		shell_print(shell, "Added target %4.4x", addr);
	}

	return 0;
}

static int cmd_send_show_targets(const struct shell *shell, size_t argc, char *argv[])
{
	int i;

	if (target_count == 0) {
		shell_print(shell, "No target");
		return 0;
	}

	for (i = 0; i < target_count; i++) {
		shell_print(shell, "%2d Target: 0x%4.4x", i + 1, targets[i]);
	}

	return 0;
}

static int cmd_send_clean_targets(const struct shell *shell, size_t argc, char *argv[])
{
	target_count = 0;

	return 0;
}

SHELL_STATIC_SUBCMD_SET_CREATE(blob_send_targerts_cmds,
	SHELL_CMD_ARG(add, NULL, "Add target addresses (Up to 32 nodes). <addr> [addr, ...]",
		      cmd_send_add_targets, 2, 31),
	SHELL_CMD_ARG(show, NULL, "Show target addresses", cmd_send_show_targets, 1, 0),
	SHELL_CMD_ARG(clean, NULL, "Clear target addresses", cmd_send_clean_targets, 1, 0),
	SHELL_SUBCMD_SET_END
);

static int cmd_send_target(const struct shell *shell, size_t argc, char *argv[])
{
	if (argc == 1) {
		shell_help(shell);
		/* shell returns 1 when help is printed */
		return 1;
	}

	shell_error(shell, "%s unknown parameter: %s", argv[0], argv[1]);

	return 0;
}

static int cmd_send_init(const struct shell *shell, size_t argc, char *argv[])
{
	int err = 0;
	off_t offset;
	size_t size;

	offset = shell_strtoul(argv[1], 16, &err);

	if (err) {
		shell_error(shell, "Unable to parse input string argument");
		return err;
	}

	size = shell_strtoul(argv[2], 16, &err);

	if (err) {
		shell_error(shell, "Unable to parse input string argument");
		return err;
	}

	if (offset < STORAGE_START) {
		shell_error(shell, "Offset must be %#x or greater", STORAGE_START);
		return -1;
	} else if (size == 0) {
		shell_error(shell, "Size 0 are not allowed");
		return -1;
	} else if (offset + size > STORAGE_END) {
		shell_error(shell, "Allowed storage range: %#x - %#x", STORAGE_START, STORAGE_END);
		return -1;
	} else if (offset % STORAGE_ALIGN != 0) {
		shell_error(shell, "Offset must be aligned in %#x", STORAGE_ALIGN);
		return -1;
	}

	err = blob_tx_flash_init(offset, size);

	if (err) {
		shell_error(shell, "Failed to init BLOB IO Flash module: %d\n", err);
		return err;
	}

	shell_print(shell, "Set flash to send blob: offset: %#lx, size: %#x", offset, size);

	return 0;
}

static int cmd_send_start(const struct shell *shell, size_t argc, char *argv[])
{
	int err = 0;
	int i;
	uint64_t blob_id;
	uint16_t base_timeout = 2;
	uint16_t group = BT_MESH_ADDR_UNASSIGNED;
	uint16_t appkey_index = 0;
	uint8_t ttl = BT_MESH_TTL_DEFAULT;
	enum bt_mesh_blob_xfer_mode mode = BT_MESH_BLOB_XFER_MODE_PUSH;

	if (!bt_mesh_is_provisioned()) {
		shell_print(shell, "The mesh node is not provisioned. Please provision the mesh "
				   "node before using the blob transfer.");
		return 1;
	}

	for (i = 2; i < argc; i += 2) {
		if (!strncmp(argv[i], "-t", 2)) {
			ttl = shell_strtoul(argv[i + 1], 10, &err);
		} else if (!strncmp(argv[i], "-b", 2)) {
			base_timeout = shell_strtoul(argv[i + 1], 10, &err);
		} else if (!strncmp(argv[i], "-g", 2)) {
			group = shell_strtoul(argv[i + 1], 16, &err);
		} else if (!strncmp(argv[i], "-k", 2)) {
			appkey_index = shell_strtoul(argv[i + 1], 10, &err);
		} else if (!strncmp(argv[i], "-m", 2)) {
			if (!strncmp(argv[i + 1], "push", 4)) {
				mode = BT_MESH_BLOB_XFER_MODE_PUSH;
			} else if (!strncmp(argv[i + 1], "pull", 4)) {
				mode = BT_MESH_BLOB_XFER_MODE_PULL;
			} else {
				err = -EINVAL;
			}
		} else {
			shell_error(shell, "Wrong argument: %s", argv[i]);
			return err;
		}
		if (err) {
			shell_error(shell, "Unable to parse input string argument");
			return err;
		}
	}

	blob_id = shell_strtoull(argv[1], 16, &err);

	if (err) {
		shell_error(shell, "Unable to parse input string argument");
		return err;
	}

	if (target_count == 0) {
		shell_error(shell, "No target. Should be added targets first.");
		return 1;
	}

	if (!blob_tx_flash_is_init()) {
		shell_error(shell, "No set flash. Should be set offset and size of flash to use.");
		return 1;
	}

	blob_tx_targets_init(targets, target_count);

	shell_print(shell,
		    "Set blob send ID: %#16.16llx, ttl: %#2.2x, base_timeout: %d\n, group: %4.4x, "
		    "appkey_index: %d, mode: %d", blob_id, ttl, base_timeout, group, appkey_index,
		     mode);

	err = blob_tx_start(blob_id, base_timeout, group, appkey_index, ttl, mode);

	if (err) {
		shell_error(shell, "Failed to start BLOB Transfer: %d", err);
		return err;
	}

	return 0;
}

static int cmd_send_cancel(const struct shell *shell, size_t argc, char *argv[])
{
	if (!bt_mesh_is_provisioned()) {
		shell_print(shell, "The mesh node is not provisioned. Please provision the mesh "
				   "node before using the blob transfer.");
		return 1;
	}

	if (blob_tx_cancel()) {
		shell_error(shell, "BLOB Transfer TX is NOT in active");
		return 1;
	}

	shell_print(shell, "Cancel to send blob");

	return 0;
}

static int cmd_send_suspend(const struct shell *shell, size_t argc, char *argv[])
{
	if (!bt_mesh_is_provisioned()) {
		shell_print(shell, "The mesh node is not provisioned. Please provision the mesh "
				   "node before using the blob transfer.");
		return 1;
	}

	if (blob_tx_suspend()) {
		shell_error(shell, "Failed to suspend");
		return 1;
	}

	shell_print(shell, "Suspend to send blob");

	return 0;
}

static int cmd_send_resume(const struct shell *shell, size_t argc, char *argv[])
{
	if (!bt_mesh_is_provisioned()) {
		shell_print(shell, "The mesh node is not provisioned. Please provision the mesh "
				   "node before using the blob transfer.");
		return 1;
	}

	if (blob_tx_resume()) {
		shell_error(shell, "Failed to resume");
		return 1;
	}

	shell_print(shell, "Resume to send blob");

	return 0;
}

SHELL_STATIC_SUBCMD_SET_CREATE(
	blob_send_cmds,
	SHELL_CMD_ARG(init, NULL, "Set flash area to send blob data. <offset> <size>",
		      cmd_send_init, 3, 0),
	SHELL_CMD(target, &blob_send_targerts_cmds, "Blob Transfer Target commands",
		  cmd_send_target),
	SHELL_CMD_ARG(start, NULL,
		      "Start to send blob data. <blob_id> [-t ttl] [-b base timeout] [-g multicast "
		      "address] [-k appkey index] [-m {push|pull}]",
		      cmd_send_start, 2, 10),
	SHELL_CMD(cancel, NULL, "Cancel transfer", cmd_send_cancel),
	SHELL_CMD(suspend, NULL, "Suspend transfer", cmd_send_suspend),
	SHELL_CMD(resume, NULL, "Resume transfer", cmd_send_resume),
	SHELL_SUBCMD_SET_END);

static int cmd_receive_init(const struct shell *shell, size_t argc, char *argv[])
{
	int err = 0;
	off_t offset;

	offset = shell_strtoul(argv[1], 16, &err);
	if (err) {
		shell_error(shell, "Unable to parse input string argument");
		return err;
	}

	if (offset < STORAGE_START) {
		shell_error(shell, "Offset must be %#x or greater", STORAGE_START);
		return -1;
	} else if (offset % STORAGE_ALIGN != 0) {
		shell_error(shell, "Offset must be aligned in %#x", STORAGE_ALIGN);
		return -1;
	}

	err = blob_rx_flash_init(offset);

	if (err) {
		shell_error(shell, "Failed to init BLOB IO Flash module: %d\n", err);
		return err;
	}

	shell_print(shell, "Set flash to receive blob: offset: %#lx", offset);

	return 0;
}

static int cmd_receive_start(const struct shell *shell, size_t argc, char *argv[])
{
	int i;
	int err = 0;
	uint64_t blob_id;
	uint16_t base_timeout = 2;
	uint8_t ttl = BT_MESH_TTL_DEFAULT;

	if (!bt_mesh_is_provisioned()) {
		shell_print(shell, "The mesh node is not provisioned. Please provision the mesh "
				   "node before using the blob transfer.");
		return 1;
	}

	for (i = 2; i < argc; i += 2) {
		if (!strncmp(argv[i], "-t", 2)) {
			ttl = shell_strtoul(argv[i + 1], 10, &err);
		} else if (!strncmp(argv[i], "-b", 2)) {
			base_timeout = shell_strtoul(argv[i + 1], 10, &err);
		} else {
			shell_error(shell, "Wrong argument: %s", argv[i]);
			return err;
		}
		if (err) {
			shell_error(shell, "Unable to parse input string argument");
			return err;
		}
	}

	blob_id = shell_strtoull(argv[1], 16, &err);

	if (err) {
		shell_error(shell, "Unable to parse input string argument");
		return err;
	}

	if (!blob_rx_flash_is_init()) {
		shell_error(shell, "No set flash. Should be set offset and size of flash to use.");
		return 1;
	}

	err = blob_rx_start(blob_id, base_timeout, ttl);

	if (err) {
		shell_error(shell, "Failed to start receiving blob: %d", err);
		return err;
	}

	shell_print(shell, "Set blob receive ID: %#16.16llx, ttl: %#2.2x, base_timeout: %d\n",
		    blob_id, ttl, base_timeout);

	return 0;
}

static int cmd_receive_cancel(const struct shell *shell, size_t argc, char *argv[])
{
	if (!bt_mesh_is_provisioned()) {
		shell_print(shell, "The mesh node is not provisioned. Please provision the mesh "
				   "node before using the blob transfer.");
		return 1;
	}

	if (blob_rx_cancel()) {
		shell_error(shell, "Failed to cancel");
		return 1;
	}
	shell_print(shell, "Cancel to receive blob");

	return 0;
}

static int cmd_receive_progress(const struct shell *shell, size_t argc, char *argv[])
{
	int progress;

	if (!bt_mesh_is_provisioned()) {
		shell_print(shell, "The mesh node is not provisioned. Please provision the mesh "
				   "node before using the blob transfer.");
		return 1;
	}

	progress = blob_rx_progress();

	if (progress < 0) {
		shell_error(shell, "BLOB Transfer RX is NOT in active");
		return 1;
	}
	shell_print(shell, "Current transfer progress: %d", progress);

	return 0;
}

SHELL_STATIC_SUBCMD_SET_CREATE(
	blob_receive_cmds,
	SHELL_CMD_ARG(init, NULL, "Set flash area to receive blob data. <offset>", cmd_receive_init,
		      2, 0),
	SHELL_CMD_ARG(start, NULL,
		      "Start to receive blob data. <blob_id> [-t ttl] [-b base_timeout]",
		      cmd_receive_start, 2, 4),
	SHELL_CMD(cancel, NULL, "Cancel transfer", cmd_receive_cancel),
	SHELL_CMD(progress, NULL, "Show progress of transfer", cmd_receive_progress),
	SHELL_SUBCMD_SET_END);

static int cmd_send(const struct shell *shell, size_t argc, char *argv[])
{
	if (argc == 1) {
		shell_help(shell);
		/* shell returns 1 when help is printed */
		return 1;
	}

	shell_error(shell, "%s unknown parameter: %s", argv[0], argv[1]);

	return 0;
}

static int cmd_receive(const struct shell *shell, size_t argc, char *argv[])
{
	if (argc == 1) {
		shell_help(shell);
		/* shell returns 1 when help is printed */
		return 1;
	}

	shell_error(shell, "%s unknown parameter: %s", argv[0], argv[1]);

	return 0;
}

static int _cmd_blob(blob_cb cb, const struct shell *shell, size_t argc, char *argv[])
{
	int err = 0;
	off_t offset;
	size_t size;

	offset = shell_strtoul(argv[1], 16, &err);

	if (err) {
		shell_error(shell, "Unable to parse input string argument");
		return err;
	}

	size = shell_strtoul(argv[2], 16, &err);

	if (err) {
		shell_error(shell, "Unable to parse input string argument");
		return err;
	}

	if (offset < STORAGE_START) {
		shell_error(shell, "Offset must be %#x or greater", STORAGE_START);
		return -1;
	} else if (size == 0) {
		shell_error(shell, "Size 0 are not allowed");
		return -1;
	} else if (offset + size > STORAGE_END) {
		shell_error(shell, "Allowed storage range: %#x - %#x", STORAGE_START, STORAGE_END);
		return -1;
	} else if (offset % STORAGE_ALIGN != 0) {
		shell_error(shell, "Offset must be aligned in %#x", STORAGE_ALIGN);
		return -1;
	}

	cb(get_flash_area_id(), offset, size);

	return 0;
}

inline static int cmd_read_blob(const struct shell *shell, size_t argc, char *argv[])
{
	return _cmd_blob(read_flash_area, shell, argc, argv);
}

inline static int cmd_write_blob(const struct shell *shell, size_t argc, char *argv[])
{
	return _cmd_blob(write_flash_area, shell, argc, argv);
}

inline static int cmd_hash_blob(const struct shell *shell, size_t argc, char *argv[])
{
	return _cmd_blob(hash_flash_area, shell, argc, argv);
}

SHELL_STATIC_SUBCMD_SET_CREATE(
	blob_cmds, SHELL_CMD(send, &blob_send_cmds, "Send Binary Large Object", cmd_send),
	SHELL_CMD(receive, &blob_receive_cmds, "Receive Binary Large Object", cmd_receive),
	SHELL_CMD_ARG(read, NULL, "Read flash area <offset> <size>", cmd_read_blob, 3, 0),
	SHELL_CMD_ARG(write, NULL, "Write data to flash <offset> <size>", cmd_write_blob, 3, 0),
	SHELL_CMD_ARG(hash, NULL, "Hash of data in flash <offset> <size>", cmd_hash_blob, 3, 0),
	SHELL_SUBCMD_SET_END);

static int cmd_blob(const struct shell *shell, size_t argc, char **argv)
{
	if (argc == 1) {
		shell_help(shell);
		/* shell returns 1 when help is printed */
		return 1;
	}

	shell_error(shell, "%s unknown parameter: %s", argv[0], argv[1]);

	return -EINVAL;
}

SHELL_CMD_ARG_REGISTER(blob, &blob_cmds, "Bluetooth Mesh Blob Transfer commands", cmd_blob, 1, 1);

void blob_shell_init(void)
{
	blob_shell = shell_backend_uart_get_ptr();
	shell_print(blob_shell, ">>> Bluetooth Mesh Blob Transfer sample <<<");
	target_count = 0;
}
```

## src/blob_xfer.c
```c
/*
 * Copyright (c) 2024 Junho Lee <tot0roprog@gmail.com>
 *
 * SPDX-License-Identifier: LicenseRef-Nordic-5-Clause
 */
#include <zephyr/storage/flash_map.h>
#include <zephyr/drivers/flash.h>
#include <zephyr/sys/hash_function.h>

#include "blob_xfer.h"

#define BLOB_AREA_ID FLASH_AREA_ID(blob_storage)
#define BUF_SIZE 0x100

static struct bt_mesh_blob_srv *blob_srv;
static struct bt_mesh_blob_cli *blob_cli;

const uint8_t SAMPLE_BLOB_DATA[] = {0xC0, 0xFF, 0xEE};

static struct bt_mesh_blob_io_flash blob_rx_flash_stream;
static struct {
	struct bt_mesh_blob_cli_inputs inputs;
	struct bt_mesh_blob_target targets[MAX_TARGET_NODES];
	struct bt_mesh_blob_target_pull pull[MAX_TARGET_NODES];
	uint8_t target_count;
	struct bt_mesh_blob_xfer xfer;
	struct bt_mesh_blob_io_flash blob_tx_flash_stream;
} blob_tx;

void write_flash_area(uint8_t id, off_t offset, size_t size)
{
	const struct flash_area *area;
	uint32_t align;
	uint32_t hash = 0;
	uint8_t buf[BUF_SIZE];
	int i = 0;
	int err;
	off_t start, end;
	off_t aligned_offset, aligned_end;
	size_t aligned_size, chunk_size;
	size_t total_written = 0;
	off_t erase_offset;
	size_t erase_size;

	if((err = flash_area_open(id, &area)) != 0) {
		printk("Failed to open flash area: %d\n", err);
		return;
	}

	/* Erase flash area */
#if defined(CONFIG_FLASH_PAGE_LAYOUT)
	struct flash_pages_info page;
	const struct device *flash_dev;


	flash_dev = flash_area_get_device(area);
	if (!flash_dev) {
		printk("Failed to get device for flash area\n");
		return;
	}

	err = flash_get_page_info_by_offs(flash_dev,
					  offset, &page);
	if (err) {
		printk("Failed to get page info: %d\n", err);
		return;
	}

	erase_offset = ROUND_DOWN(offset, page.size);
	erase_size = page.size * DIV_ROUND_UP(ROUND_UP(offset + size, page.size) - erase_offset,
					      page.size);
#else
	erase_offset = ROUND_DOWN(offset, align);
	erase_size = offset % align + size + ROUND_UP(i, align);
#endif
	printk("Erase flash: offset: %#lx, size: %#x\n", erase_offset, erase_size);
	if ((err = flash_area_erase(area, erase_offset, erase_size) != 0)) {
		printk("Failed to erase flash area: %d\n", err);
		return;
	}

	/* Write flash area */
	printk("Write data to flash (size: %#x)\n", size);

	align = flash_area_align(area);
	aligned_offset = ROUND_DOWN(offset, align);
	aligned_end = ROUND_UP(offset + size, align);
	aligned_size = aligned_end - aligned_offset;

	while (total_written < size) {
		chunk_size = aligned_size > BUF_SIZE ? BUF_SIZE : aligned_size;

		memset(buf, 0xFF, chunk_size);

		start = (total_written == 0) ? offset - aligned_offset : 0;
		end = (chunk_size < size - total_written) ? chunk_size : size - total_written +
											      start;

		for (i = start; i < end; i ++) {
			buf[i] = SAMPLE_BLOB_DATA[total_written++ % ARRAY_SIZE(SAMPLE_BLOB_DATA)];
		}
		hash += sys_hash32(&buf[start], end - start);

		if ((err = flash_area_write(area, aligned_offset, buf, chunk_size) != 0)) {
			printk("Failed to write data to flash: %d\n", err);
			return;
		}

		aligned_offset += chunk_size;
		aligned_size -= chunk_size;
	}

	flash_area_close(area);

	printk("Hash value of written data: %#8.8x\n", hash);
}

void read_flash_area(uint8_t id, off_t offset, size_t size)
{
	const struct flash_area *area;
	uint8_t buf[BUF_SIZE];
	uint32_t align;
	off_t aligned_offset, aligned_end;
	off_t start, end;
	size_t aligned_size, chunk_size;
	size_t total_read = 0;
	int i;
	int err;

	if((err = flash_area_open(id, &area)) != 0) {
		printk("Failed to open flash area: %d\n", err);
		return;
	}

	align = flash_area_align(area);

	aligned_offset = ROUND_DOWN(offset, align);
	aligned_end = ROUND_UP(offset + size, align);
	aligned_size = aligned_end - aligned_offset;

	while (total_read < size) {
		chunk_size = aligned_size > BUF_SIZE ? BUF_SIZE : aligned_size;

		if ((err = flash_area_read(area, aligned_offset, buf, chunk_size)) != 0) {
			printk("Failed to read: %d\n", err);
			return;
		}

		start = (total_read == 0) ? offset - aligned_offset : 0;
		end = (chunk_size < size - total_read) ? chunk_size : size - total_read + start;

		for (i = start; i < end; i++) {
			if (total_read % 32 == 0) {
				printk("\n%#8.8lx to %#8.8lx: ", offset + total_read,
				       MIN(offset + total_read + 31, offset + size - 1));
			}
			printk("%2.2x", buf[i]);
			total_read++;
		}
		aligned_offset += chunk_size;
		aligned_size -= chunk_size;
	}
	printk("\n");

	flash_area_close(area);
}

void hash_flash_area(uint8_t id, off_t offset, size_t size)
{
	const struct flash_area *area;
	uint8_t buf[BUF_SIZE];
	uint32_t align;
	uint32_t hash = 0;
	off_t aligned_offset, aligned_end;
	off_t start, end;
	size_t aligned_size, chunk_size;
	size_t total_read = 0;
	int err;

	if((err = flash_area_open(id, &area)) != 0) {
		printk("Failed to open flash area: %d\n", err);
		return;
	}

	align = flash_area_align(area);

	aligned_offset = ROUND_DOWN(offset, align);
	aligned_end = ROUND_UP(offset + size, align);
	aligned_size = aligned_end - aligned_offset;

	while (total_read < size) {
		chunk_size = aligned_size > BUF_SIZE ? BUF_SIZE : aligned_size;

		if ((err = flash_area_read(area, aligned_offset, buf, chunk_size)) != 0) {
			printk("Failed to read: %d\n", err);
			return;
		}

		start = (total_read == 0) ? offset - aligned_offset : 0;
		end = (chunk_size < size - total_read) ? chunk_size : size - total_read + start;

		hash += sys_hash32(&buf[start], end - start);

		aligned_offset += chunk_size;
		aligned_size -= chunk_size;
		total_read += end - start;
	}
	printk("\n");

	flash_area_close(area);

	printk("Hash value of read data: %#8.8x\n", hash);
}

uint8_t get_flash_area_id(void)
{
	return BLOB_AREA_ID;
}

static int blob_xfer_srv_start(struct bt_mesh_blob_srv *srv, struct bt_mesh_msg_ctx *ctx,
			      struct bt_mesh_blob_xfer *xfer)
{
	printk("BLOB Transfer RX Start\n");
	return 0;
}

static void blob_xfer_srv_end(struct bt_mesh_blob_srv *srv, uint64_t id, bool success)
{
	struct bt_mesh_blob_io_flash *flash_stream =
		CONTAINER_OF(srv->io, struct bt_mesh_blob_io_flash, io);
	size_t size;
	off_t offset;

	if (success == 1){
		printk("BLOB Transfer RX End: Success - id(%16.16llx)\n", id);
		size = srv->state.xfer.size;
		offset = flash_stream->offset;
		hash_flash_area(flash_stream->area_id, offset, size);
	}
	else {
		printk("BLOB Transfer RX End: Failed - id(%16.16llx)\n", id);
	}
}

static void blob_xfer_srv_suspended(struct bt_mesh_blob_srv *srv)
{
	printk("BLOB Transfer RX Suspended\n");
}

static void blob_xfer_srv_resume(struct bt_mesh_blob_srv *srv)
{
	printk("BLOB Transfer RX Resume\n");
}

static int blob_xfer_srv_recover(struct bt_mesh_blob_srv *srv, struct bt_mesh_blob_xfer *xfer,
				const struct bt_mesh_blob_io **io)
{
	printk("BLOB Transfer RX Recover\n");
	*io = &blob_rx_flash_stream.io;

	return 0;
}

static void blob_xfer_cli_caps(struct bt_mesh_blob_cli *b, const struct bt_mesh_blob_cli_caps *caps)
{
	int err;

	printk("BLOB Transfer TX Caps\n");

	blob_tx.xfer.block_size_log = caps->max_block_size_log;
	blob_tx.xfer.chunk_size = caps->max_chunk_size;

	if (!(blob_tx.xfer.mode & BT_MESH_BLOB_XFER_MODE_ALL)) {
		blob_tx.xfer.mode =
			caps->modes == BT_MESH_BLOB_XFER_MODE_ALL ?
			BT_MESH_BLOB_XFER_MODE_PUSH : caps->modes;
	} else {
		blob_tx.xfer.mode =
			caps->modes == BT_MESH_BLOB_XFER_MODE_ALL ?
			blob_tx.xfer.mode : caps->modes;
	}

	err = bt_mesh_blob_cli_send(b, &blob_tx.inputs, &blob_tx.xfer,
				    &blob_tx.blob_tx_flash_stream.io);
	if (err) {
		printk("Starting BLOB xfer failed: %d\n", err);
	}
}

static void blob_xfer_cli_lost_target(struct bt_mesh_blob_cli *b, struct bt_mesh_blob_target *blobt,
				     enum bt_mesh_blob_status reason)
{
	printk("BLOB Transfer TX Lost Target: %4.4x reason %d\n", blobt->addr, reason);
}

static void blob_xfer_cli_suspended(struct bt_mesh_blob_cli *b)
{
	printk("BLOB Transfer TX Suspended\n");
}

static void blob_xfer_cli_end(struct bt_mesh_blob_cli *b, const struct bt_mesh_blob_xfer *xfer,
			     bool success)
{
	if (success) {
		printk("BLOB Transfer TX Success\n");
		return;
	}
	printk("BLOB Transfer TX Fail\n");
}

/* API */

int blob_tx_flash_init(off_t offset, size_t size)
{
	int err = 0;

	err = bt_mesh_blob_io_flash_init(&blob_tx.blob_tx_flash_stream, BLOB_AREA_ID,
					 ROUND_DOWN(offset, 4));

	if (err)
		return err;

	blob_tx.xfer.size = ROUND_UP(size, 4);

	return 0;
}

int blob_tx_flash_is_init(void)
{
	return !!blob_tx.xfer.size && blob_tx.blob_tx_flash_stream.offset >= STORAGE_START;
}

void blob_tx_targets_init(int targets[], int target_count)
{
	int i;

	sys_slist_init(&blob_tx.inputs.targets);
	for (i = 0; i < target_count; i++) {
		uint16_t addr = targets[i];
		memset(&blob_tx.targets[i], 0, sizeof(struct bt_mesh_blob_target));
		memset(&blob_tx.pull[i], 0, sizeof(struct bt_mesh_blob_target_pull));
		blob_tx.targets[i].addr = addr;
		blob_tx.targets[i].pull = &blob_tx.pull[i];

		sys_slist_append(&blob_tx.inputs.targets, &blob_tx.targets[i].n);
	}
}

int blob_tx_start(uint64_t blob_id, uint16_t base_timeout, uint16_t group, uint16_t appkey_index,
		  uint8_t ttl, enum bt_mesh_blob_xfer_mode mode)
{
	blob_tx.inputs.app_idx = appkey_index;
	blob_tx.inputs.group = group;
	blob_tx.inputs.ttl = ttl;
	blob_tx.inputs.timeout_base = base_timeout;
	blob_tx.xfer.id = blob_id;
	blob_tx.xfer.mode = mode;

	hash_flash_area(blob_tx.blob_tx_flash_stream.area_id, blob_tx.blob_tx_flash_stream.offset,
			blob_tx.xfer.size);

	return bt_mesh_blob_cli_caps_get(blob_cli, &blob_tx.inputs);
}

int blob_tx_cancel(void)
{
	if (!bt_mesh_blob_cli_is_busy(blob_cli))
		return -1;

	bt_mesh_blob_cli_cancel(blob_cli);

	return 0;
}

int blob_tx_suspend(void)
{
	return bt_mesh_blob_cli_suspend(blob_cli);;
}

int blob_tx_resume(void)
{
	return bt_mesh_blob_cli_resume(blob_cli);;
}

int blob_rx_flash_init(off_t offset)
{
	int err = 0;

	err = bt_mesh_blob_io_flash_init(&blob_rx_flash_stream, BLOB_AREA_ID,
					 ROUND_DOWN(offset, 4));

	if (err)
		return err;

	return 0;
}

int blob_rx_flash_is_init(void)
{
	return blob_rx_flash_stream.offset >= STORAGE_START;
}

int blob_rx_start(uint64_t blob_id, uint16_t base_timeout, uint8_t ttl)
{
	return bt_mesh_blob_srv_recv(blob_srv, blob_id, &blob_rx_flash_stream.io, ttl,
				     base_timeout);
}

int blob_rx_cancel(void)
{
	return bt_mesh_blob_srv_cancel(blob_srv);
}

int blob_rx_progress(void)
{
	if (!bt_mesh_is_provisioned())
		return -1;

	return bt_mesh_blob_srv_progress(blob_srv);
}

static const struct bt_mesh_blob_srv_cb blob_srv_cb = {
	.start = blob_xfer_srv_start,
	.end = blob_xfer_srv_end,
	.suspended = blob_xfer_srv_suspended,
	.resume = blob_xfer_srv_resume,
	.recover = blob_xfer_srv_recover
};

static const struct bt_mesh_blob_cli_cb blob_cli_cb = {
	.caps = blob_xfer_cli_caps,
	.lost_target = blob_xfer_cli_lost_target,
	.suspended = blob_xfer_cli_suspended,
	.end = blob_xfer_cli_end
};

void blob_xfer_srv_init(struct bt_mesh_blob_srv *srv)
{
	srv->cb = &blob_srv_cb;
	blob_srv = srv;
}

void blob_xfer_cli_init(struct bt_mesh_blob_cli *cli)
{
	cli->cb = &blob_cli_cb;
	cli->xfer = &blob_tx.xfer,
	cli->inputs = &blob_tx.inputs,
	cli->io = &blob_tx.blob_tx_flash_stream.io,
	blob_cli = cli;
}
```

## src/model_handler.c
```c
/*
 * Copyright (c) 2019 Nordic Semiconductor ASA
 *
 * SPDX-License-Identifier: LicenseRef-Nordic-5-Clause
 */
#include <stdio.h>

#include <zephyr/bluetooth/bluetooth.h>
#include <bluetooth/mesh/models.h>
#include <dk_buttons_and_leds.h>

#include "model_handler.h"
#include "blob_xfer.h"

/******************************************************************************/
/*************************** Health server setup ******************************/
/******************************************************************************/
/* Set up a repeating delayed work to blink the DK's LEDs when attention is
 * requested.
 */
static struct k_work_delayable attention_blink_work;
static bool attention;

static void attention_blink(struct k_work *work)
{
	static int idx;
	const uint8_t pattern[] = {
		BIT(0) | BIT(1),
		BIT(1) | BIT(2),
		BIT(2) | BIT(3),
		BIT(3) | BIT(0),
	};

	if (attention) {
		dk_set_leds(pattern[idx++ % ARRAY_SIZE(pattern)]);
		k_work_reschedule(&attention_blink_work, K_MSEC(30));
	} else {
		dk_set_leds(DK_NO_LEDS_MSK);
	}
}

static void attention_on(const struct bt_mesh_model *mod)
{
	attention = true;
	k_work_reschedule(&attention_blink_work, K_NO_WAIT);
}

static void attention_off(const struct bt_mesh_model *mod)
{
	/* Will stop rescheduling blink timer */
	attention = false;
}

static const struct bt_mesh_health_srv_cb health_srv_cb = {
	.attn_on = attention_on,
	.attn_off = attention_off,
};

static struct bt_mesh_health_srv health_srv = {
	.cb = &health_srv_cb,
};

BT_MESH_HEALTH_PUB_DEFINE(health_pub, 0);

/******************************************************************************/
/************************ Blob Transfer model setup ***************************/
/******************************************************************************/
static struct bt_mesh_blob_srv blob_srv;
static struct bt_mesh_blob_cli blob_cli;

static struct bt_mesh_elem elements[] = {
	BT_MESH_ELEM(
		1,
		BT_MESH_MODEL_LIST(
			BT_MESH_MODEL_CFG_SRV,
			BT_MESH_MODEL_HEALTH_SRV(&health_srv, &health_pub),
			BT_MESH_MODEL_BLOB_SRV(&blob_srv)),
			BT_MESH_MODEL_NONE),
	BT_MESH_ELEM(
		2,
		BT_MESH_MODEL_LIST(
			BT_MESH_MODEL_BLOB_CLI(&blob_cli)),
			BT_MESH_MODEL_NONE),
};

static const struct bt_mesh_comp comp = {
	.cid = CONFIG_BT_COMPANY_ID,
	.elem = elements,
	.elem_count = ARRAY_SIZE(elements),
};

/******************************************************************************/
/******************************** Public API **********************************/
/******************************************************************************/
const struct bt_mesh_comp *model_handler_init(void)
{
	k_work_init_delayable(&attention_blink_work, attention_blink);

	blob_xfer_srv_init(&blob_srv);
	blob_xfer_cli_init(&blob_cli);

	return &comp;
}
```
