## samples/bluetooth/nrf5340_audio/src/events/Kconfig
```kconfig
#
# Copyright (c) 2022 Nordic Semiconductor ASA
#
# SPDX-License-Identifier: LicenseRef-Nordic-5-Clause
#

menu "Events"

menu "Log levels"

config LOG_CTRL_EVENTS_LEVEL
	int "Log level for ctrl_events.c"
	default 2

endmenu # Log levels
endmenu # Events
```

## samples/bluetooth/nrf_auraconfig/sample.yaml
```yaml
sample:
  name: Bluetooth Low Energy nRF Auraconfig
  description: Bluetooth LE shell configurable Auracast tool
common:
  integration_platforms:
    - nrf5340_audio_dk/nrf5340/cpuapp
  platform_allow:
    - nrf5340_audio_dk/nrf5340/cpuapp
  sysbuild: true
  build_only: true
  tags:
    - ci_build
    - sysbuild
    - bluetooth
tests:
  sample.bluetooth.nrf_auraconfig.build:
    extra_args: []
```

## samples/bluetooth/nrf_dm/boards/nrf5340dk_nrf5340_cpuapp.conf
```kconfig
#
# Copyright (c) 2022 Nordic Semiconductor
#
# SPDX-License-Identifier: LicenseRef-Nordic-5-Clause
#

# Distance Measurement
CONFIG_DM_MODULE_RPC=y
CONFIG_DM_MODULE_RPC_CLIENT=y

CONFIG_TEST_RANDOM_GENERATOR=y

# NRF RPC
CONFIG_NRF_RPC_THREAD_POOL_SIZE=2

# SYSTEM WORKQUEUE
CONFIG_SYSTEM_WORKQUEUE_STACK_SIZE=3072
```

## samples/bluetooth/path_loss_monitoring/central/sample.yaml
```yaml
#
# Copyright (c) 2025 Nordic Semiconductor ASA
#
# SPDX-License-Identifier: LicenseRef-Nordic-5-Clause
#

sample:
	description: Central device of a Bluetooth Low Energy Path Loss Monitor, where path loss zones are indicated by LED0, LED1, and LED2.
	name: Bluetooth LE Central Path Loss Monitoring Sample
tests:
	sample.bluetooth.central_path_loss_monitoring:
		sysbuild: true
		build_only: true
		integration_platforms:
			- nrf52840dk/nrf52840
			- nrf5340dk/nrf5340/cpuapp
			- nrf54l15dk/nrf54l15/cpuapp
			- nrf54h20dk/nrf54h20/cpuapp
		platform_allow:
			- nrf52840dk/nrf52840
			- nrf5340dk/nrf5340/cpuapp
			- nrf54l15dk/nrf54l15/cpuapp
			- nrf54h20dk/nrf54h20/cpuapp
		tags:
			- bluetooth
			- ci_build
			- sysbuild
```

## samples/bluetooth/path_loss_monitoring/peripheral/boards/nrf54h20dk_nrf54h20_cpuapp.conf
```kconfig
#
# Copyright (c) 2025 Nordic Semiconductor
#
# SPDX-License-Identifier: LicenseRef-Nordic-5-Clause
#

CONFIG_SOC_NRF54H20_CPURAD_ENABLE=y
```

## samples/bluetooth/path_loss_monitoring/peripheral/sample.yaml
```yaml
#
# Copyright (c) 2025 Nordic Semiconductor ASA
#
# SPDX-License-Identifier: LicenseRef-Nordic-5-Clause
#

sample:
	name: Bluetooth LE Peripheral Path Loss Monitoring Sample

common:
		sysbuild: true
		build_only: true
		integration_platforms:
			- nrf52840dk/nrf52840
			- nrf5340dk/nrf5340/cpuapp
			- nrf54l15dk/nrf54l15/cpuapp
			- nrf54h20dk/nrf54h20/cpuapp
		platform_allow:
			- nrf52840dk/nrf52840
			- nrf5340dk/nrf5340/cpuapp
			- nrf54l15dk/nrf54l15/cpuapp
			- nrf54h20dk/nrf54h20/cpuapp
```

## samples/bluetooth/peripheral_ams_client/sample.yaml
```yaml
sample:
  description: Bluetooth Low Energy AMS client sample
  name: Bluetooth LE AMS client
tests:
  sample.bluetooth.peripheral_ams_client.build:
    sysbuild: true
    build_only: true
    integration_platforms:
      - nrf52840dk/nrf52840
      - nrf5340dk/nrf5340/cpuapp
      - nrf54h20dk/nrf54h20/cpuapp
    platform_allow:
      - nrf52dk/nrf52832
      - nrf52840dk/nrf52840
      - nrf5340dk/nrf5340/cpuapp
      - nrf5340dk/nrf5340/cpuapp/ns
      - nrf54lm20dk/nrf54lm20a/cpuapp
      - nrf54lm20dk/nrf54lm20a/cpuapp/ns
      - nrf54lm20dk/nrf54lm20b/cpuapp
      - nrf54lm20dk/nrf54lm20b/cpuapp/ns
      - nrf7120dk/nrf7120/cpuapp
      - nrf54h20dk/nrf54h20/cpuapp
      - nrf54lv10dk/nrf54lv10a/cpuapp
      - nrf54lv10dk/nrf54lv10a/cpuapp/ns
      - nrf54lc10dk/nrf54lc10a/cpuapp
      - nrf54lc10dk/nrf54lc10a/cpuapp/ns
    tags:
      - bluetooth
      - ci_build
      - sysbuild
      - ci_samples_bluetooth
```

## samples/bluetooth/peripheral_ancs_client/sample.yaml
```yaml
sample:
  description: Bluetooth Low Energy ANCS client sample
  name: Bluetooth LE ANCS client
tests:
  sample.bluetooth.peripheral_ancs_client.build:
    sysbuild: true
    build_only: true
    integration_platforms:
      - nrf52dk/nrf52832
      - nrf52840dk/nrf52840
      - nrf5340dk/nrf5340/cpuapp
      - nrf5340dk/nrf5340/cpuapp/ns
      - nrf54h20dk/nrf54h20/cpuapp
    platform_allow:
      - nrf52dk/nrf52832
      - nrf52840dk/nrf52840
      - nrf5340dk/nrf5340/cpuapp
      - nrf5340dk/nrf5340/cpuapp/ns
      - nrf54h20dk/nrf54h20/cpuapp
    tags:
      - bluetooth
      - ci_build
      - sysbuild
```

## samples/bluetooth/peripheral_bms/boards/nrf54lm20dk_nrf54lm20a_cpuapp_ns.conf
```kconfig
#
# Copyright (c) 2026 Nordic Semiconductor ASA
#
# SPDX-License-Identifier: LicenseRef-Nordic-5-Clause
#

CONFIG_MPSL_FORCE_RRAM_ON_ALL_THE_TIME=n
```

## samples/bluetooth/peripheral_bms/sample.yaml
```yaml
sample:
  description: Bluetooth Low Energy Bond Management service sample
  name: Bluetooth LE Bond Management service
tests:
  sample.bluetooth.peripheral_bms:
    sysbuild: true
    integration_platforms:
      - nrf52dk/nrf52832
      - nrf52840dk/nrf52840
      - nrf5340dk/nrf5340/cpuapp
      - nrf54l15dk/nrf54l05/cpuapp
      - nrf54l15dk/nrf54l10/cpuapp
      - nrf54l15dk/nrf54l15/cpuapp
      - nrf54l15dk/nrf54l15/cpuapp/ns
      - nrf54h20dk/nrf54h20/cpuapp
      - nrf54lm20dk/nrf54lm20a/cpuapp
      - nrf54lm20dk/nrf54lm20a/cpuapp/ns
      - nrf54lv10dk/nrf54lv10a/cpuapp
    platform_allow:
      - nrf52dk/nrf52832
      - nrf52840dk/nrf52840
      - nrf5340dk/nrf5340/cpuapp
      - nrf54l15dk/nrf54l05/cpuapp
      - nrf54l15dk/nrf54l10/cpuapp
      - nrf54l15dk/nrf54l15/cpuapp
      - nrf54l15dk/nrf54l15/cpuapp/ns
      - nrf54h20dk/nrf54h20/cpuapp
      - nrf54lm20dk/nrf54lm20a/cpuapp
      - nrf54lm20dk/nrf54lm20a/cpuapp/ns
      - nrf54lv10dk/nrf54lv10a/cpuapp
      - nrf54lv10dk/nrf54lv10a/cpuapp/ns
    tags:
      - bluetooth
      - ci_build
      - sysbuild
    harness: console
    harness_config:
      type: multi_line
      ordered: true
      regex:
        - "Starting Bluetooth Peripheral BMS sample"
        - "Bluetooth initialized"
        - "Advertising successfully started"
    timeout: 15
```

## samples/bluetooth/peripheral_cgms/sample.yaml
```yaml
sample:
  description: Bluetooth Low Energy peripheral Continuous Glucose Monitoring Service
  name: Bluetooth LE Continuous Glucose Monitoring Service
tests:
  sample.bluetooth.peripheral_cgm:
    sysbuild: true
    integration_platforms:
      - nrf54l15dk/nrf54l15/cpuapp
    platform_allow:
      - nrf52dk/nrf52832
      - nrf52833dk/nrf52833
      - nrf52840dk/nrf52840
      - nrf5340dk/nrf5340/cpuapp
      - nrf5340dk/nrf5340/cpuapp/ns
      - nrf54l15dk/nrf54l05/cpuapp
      - nrf54l15dk/nrf54l10/cpuapp
      - nrf54l15dk/nrf54l15/cpuapp
      - nrf54l15dk/nrf54l15/cpuapp/ns
      - nrf54h20dk/nrf54h20/cpuapp
      - nrf54lm20dk/nrf54lm20a/cpuapp
      - nrf54lm20dk/nrf54lm20a/cpuapp/ns
      - nrf54lv10dk/nrf54lv10a/cpuapp
      - nrf54lv10dk/nrf54lv10a/cpuapp/ns
    tags:
      - bluetooth
      - ci_build
      - sysbuild
    harness: console
    harness_config:
      type: multi_line
      ordered: true
      regex:
        - "Starting Bluetooth Peripheral CGM sample"
        - "Bluetooth initialized"
        - "Advertising successfully started"
    timeout: 15
```

## samples/bluetooth/peripheral_cts_client/sample.yaml
```yaml
sample:
  description: Bluetooth Low Energy CTS client sample
  name: BLE CTS client sample
tests:
  sample.bluetooth.peripheral_cts_client.build:
    build_only: true
    integration_platforms:
      - nrf52dk_nrf52832
      - nrf52840dk_nrf52840
      - nrf5340dk_nrf5340_cpuapp
      - nrf5340dk_nrf5340_cpuapp_ns
    platform_allow: nrf52dk_nrf52832 nrf52840dk_nrf52840 nrf5340dk_nrf5340_cpuapp
      nrf5340dk_nrf5340_cpuapp_ns
    tags: bluetooth ci_build
```

## samples/bluetooth/peripheral_esl/Kconfig
```kconfig
#
# Copyright (c) 2022 Nordic Semiconductor
#
# SPDX-License-Identifier: LicenseRef-Nordic-5-Clause
#

source "Kconfig.zephyr"

menu "Nordic ESL BLE GATT service sample"

config BT_ESL_THREAD_STACK_SIZE
	int "Thread stack size"
	default 1024
	help
	  Stack size used in each of the two threads

config BT_ESL_SECURITY_ENABLED
	bool "Enable security"
	select BT_SMP
	select BT_BONDABLE
	select BT_BONDING_REQUIRED
	help
	  "Enable BLE security for the ESL service"

config ESL_SIMULATE_DISPLAY
	bool "Use LED2 on DK board to simulate display"
	help
	  "LED2 on DK will blink few times when receive display image ECP command"

config ESL_SIMULATE_DISPLAY_BLINK_TIMES
	int "LED blinking times to indicate display image change"
	default 5
	help
	  "How many times to blink"

config BT_ESL_PTS
	bool "ESL peripheral for PTS test"
	help
	  Enable PTS test for ESL peripheral

config ESL_POWER_PROFILE
	bool "Minimize power cunsumption for measure current"
	help
	  Turn off SPI and EPD power when not in use

module = PERIPHERAL_ESL
module-str = peripheral esl
source "${ZEPHYR_BASE}/subsys/logging/Kconfig.template.log_config"
endmenu
```
