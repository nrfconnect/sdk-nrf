## samples/bluetooth/mesh/nlc_lightness_controller/sample.yaml
```yaml
sample:
  description: Bluetooth Mesh NLC light control sample
  name: Bluetooth Mesh NLC lightness controller
tests:
  sample.bluetooth.mesh.nlc_lightness_controller:
    sysbuild: true
    build_only: true
    integration_platforms:
      - nrf52dk/nrf52832
      - nrf52840dk/nrf52840
      - nrf52833dk/nrf52833
      - nrf5340dk/nrf5340/cpuapp
      - nrf5340dk/nrf5340/cpuapp/ns
      - thingy53/nrf5340/cpuapp
      - nrf21540dk/nrf52840
      - nrf52840dongle/nrf52840
      - nrf54l15dk/nrf54l15/cpuapp
      - nrf54l15dk/nrf54l10/cpuapp
      - nrf54l15dk/nrf54l05/cpuapp
      - nrf54lm20dk/nrf54lm20a/cpuapp
    platform_allow:
      - nrf52dk/nrf52832
      - nrf52840dk/nrf52840
      - nrf5340dk/nrf5340/cpuapp
      - nrf5340dk/nrf5340/cpuapp/ns
      - thingy53/nrf5340/cpuapp
      - nrf21540dk/nrf52840
      - nrf52833dk/nrf52833
      - nrf52840dongle/nrf52840
      - nrf54l15dk/nrf54l15/cpuapp
      - nrf54l15dk/nrf54l10/cpuapp
      - nrf54l15dk/nrf54l05/cpuapp
      - nrf54lm20dk/nrf54lm20a/cpuapp
    tags:
      - bluetooth
      - ci_build
      - sysbuild
  sample.bluetooth.mesh.nlc_lightness_controller.emds:
    sysbuild: true
    extra_args: OVERLAY_CONFIG="overlay-emds.conf"
    build_only: true
    integration_platforms:
      - nrf52840dk/nrf52840
      - nrf52833dk/nrf52833
      - nrf5340dk/nrf5340/cpuapp
      - nrf5340dk/nrf5340/cpuapp/ns
      - thingy53/nrf5340/cpuapp
      - nrf21540dk/nrf52840
      - nrf54l15dk/nrf54l15/cpuapp
      - nrf54l15dk/nrf54l10/cpuapp
      - nrf54l15dk/nrf54l05/cpuapp
      - nrf54lm20dk/nrf54lm20a/cpuapp
    platform_allow:
      - nrf52840dk/nrf52840
      - nrf5340dk/nrf5340/cpuapp
      - nrf5340dk/nrf5340/cpuapp/ns
      - thingy53/nrf5340/cpuapp
      - nrf21540dk/nrf52840
      - nrf52833dk/nrf52833
      - nrf54l15dk/nrf54l15/cpuapp
      - nrf54l15dk/nrf54l10/cpuapp
      - nrf54l15dk/nrf54l05/cpuapp
      - nrf54lm20dk/nrf54lm20a/cpuapp
    tags:
      - bluetooth
      - ci_build
      - sysbuild
  sample.bluetooth.mesh.nlc_lightness_controller.settings_ext_flash:
    sysbuild: true
    build_only: true
    integration_platforms:
      - nrf52840dk/nrf52840
      - nrf54l15dk/nrf54l15/cpuapp
      - nrf54l15dk/nrf54l10/cpuapp
      - nrf54l15dk/nrf54l05/cpuapp
    platform_allow:
      - nrf52840dk/nrf52840
      - nrf54l15dk/nrf54l15/cpuapp
      - nrf54l15dk/nrf54l10/cpuapp
      - nrf54l15dk/nrf54l05/cpuapp
    extra_args: FILE_SUFFIX=settings_ext_flash
    tags:
      - bluetooth
      - ci_build
      - sysbuild
```

## samples/bluetooth/mesh/sensor_client/Kconfig.sysbuild
```kconfig
#
# Copyright (c) 2023 Nordic Semiconductor
#
# SPDX-License-Identifier: LicenseRef-Nordic-5-Clause
#

config NRF_DEFAULT_IPC_RADIO
	default y

config NETCORE_IPC_RADIO_BT_HCI_IPC
	default y

config PARTITION_MANAGER
	default n

source "share/sysbuild/Kconfig"
```

## samples/bluetooth/mesh/sensor_client/sample.yaml
```yaml
sample:
  description: Bluetooth Mesh sensor observer sample
  name: Bluetooth Mesh sensor observer
tests:
  sample.bluetooth.mesh.sensor_client:
    sysbuild: true
    build_only: true
    integration_platforms:
      - nrf52840dk/nrf52840
      - nrf21540dk/nrf52840
      - nrf54l15dk/nrf54l15/cpuapp
      - nrf54l15dk/nrf54l10/cpuapp
      - nrf54l15dk/nrf54l05/cpuapp
    platform_allow:
      - nrf52840dk/nrf52840
      - nrf21540dk/nrf52840
      - nrf54l15dk/nrf54l15/cpuapp
      - nrf54l15dk/nrf54l10/cpuapp
      - nrf54l15dk/nrf54l05/cpuapp
    tags:
      - bluetooth
      - ci_build
      - sysbuild
  sample.bluetooth.mesh.sensor_client.ext_flash_settings:
    sysbuild: true
    build_only: true
    integration_platforms:
      - nrf52840dk/nrf52840
    platform_allow:
      - nrf52840dk/nrf52840
    extra_args:
      - FILE_SUFFIX=ext_flash
      - EXTRA_CONF_FILE=boards/nrf52840dk_nrf52840/ext_flash_settings.conf
    tags:
      - bluetooth
      - ci_build
      - sysbuild
```

## samples/bluetooth/mesh/sensor_observer/boards/nrf54l15dk_nrf54l15_cpuapp.conf
```kconfig
#
# Copyright (c) 2024 Nordic Semiconductor ASA
#
# SPDX-License-Identifier: LicenseRef-Nordic-5-Clause
#
################################################################################
# Application overlay - nrf54l15

CONFIG_SOC_FLASH_NRF_PARTIAL_ERASE=n
CONFIG_NVS=n
CONFIG_NVS_LOOKUP_CACHE=n
CONFIG_SETTINGS_NVS_NAME_CACHE=n
CONFIG_ZMS=y
CONFIG_SETTINGS_ZMS_SECTOR_COUNT=8
CONFIG_ZMS_LOOKUP_CACHE=y
CONFIG_ZMS_LOOKUP_CACHE_SIZE=512
CONFIG_SETTINGS_ZMS_NAME_CACHE=y
CONFIG_SETTINGS_ZMS_NAME_CACHE_SIZE=512
CONFIG_ZMS_LOOKUP_CACHE_FOR_SETTINGS=y
```

## samples/bluetooth/mesh/sensor_server/boards/thingy53_nrf5340_cpuapp.conf
```kconfig
#
# Copyright (c) 2021 Nordic Semiconductor ASA
#
# SPDX-License-Identifier: LicenseRef-Nordic-5-Clause
#
################################################################################
# Application overlay - Thingy:53 DFU

CONFIG_NCS_SAMPLE_MCUMGR_BT_OTA_DFU=y
CONFIG_NCS_SAMPLE_MCUMGR_BT_OTA_DFU_SPEEDUP=y

CONFIG_SYSTEM_WORKQUEUE_STACK_SIZE=4096

# Use deferred logging
CONFIG_NCS_SAMPLES_DEFAULTS=n
CONFIG_LOG=y
CONFIG_ASSERT=y
CONFIG_ASSERT_NO_COND_INFO=y
CONFIG_ASSERT_NO_MSG_INFO=y
CONFIG_HW_STACK_PROTECTION=y

################################################################################
# Sensor configuration

# Enable Temprature Sensor
CONFIG_BME680=y

# Disable nRF5 sensor
CONFIG_TEMP_NRF5=n
```

## samples/bluetooth/mesh/sensor_server/boards/thingy53_nrf5340_cpuapp_ns.conf
```kconfig
#
# Copyright (c) 2021 Nordic Semiconductor ASA
#
# SPDX-License-Identifier: LicenseRef-Nordic-5-Clause
#
################################################################################
# Application overlay - Thingy:53 DFU

CONFIG_MCUMGR=y
CONFIG_MCUMGR_SMP_BT=y
CONFIG_MCUMGR_SMP_BT_AUTHEN=n

CONFIG_MCUMGR_CMD_IMG_MGMT=y
CONFIG_MCUMGR_CMD_OS_MGMT=y

# Enable custom SMP request to erase settings partition.
CONFIG_MCUMGR_GRP_ZEPHYR_BASIC=y
CONFIG_MCUMGR_GRP_BASIC_CMD_STORAGE_ERASE=y

# Increase system workqueue stack size to prevent stack overflows while handling
# SMP requests.
CONFIG_SYSTEM_WORKQUEUE_STACK_SIZE=2800

CONFIG_BT_L2CAP_TX_MTU=498
CONFIG_BT_BUF_ACL_TX_SIZE=251
CONFIG_BT_BUF_ACL_RX_SIZE=502

# Use connection parameters that ensure quick data transfer
CONFIG_BT_PERIPHERAL_PREF_MIN_INT=6
CONFIG_BT_PERIPHERAL_PREF_MAX_INT=6
CONFIG_BT_PERIPHERAL_PREF_LATENCY=0
CONFIG_BT_PERIPHERAL_PREF_TIMEOUT=42

# LEDs are not inverted on Thingy:53
CONFIG_DK_LIBRARY_INVERT_LEDS=n

# Use deferred logging
CONFIG_NCS_SAMPLES_DEFAULTS=n
CONFIG_LOG=y
CONFIG_LOG_PRINTK=y
CONFIG_LOG_PROCESS_THREAD_STACK_SIZE=1024
CONFIG_LOG_PROCESS_THREAD_STARTUP_DELAY_MS=4000
CONFIG_ASSERT=y
CONFIG_ASSERT_NO_COND_INFO=y
CONFIG_ASSERT_NO_MSG_INFO=y
CONFIG_HW_STACK_PROTECTION=y

################################################################################
# Bootloader configuration

CONFIG_BOOTLOADER_MCUBOOT=y
CONFIG_MCUBOOT_IMAGE_VERSION="1.0.0+0"
CONFIG_UPDATEABLE_IMAGE_NUMBER=2

CONFIG_IMG_MANAGER=y
CONFIG_MCUBOOT_IMG_MANAGER=y
CONFIG_IMG_ERASE_PROGRESSIVELY=y

################################################################################
# External flash configuration

CONFIG_NORDIC_QSPI_NOR=y
CONFIG_NORDIC_QSPI_NOR_FLASH_LAYOUT_PAGE_SIZE=4096
CONFIG_NORDIC_QSPI_NOR_STACK_WRITE_BUFFER_SIZE=16

# FLASH nop device is enabled to prevent bus faults when mcumgr tries to access
# simulated partition with network core image data.
CONFIG_FLASH_NOP_DEVICE=y

################################################################################
# Enable USB CDC ACM

CONFIG_USB_DEVICE_STACK=y
CONFIG_USB_DEVICE_PRODUCT="Thingy:53 Application"
CONFIG_USB_DEVICE_VID=0x1915
CONFIG_USB_DEVICE_PID=0x530C
CONFIG_USB_CDC_ACM=y
CONFIG_USB_CDC_ACM_LOG_LEVEL_ERR=y
CONFIG_USB_DEVICE_LOG_LEVEL_ERR=y

# Use CDC_ACM0 for logs
CONFIG_LOG_BACKEND_UART=y
CONFIG_USE_SEGGER_RTT=n
CONFIG_LOG_BACKEND_RTT=n

################################################################################
# Sensor configuration

# Enable Temprature Sensor
CONFIG_BME680=y

# Disable nRF5 sensor
CONFIG_TEMP_NRF5=n
```

## samples/bluetooth/mesh/silvair_enocean/Kconfig.sysbuild
```kconfig
#
# Copyright (c) 2023 Nordic Semiconductor
#
# SPDX-License-Identifier: LicenseRef-Nordic-5-Clause
#

config NRF_DEFAULT_IPC_RADIO
	default y

config PARTITION_MANAGER
	default n

source "share/sysbuild/Kconfig"
```

## samples/bluetooth/mesh/silvair_enocean/sample.yaml
```yaml
sample:
  description: Bluetooth Mesh Silvair EnOcean sample
  name: Bluetooth Mesh Silvair EnOcean
tests:
  sample.bluetooth.mesh.silvair_enocean:
    sysbuild: true
    build_only: true
    integration_platforms:
      - nrf52dk/nrf52832
      - nrf52840dk/nrf52840
      - nrf52833dk/nrf52833
      - nrf5340dk/nrf5340/cpuapp
      - nrf5340dk/nrf5340/cpuapp/ns
      - nrf21540dk/nrf52840
      - nrf54l15dk/nrf54l15/cpuapp
      - nrf54l15dk/nrf54l10/cpuapp
      - nrf54l15dk/nrf54l05/cpuapp
      - nrf54lm20dk/nrf54lm20a/cpuapp
    platform_allow:
      - nrf52dk/nrf52832
      - nrf52840dk/nrf52840
      - nrf5340dk/nrf5340/cpuapp
      - nrf5340dk/nrf5340/cpuapp/ns
      - nrf21540dk/nrf52840
      - nrf52833dk/nrf52833
      - nrf54l15dk/nrf54l15/cpuapp
      - nrf54l15dk/nrf54l10/cpuapp
      - nrf54l15dk/nrf54l05/cpuapp
      - nrf54lm20dk/nrf54lm20a/cpuapp
    tags:
      - bluetooth
      - ci_build
      - sysbuild
  sample.bluetooth.mesh.silvair_enocean.settings_ext_flash:
    sysbuild: true
    build_only: true
    integration_platforms:
      - nrf52840dk/nrf52840
    platform_allow:
      - nrf52840dk/nrf52840
    extra_args: FILE_SUFFIX=settings_ext_flash
    tags:
      - bluetooth
      - ci_build
      - sysbuild
```

## samples/bluetooth/multiple_adv_sets/sample.yaml
```yaml
sample:
  description: Bluetooth Low Energy multiple advertising sets sample
  name: Bluetooth LE multiple advertising sets
tests:
  sample.bluetooth.multiple_adv_sets.build:
    sysbuild: true
    build_only: true
    integration_platforms:
      - nrf52dk/nrf52832
      - nrf52840dk/nrf52840
      - nrf5340dk/nrf5340/cpuapp
      - nrf5340dk/nrf5340/cpuapp/ns
      - nrf54l15dk/nrf54l05/cpuapp
      - nrf54l15dk/nrf54l10/cpuapp
      - nrf54l15dk/nrf54l15/cpuapp
      - nrf54h20dk/nrf54h20/cpuapp
    platform_allow:
      - nrf52dk/nrf52832
      - nrf52840dk/nrf52840
      - nrf5340dk/nrf5340/cpuapp
      - nrf5340dk/nrf5340/cpuapp/ns
      - nrf54l15dk/nrf54l05/cpuapp
      - nrf54l15dk/nrf54l10/cpuapp
      - nrf54l15dk/nrf54l15/cpuapp
      - nrf54h20dk/nrf54h20/cpuapp
    tags:
      - bluetooth
      - ci_build
      - sysbuild
```

## samples/bluetooth/nfc_pairing/sample.yaml
```yaml
sample:
  name: BLE NFC Pairing reference
  description: BLE NFC Pairing reference sample
tests:
  samples.bluetooth.nfc_pairing:
    build_only: true
    build_on_all: true
    platform_allow: nrf52840_pca10056 nrf52_pca10040 nrf5340_dk_nrf5340_cpuapp
    tags: bluetooth ci_build
```

## samples/bluetooth/nrf5340_audio/Kconfig.defaults
```kconfig
#
# Copyright (c) 2022 Nordic Semiconductor ASA
#
# SPDX-License-Identifier: LicenseRef-Nordic-5-Clause
#

config REBOOT
	bool
	default y

config MAIN_THREAD_PRIORITY
	int
	default 10

config MAIN_STACK_SIZE
	int
	default 3616

config SYSTEM_WORKQUEUE_STACK_SIZE
	int
	default 4096

# As long as thread names are used, config must be set to "y"
config THREAD_NAME
	bool
	default y

# Workaround to not use fatal_error.c in NCS. Note that the system may still
# reset on error depending on the build configuraion
config RESET_ON_FATAL_ERROR
	bool
	default n
```

## samples/bluetooth/nrf5340_audio/src/bluetooth/Kconfig
```kconfig
#
# Copyright (c) 2022 Nordic Semiconductor ASA
#
# SPDX-License-Identifier: LicenseRef-Nordic-5-Clause
#

rsource "Kconfig.defaults"

menu "Bluetooth"

config BLE_ACL_CONN_INTERVAL
	int "BLE ACL Connection Interval (x*1.25ms)"
	default 80

config BLE_ACL_SLAVE_LATENCY
	int "BLE Slave Latency"
	default 0

config BLE_ACL_SUP_TIMEOUT
	int "BLE Supervision Timeout (x*10ms)"
	default 400

config BLE_LE_POWER_CONTROL_ENABLED
	bool "Enable LE power control feature"
	default n
	help
	 The LE power control feature makes devices be able to change TX power
	 dynamically and automatically during connection, which provides effective
	 communication.

choice	BLE_CONN_TX_POWER
	prompt "Default TX power for BLE connections"
	default BLE_CONN_TX_POWER_0DBM
	help
		Set the default TX power for BLE connections.

config BLE_CONN_TX_POWER_0DBM
	bool "0dBm"

config BLE_CONN_TX_POWER_NEG_1DBM
	bool "-1dBm"

config BLE_CONN_TX_POWER_NEG_2DBM
	bool "-2dBm"

config BLE_CONN_TX_POWER_NEG_3DBM
	bool "-3dBm"

config BLE_CONN_TX_POWER_NEG_4DBM
	bool "-4dBm"

config BLE_CONN_TX_POWER_NEG_5DBM
	bool "-5dBm"

config BLE_CONN_TX_POWER_NEG_6DBM
	bool "-6dBm"

config BLE_CONN_TX_POWER_NEG_7DBM
	bool "-7dBm"

config BLE_CONN_TX_POWER_NEG_8DBM
	bool "-8dBm"

config BLE_CONN_TX_POWER_NEG_12DBM
	bool "-12dBm"

config BLE_CONN_TX_POWER_NEG_16DBM
	bool "-14dBm"

config BLE_CONN_TX_POWER_NEG_20DBM
	bool "-20dBm"

config BLE_CONN_TX_POWER_NEG_40DBM
	bool "-40dBm"

endchoice

config BLE_CONN_TX_POWER_DBM
	int
	default 0 if BLE_CONN_TX_POWER_0DBM
	default -1 if BLE_CONN_TX_POWER_NEG_1DBM
	default -2 if BLE_CONN_TX_POWER_NEG_2DBM
	default -3 if BLE_CONN_TX_POWER_NEG_3DBM
	default -4 if BLE_CONN_TX_POWER_NEG_4DBM
	default -5 if BLE_CONN_TX_POWER_NEG_5DBM
	default -6 if BLE_CONN_TX_POWER_NEG_6DBM
	default -7 if BLE_CONN_TX_POWER_NEG_7DBM
	default -8 if BLE_CONN_TX_POWER_NEG_8DBM
	default -12 if BLE_CONN_TX_POWER_NEG_12DBM
	default -16 if BLE_CONN_TX_POWER_NEG_16DBM
	default -20 if BLE_CONN_TX_POWER_NEG_20DBM
	default -40 if BLE_CONN_TX_POWER_NEG_40DBM

choice	BLE_ADV_TX_POWER
	prompt "Default TX power for BLE advertising"
	default BLE_ADV_TX_POWER_0DBM
	help
		Set the default TX power for BLE advertising

config BLE_ADV_TX_POWER_0DBM
	bool "0dBm"

config BLE_ADV_TX_POWER_NEG_1DBM
	bool "-1dBm"

config BLE_ADV_TX_POWER_NEG_2DBM
	bool "-2dBm"

config BLE_ADV_TX_POWER_NEG_3DBM
	bool "-3dBm"

config BLE_ADV_TX_POWER_NEG_4DBM
	bool "-4dBm"

config BLE_ADV_TX_POWER_NEG_5DBM
	bool "-5dBm"

config BLE_ADV_TX_POWER_NEG_6DBM
	bool "-6dBm"

config BLE_ADV_TX_POWER_NEG_7DBM
	bool "-7dBm"

config BLE_ADV_TX_POWER_NEG_8DBM
	bool "-8dBm"

config BLE_ADV_TX_POWER_NEG_12DBM
	bool "-12dBm"

config BLE_ADV_TX_POWER_NEG_16DBM
	bool "-14dBm"

config BLE_ADV_TX_POWER_NEG_20DBM
	bool "-20dBm"

config BLE_ADV_TX_POWER_NEG_40DBM
	bool "-40dBm"

endchoice

config BLE_ADV_TX_POWER_DBM
	int
	default 0 if BLE_ADV_TX_POWER_0DBM
	default -1 if BLE_ADV_TX_POWER_NEG_1DBM
	default -2 if BLE_ADV_TX_POWER_NEG_2DBM
	default -3 if BLE_ADV_TX_POWER_NEG_3DBM
	default -4 if BLE_ADV_TX_POWER_NEG_4DBM
	default -5 if BLE_ADV_TX_POWER_NEG_5DBM
	default -6 if BLE_ADV_TX_POWER_NEG_6DBM
	default -7 if BLE_ADV_TX_POWER_NEG_7DBM
	default -8 if BLE_ADV_TX_POWER_NEG_8DBM
	default -12 if BLE_ADV_TX_POWER_NEG_12DBM
	default -16 if BLE_ADV_TX_POWER_NEG_16DBM
	default -20 if BLE_ADV_TX_POWER_NEG_20DBM
	default -40 if BLE_ADV_TX_POWER_NEG_40DBM

config BLE_ISO_TEST_PATTERN
	bool "Transmit a test pattern to measure link performance"
	default n
	help
	 This will transmit the same amount of data as an audio stream, but the
	 data will be an incrementing value ranging from 0-255 and repeating.
	 Note that enabling this feature will disable the audio stream.

config BLE_ISO_RX_STATS_S
	int "Interval in seconds to print BLE ISO RX stats. 0 to deactivate"
	default 0

#----------------------------------------------------------------------------#
menu "Log levels"

config LOG_BLE_LEVEL
	int "Log level for Bluetooth related files"
	default 3

config LOG_AUDIO_SERVICES_LEVEL
	int "Log level for LE Audio services"
	default 3

endmenu # Log levels
endmenu # Bluetooth
```
