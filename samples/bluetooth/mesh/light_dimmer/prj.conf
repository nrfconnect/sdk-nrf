## CMakeLists.txt
```
#
# Copyright (c) 2023 Nordic Semiconductor ASA
#
# SPDX-License-Identifier: LicenseRef-Nordic-5-Clause
#
cmake_minimum_required(VERSION 3.20.0)

find_package(Zephyr REQUIRED HINTS $ENV{ZEPHYR_BASE})
project(mesh_light_dimmer)

# NORDIC SDK APP START
target_sources(app PRIVATE
  src/main.c
  src/model_handler.c
)
target_include_directories(app PRIVATE include)

# NORDIC SDK APP END
```

## Kconfig.sysbuild
```
#
# Copyright (c) 2023 Nordic Semiconductor
#
# SPDX-License-Identifier: LicenseRef-Nordic-5-Clause
#

config NRF_DEFAULT_IPC_RADIO
	default y

config PARTITION_MANAGER
	default y if BOARD_THINGY53_NRF5340_CPUAPP
	default n

source "share/sysbuild/Kconfig"
```

## sample.yaml
```
sample:
  description: Bluetooth Mesh light dimmer sample
  name: Bluetooth Mesh light dimmer
common:
  tags:
    - bluetooth
    - ci_build
    - sysbuild
    - ci_samples_bluetooth
tests:
  sample.bluetooth.mesh.light_dimmer:
    sysbuild: true
    build_only: true
    integration_platforms:
      - nrf54l15dk/nrf54l15/cpuapp
    platform_allow:
      - nrf5340dk/nrf5340/cpuapp
      - nrf5340dk/nrf5340/cpuapp/ns
      - nrf54l15dk/nrf54l15/cpuapp
      - nrf54l15dk/nrf54l10/cpuapp
      - nrf54l15dk/nrf54l05/cpuapp
      - nrf54lc10dk/nrf54lc10a/cpuapp
      - nrf54lm20dk/nrf54lm20a/cpuapp
      - nrf54lm20dk/nrf54lm20a/cpuapp/ite
  sample.bluetooth.mesh.light_dimmer.settings_ext_flash:
    sysbuild: true
    build_only: true
    integration_platforms:
      - nrf54l15dk/nrf54l15/cpuapp
    platform_allow:
      - nrf54l15dk/nrf54l15/cpuapp
      - nrf54l15dk/nrf54l10/cpuapp
      - nrf54l15dk/nrf54l05/cpuapp
    extra_args: FILE_SUFFIX=settings_ext_flash
```

## prj.conf
```kconfig
#
# Copyright (c) 2023 Nordic Semiconductor ASA
#
# SPDX-License-Identifier: LicenseRef-Nordic-5-Clause
#
CONFIG_NCS_SAMPLES_DEFAULTS=y

# Deferred logging helps improve LPN power consumption
# when friendship is established.
CONFIG_LOG_MODE_DEFERRED=y

# General configuration
CONFIG_NCS_APPLICATION_BOOT_BANNER_STRING="Mesh Light Dimmer"
CONFIG_SYSTEM_WORKQUEUE_STACK_SIZE=2048
CONFIG_FLASH=y
CONFIG_FLASH_MAP=y
CONFIG_NVS=y
CONFIG_SETTINGS=y
CONFIG_NVS_LOOKUP_CACHE=y
CONFIG_SETTINGS_NVS_NAME_CACHE=y
CONFIG_HWINFO=y
CONFIG_DK_LIBRARY=y
CONFIG_SOC_FLASH_NRF_PARTIAL_ERASE=y
CONFIG_BT_MESH_NODE_RESET_BUTTON=y

# Bluetooth configuration
CONFIG_BT=y
CONFIG_BT_DEVICE_NAME="Mesh Light Dimmer"
CONFIG_BT_L2CAP_TX_BUF_COUNT=8
CONFIG_BT_OBSERVER=y
CONFIG_BT_PERIPHERAL=y
CONFIG_BT_SETTINGS=y

# Disable unused Bluetooth features
CONFIG_BT_CTLR_LE_ENC=n
CONFIG_BT_PHY_UPDATE=n
CONFIG_BT_CTLR_CHAN_SEL_2=n
CONFIG_BT_CTLR_MIN_USED_CHAN=n
CONFIG_BT_CTLR_PRIVACY=n

# Bluetooth Mesh configuration
CONFIG_BT_MESH=y
CONFIG_BT_MESH_RELAY=y
CONFIG_BT_MESH_FRIEND=y
CONFIG_BT_MESH_TX_SEG_MAX=32
CONFIG_BT_MESH_PB_GATT=y
CONFIG_BT_MESH_GATT_PROXY=y
CONFIG_BT_MESH_PROXY_USE_DEVICE_NAME=y
CONFIG_BT_MESH_DK_PROV=y
CONFIG_BT_MESH_NLC_PERF_DIMMING_CONTROL=y
CONFIG_BT_MESH_NLC_PERF_SCENE_SELECTOR=y
# Enabling NLC Dimming Control profile enables support for 3 application keys by
# default. Therefore, allow up to 3 application key bindings per model instance.
CONFIG_BT_MESH_MODEL_KEY_COUNT=3

# Bluetooth Mesh models
CONFIG_BT_MESH_LVL_CLI=y
CONFIG_BT_MESH_ONOFF_CLI=y
CONFIG_BT_MESH_SCENE_CLI=y

# Debugging
CONFIG_BT_MESH_LOG_LEVEL_DBG=y

CONFIG_LTO=y
CONFIG_ISR_TABLES_LOCAL_DECLARATION=y
```

## boards/nrf52840dongle_nrf52840.conf
```kconfig
#
# Copyright (c) 2026 Nordic Semiconductor ASA
#
# SPDX-License-Identifier: LicenseRef-Nordic-5-Clause
#

CONFIG_USE_DT_CODE_PARTITION=y
```

## boards/nrf5340dk_nrf5340_cpuapp_ns.conf
```kconfig
#
# Copyright (c) 2023 Nordic Semiconductor ASA
#
# SPDX-License-Identifier: LicenseRef-Nordic-5-Clause
#
################################################################################
# Application overlay - nrf5340dk non secure image

CONFIG_SOC_FLASH_NRF_PARTIAL_ERASE=n
```

## boards/nrf54l15dk_nrf54l05_cpuapp_settings_ext_flash.conf
```kconfig
#
# Copyright (c) 2025 Nordic Semiconductor ASA
#
# SPDX-License-Identifier: LicenseRef-Nordic-5-Clause
#
################################################################################
# Application overlay - nrf54l05

CONFIG_SOC_FLASH_NRF_PARTIAL_ERASE=n
CONFIG_NVS=n
CONFIG_NVS_LOOKUP_CACHE=n
CONFIG_SETTINGS_NVS_NAME_CACHE=n
CONFIG_ZMS=y
CONFIG_SETTINGS_ZMS_CUSTOM_SECTOR_COUNT=y
CONFIG_SETTINGS_ZMS_SECTOR_COUNT=8
CONFIG_ZMS_LOOKUP_CACHE=y
CONFIG_ZMS_LOOKUP_CACHE_SIZE=512
CONFIG_ZMS_LOOKUP_CACHE_FOR_SETTINGS=y
CONFIG_SYSTEM_WORKQUEUE_STACK_SIZE=4096
CONFIG_BT_RX_STACK_SIZE=5120
CONFIG_BT_MESH_SETTINGS_WORKQ_STACK_SIZE=1800

# External flash specific settings
CONFIG_GPIO=y
CONFIG_SPI=y
CONFIG_SPI_NOR=y
CONFIG_SPI_NOR_SFDP_DEVICETREE=y
CONFIG_SPI_NOR_FLASH_LAYOUT_PAGE_SIZE=4096
# QSPI drivers are enabled by default for some chips.
# Disable it explicitly to be sure QSPI is disabled.
CONFIG_NORDIC_QSPI_NOR=n

# Relocate settings partition to external flash
CONFIG_PM_PARTITION_REGION_SETTINGS_STORAGE_EXTERNAL=y
CONFIG_PM_PARTITION_SIZE_SETTINGS_STORAGE=0x8000
```

## boards/nrf54l15dk_nrf54l10_cpuapp.conf
```kconfig
#
# Copyright (c) 2024 Nordic Semiconductor ASA
#
# SPDX-License-Identifier: LicenseRef-Nordic-5-Clause
#
################################################################################
# Application overlay - nrf54l10

CONFIG_SOC_FLASH_NRF_PARTIAL_ERASE=n
CONFIG_NVS=n
CONFIG_NVS_LOOKUP_CACHE=n
CONFIG_SETTINGS_NVS_NAME_CACHE=n
CONFIG_ZMS=y
CONFIG_SETTINGS_ZMS_CUSTOM_SECTOR_COUNT=y
CONFIG_SETTINGS_ZMS_SECTOR_COUNT=8
CONFIG_ZMS_LOOKUP_CACHE=y
CONFIG_ZMS_LOOKUP_CACHE_SIZE=512
CONFIG_SETTINGS_ZMS_NAME_CACHE=y
CONFIG_SETTINGS_ZMS_NAME_CACHE_SIZE=512
CONFIG_ZMS_LOOKUP_CACHE_FOR_SETTINGS=y
CONFIG_SYSTEM_WORKQUEUE_STACK_SIZE=4096
CONFIG_BT_RX_STACK_SIZE=5120
```

## boards/nrf54l15dk_nrf54l15_cpuapp.conf
```kconfig
#
# Copyright (c) 2024 Nordic Semiconductor ASA
#
# SPDX-License-Identifier: LicenseRef-Nordic-5-Clause
#
################################################################################
# Application overlay - nrf54l15

CONFIG_SOC_FLASH_NRF_PARTIAL_ERASE=n
CONFIG_NVS=n
CONFIG_NVS_LOOKUP_CACHE=n
CONFIG_SETTINGS_NVS_NAME_CACHE=n
CONFIG_ZMS=y
CONFIG_SETTINGS_ZMS_CUSTOM_SECTOR_COUNT=y
CONFIG_SETTINGS_ZMS_SECTOR_COUNT=8
CONFIG_ZMS_LOOKUP_CACHE=y
CONFIG_ZMS_LOOKUP_CACHE_SIZE=512
CONFIG_SYSTEM_WORKQUEUE_STACK_SIZE=4096
CONFIG_BT_RX_STACK_SIZE=5120
```

## boards/thingy53_nrf5340_cpuapp.conf
```kconfig
#
# Copyright (c) 2023 Nordic Semiconductor ASA
#
# SPDX-License-Identifier: LicenseRef-Nordic-5-Clause
#
################################################################################
# Application overlay - Thingy:53 DFU

CONFIG_NCS_SAMPLE_MCUMGR_BT_OTA_DFU=y
CONFIG_NCS_SAMPLE_MCUMGR_BT_OTA_DFU_SPEEDUP=y

CONFIG_SYSTEM_WORKQUEUE_STACK_SIZE=4096

CONFIG_BT_RX_STACK_SIZE=4096

# Use deferred logging
CONFIG_NCS_SAMPLES_DEFAULTS=n
CONFIG_LOG=y
CONFIG_ASSERT=y
CONFIG_ASSERT_NO_COND_INFO=y
CONFIG_ASSERT_NO_MSG_INFO=y
CONFIG_HW_STACK_PROTECTION=y
```

## boards/nrf52840dongle_nrf52840.overlay
```dts
/* Copyright (c) 2026 Nordic Semiconductor ASA
 *
 * SPDX-License-Identifier: LicenseRef-Nordic-5-Clause
 */

/delete-node/ &boot_partition;
/delete-node/ &slot0_partition;
/delete-node/ &slot1_partition;
/delete-node/ &storage_partition;

&flash0 {
	partitions {
		slot0_partition: partition@1000 {
			compatible = "zephyr,mapped-partition";
			label = "image-0";
			reg = <0x00001000 0x000d7000>;
		};

		storage_partition: partition@d8000 {
			compatible = "zephyr,mapped-partition";
			label = "storage";
			reg = <0x000d8000 0x00008000>;
		};
	};
};
```

## src/main.c
```c
/*
 * Copyright (c) 2023 Nordic Semiconductor ASA
 *
 * SPDX-License-Identifier: LicenseRef-Nordic-5-Clause
 */

/** @file
 *  @brief Nordic mesh light switch sample
 */
#include <zephyr/bluetooth/bluetooth.h>
#include <bluetooth/mesh/models.h>
#include <bluetooth/mesh/dk_prov.h>
#include <dk_buttons_and_leds.h>
#include <bluetooth/mesh/node_reset_button.h>
#include "model_handler.h"

static void bt_ready(int err)
{
	if (err) {
		printk("Bluetooth init failed (err %d)\n", err);
		return;
	}

	printk("Bluetooth initialized\n");

	err = dk_leds_init();
	if (err) {
		printk("Initializing LEDs failed (err %d)\n", err);
		return;
	}

	err = dk_buttons_init(NULL);
	if (err) {
		printk("Initializing buttons failed (err %d)\n", err);
		return;
	}

	if (IS_ENABLED(CONFIG_BT_MESH_NODE_RESET_BUTTON)) {
		bt_mesh_node_reset_button_init();
	}

	err = bt_mesh_init(bt_mesh_dk_prov_init(), model_handler_init());
	if (err) {
		printk("Initializing mesh failed (err %d)\n", err);
		return;
	}

	if (IS_ENABLED(CONFIG_SETTINGS)) {
		settings_load();
	}

	/* This will be a no-op if settings_load() loaded provisioning info */
	bt_mesh_prov_enable(BT_MESH_PROV_ADV | BT_MESH_PROV_GATT);

	printk("Mesh initialized\n");
}

int main(void)
{
	int err;

	printk("Initializing...\n");

	err = bt_enable(bt_ready);
	if (err) {
		printk("Bluetooth init failed (err %d)\n", err);
	}

	return 0;
}
```

## include/model_handler.h
```c
/*
 * Copyright (c) 2023 Nordic Semiconductor ASA
 *
 * SPDX-License-Identifier: LicenseRef-Nordic-5-Clause
 */

/**
 * @file
 * @brief Model handler
 */

#ifndef MODEL_HANDLER_H__
#define MODEL_HANDLER_H__

#include <zephyr/bluetooth/mesh.h>

#ifdef __cplusplus
extern "C" {
#endif

const struct bt_mesh_comp *model_handler_init(void);

#ifdef __cplusplus
}
#endif

#endif /* MODEL_HANDLER_H__ */
```

## src/model_handler.c
```c
/*
 * Copyright (c) 2023 Nordic Semiconductor ASA
 *
 * SPDX-License-Identifier: LicenseRef-Nordic-5-Clause
 */

/**
 * @file
 * @brief Model handler for the Light Dimmer Controller.
 *
 */
#include <zephyr/bluetooth/bluetooth.h>
#include <zephyr/bluetooth/mesh/proxy.h>
#include <bluetooth/mesh/models.h>
#include <dk_buttons_and_leds.h>
#include "model_handler.h"
#include <time.h>

#include <zephyr/logging/log.h>
LOG_MODULE_REGISTER(dimmer_sample, LOG_LEVEL_INF);

#define SHORT_PRESS_THRESHOLD_MS 300
#define LONG_PRESS_TIMEOUT_SEC K_SECONDS(20)
#define DELTA_MOVE_STEP 1000
#define SCENE_COUNT 4

enum dim_direction { DIM_DOWN, DIM_UP };

/** Context for a single Light Dimmer instance. */
struct dimmer_ctx {
	/** Generic OnOff client instance for this switch */
	struct bt_mesh_onoff_cli onoff_client;
	/** Generic Level client instance for this switch */
	struct bt_mesh_lvl_cli lvl_client;
	/* Relative start time of the latest press of the button */
	int64_t press_start_time;
	/* Dimmer direction */
	enum dim_direction direction;
	/* Long press work (Dimmer mode) */
	struct k_work_delayable long_press_start_work;
	struct k_work_delayable long_press_stop_work;
};

/** Context for a single scene button instance */
struct scene_btn_ctx {
	/** Scene client instance for this button */
	struct bt_mesh_scene_cli client;
	/** The currently recalled scene*/
	uint16_t current_scene;
	/** Time when button was pressed */
	int64_t press_start_time;
};

#if IS_ENABLED(CONFIG_BT_MESH_NLC_PERF_BASELINE)
static const uint8_t cmp2_elem_offset[1] = { 0 };

static const struct bt_mesh_comp2_record comp_rec[2] = {
	{/* Basic Scene Selector NLC Profile 1.0.1*/
	.id = BT_MESH_NLC_PROFILE_ID_BASIC_SCENE_SELECTOR,
	.version.x = 1,
	.version.y = 0,
	.version.z = 1,
	.elem_offset_cnt = 1,
	.elem_offset = cmp2_elem_offset,
	.data_len = 0
	},
	{/* Dimming Control NLC Profile 1.0.1 */
	.id = BT_MESH_NLC_PROFILE_ID_DIMMING_CONTROL,
	.version.x = 1,
	.version.y = 0,
	.version.z = 1,
	.elem_offset_cnt = 1,
	.elem_offset = cmp2_elem_offset,
	.data_len = 0
	}
};

static const struct bt_mesh_comp2 comp_p2 = {
	.record_cnt = 2,
	.record = comp_rec
};
#endif

static void dimmer_start(struct k_work *work)
{
	struct dimmer_ctx *ctx = CONTAINER_OF(k_work_delayable_from_work(work), struct dimmer_ctx,
					      long_press_start_work);

	struct bt_mesh_lvl_move_set move_set = {
		.delta = (ctx->direction == DIM_UP) ? DELTA_MOVE_STEP :
						      (int16_t)(-1 * DELTA_MOVE_STEP),
		.transition = &(struct bt_mesh_model_transition){ .time = 500 },
	};

	LOG_INF("Start dimming %s...", (ctx->direction == DIM_UP ? "UP" : "DOWN"));

	/* As we can't know how many nodes are in a group, it doesn't
	 * make sense to send acknowledged messages to group addresses.
	 */
	if (bt_mesh_model_pub_is_unicast(ctx->lvl_client.model)) {
		bt_mesh_lvl_cli_move_set(&ctx->lvl_client, NULL, &move_set, NULL);
	} else {
		bt_mesh_lvl_cli_move_set_unack(&ctx->lvl_client, NULL, &move_set);
	}

	k_work_reschedule(&ctx->long_press_stop_work, LONG_PRESS_TIMEOUT_SEC);
}

static void dimmer_stop(struct k_work *work)
{
	struct dimmer_ctx *ctx = CONTAINER_OF(k_work_delayable_from_work(work), struct dimmer_ctx,
					      long_press_stop_work);

	struct bt_mesh_lvl_move_set move_set = {
		.delta = 0,
		.transition = NULL,
	};

	if (bt_mesh_model_pub_is_unicast(ctx->lvl_client.model)) {
		bt_mesh_lvl_cli_move_set(&ctx->lvl_client, NULL, &move_set, NULL);
	} else {
		bt_mesh_lvl_cli_move_set_unack(&ctx->lvl_client, NULL, &move_set);
	}
}

static struct dimmer_ctx dimmer = {
	.lvl_client = BT_MESH_LVL_CLI_INIT(NULL),
	.onoff_client = BT_MESH_ONOFF_CLI_INIT(NULL),
	.press_start_time = 0,
	.direction = DIM_DOWN
};

static void dimmer_button_handler(struct dimmer_ctx *ctx, bool pressed)
{
	int err;

	if (pressed) {
		ctx->direction = (ctx->direction == DIM_UP) ? DIM_DOWN : DIM_UP;

		ctx->press_start_time = k_uptime_get();
		err = k_work_reschedule(&ctx->long_press_start_work,
					K_MSEC(SHORT_PRESS_THRESHOLD_MS));

		if (err < 0) {
			LOG_ERR("Scheduling dimming to start failed: %d", err);
		}
	} else {
		if ((k_uptime_get() - ctx->press_start_time) >= SHORT_PRESS_THRESHOLD_MS) {
			/** Button was released after a long time.
			 * Stop dimming immediately.
			 */
			err = k_work_reschedule(&ctx->long_press_stop_work, K_NO_WAIT);

			if (err < 0) {
				LOG_INF("Scheduling dimming to stop failed: %d", err);
			}

		} else {
			/** Button was released after a short time.
			 * Cancel dimming operation and toggle light on/off.
			 */
			LOG_INF("Toggle light %s", (ctx->direction == DIM_UP ? "ON" : "OFF"));
			k_work_cancel_delayable(&ctx->long_press_start_work);

			struct bt_mesh_onoff_set set = {
				.on_off = ctx->direction,
			};

			/* As we can't know how many nodes are in a group, it doesn't
			 * make sense to send acknowledged messages to group addresses.
			 */
			if (bt_mesh_model_pub_is_unicast(ctx->onoff_client.model)) {
				err = bt_mesh_onoff_cli_set(&ctx->onoff_client, NULL, &set, NULL);
			} else {
				err = bt_mesh_onoff_cli_set_unack(&ctx->onoff_client, NULL, &set);
			}

			if (err) {
				LOG_ERR("Failed to send OnOff set message: %d", err);
			}
		}
	}
}

static struct scene_btn_ctx scene_btn = {
	.current_scene = 1,
	.press_start_time = 0
};

static void scene_button_handler(struct scene_btn_ctx *ctx, bool pressed)
{
	if (pressed) {
		ctx->press_start_time = k_uptime_get();
	} else {
		int err;

		if (k_uptime_get() - ctx->press_start_time > SHORT_PRESS_THRESHOLD_MS) {
			/* Long press, store scene */
			LOG_INF("Storing scene %d", ctx->current_scene);
			err = bt_mesh_scene_cli_store_unack(&ctx->client, NULL,
							    ctx->current_scene);

			if (err) {
				LOG_ERR("Failed to send Scene Store message: %d", err);
			}
		} else {
			/* Short press, recall next scene */
			ctx->current_scene = (ctx->current_scene >= SCENE_COUNT) ?
					     1 : ctx->current_scene + 1;
			LOG_INF("Recalling scene %d", ctx->current_scene);
			err = bt_mesh_scene_cli_recall_unack(&ctx->client, NULL,
							     ctx->current_scene, NULL);

			if (err) {
				LOG_ERR("Failed to send Scene Recall message: %d", err);
			}
		}
	}
}

static void button_handler_cb(uint32_t pressed, uint32_t changed)
{
	if (!bt_mesh_is_provisioned()) {
		return;
	}

	if (changed & BIT(0)) {
		dimmer_button_handler(&dimmer, pressed & BIT(0));
	}
	if (changed & BIT(1)) {
		scene_button_handler(&scene_btn, pressed & BIT(1));
	}
}

/* Set up a repeating delayed work to blink the DK's LEDs when attention is
 * requested.
 */
static struct k_work_delayable attention_blink_work;
static bool attention;

static void attention_blink(struct k_work *work)
{
	static int idx;
	const uint8_t pattern[] = {
#if DT_NODE_EXISTS(DT_ALIAS(sw0))
		BIT(0),
#endif
#if DT_NODE_EXISTS(DT_ALIAS(sw1))
		BIT(1),
#endif
#if DT_NODE_EXISTS(DT_ALIAS(sw2))
		BIT(2),
#endif
#if DT_NODE_EXISTS(DT_ALIAS(sw3))
		BIT(3),
#endif
	};

	if (attention) {
		dk_set_leds(pattern[idx++ % ARRAY_SIZE(pattern)]);
		k_work_reschedule(&attention_blink_work, K_MSEC(30));
	} else {
		dk_set_leds(DK_NO_LEDS_MSK);
	}
}

static void attention_on(const struct bt_mesh_model *mod)
{
	attention = true;
	k_work_reschedule(&attention_blink_work, K_NO_WAIT);
}

static void attention_off(const struct bt_mesh_model *mod)
{
	/* Will stop rescheduling blink timer */
	attention = false;
}

static const struct bt_mesh_health_srv_cb health_srv_cb = {
	.attn_on = attention_on,
	.attn_off = attention_off,
};

static struct bt_mesh_health_srv health_srv = {
	.cb = &health_srv_cb,
};

BT_MESH_HEALTH_PUB_DEFINE(health_pub, 0);

static struct bt_mesh_elem elements[] = {
	BT_MESH_ELEM(1,
		     BT_MESH_MODEL_LIST(BT_MESH_MODEL_CFG_SRV,
					BT_MESH_MODEL_HEALTH_SRV(&health_srv, &health_pub),
					BT_MESH_MODEL_ONOFF_CLI(&dimmer.onoff_client),
					BT_MESH_MODEL_LVL_CLI(&dimmer.lvl_client),
					BT_MESH_MODEL_SCENE_CLI(&scene_btn.client)),
		     BT_MESH_MODEL_NONE),
};

static const struct bt_mesh_comp comp = {
	.cid = CONFIG_BT_COMPANY_ID,
	.elem = elements,
	.elem_count = ARRAY_SIZE(elements),
};

const struct bt_mesh_comp *model_handler_init(void)
{
#if IS_ENABLED(CONFIG_BT_MESH_NLC_PERF_BASELINE)
	if (bt_mesh_comp2_register(&comp_p2)) {
		printf("Failed to register comp2\n");
	}
#endif

	static struct button_handler button_handler = {
		.cb = button_handler_cb,
	};

	dk_button_handler_add(&button_handler);
	k_work_init_delayable(&attention_blink_work, attention_blink);
	k_work_init_delayable(&dimmer.long_press_start_work, dimmer_start);
	k_work_init_delayable(&dimmer.long_press_stop_work, dimmer_stop);

	return &comp;
}
```
