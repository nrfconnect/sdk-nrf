## CMakeLists.txt
```
#
# Copyright (c) 2021 Nordic Semiconductor ASA
#
# SPDX-License-Identifier: LicenseRef-Nordic-5-Clause
#

cmake_minimum_required(VERSION 3.20.0)

find_package(Zephyr REQUIRED HINTS $ENV{ZEPHYR_BASE})
project(ble_peripheral_lbs_coex)

# NORDIC SDK APP START
target_sources(app PRIVATE
  src/main.c
  src/lb_service_handler.c
  src/model_handler.c
)
target_include_directories(app PRIVATE include)

# NORDIC SDK APP END
```

## sample.yaml
```
sample:
  description: Bluetooth Mesh and Peripheral Coexistence sample
  name: Bluetooth Mesh and Peripheral Coexistence
common:
  tags:
    - bluetooth
    - ci_build
    - sysbuild
    - ci_samples_bluetooth
tests:
  sample.bluetooth.mesh.ble_and_mesh:
    sysbuild: true
    build_only: true
    integration_platforms:
      - nrf54l15dk/nrf54l15/cpuapp
    platform_allow:
      - nrf54l15dk/nrf54l15/cpuapp
      - nrf54l15dk/nrf54l10/cpuapp
      - nrf54l15dk/nrf54l05/cpuapp
      - nrf54lc10dk/nrf54lc10a/cpuapp
      - nrf54lm20dk/nrf54lm20a/cpuapp
      - nrf54lm20dk/nrf54lm20a/cpuapp/ite
  sample.bluetooth.mesh.ble_and_mesh.settings_ext_flash:
    sysbuild: true
    build_only: true
    extra_args: FILE_SUFFIX=settings_ext_flash
    integration_platforms:
      - nrf54l15dk/nrf54l15/cpuapp
    platform_allow:
      - nrf54l15dk/nrf54l15/cpuapp
      - nrf54l15dk/nrf54l10/cpuapp
      - nrf54l15dk/nrf54l05/cpuapp
```

## prj.conf
```kconfig
#
# Copyright (c) 2021 Nordic Semiconductor ASA
#
# SPDX-License-Identifier: LicenseRef-Nordic-5-Clause
#
CONFIG_NCS_SAMPLES_DEFAULTS=y

# Deferred logging helps improve LPN power consumption
# when friendship is established.
CONFIG_LOG_MODE_DEFERRED=y

# General configuration
CONFIG_NCS_APPLICATION_BOOT_BANNER_STRING="Mesh and Peripheral Coex"
CONFIG_SYSTEM_WORKQUEUE_STACK_SIZE=2048
CONFIG_FLASH=y
CONFIG_FLASH_MAP=y
CONFIG_NVS=y
CONFIG_SETTINGS=y
CONFIG_NVS_LOOKUP_CACHE=y
CONFIG_SETTINGS_NVS_NAME_CACHE=y
CONFIG_HWINFO=y
CONFIG_DK_LIBRARY=y
CONFIG_SOC_FLASH_NRF_PARTIAL_ERASE=y
CONFIG_BT_MESH_NODE_RESET_BUTTON=y

# Bluetooth configuration
CONFIG_BT=y
CONFIG_BT_DEVICE_NAME="Mesh and Peripheral Coex"
CONFIG_BT_L2CAP_TX_BUF_COUNT=8
CONFIG_BT_OBSERVER=y
CONFIG_BT_PERIPHERAL=y
CONFIG_BT_SETTINGS=y

CONFIG_BT_EXT_ADV=y
# 5 sets are used by Bluetooth Mesh, 1 is needed for the sample advs.
CONFIG_BT_EXT_ADV_MAX_ADV_SET=6
CONFIG_BT_MAX_CONN=3
CONFIG_BT_ID_MAX=2

# Disable unused Bluetooth features
CONFIG_BT_CTLR_LE_ENC=n
CONFIG_BT_PHY_UPDATE=n
CONFIG_BT_CTLR_CHAN_SEL_2=n
CONFIG_BT_CTLR_MIN_USED_CHAN=n
CONFIG_BT_CTLR_PRIVACY=n

# Bluetooth Mesh configuration
CONFIG_BT_MESH=y
CONFIG_BT_MESH_RELAY=y
CONFIG_BT_MESH_FRIEND=y
CONFIG_BT_MESH_TX_SEG_MAX=10
CONFIG_BT_MESH_PB_GATT=y
CONFIG_BT_MESH_GATT_PROXY=y
CONFIG_BT_MESH_PROXY_USE_DEVICE_NAME=y
CONFIG_BT_MESH_DK_PROV=y

# Bluetooth Mesh models
CONFIG_BT_MESH_ONOFF_SRV=y

# Enable the LBS service
CONFIG_BT_LBS=y
CONFIG_BT_LBS_POLL_BUTTON=y

# Increase the HCI command buffers to 3 for additional Peripheral LE Service
CONFIG_BT_BUF_CMD_TX_COUNT=3

CONFIG_LTO=y
CONFIG_ISR_TABLES_LOCAL_DECLARATION=y
```

## boards/nrf54l15dk_nrf54l05_cpuapp.conf
```kconfig
#
# Copyright (c) 2024 Nordic Semiconductor ASA
#
# SPDX-License-Identifier: LicenseRef-Nordic-5-Clause
#
################################################################################
# Application overlay - nrf54l05

CONFIG_SOC_FLASH_NRF_PARTIAL_ERASE=n
CONFIG_NVS=n
CONFIG_NVS_LOOKUP_CACHE=n
CONFIG_SETTINGS_NVS_NAME_CACHE=n
CONFIG_ZMS=y
CONFIG_SETTINGS_ZMS_CUSTOM_SECTOR_COUNT=y
CONFIG_SETTINGS_ZMS_SECTOR_COUNT=8
CONFIG_ZMS_LOOKUP_CACHE=y
CONFIG_ZMS_LOOKUP_CACHE_SIZE=512
CONFIG_SYSTEM_WORKQUEUE_STACK_SIZE=4096
CONFIG_BT_RX_STACK_SIZE=5120
```

## boards/nrf54l15pdk_nrf54l15_cpuapp.conf
```kconfig
#
# Copyright (c) 2024 Nordic Semiconductor ASA
#
# SPDX-License-Identifier: LicenseRef-Nordic-5-Clause
#
################################################################################
# Application overlay - nrf54l15

CONFIG_SOC_FLASH_NRF_PARTIAL_ERASE=n
```

## src/main.c
```c
/*
 * Copyright (c) 2021 Nordic Semiconductor ASA
 *
 * SPDX-License-Identifier: LicenseRef-Nordic-5-Clause
 */

/** @file
 *  @brief Nordic mesh and peripheral coexistence sample
 */

#include <zephyr/bluetooth/bluetooth.h>
#include <bluetooth/mesh/models.h>
#include <bluetooth/mesh/dk_prov.h>
#include <dk_buttons_and_leds.h>
#include <bluetooth/mesh/node_reset_button.h>
#include "model_handler.h"
#include "lb_service_handler.h"

static void bt_ready(int err)
{
	if (err) {
		printk("Bluetooth init failed (err %d)\n", err);
		return;
	}

	printk("Bluetooth initialized\n");

	err = dk_leds_init();
	if (err) {
		printk("Initializing LEDs failed (err %d)\n", err);
		return;
	}

	err = dk_buttons_init(NULL);
	if (err) {
		printk("Initializing buttons failed (err %d)\n", err);
		return;
	}

	if (IS_ENABLED(CONFIG_BT_MESH_NODE_RESET_BUTTON)) {
		bt_mesh_node_reset_button_init();
	}

	err = bt_mesh_init(bt_mesh_dk_prov_init(), model_handler_init());
	if (err) {
		printk("Initializing mesh failed (err %d)\n", err);
		return;
	}

	if (IS_ENABLED(CONFIG_SETTINGS)) {
		settings_load();
	}

	/* This will be a no-op if settings_load() loaded provisioning info */
	bt_mesh_prov_enable(BT_MESH_PROV_ADV | BT_MESH_PROV_GATT);

	printk("Mesh initialized\n");

	lbs_handler_init();

}

int main(void)
{
	int err;

	printk("Initializing...\n");

	err = bt_enable(bt_ready);
	if (err) {
		printk("Bluetooth init failed (err %d)\n", err);
	}

	return 0;
}
```

## include/lb_service_handler.h
```c
/*
 * Copyright (c) 2021 Nordic Semiconductor ASA
 *
 * SPDX-License-Identifier: LicenseRef-Nordic-5-Clause
 */

/**
 * @file
 * @brief LED Button service handler
 */

#ifndef LB_SERVICE_HANDLER_H__
#define LB_SERVICE_HANDLER_H__

#ifdef __cplusplus
extern "C" {
#endif

void lbs_handler_init(void);

#ifdef __cplusplus
}
#endif

#endif /* LB_SERVICE_HANDLER_H__ */
```

## include/model_handler.h
```c
/*
 * Copyright (c) 2021 Nordic Semiconductor ASA
 *
 * SPDX-License-Identifier: LicenseRef-Nordic-5-Clause
 */

/**
 * @file
 * @brief Model handler
 */

#ifndef MODEL_HANDLER_H__
#define MODEL_HANDLER_H__

#include <zephyr/bluetooth/mesh.h>

#ifdef __cplusplus
extern "C" {
#endif

void ble_conn_init(void);

const struct bt_mesh_comp *model_handler_init(void);

#ifdef __cplusplus
}
#endif

#endif /* MODEL_HANDLER_H__ */
```

## src/lb_service_handler.c
```c
/*
 * Copyright (c) 2021 Nordic Semiconductor ASA
 *
 * SPDX-License-Identifier: LicenseRef-Nordic-5-Clause
 */

#include <zephyr/types.h>
#include <stddef.h>
#include <zephyr/sys/printk.h>
#include <zephyr/sys/byteorder.h>
#include <zephyr/kernel.h>
#include <zephyr/drivers/gpio.h>
#include <soc.h>

#include <zephyr/bluetooth/bluetooth.h>
#include <zephyr/bluetooth/hci.h>
#include <zephyr/bluetooth/conn.h>
#include <zephyr/bluetooth/uuid.h>

#include <bluetooth/services/lbs.h>
#include <dk_buttons_and_leds.h>

#if !DT_NODE_EXISTS(DT_ALIAS(sw0))
#error "Unsupported board: sw0 devicetree alias is not defined"
#endif

#if !DT_NODE_EXISTS(DT_ALIAS(led1))
#error "Unsupported board: led1 devicetree alias is not defined"
#endif

#define LBS_LED DK_LED2
#define LBS_BUTTON DK_BTN1_MSK

static const struct bt_data ad[] = {
	BT_DATA_BYTES(BT_DATA_FLAGS, (BT_LE_AD_GENERAL | BT_LE_AD_NO_BREDR)),
	BT_DATA(BT_DATA_NAME_COMPLETE, CONFIG_BT_DEVICE_NAME, (sizeof(CONFIG_BT_DEVICE_NAME) - 1)),
};

static const struct bt_data sd[] = {
	BT_DATA_BYTES(BT_DATA_UUID128_ALL, BT_UUID_LBS_VAL),
};

static struct bt_le_ext_adv *adv;
static uint8_t lbs_conn_id;
static bool ble_button_state;

static void connected(struct bt_conn *conn, uint8_t err)
{
	struct bt_conn_info cinfo;
	int ec;

	ec = bt_conn_get_info(conn, &cinfo);
	if (ec) {
		printk("Unable to get connection info (err %d)\n", ec);
		return;
	}

	if (cinfo.id != lbs_conn_id) {
		return;
	}

	if (err) {
		printk("Connection failed (err %u)\n", err);
		return;
	}

	printk("Connected\n");
}

static void disconnected(struct bt_conn *conn, uint8_t reason)
{
	struct bt_conn_info cinfo;
	int ec;

	ec = bt_conn_get_info(conn, &cinfo);
	if (ec) {
		printk("Unable to get connection info (err %d)\n", ec);
		return;
	}

	if (cinfo.id != lbs_conn_id) {
		return;
	}

	printk("Disconnected (reason %u)\n", reason);
}

BT_CONN_CB_DEFINE(conn_callbacks) = {
	.connected = connected,
	.disconnected = disconnected,
};

static void app_led_cb(bool led_state)
{
	dk_set_led(LBS_LED, led_state);
}

static bool app_button_cb(void)
{
	return ble_button_state;
}

static struct bt_lbs_cb lbs_callbacs = {
	.led_cb = app_led_cb,
	.button_cb = app_button_cb,
};

static void button_changed(uint32_t button_state, uint32_t has_changed)
{
	if (has_changed & LBS_BUTTON) {
		uint32_t user_button_state = button_state & LBS_BUTTON;

		bt_lbs_send_button_state(user_button_state);
		ble_button_state = user_button_state ? true : false;
	}
}

static void lbs_adv_start(void)
{
	int err;
	size_t id_count = 0xFF;
	struct bt_le_adv_param adv_params = *BT_LE_ADV_CONN_FAST_2;
	/* Use different identity from Bluetooth Mesh to avoid conflicts with Mesh Provisioning
	 * Service and Mesh Proxy Service advertisements.
	 */
	(void)bt_id_get(NULL, &id_count);

	if (id_count < CONFIG_BT_ID_MAX) {
		int id = bt_id_create(NULL, NULL);

		if (id < 0) {
			printk("Unable to create a new identity for LBS (err %d)."
			       " Using the default one.\n", id);
			lbs_conn_id = BT_ID_DEFAULT;
		} else {
			lbs_conn_id = id;
		}

		printk("Created a new identity for LBS: %d\n", lbs_conn_id);
	} else {
		lbs_conn_id = BT_ID_DEFAULT + 1;
		printk("Recovered identity for LBS: %d\n", lbs_conn_id);
	}

	adv_params.id = lbs_conn_id;

	err = bt_le_ext_adv_create(&adv_params, NULL, &adv);
	if (err) {
		printk("Creating LBS service adv instance failed (err %d)\n", err);
		return;
	}

	err = bt_le_ext_adv_set_data(adv, ad, ARRAY_SIZE(ad), sd, ARRAY_SIZE(sd));
	if (err) {
		printk("Setting LBS service adv data failed (err %d)\n", err);
		return;
	}

	err = bt_le_ext_adv_start(adv, BT_LE_EXT_ADV_START_DEFAULT);
	if (err) {
		printk("Starting advertising of LBS service failed (err %d)\n", err);
	} else {
		printk("Advertising successfully started\n");
	}
}

static void lbs_init(void)
{
	static struct button_handler button_handler = {
		.cb = button_changed,
	};

	dk_button_handler_add(&button_handler);

	int err = bt_lbs_init(&lbs_callbacs);

	if (err) {
		printk("Failed to init LBS (err:%d)\n", err);
		return;
	}
}

void lbs_handler_init(void)
{
	/** Initiate and add LBS to the device service list. */
	lbs_init();

	/** Start separate advertiser instance. This will allow two simountanious GATT
	 *  connections to the device, one for Mesh and one for the LBS.
	 */
	lbs_adv_start();
}
```

## src/model_handler.c
```c
/*
 * Copyright (c) 2021 Nordic Semiconductor ASA
 *
 * SPDX-License-Identifier: LicenseRef-Nordic-5-Clause
 */

#include <zephyr/bluetooth/bluetooth.h>
#include <bluetooth/mesh/models.h>
#include <dk_buttons_and_leds.h>
#include "model_handler.h"

#if !DT_NODE_EXISTS(DT_ALIAS(led0))
#error "Unsupported board: led0 devicetree alias is not defined"
#endif

#define MESH_LED DK_LED1

static void led_set(struct bt_mesh_onoff_srv *srv, struct bt_mesh_msg_ctx *ctx,
		    const struct bt_mesh_onoff_set *set, struct bt_mesh_onoff_status *rsp);

static void led_get(struct bt_mesh_onoff_srv *srv, struct bt_mesh_msg_ctx *ctx,
		    struct bt_mesh_onoff_status *rsp);

static const struct bt_mesh_onoff_srv_handlers onoff_handlers = {
	.set = led_set,
	.get = led_get,
};

struct led_ctx {
	struct bt_mesh_onoff_srv srv;
	struct k_work_delayable work;
	uint32_t remaining;
	bool value;
};

static struct led_ctx led_ctx = {
	.srv = BT_MESH_ONOFF_SRV_INIT(&onoff_handlers),
};

static void led_transition_start(void)
{
	/* As long as the transition is in progress, the onoff
	 * state is "on":
	 */
	dk_set_led(MESH_LED, true);
	k_work_reschedule(&led_ctx.work, K_MSEC(led_ctx.remaining));
	led_ctx.remaining = 0;
}

static void led_status(struct bt_mesh_onoff_status *status)
{
	status->remaining_time =
		k_ticks_to_ms_ceil32(k_work_delayable_remaining_get(&led_ctx.work)) +
		led_ctx.remaining;
	status->target_on_off = led_ctx.value;
	/* As long as the transition is in progress, the onoff state is "on": */
	status->present_on_off = led_ctx.value || status->remaining_time;
}

static void led_set(struct bt_mesh_onoff_srv *srv, struct bt_mesh_msg_ctx *ctx,
		    const struct bt_mesh_onoff_set *set, struct bt_mesh_onoff_status *rsp)
{
	if (set->on_off == led_ctx.value) {
		goto respond;
	}

	led_ctx.value = set->on_off;
	if (!bt_mesh_model_transition_time(set->transition)) {
		led_ctx.remaining = 0;
		dk_set_led(MESH_LED, set->on_off);
		goto respond;
	}

	led_ctx.remaining = set->transition->time;

	if (set->transition->delay) {
		k_work_reschedule(&led_ctx.work, K_MSEC(set->transition->delay));
	} else {
		led_transition_start();
	}

respond:
	if (rsp) {
		led_status(rsp);
	}
}

static void led_get(struct bt_mesh_onoff_srv *srv, struct bt_mesh_msg_ctx *ctx,
		    struct bt_mesh_onoff_status *rsp)
{
	led_status(rsp);
}

static void led_work(struct k_work *work)
{
	if (led_ctx.remaining) {
		led_transition_start();
	} else {
		dk_set_led(MESH_LED, led_ctx.value);

		/* Publish the new value at the end of the transition */
		struct bt_mesh_onoff_status status;

		led_status(&status);
		bt_mesh_onoff_srv_pub(&led_ctx.srv, NULL, &status);
	}
}

/* Set up a repeating delayed work to blink the DK's LEDs when attention is
 * requested.
 */
static struct k_work_delayable attention_blink_work;
static bool attention;

static void attention_blink(struct k_work *work)
{
	static int idx;

	if (attention) {
		dk_set_leds(BIT((idx++) % 2));
		k_work_reschedule(&attention_blink_work, K_MSEC(30));
	} else {
		dk_set_leds(DK_NO_LEDS_MSK);
	}
}

static void attention_on(const struct bt_mesh_model *mod)
{
	attention = true;
	k_work_reschedule(&attention_blink_work, K_NO_WAIT);
}

static void attention_off(const struct bt_mesh_model *mod)
{
	/* Will stop rescheduling blink timer */
	attention = false;
}

static const struct bt_mesh_health_srv_cb health_srv_cb = {
	.attn_on = attention_on,
	.attn_off = attention_off,
};

static struct bt_mesh_health_srv health_srv = {
	.cb = &health_srv_cb,
};

BT_MESH_HEALTH_PUB_DEFINE(health_pub, 0);

static struct bt_mesh_elem elements[] = {
	BT_MESH_ELEM(1,
		     BT_MESH_MODEL_LIST(BT_MESH_MODEL_CFG_SRV,
					BT_MESH_MODEL_HEALTH_SRV(&health_srv, &health_pub),
					BT_MESH_MODEL_ONOFF_SRV(&led_ctx.srv)),
		     BT_MESH_MODEL_NONE),
};

static const struct bt_mesh_comp comp = {
	.cid = CONFIG_BT_COMPANY_ID,
	.elem = elements,
	.elem_count = ARRAY_SIZE(elements),
};

const struct bt_mesh_comp *model_handler_init(void)
{
	k_work_init_delayable(&attention_blink_work, attention_blink);
	k_work_init_delayable(&led_ctx.work, led_work);

	return &comp;
}
```
