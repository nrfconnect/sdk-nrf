## samples/bluetooth/peripheral_uart/sample.yaml
```yaml
sample:
  description: Bluetooth Low Energy UART service sample
  name: Bluetooth LE UART service

common:
  sysbuild: true
  build_only: true
  tags:
    - bluetooth
    - ci_build
    - sysbuild
    - ci_samples_bluetooth

tests:
  sample.bluetooth.peripheral_uart:
    build_only: false
    platform_allow: &peripheral_uart_platforms
      - nrf52dk/nrf52832
      - nrf52833dk/nrf52833
      - nrf52840dk/nrf52840
      - nrf5340dk/nrf5340/cpuapp
      - nrf5340dk/nrf5340/cpuapp/ns
      - thingy53/nrf5340/cpuapp
      - nrf21540dk/nrf52840
      - nrf54l15dk/nrf54l05/cpuapp
      - nrf54l15dk/nrf54l10/cpuapp
      - nrf54l15dk/nrf54l15/cpuapp
      - nrf54l15dk/nrf54l15/cpuapp/ns
      - nrf54ls05dk/nrf54ls05a/cpuapp
      - nrf54ls05dk/nrf54ls05b/cpuapp
      - nrf54lm20dk/nrf54lm20a/cpuapp
      - nrf54lm20dk/nrf54lm20a/cpuapp/ns
      - nrf54lm20dk/nrf54lm20b/cpuapp
      - nrf54lm20dk/nrf54lm20b/cpuapp/ns
      - nrf54lv10dk/nrf54lv10a/cpuapp
      - nrf54lv10dk/nrf54lv10a/cpuapp/ns
      - nrf54h20dk/nrf54h20/cpuapp
      - nrf54h20dk/nrf54h20/cpurad
    integration_platforms: *peripheral_uart_platforms
    harness: console
    harness_config:
      type: multi_line
      ordered: true
      regex:
        - "Starting Nordic UART service sample"
    timeout: 15

  sample.bluetooth.peripheral_uart_cdc:
    platform_allow:
      - nrf52840dk/nrf52840
      - nrf52833dk/nrf52833
    integration_platforms:
      - nrf52840dk/nrf52840
    extra_args:
      - OVERLAY_CONFIG=prj_cdc.conf
      - DTC_OVERLAY_FILE="usb.overlay"

  sample.bluetooth.peripheral_uart_minimal:
    platform_allow:
      - nrf52833dk/nrf52820
      - nrf54ls05dk/nrf54ls05a/cpuapp
    integration_platforms:
      - nrf52833dk/nrf52820
    extra_args: FILE_SUFFIX=minimal

  sample.bluetooth.peripheral_uart_ble_rpc:
    platform_exclude:
      - nrf52840dk/nrf52840
    platform_allow:
      - nrf5340dk/nrf5340/cpuapp
      - nrf54h20dk/nrf54h20/cpuapp
    integration_platforms:
      - nrf54h20dk/nrf54h20/cpuapp
    extra_args:
      - SNIPPET=nordic-bt-rpc
      - FILE_SUFFIX=bt_rpc

  sample.bluetooth.peripheral_uart.security_disabled:
    platform_allow: *peripheral_uart_platforms
    integration_platforms:
      - nrf52840dk/nrf52840
    extra_configs:
      - CONFIG_BT_NUS_SECURITY_ENABLED=n
```

## samples/bluetooth/peripheral_uart/sysbuild/mcuboot/boards/thingy53_nrf5340_cpuapp.conf
```kconfig
#
# Copyright (c) 2026 Nordic Semiconductor ASA
#
# SPDX-License-Identifier: LicenseRef-Nordic-5-Clause
#
CONFIG_PM=n

CONFIG_MAIN_STACK_SIZE=10240

CONFIG_PICOLIBC=y
CONFIG_COMMON_LIBC_MALLOC_ARENA_SIZE=0

CONFIG_BOOT_SWAP_SAVE_ENCTLV=n
CONFIG_BOOT_ENCRYPT_IMAGE=n
CONFIG_BOOT_BOOTSTRAP=n
CONFIG_LOG_MODE_MINIMAL=y
CONFIG_LOG_DEFAULT_LEVEL=0
CONFIG_MCUBOOT_LOG_LEVEL_INF=y
CONFIG_NCS_APPLICATION_BOOT_BANNER_STRING="MCUboot"

CONFIG_SYSTEM_CLOCK_NO_WAIT=y

CONFIG_BOOT_SIGNATURE_TYPE_RSA=y

# Flash
CONFIG_BOOT_ERASE_PROGRESSIVELY=y
CONFIG_SOC_FLASH_NRF_EMULATE_ONE_BYTE_WRITE_ACCESS=y

# Serial recovery
CONFIG_SERIAL=y
CONFIG_UART_LINE_CTRL=y
CONFIG_UART_CONSOLE=n
CONFIG_GPIO=y
CONFIG_GPIO_NRFX_INTERRUPT=n
CONFIG_MCUBOOT_SERIAL=y
CONFIG_MCUBOOT_SERIAL_DIRECT_IMAGE_UPLOAD=y
CONFIG_BOOT_SERIAL_CDC_ACM=y

# Required by QSPI
CONFIG_NORDIC_QSPI_NOR=y
CONFIG_NORDIC_QSPI_NOR_FLASH_LAYOUT_PAGE_SIZE=4096
CONFIG_NORDIC_QSPI_NOR_STACK_WRITE_BUFFER_SIZE=16

# Required by USB
CONFIG_MULTITHREADING=y

# USB
CONFIG_BOARD_SERIAL_BACKEND_CDC_ACM=n
CONFIG_USB_DEVICE_REMOTE_WAKEUP=n
CONFIG_USB_DEVICE_MANUFACTURER="Nordic Semiconductor ASA"
CONFIG_USB_DEVICE_PRODUCT="Bootloader Thingy:53"
CONFIG_USB_DEVICE_VID=0x1915
CONFIG_USB_DEVICE_PID=0x5300
CONFIG_USB_CDC_ACM=y

# Decrease memory footprint
CONFIG_ERRNO=n
CONFIG_I2C=n
CONFIG_SPI=n
CONFIG_UART_NRFX=n

# The following configurations are required to support simultaneous multi image update
CONFIG_PCD_APP=y
CONFIG_UPDATEABLE_IMAGE_NUMBER=2
CONFIG_BOOT_UPGRADE_ONLY=y
CONFIG_MCUBOOT_VERIFY_IMG_ADDRESS=n
CONFIG_NRF53_MULTI_IMAGE_UPDATE=y
# The network core cannot access external flash directly. The flash simulator must be used to
# provide a memory region that is used to forward the new firmware to the network core.
CONFIG_FLASH_SIMULATOR=y
CONFIG_FLASH_SIMULATOR_DOUBLE_WRITES=y
CONFIG_FLASH_SIMULATOR_STATS=n

CONFIG_ISR_TABLES_LOCAL_DECLARATION=y
CONFIG_LTO=y
```

## samples/bluetooth/peripheral_uart_nrf53/common/Kconfig
```kconfig
#
# Copyright (c) 2020 Nordic Semiconductor ASA
#
# SPDX-License-Identifier: LicenseRef-BSD-5-Clause-Nordic
#

config APP_TO_NETWORK_MAX_PACKET_SIZE
	int "Maxiumum size of data packet sent from the Application core to the Network core"
	default 64
	help
	  Maximum data size of data packet between the Application core and Network core, including CBOR encoding
config NETWORK_TO_APP_MAX_PACKET_SIZE
	int "Maxiumum size of data packet sent from the Network core to the Application core"
	default 64
	help
	  Maximum data size of data packet between the Application core and Network core, including CBOR encoding

config APP_WAIT_FOR_RESPONSE_TIME
	int "Waiting time for a response for command"
	default 150
	help
	  Maxiumum time which application waits for command response in milliseconds

choice
	prompt "RPMSG device role"
	default RPMSG_REMOTE

config RPMSG_REMOTE
	bool "Remote"

config RPMSG_MASTER
	bool "Master"

endchoice
```

## samples/bluetooth/peripheral_uart_nrf53/cpuapp/Kconfig
```kconfig
#
# Copyright (c) 2020 Nordic Semiconductor
#
# SPDX-License-Identifier: LicenseRef-BSD-5-Clause-Nordic
#

source "Kconfig.zephyr"

menu "Nordic UART BLE GATT service application core sample"

config BT_GATT_NUS_THREAD_STACK_SIZE
	int "Thread stack size"
	default 1024
	help
	  Stack size used in each of the two threads

config BT_GATT_NUS_UART_BUFFER_SIZE
	int "UART payload buffer element size"
	default 20
	help
	  Size of the payload buffer in each RX and TX FIFO element

rsource "../common/Kconfig"

endmenu
```

## samples/bluetooth/peripheral_uart_nrf53/cpuapp/sample.yaml
```yaml
sample:
  name: BLE UART service application core
  description: Bluetooth Low Energy UART service application core sample
tests:
  test_build:
    build_only: true
    build_on_all: true
    platform_whitelist: nrf5340_dk_nrf5340_cpuapp nrf5340_dk_nrf5340_cpuappns
    tags: bluetooth ci_build
```

## samples/bluetooth/peripheral_uart_nrf53/cpunet/Kconfig
```kconfig
#
# Copyright (c) 2020 Nordic Semiconductor
#
# SPDX-License-Identifier: LicenseRef-BSD-5-Clause-Nordic
#

source "Kconfig.zephyr"

menu "Nordic UART BLE GATT service application core sample"

config BT_GATT_NUS_SECURITY_ENABLED
	bool "Enable security"
	default y
	select BT_SMP
	help
	  "Enable BLE security for the UART service"

rsource "../common/Kconfig"

endmenu
```

## samples/bluetooth/peripheral_uart_nrf53/cpunet/sample.yaml
```yaml
sample:
  name: BLE UART service network core
  description: Bluetooth Low Energy UART service network core sample
tests:
  test_build:
    build_only: true
    build_on_all: true
    platform_whitelist: nrf5340_dk_nrf5340_cpunet
    tags: bluetooth ci_build
```

## samples/bluetooth/peripheral_with_multiple_identities/boards/nrf54h20dk_nrf54h20_cpuapp.conf
```kconfig
#
# Copyright (c) 2024 Nordic Semiconductor
#
# SPDX-License-Identifier: LicenseRef-Nordic-5-Clause
#

# Application core does not have BLE controller. Disable controller related options.
CONFIG_BT_CTLR_ADV_EXT=n
```

## samples/bluetooth/peripheral_with_multiple_identities/sample.yaml
```yaml
sample:
  description: Peripheral with multiple identities sample
  name: Peripheral with multiple identities
tests:
  sample.bluetooth.peripheral_with_multiple_identities:
    sysbuild: true
    integration_platforms:
      - nrf52840dk/nrf52840
      - nrf5340dk/nrf5340/cpuapp
      - nrf54l15dk/nrf54l05/cpuapp
      - nrf54l15dk/nrf54l10/cpuapp
      - nrf54l15dk/nrf54l15/cpuapp
      - nrf54h20dk/nrf54h20/cpurad
      - nrf54lm20dk/nrf54lm20a/cpuapp
      - nrf54lv10dk/nrf54lv10a/cpuapp
    platform_allow:
      - nrf52840dk/nrf52840
      - nrf5340dk/nrf5340/cpuapp
      - nrf54l15dk/nrf54l05/cpuapp
      - nrf54l15dk/nrf54l10/cpuapp
      - nrf54l15dk/nrf54l15/cpuapp
      - nrf54h20dk/nrf54h20/cpurad
      - nrf54lm20dk/nrf54lm20a/cpuapp
      - nrf54lv10dk/nrf54lv10a/cpuapp
      - nrf54lv10dk/nrf54lv10a/cpuapp/ns
    tags:
      - bluetooth
      - ci_build
      - sysbuild
    harness: console
    harness_config:
      type: multi_line
      ordered: true
      regex:
        - "Bluetooth initialized"
        - "Advertiser 19 successfully started"
    timeout: 15
```

## samples/bluetooth/radio_coex_1wire/dts/bindings/coex-pta-grant-gpios.yaml
```yaml
# Copyright (c) 2024 Nordic Semiconductor ASA
# SPDX-License-Identifier: LicenseRef-Nordic-5-Clause

description: |
    Coexistence PTA (Packet Traffic Arbiter) grant GPIOs

include: base.yaml

properties:
  coex-pta-grant-gpios:
    type: phandle-array
    description: |
      A phandle to the GPIO controller that provides the GRANT signal.
      The GPIO controller must be defined in the device tree.
    required: true

compatible: "coex-pta-grant-gpios"
```

## samples/bluetooth/radio_coex_1wire/sample.yaml
```yaml
sample:
  description: Bluetooth radio coexistence
  name: Bluetooth radio coexistence 1wire sample
tests:
  sample.bluetooth.radio_coex_1wire:
    sysbuild: true
    build_only: true
    integration_platforms:
      - nrf52840dk/nrf52840
      - nrf54l15dk/nrf54l05/cpuapp
      - nrf54l15dk/nrf54l10/cpuapp
      - nrf54l15dk/nrf54l15/cpuapp
      - nrf54h20dk/nrf54h20/cpurad
      - nrf54lm20dk/nrf54lm20a/cpuapp
    platform_allow:
      - nrf52840dk/nrf52840
      - nrf54l15dk/nrf54l05/cpuapp
      - nrf54l15dk/nrf54l10/cpuapp
      - nrf54l15dk/nrf54l15/cpuapp
      - nrf54h20dk/nrf54h20/cpurad
      - nrf54lm20dk/nrf54lm20a/cpuapp
    tags:
      - bluetooth
      - ci_build
      - sysbuild
```

## samples/bluetooth/radio_coex_3wire/sample.yaml
```yaml
sample:
  description: Bluetooth radio coexistence
  name: Bluetooth radio coexistence 3wire sample
tests:
  sample.bluetooth.radio_coex_3wire:
    build_only: true
    integration_platforms:
      - nrf52840dk_nrf52840
    platform_allow: nrf52840dk_nrf52840
    tags: bluetooth ci_build
```

## samples/bluetooth/radio_notification_cb/Kconfig.sysbuild
```kconfig
#
# Copyright (c) 2024 Nordic Semiconductor
#
# SPDX-License-Identifier: LicenseRef-Nordic-5-Clause
#

config NRF_DEFAULT_EMPTY
	default y if SOC_SERIES_NRF53

source "share/sysbuild/Kconfig"
```

## samples/bluetooth/radio_notification_cb/sample.yaml
```yaml
sample:
  description: Connection event callback sample
  name: Connection event callback
tests:
  sample.bluetooth.conn_evt_cb:
    sysbuild: true
    integration_platforms:
      - nrf52dk/nrf52832
      - nrf52840dk/nrf52840
      - nrf5340dk/nrf5340/cpunet
      - nrf54h20dk/nrf54h20/cpurad
      - nrf54l15dk/nrf54l05/cpuapp
      - nrf54l15dk/nrf54l10/cpuapp
      - nrf54l15dk/nrf54l15/cpuapp
      - nrf54lm20dk/nrf54lm20a/cpuapp
      - nrf54lv10dk/nrf54lv10a/cpuapp
    platform_allow:
      - nrf52dk/nrf52832
      - nrf52840dk/nrf52840
      - nrf5340dk/nrf5340/cpunet
      - nrf54h20dk/nrf54h20/cpurad
      - nrf54l15dk/nrf54l05/cpuapp
      - nrf54l15dk/nrf54l10/cpuapp
      - nrf54l15dk/nrf54l15/cpuapp
      - nrf54lm20dk/nrf54lm20a/cpuapp
      - nrf54lv10dk/nrf54lv10a/cpuapp
    tags:
      - bluetooth
      - ci_build
      - sysbuild
    harness: console
    harness_config:
      type: multi_line
      ordered: true
      regex:
        - "Starting radio notification callback sample"
    timeout: 15
```

## samples/bluetooth/rpc_beacon/sample.yaml
```yaml
sample:
  name: BLE over nRF RPC
  description: Show usage of BLE API over nRF RPC
tests:
  samples.bluetooth.rpc:
    build_only: true
    build_on_all: true
    platform_whitelist: nrf5340pdk_nrf5340_cpuapp
    tags: bluetooth ci_build
```

## samples/bluetooth/rpc_host/Kconfig
```kconfig
#
# Copyright (c) 2018 Nordic Semiconductor
#
# SPDX-License-Identifier: LicenseRef-BSD-5-Clause-Nordic
#

source "$ZEPHYR_BASE/Kconfig.zephyr"
```

## samples/bluetooth/rpc_host/sample.yaml
```yaml
sample:
  description: nRF RPC host providing Bluetooth Low Energy API access
  name: nRF RPC host for Bluetooth LE API
tests:
  sample.bluetooth.rpc_host:
    sysbuild: true
    build_only: true
    integration_platforms:
      - nrf5340dk/nrf5340/cpunet
    platform_allow: nrf5340dk/nrf5340/cpunet
    tags:
      - bluetooth
      - ci_build
      - sysbuild
```

## samples/bluetooth/rssi_power_control/central/sample.yaml
```yaml
#
# Copyright (c) 2025 Nordic Semiconductor
#
# SPDX-License-Identifier: LicenseRef-Nordic-5-Clause
#

sample:
  description: Central device of a Bluetooth Low Energy automated power controller.
    A feedback system that adjusts the transmit power based on the current RSSI
    — increasing, decreasing, or maintaining it as needed.
  name: Bluetooth LE central with automated power control
tests:
  sample.bluetooth.central_automated_power_control:
    sysbuild: true
    integration_platforms:
      - nrf52840dk/nrf52840
      - nrf54l15dk/nrf54l15/cpuapp
    platform_allow:
      - nrf52840dk/nrf52840
      - nrf54l15dk/nrf54l15/cpuapp
    harness: console
    harness_config:
      type: one_line
      regex:
        - "Scanning for peripherals..."
    tags:
      - bluetooth
      - ci_build
      - sysbuild
```

## samples/bluetooth/rssi_power_control/peripheral/sample.yaml
```yaml
#
# Copyright (c) 2025 Nordic Semiconductor
#
# SPDX-License-Identifier: LicenseRef-Nordic-5-Clause
#

sample:
  description: Peripheral device of a Bluetooth Low Energy automated power controller.
    A feedback system that adjusts the transmit power based on the current RSSI
    — increasing, decreasing, or maintaining it as needed.
  name: Bluetooth LE peripheral with automated power control
tests:
  sample.bluetooth.peripheral_automated_power_control:
    sysbuild: true
    integration_platforms:
      - nrf52840dk/nrf52840
      - nrf54l15dk/nrf54l15/cpuapp
    platform_allow:
      - nrf52840dk/nrf52840
      - nrf54l15dk/nrf54l15/cpuapp
    harness: console
    harness_config:
      type: one_line
      regex:
        - "Advertising successfully started"
    tags:
      - bluetooth
      - ci_build
      - sysbuild
```

## samples/bluetooth/scanner_rssi/sample.yaml
```yaml
sample:
  description: TBD
  name: TBD
tests:
  sample.bluetooth.scanner.rssi:
    platform_allow: nrf5340dk_nrf5340_cpuapp, nrf5340dk_nrf5340_cpuappns, nrf5340pdk_nrf5340_cpuapp, nrf5340pdk_nrf5340_cpuappns, nrf52dk_nrf52832, nrf52840dk_nrf52840, nrf52833dk_nrf52820, nrf52833dk_nrf52833
    tags: bluetooth
```

## samples/bluetooth/scanning_while_connecting/Kconfig.sysbuild
```kconfig
#
# Copyright (c) 2024 Nordic Semiconductor
#
# SPDX-License-Identifier: LicenseRef-Nordic-5-Clause
#

config PARTITION_MANAGER
	default n if !BOARD_IS_NON_SECURE

config NRF_DEFAULT_IPC_RADIO
	default y

config NETCORE_IPC_RADIO_BT_HCI_IPC
	default y

source "share/sysbuild/Kconfig"
```
