## CMakeLists.txt
```
#
# Copyright (c) 2020 Nordic Semiconductor ASA
#
# SPDX-License-Identifier: LicenseRef-Nordic-5-Clause
#
cmake_minimum_required(VERSION 3.20.0)

find_package(Zephyr REQUIRED HINTS $ENV{ZEPHYR_BASE})
project(NONE)

# NORDIC SDK APP START
target_sources(app PRIVATE src/main.c)
# NORDIC SDK APP END
```

## Kconfig
```
#
# Copyright (c) 2024 Nordic Semiconductor
#
# SPDX-License-Identifier: LicenseRef-Nordic-5-Clause
#

source "Kconfig.zephyr"

config SETTINGS
	default y

config ZMS
	default y if (SOC_FLASH_NRF_RRAM || SOC_FLASH_NRF_MRAM)

config NVS
	default y if !(SOC_FLASH_NRF_RRAM || SOC_FLASH_NRF_MRAM)
```

## Kconfig.sysbuild
```
#
# Copyright (c) 2023 Nordic Semiconductor
#
# SPDX-License-Identifier: LicenseRef-Nordic-5-Clause
#

config NRF_DEFAULT_IPC_RADIO
	default y

config NETCORE_IPC_RADIO_BT_HCI_IPC
	default y

source "$(ZEPHYR_BASE)/share/sysbuild/Kconfig"
```

## sample.yaml
```
sample:
  description: Sample demonstrating basic usage of the EnOcean library
  name: EnOcean
tests:
  sample.bluetooth.enocean:
    sysbuild: true
    build_only: true
    integration_platforms:
      - nrf54l15dk/nrf54l15/cpuapp
    platform_allow:
      - nrf54l15dk/nrf54l15/cpuapp
    tags:
      - bluetooth
      - ci_build
      - sysbuild
      - ci_samples_bluetooth
```

## prj.conf
```kconfig
#
# Copyright (c) 2020 Nordic Semiconductor ASA
#
# SPDX-License-Identifier: LicenseRef-Nordic-5-Clause
#
CONFIG_NCS_SAMPLES_DEFAULTS=y

# General configuration
CONFIG_FLASH=y
CONFIG_FLASH_MAP=y
CONFIG_DK_LIBRARY=y

# Bluetooth configuration
CONFIG_BT=y
CONFIG_BT_OBSERVER=y
CONFIG_BT_HOST_CCM=y
CONFIG_BT_SETTINGS=y

# EnOcean configuration
CONFIG_BT_ENOCEAN=y
CONFIG_BT_ENOCEAN_DEVICES_MAX=4
```

## src/main.c
```c
/*
 * Copyright (c) 2020 Nordic Semiconductor ASA
 *
 * SPDX-License-Identifier: LicenseRef-Nordic-5-Clause
 */
#include <zephyr/bluetooth/bluetooth.h>
#include <bluetooth/enocean.h>
#include <zephyr/settings/settings.h>
#include <dk_buttons_and_leds.h>

static void enocean_button(struct bt_enocean_device *device,
			   enum bt_enocean_button_action action, uint8_t changed,
			   const uint8_t *opt_data, size_t opt_data_len)
{
	char addr[BT_ADDR_LE_STR_LEN];

	bt_addr_le_to_str(&device->addr, addr, sizeof(addr));

	printk("EnOcean button RX: %s: %s %u %u %u %u\n", addr,
	       action == BT_ENOCEAN_BUTTON_PRESS ? "pressed: " : "released:",
	       !!(changed & BT_ENOCEAN_SWITCH_OA),
	       !!(changed & BT_ENOCEAN_SWITCH_IA),
	       !!(changed & BT_ENOCEAN_SWITCH_OB),
	       !!(changed & BT_ENOCEAN_SWITCH_IB));

	if (changed & (BT_ENOCEAN_SWITCH_OA | BT_ENOCEAN_SWITCH_IA)) {
		dk_set_led(DK_LED1, (action == BT_ENOCEAN_BUTTON_PRESS));
		dk_set_led(DK_LED3, !!(changed & BT_ENOCEAN_SWITCH_OA));
	}

	if (changed & (BT_ENOCEAN_SWITCH_OB | BT_ENOCEAN_SWITCH_IB)) {
		dk_set_led(DK_LED2, (action == BT_ENOCEAN_BUTTON_PRESS));
		dk_set_led(DK_LED4, !!(changed & BT_ENOCEAN_SWITCH_OB));
	}
}

static void enocean_sensor(struct bt_enocean_device *device,
			   const struct bt_enocean_sensor_data *data,
			   const uint8_t *opt_data, size_t opt_data_len)
{
	char addr[BT_ADDR_LE_STR_LEN];

	dk_set_leds_state(DK_LED1_MSK | DK_LED2_MSK, 0);
	k_sleep(K_MSEC(50));
	dk_set_leds_state(0, DK_LED1_MSK | DK_LED2_MSK);

	bt_addr_le_to_str(&device->addr, addr, sizeof(addr));
	printk("EnOcean sensor RX: %s:\n", addr);

	if (data->occupancy) {
		printk("\tOccupancy:          %s\n",
		       *data->occupancy ? "true" : "false");
	}

	if (data->light_sensor) {
		printk("\tLight (sensor):     %u lx\n", *data->light_sensor);
	}

	if (data->energy_lvl) {
		printk("\tEnergy level:       %u %%\n", *data->energy_lvl);
	}

	if (data->battery_voltage) {
		printk("\tBattery voltage:    %u mV\n", *data->battery_voltage);
	}

	if (data->light_solar_cell) {
		printk("\tLight (solar cell): %u lx\n",
		       *data->light_solar_cell);
	}
}

static void enocean_commissioned(struct bt_enocean_device *device)
{
	char addr[BT_ADDR_LE_STR_LEN];

	bt_addr_le_to_str(&device->addr, addr, sizeof(addr));
	printk("EnOcean Device commissioned: %s\n", addr);

	/* Blink leds number of times to show commissioned */
	for (int i = 0; i < 4; ++i) {
		dk_set_leds_state(DK_LED1_MSK | DK_LED2_MSK, 0);
		k_sleep(K_MSEC(100));
		dk_set_leds_state(0, DK_LED1_MSK | DK_LED2_MSK);
		k_sleep(K_MSEC(100));
	}
}

static void enocean_decommissioned(struct bt_enocean_device *device)
{
	char addr[BT_ADDR_LE_STR_LEN];

	bt_addr_le_to_str(&device->addr, addr, sizeof(addr));
	printk("EnOcean Device decommissioned: %s\n", addr);

	/* Blink leds number of times to show decommissioned */
	for (int i = 0; i < 4; ++i) {
		dk_set_leds_state(DK_LED3_MSK | DK_LED4_MSK, 0);
		k_sleep(K_MSEC(100));
		dk_set_leds_state(0, DK_LED3_MSK | DK_LED4_MSK);
		k_sleep(K_MSEC(100));
	}
}

static void enocean_loaded(struct bt_enocean_device *device)
{
	char addr[BT_ADDR_LE_STR_LEN];

	bt_addr_le_to_str(&device->addr, addr, sizeof(addr));
	printk("EnOcean Device loaded: %s\n", addr);
}

int main(void)
{
	static const struct bt_le_scan_param scan_param = {
		.type = BT_LE_SCAN_TYPE_PASSIVE,
		.options = BT_LE_SCAN_OPT_NONE,
		.interval = BT_GAP_SCAN_FAST_INTERVAL,
		.window = BT_GAP_SCAN_FAST_WINDOW,
	};
	int err;

	err = dk_leds_init();
	if (err) {
		printk("Initializing dk_leds failed (err: %d)\n", err);
		return 0;
	}

	err = bt_enable(NULL);
	if (err) {
		printk("Bluetooth init failed (err %d)\n", err);
		return 0;
	}

	static const struct bt_enocean_callbacks enocean_callbacks = {
		.button = enocean_button,
		.sensor = enocean_sensor,
		.commissioned = enocean_commissioned,
		.decommissioned = enocean_decommissioned,
		.loaded = enocean_loaded,
	};

	bt_enocean_init(&enocean_callbacks);

	if (IS_ENABLED(CONFIG_SETTINGS)) {
		settings_load();
	}

	err = bt_le_scan_start(&scan_param, NULL);
	if (err) {
		printk("Bluetooth scan start failed (err %d)\n", err);
		return 0;
	}

	bt_enocean_commissioning_enable();

	printk("EnOcean sample is ready!\n");

	return 0;
}
```
