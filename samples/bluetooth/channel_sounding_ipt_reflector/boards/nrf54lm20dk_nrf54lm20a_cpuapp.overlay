/*
 * Copyright (c) 2025 Nordic Semiconductor ASA
 *
 * SPDX-License-Identifier: LicenseRef-Nordic-5-Clause
 */

/ {
	cs_antenna_switch: cs-antenna-config {
		status = "okay";
		compatible = "nordic,bt-cs-antenna-switch";
		ant-gpios = <&gpio1 17 (GPIO_ACTIVE_HIGH)>,
			    <&gpio1 18 (GPIO_ACTIVE_HIGH)>,
			    <&gpio1 19 (GPIO_ACTIVE_HIGH)>,
			    <&gpio1 20 (GPIO_ACTIVE_HIGH)>;
		multiplexing-mode = <0>;
	};
};
