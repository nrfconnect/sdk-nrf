/*
 * Copyright (c) 2023 Nordic Semiconductor ASA
 *
 * SPDX-License-Identifier: LicenseRef-Nordic-5-Clause
 */

/ {
	chosen {
		ncs,dtm-uart = &uart0;
	};
};

&uart0 {
	status = "okay";
	compatible = "nordic,nrf-ipc-uart";
	ipc = <&ipc0>;
	ept-name = "remote shell";
	current-speed = <19200>;
};
