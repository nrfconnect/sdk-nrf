/*
 * Copyright (c) 2024 Nordic Semiconductor ASA
 *
 * SPDX-License-Identifier: LicenseRef-Nordic-5-Clause
 */

/* Forwards nRF21540 EK and radio dfe pins to the network core. Network core requires these pins
 * to control front-end module by GPIO and SPI interfaces and to perform the DFE functionality.
 */
&gpio_fwd {
	dfe-radio {
	    gpios = <&gpio0 4 0>,
		<&gpio0 5 0>,
		<&gpio0 6 0>,
		<&gpio0 7 0>;
	};
	nrf21540-gpio-if {
	    gpios = <&gpio1 7 0>,
		<&gpio1 6 0>,
		<&gpio1 5 0>,
		<&gpio1 11 0>,
		<&gpio1 4 0>;
	};
	nrf21540-spi-if {
	    gpios = <&gpio1 12 0>,
		<&gpio1 15 0>,
		<&gpio1 14 0>,
		<&gpio1 13 0>;
	};
};
