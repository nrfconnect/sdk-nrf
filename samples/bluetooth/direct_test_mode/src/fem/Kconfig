## samples/bluetooth/fast_pair/locator_tag/Kconfig.motion_detector
```kconfig
#
# Copyright (c) 2026 Nordic Semiconductor
#
# SPDX-License-Identifier: LicenseRef-Nordic-5-Clause
#

config APP_MOTION_DETECTOR_ACT_INACT_DETECTION_SUPPORTED
	bool
	default y
	depends on DT_HAS_ADI_ADXL362_ENABLED && ADXL362_TRIGGER
	help
	  Indicates whether the motion detector supports activity/inactivity detection.
	  This is only supported on the ADXL362 when the trigger feature is enabled.
	  The activity/inactivity detection usage can decrease power consumption
	  by allowing the system to enter a low power state when no motion is detected.
```

## samples/bluetooth/fast_pair/locator_tag/Kconfig.ranging
```kconfig
#
# Copyright (c) 2026 Nordic Semiconductor
#
# SPDX-License-Identifier: LicenseRef-Nordic-5-Clause
#

config APP_RANGING
	bool "Application ranging module [EXPERIMENTAL]"
	default y
	select EXPERIMENTAL
	select BT_CHANNEL_SOUNDING
	select BT_FAST_PAIR_FHN_PF
	select BT_RAS
	select BT_RAS_RRSP
	imply BT_TRANSMIT_POWER_CONTROL
	depends on HAS_HW_NRF_RADIO_CS
	help
	  Enable the application ranging using the Precision Finding feature
	  for the Find Hub Network (FHN) extension.

	  The module is only available for targets that support the Bluetooth
	  Low Energy (BLE) Channel Sounding (CS) as the ranging technology.

	  This Kconfig option enables additional Kconfig options that are required
	  for ranging over the BLE CS technology. It enables the Ranging Service
	  (RAS) module in the Ranging Responder (RRSP) role variant. Additionally,
	  this Kconfig option implies the LE Power Control Request feature that
	  allows the CS and ACL to use different PHYs.

	  The application module is tagged as experimental as it inherits the
	  experimental status of its dependencies:
	  - Bluetooth Channel Sounding (BT_CHANNEL_SOUNDING)
	  - FHN Precision Finding (BT_FAST_PAIR_FHN_PF)

if APP_RANGING

#  Override the default Bluetooth configuration.
## Enable support for ranging with 2 antennas in the case the Initiator has 2 antennas.
config BT_CTLR_SDC_CS_MAX_ANTENNA_PATHS
	default 2

config BT_RAS_MAX_ANTENNA_PATHS
	default 2

## Optimize memory usage by disabling unnecessary features.
config BT_CTLR_CHANNEL_SOUNDING_TEST
	default n

choice BT_CTLR_SDC_CS_ROLE
	default BT_CTLR_SDC_CS_ROLE_REFLECTOR_ONLY
endchoice

config BT_RAS_MODE_3_SUPPORTED
	default n

endif # APP_RANGING
```

## samples/bluetooth/fast_pair/locator_tag/Kconfig.sysbuild
```kconfig
#
# Copyright (c) 2024-2025 Nordic Semiconductor
#
# SPDX-License-Identifier: LicenseRef-Nordic-5-Clause
#

config BT_FAST_PAIR_MODEL_ID
	default 0x4A436B

# The Anti-Spoofing Private Key is confidential and must be handled securely.
# The following key is only used for demonstration purposes and must not be used in production.
config BT_FAST_PAIR_ANTI_SPOOFING_PRIVATE_KEY
	default "rie10A7ONqwd77VmkxGsblPUbMt384qjDgcEJ/ctT9Y="

config APP_DFU
	bool "Enable MCUmgr OTA DFU over Bluetooth"
	default y
	depends on BOOTLOADER_MCUBOOT || SOC_SERIES_NRF54HX
	help
	  This option enables the DFU functionality in this application.
	  The DFU solution is supported for the MCUboot-based targets
	  (BOOTLOADER_MCUBOOT Kconfig) and for the SUIT-based targets
	  (SOC_SERIES_NRF54HX Kconfig).

source "share/sysbuild/Kconfig"
```

## samples/bluetooth/fast_pair/locator_tag/Kconfig.ui
```kconfig
#
# Copyright (c) 2024-2026 Nordic Semiconductor
#
# SPDX-License-Identifier: LicenseRef-Nordic-5-Clause
#

config APP_UI_USE_HW_SPEAKER
	bool
	default y
	depends on $(dt_alias_enabled,pwm-spk)

config APP_UI_SPEAKER_FREQ
	int "Speaker frequency [Hz]"
	default 4000
	depends on APP_UI_USE_HW_SPEAKER
	help
	  Frequency of every sound generated by the speaker.
```

## samples/bluetooth/fast_pair/locator_tag/configuration/boards/nrf52dk_nrf52832.conf
```kconfig
#
# Copyright (c) 2026 Nordic Semiconductor ASA
#
# SPDX-License-Identifier: LicenseRef-Nordic-5-Clause
#

# Enable code partitioning with DTS
CONFIG_USE_DT_CODE_PARTITION=y
```

## samples/bluetooth/fast_pair/locator_tag/configuration/boards/nrf54h20dk_nrf54h20_cpuapp.conf
```kconfig
#
# Copyright (c) 2024 Nordic Semiconductor ASA
#
# SPDX-License-Identifier: LicenseRef-Nordic-5-Clause
#

# nRF54H-specific power management configuration
CONFIG_PM=y
```

## samples/bluetooth/fast_pair/locator_tag/configuration/boards/nrf54l15dk_nrf54l05_cpuapp.conf
```kconfig
#
# Copyright (c) 2025 Nordic Semiconductor ASA
#
# SPDX-License-Identifier: LicenseRef-Nordic-5-Clause
#

CONFIG_SYSTEM_WORKQUEUE_STACK_SIZE=3584

# Align the TX power encoded in the Fast Pair advertising set and
# the Read Beacon Parameters response with Fast Pair expectations.
CONFIG_BT_ADV_PROV_TX_POWER_CORRECTION_VAL=-11
CONFIG_BT_FAST_PAIR_FMDN_TX_POWER_CORRECTION_VAL=-11

# Use the CRACEN HW peripheral only for random number generation (RNG) to save memory.
# Other crypto primitives are handled by the SW crypto library (Oberon),
# which is less secure option than the HW crypto (CRACEN).
CONFIG_PSA_CRYPTO_DRIVER_OBERON=y
CONFIG_PSA_CRYPTO_DRIVER_CRACEN=y
CONFIG_PSA_USE_CRACEN_CIPHER_DRIVER=n
CONFIG_PSA_USE_CRACEN_AEAD_DRIVER=n
CONFIG_PSA_USE_CRACEN_HASH_DRIVER=n
CONFIG_PSA_USE_CRACEN_MAC_DRIVER=n
CONFIG_PSA_USE_CRACEN_PAKE_DRIVER=n
CONFIG_PSA_USE_CRACEN_ASYMMETRIC_ENCRYPTION_DRIVER=n
CONFIG_PSA_USE_CRACEN_ASYMMETRIC_SIGNATURE_DRIVER=n
CONFIG_PSA_USE_CRACEN_KEY_AGREEMENT_DRIVER=n
CONFIG_PSA_USE_CRACEN_KEY_DERIVATION_DRIVER=n
CONFIG_PSA_USE_CRACEN_KEY_MANAGEMENT_DRIVER=n
CONFIG_CRACEN_LIB_KMU=n
```
