## samples/bluetooth/direct_test_mode/src/fem/Kconfig
```kconfig
#
# Copyright (c) 2021 Nordic Semiconductor
#
# SPDX-License-Identifier: LicenseRef-Nordic-5-Clause
#

DT_COMPAT_NORDIC_NRF21540 := nordic,nrf21540-fem
DT_COMPAT_GENERIC_FEM_2_CTRL_PIN := generic-fem-two-ctrl-pins

config NRF21540_FEM_SUPPORTED
	bool
	default $(dt_nodelabel_has_compat,nrf_radio_fem,$(DT_COMPAT_NORDIC_NRF21540))

config GENERIC_FEM_SUPPORTED
	bool
	default $(dt_nodelabel_has_compat,nrf_radio_fem,$(DT_COMPAT_GENERIC_FEM_2_CTRL_PIN))

config FEM
	bool "Front-end module (FEM) support"
	default y
	depends on NRF21540_FEM_SUPPORTED || GENERIC_FEM_SUPPORTED
	help
	  Controls if front-end module (FEM) is to be configured and enabled.
	  Default type of FEM to use depends on which compatible nodes are in devicetree.

if FEM

choice FEM_CHOICE
	prompt "Radio front-end module (FEM) type"

config NRF21540_FEM
	bool "nRF21540 front-end module"
	depends on NRF21540_FEM_SUPPORTED
	select SPI if !SOC_NRF5340_CPUNET
	select NRFX_SPIM0 if SOC_NRF5340_CPUNET
	select NRFX_TIMER2
	help
	  Enable nRF21540 front-end module support.

config GENERIC_FEM
	bool "Generic front-end module with two-pin control"
	depends on GENERIC_FEM_SUPPORTED
	select NRFX_TIMER2
	help
	  FEM device has a generic two-pin control interface.

endchoice #FEM_CHOICE

if NRF21540_FEM

config NRF21540_FEM_GPIOTE_TX_EN
	int "GPIOTE channel number used to control TX_EN pin of the front-end Module"
	default 7

config NRF21540_FEM_GPIOTE_RX_EN
	int "GPIOTE channel number used to control RX_EN pin of the front-end Module"
	default 6

endif # NRF21540_FEM

if GENERIC_FEM

# The Skyworks front-end module devices specific configuration.
choice SKYWORKS_MODE
	prompt "Skyworks front-end module mode"
	default SKYWORKS_LOW_POWER_MODE

config SKYWORKS_LOW_POWER_MODE
	bool "Low power-mode"
	help
	  Skywork front-end module low-power mode or mode selection is handled by user hardware.

config SKYWORKS_HIGH_POWER_MODE
	bool "High power-mode"
	depends on $(dt_node_has_prop,nrf_radio_fem,chl-gpios)
	help
	  Skyworks front-end module high-power mode.

config SKYWORKS_BYPASS_MODE
	bool "Bypass mode"
	depends on $(dt_node_has_prop,nrf_radio_fem,cps-gpios)
	help
	  Skyworks front-end module bypass mode. Bypass path for the integrated LNA.
	  For more details check your device product specification.


endchoice # SKYWORKS_MODE

endif # GENERIC_FEM

endif # FEM
```

## samples/bluetooth/direction_finding_central/Kconfig
```kconfig
# Override Bluetooth host defaults for this sample to reduce RAM usage.
# We cannot modify Zephyr, so we adjust the default of the existing symbol here.
# BT_TX_PROCESSOR_THREAD is a hidden (no prompt) symbol that defaults to 'y' on non-nRF51.
# Provide a sample-level switch so boards can enable the reduction via their .conf.

config DF_CENTRAL_DISABLE_BT_TX_THREAD
	bool "Disable BT TX processor thread for DF central"

if DF_CENTRAL_DISABLE_BT_TX_THREAD

config BT_TX_PROCESSOR_THREAD
	bool
	def_bool n

endif
```

## samples/bluetooth/direction_finding_central/boards/nrf52833dk_nrf52833.conf
```kconfig
#
# Copyright (c) 2022 Nordic Semiconductor ASA
#
# SPDX-License-Identifier: LicenseRef-Nordic-5-Clause
#

# Enable Direction Finding Feature
CONFIG_BT_CTLR_DF=y

CONFIG_BT_CTLR_DF_CTE_RX=y
CONFIG_BT_CTLR_DF_CONN_CTE_RX=y
CONFIG_BT_CTLR_DF_ANT_SWITCH_RX=y
CONFIG_BT_CTLR_DF_CONN_CTE_REQ=y

# Ensure that there are enough control procedure contexts to queue and execute all procedures
CONFIG_BT_CTLR_LLCP_LOCAL_PROC_CTX_BUF_NUM=6
CONFIG_BT_CTLR_ADVANCED_FEATURES=y
```

## samples/bluetooth/direction_finding_central/sample.yaml
```yaml
sample:
  name: Direction Finding Central
  description: Sample application showing central role of Direction Finding in connected
    mode
tests:
  sample.bluetooth.direction_finding_central_nrf:
    sysbuild: true
    build_only: true
    platform_allow:
      - nrf52833dk/nrf52833
      - nrf52833dk/nrf52820
      - nrf5340dk/nrf5340/cpuapp
    tags:
      - bluetooth
      - sysbuild
    integration_platforms:
      - nrf52833dk/nrf52833
      - nrf52833dk/nrf52820
      - nrf5340dk/nrf5340/cpuapp
  sample.bluetooth.direction_finding_central_nrf.aod:
    sysbuild: true
    extra_args: OVERLAY_CONFIG="overlay-aod.conf"
    build_only: true
    platform_allow:
      - nrf52833dk/nrf52833
      - nrf52833dk/nrf52820
      - nrf5340dk/nrf5340/cpuapp
    tags:
      - bluetooth
      - sysbuild
    integration_platforms:
      - nrf52833dk/nrf52833
      - nrf52833dk/nrf52820
      - nrf5340dk/nrf5340/cpuapp
```

## samples/bluetooth/direction_finding_connectionless_rx/boards/nrf52833dk_nrf52833.conf
```kconfig
#
# Copyright (c) 2021 Nordic Semiconductor ASA
#
# SPDX-License-Identifier: LicenseRef-Nordic-5-Clause
#

CONFIG_BT_CTLR_ADV_EXT=y
CONFIG_BT_CTLR_SYNC_PERIODIC=y

# Enable Direction Finding Feature
CONFIG_BT_CTLR_DF=y

# Disable Direction Finding TX mode
CONFIG_BT_CTLR_DF_ANT_SWITCH_TX=n
CONFIG_BT_CTLR_DF_ADV_CTE_TX=n
```

## samples/bluetooth/direction_finding_connectionless_tx/boards/nrf52833dk_nrf52820.conf
```kconfig
#
# Copyright (c) 2021 Nordic Semiconductor ASA
#
# SPDX-License-Identifier: LicenseRef-Nordic-5-Clause
#

# Enable Direction Finding TX Feature
CONFIG_BT_CTLR_DF=y

# Disable Direction Finding RX mode
CONFIG_BT_CTLR_DF_ANT_SWITCH_RX=n
CONFIG_BT_CTLR_DF_SCAN_CTE_RX=n

# Disable AoD Feature (antenna switching) in Tx mode in Controller
CONFIG_BT_CTLR_DF_ANT_SWITCH_TX=n
```

## samples/bluetooth/direction_finding_connectionless_tx/sample.yaml
```yaml
sample:
  name: Direction Finding Connectionless Beacon
  description: Sample application showing connectionless Direction Finding transmission
tests:
  sample.bluetooth.direction_finding_connectionless_tx.aoa.sdc:
    sysbuild: true
    build_only: true
    platform_allow:
      - nrf52833dk/nrf52833
      - nrf52833dk/nrf52820
      - nrf5340dk/nrf5340/cpuapp
      - nrf54l15dk/nrf54l05/cpuapp
      - nrf54l15dk/nrf54l10/cpuapp
      - nrf54l15dk/nrf54l15/cpuapp
      - nrf54lm20dk/nrf54lm20a/cpuapp
      - nrf54lv10dk/nrf54lv10a/cpuapp
    tags:
      - bluetooth
      - sysbuild
    integration_platforms:
      - nrf52833dk/nrf52833
      - nrf52833dk/nrf52820
      - nrf5340dk/nrf5340/cpuapp
      - nrf54l15dk/nrf54l05/cpuapp
      - nrf54l15dk/nrf54l10/cpuapp
      - nrf54l15dk/nrf54l15/cpuapp
      - nrf54lm20dk/nrf54lm20a/cpuapp
      - nrf54lv10dk/nrf54lv10a/cpuapp
  sample.bluetooth.direction_finding_connectionless_tx.aoa.bt_ll_sw_split.nrf52:
    sysbuild: false
    build_only: true
    extra_args:
      - OVERLAY_CONFIG="overlay-bt_ll_sw_split.conf"
      - SNIPPET="bt-ll-sw-split"
    platform_allow:
      - nrf52833dk/nrf52833
      - nrf52833dk/nrf52820
    tags: bluetooth
    integration_platforms:
      - nrf52833dk/nrf52833
      - nrf52833dk/nrf52820
  sample.bluetooth.direction_finding_connectionless_tx.aoa.bt_ll_sw_split.nrf53:
    sysbuild: true
    build_only: true
    extra_args:
      - ipc_radio_OVERLAY_CONFIG="../../overlay-bt_ll_sw_split.conf"
      - ipc_radio_SNIPPET="bt-ll-sw-split"
    platform_allow:
      - nrf5340dk/nrf5340/cpuapp
    tags:
      - bluetooth
      - sysbuild
    integration_platforms:
      - nrf5340dk/nrf5340/cpuapp
  sample.bluetooth.direction_finding_connectionless_tx.aod.bt_ll_sw_split.nrf52:
    sysbuild: false
    build_only: true
    extra_args:
      - OVERLAY_CONFIG="overlay-aod.conf;overlay-bt_ll_sw_split.conf"
      - SNIPPET="bt-ll-sw-split"
    platform_allow:
      - nrf52833dk/nrf52833
      - nrf52833dk/nrf52820
    tags: bluetooth
    integration_platforms:
      - nrf52833dk/nrf52833
      - nrf52833dk/nrf52820
  sample.bluetooth.direction_finding_connectionless_tx.aod.bt_ll_sw_split.nrf53:
    sysbuild: true
    build_only: true
    extra_args:
      - OVERLAY_CONFIG="overlay-aod.conf"
      - ipc_radio_OVERLAY_CONFIG="../../overlay-bt_ll_sw_split.conf"
      - ipc_radio_SNIPPET="bt-ll-sw-split"
    platform_allow:
      - nrf5340dk/nrf5340/cpuapp
    tags:
      - bluetooth
      - sysbuild
    integration_platforms:
      - nrf5340dk/nrf5340/cpuapp
```

## samples/bluetooth/direction_finding_peripheral/Kconfig
```kconfig
#
# Copyright (c) 2025 Nordic Semiconductor
#
# SPDX-License-Identifier: LicenseRef-Nordic-5-Clause
#

# RAM for this application for this board is too few to use
# the BT TX processor thread.
configdefault BT_TX_PROCESSOR_THREAD
	default n if BOARD_NRF52833DK_NRF52820

source "Kconfig.zephyr"
```

## samples/bluetooth/direction_finding_peripheral/boards/nrf52833dk_nrf52833.conf
```kconfig
#
# Copyright (c) 2022 Nordic Semiconductor ASA
#
# SPDX-License-Identifier: LicenseRef-Nordic-5-Clause
#

# Enable Direction Finding Feature including AoA and AoD
CONFIG_BT_CTLR_DF=y

CONFIG_BT_CTLR_DF_CTE_TX=y
CONFIG_BT_CTLR_DF_CONN_CTE_TX=y
CONFIG_BT_CTLR_DF_ANT_SWITCH_TX=y
CONFIG_BT_CTLR_DF_CONN_CTE_RSP=y
```

## samples/bluetooth/direction_finding_peripheral/boards/nrf54lm20dk_nrf54lm20a_cpuapp.conf
```kconfig
#
# Copyright (c) 2025 Nordic Semiconductor ASA
#
# SPDX-License-Identifier: LicenseRef-Nordic-5-Clause
#

# Enable Direction Finding Feature
CONFIG_BT_CTLR_DF=y

CONFIG_BT_CTLR_DF_CTE_TX=y
CONFIG_BT_CTLR_DF_CONN_CTE_TX=y
CONFIG_BT_CTLR_DF_CONN_CTE_RSP=y

# Disable AoD Feature (antenna switching) in Tx mode in Controller
CONFIG_BT_CTLR_DF_ANT_SWITCH_TX=n
```

## samples/bluetooth/direction_finding_peripheral/sample.yaml
```yaml
sample:
  name: Direction Finding Peripheral
  description: Sample application showing peripheral role of Direction Finding in connected mode
tests:
  sample.bluetooth.direction_finding_peripheral.aoa.sdc.nrf52_nrf53:
    sysbuild: true
    extra_args:
      - OVERLAY_CONFIG="overlay-aoa.conf"
    build_only: true
    platform_allow:
      - nrf52833dk/nrf52833
      - nrf52833dk/nrf52820
      - nrf5340dk/nrf5340/cpuapp
    tags: bluetooth sysbuild
    integration_platforms:
      - nrf52833dk/nrf52833
      - nrf52833dk/nrf52820
      - nrf5340dk/nrf5340/cpuapp
  sample.bluetooth.direction_finding_peripheral.aoa.bt_ll_sw_split.nrf52:
    sysbuild: false
    build_only: true
    extra_args:
      - OVERLAY_CONFIG="overlay-aoa.conf;overlay-bt_ll_sw_split.conf"
      - SNIPPET="bt-ll-sw-split"
    platform_allow:
      - nrf52833dk/nrf52833
      - nrf52833dk/nrf52820
    tags: bluetooth
    integration_platforms:
      - nrf52833dk/nrf52833
      - nrf52833dk/nrf52820
  sample.bluetooth.direction_finding_peripheral.aoa.bt_ll_sw_split.nrf53:
    sysbuild: true
    build_only: true
    extra_args:
      - OVERLAY_CONFIG="overlay-aoa.conf"
      - ipc_radio_OVERLAY_CONFIG="../../overlay-bt_ll_sw_split.conf"
      - ipc_radio_SNIPPET="bt-ll-sw-split"
    platform_allow:
      - nrf5340dk/nrf5340/cpuapp
    tags: bluetooth sysbuild
    integration_platforms:
      - nrf5340dk/nrf5340/cpuapp
  sample.bluetooth.direction_finding_peripheral.all.bt_ll_sw_split.nrf52:
    sysbuild: false
    build_only: true
    extra_args:
      - OVERLAY_CONFIG="overlay-bt_ll_sw_split.conf"
      - SNIPPET="bt-ll-sw-split"
    platform_allow:
      - nrf52833dk/nrf52833
      - nrf52833dk/nrf52820
    tags: bluetooth
    integration_platforms:
      - nrf52833dk/nrf52833
      - nrf52833dk/nrf52820
  sample.bluetooth.direction_finding_peripheral.all.bt_ll_sw_split.nrf53:
    sysbuild: true
    build_only: true
    extra_args:
      - ipc_radio_OVERLAY_CONFIG="../../overlay-bt_ll_sw_split.conf"
      - ipc_radio_SNIPPET="bt-ll-sw-split"
    platform_allow:
      - nrf5340dk/nrf5340/cpuapp
    tags: bluetooth sysbuild
    integration_platforms:
      - nrf5340dk/nrf5340/cpuapp
```

## samples/bluetooth/event_trigger/Kconfig.sysbuild
```kconfig
#
# Copyright (c) 2024 Nordic Semiconductor
#
# SPDX-License-Identifier: LicenseRef-Nordic-5-Clause
#

config PARTITION_MANAGER
	default n if !BOARD_IS_NON_SECURE

config NRF_DEFAULT_EMPTY
	default y if SOC_SERIES_NRF53X

source "share/sysbuild/Kconfig"
```

## samples/bluetooth/event_trigger/sample.yaml
```yaml
sample:
  description: Buetooth Low Energy Event Trigger sample
  name: Bluetooth LE Event Trigger
tests:
  sample.bluetooth.event_trigger:
    sysbuild: true
    integration_platforms:
      - nrf52dk/nrf52832
      - nrf52840dk/nrf52840
      - nrf5340dk/nrf5340/cpunet
      - nrf54l15dk/nrf54l05/cpuapp
      - nrf54l15dk/nrf54l10/cpuapp
      - nrf54l15dk/nrf54l15/cpuapp
      - nrf54h20dk/nrf54h20/cpurad
      - nrf54lm20dk/nrf54lm20a/cpuapp
      - nrf54lv10dk/nrf54lv10a/cpuapp
    platform_allow:
      - nrf52dk/nrf52832
      - nrf52840dk/nrf52840
      - nrf5340dk/nrf5340/cpunet
      - nrf54l15dk/nrf54l05/cpuapp
      - nrf54l15dk/nrf54l10/cpuapp
      - nrf54l15dk/nrf54l15/cpuapp
      - nrf54h20dk/nrf54h20/cpurad
      - nrf54lm20dk/nrf54lm20a/cpuapp
      - nrf54lv10dk/nrf54lv10a/cpuapp
    tags:
      - bluetooth
      - ci_build
      - sysbuild
    harness: console
    harness_config:
      type: multi_line
      ordered: true
      regex:
        - "Starting Event Trigger Sample."
    timeout: 15
```

## samples/bluetooth/fast_pair/input_device/Kconfig.sysbuild
```kconfig
#
# Copyright (c) 2023-2025 Nordic Semiconductor
#
# SPDX-License-Identifier: LicenseRef-Nordic-5-Clause
#

config BT_FAST_PAIR_MODEL_ID
	default 0x2A410B

# The Anti-Spoofing Private Key is confidential and must be handled securely.
# The following key is only used for demonstration purposes and must not be used in production.
config BT_FAST_PAIR_ANTI_SPOOFING_PRIVATE_KEY
	default "Unoh+nycK/ZJ7k3dHsdcNpiP1SfOy0P/Lx5XixyYois="

config NRF_DEFAULT_IPC_RADIO
	default y

source "share/sysbuild/Kconfig"
```

## samples/bluetooth/fast_pair/input_device/boards/nrf54l15dk_nrf54l15_cpuapp.conf
```kconfig
#
# Copyright (c) 2024-2025 Nordic Semiconductor ASA
#
# SPDX-License-Identifier: LicenseRef-Nordic-5-Clause
#

CONFIG_SYSTEM_WORKQUEUE_STACK_SIZE=3584

# Align the advertised TX power with Fast Pair expectations.
CONFIG_BT_ADV_PROV_TX_POWER_CORRECTION_VAL=-11
```

## samples/bluetooth/fast_pair/input_device/boards/nrf54ls05dk_nrf54ls05a_cpuapp.conf
```kconfig
#
# Copyright (c) 2026 Nordic Semiconductor ASA
#
# SPDX-License-Identifier: LicenseRef-Nordic-5-Clause
#

# Align the advertised TX power with Fast Pair expectations.
CONFIG_BT_ADV_PROV_TX_POWER_CORRECTION_VAL=-13
```

## samples/bluetooth/fast_pair/input_device/sample.yaml
```yaml
sample:
  name: Fast Pair input device
  description: Bluetooth Fast Pair Provider sample setup for the input device use
    case
tests:
  sample.bluetooth.fast_pair.input_device:
    build_only: true
    sysbuild: true
    integration_platforms:
      - nrf52dk/nrf52832
      - nrf52840dk/nrf52840
      - nrf5340dk/nrf5340/cpuapp
      - nrf5340dk/nrf5340/cpuapp/ns
      - nrf54l15dk/nrf54l05/cpuapp
      - nrf54l15dk/nrf54l10/cpuapp
      - nrf54l15dk/nrf54l15/cpuapp
      - nrf54lm20dk/nrf54lm20a/cpuapp
      - nrf54h20dk/nrf54h20/cpuapp
    platform_allow:
      - nrf52dk/nrf52832
      - nrf52840dk/nrf52840
      - nrf5340dk/nrf5340/cpuapp
      - nrf5340dk/nrf5340/cpuapp/ns
      - nrf54l15dk/nrf54l05/cpuapp
      - nrf54l15dk/nrf54l10/cpuapp
      - nrf54l15dk/nrf54l15/cpuapp
      - nrf54lm20dk/nrf54lm20a/cpuapp
      - nrf54h20dk/nrf54h20/cpuapp
    tags:
      - bluetooth
      - ci_build
      - sysbuild
```

## samples/bluetooth/fast_pair/locator_tag/Kconfig
```kconfig
#
# Copyright (c) 2024-2026 Nordic Semiconductor
#
# SPDX-License-Identifier: LicenseRef-Nordic-5-Clause
#

menu "Nordic Fast Pair Locator tag sample"

config APP_PLATFORM_DK
	bool
	default y
	depends on !APP_PLATFORM_REF

config APP_PLATFORM_REF
	bool
	default y
	depends on BOARD_THINGY53 || BOARD_NRF54L15TAG

rsource "Kconfig.battery"
rsource "Kconfig.dfu"
rsource "Kconfig.motion_detector"
rsource "Kconfig.ranging"
rsource "Kconfig.ui"

config SETTINGS
	default y

config ZMS
	default y if (SOC_FLASH_NRF_RRAM || SOC_FLASH_NRF_MRAM)

config NVS
	default y if !(SOC_FLASH_NRF_RRAM || SOC_FLASH_NRF_MRAM)

endmenu

source "Kconfig.zephyr"
```
