/ {
	chosen {
		ncs,dtm-uart = &uart0;
	};
};

&uart0 {
	status = "okay";
	compatible = "nordic,nrf-ipc-uart";
	ipc = <&ipc0>;
	ept-name = "remote shell";
	current-speed = <19200>;
};

/* Disable direction finding */
&radio {
	/delete-property/ dfe-supported;
};
