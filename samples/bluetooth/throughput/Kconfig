## samples/bluetooth/throughput/Kconfig
```kconfig
#
# Copyright (c) 2022 Nordic Semiconductor
#
# SPDX-License-Identifier: LicenseRef-Nordic-5-Clause
#

source "Kconfig.zephyr"

menu "Nordic BLE throughput sample"

config BT_THROUGHPUT_DURATION
	int "Throughput test duration in milliseconds"
	default 20000

endmenu
```

## samples/bluetooth/throughput/boards/nrf5340dk_nrf5340_cpuapp.conf
```kconfig
#
# Copyright (c) 2018 Nordic Semiconductor
#
# SPDX-License-Identifier: LicenseRef-Nordic-5-Clause
#

# For better shell and logger coexistence.
CONFIG_NCS_SAMPLES_DEFAULTS=n
```

## samples/bluetooth/throughput/boards/nrf54h20dk_nrf54h20_cpuapp.conf
```kconfig
#
# Copyright (c) 2024 Nordic Semiconductor
#
# SPDX-License-Identifier: LicenseRef-Nordic-5-Clause
#

# For better shell and logger coexistence.
CONFIG_NCS_SAMPLES_DEFAULTS=n

CONFIG_SOC_NRF54H20_CPURAD_ENABLE=y
```

## samples/bluetooth/throughput/sample.yaml
```yaml
sample:
  description: Bluetooth Low Energy throughput sample
  name: Bluetooth LE throughput
tests:
  sample.bluetooth.throughput:
    sysbuild: true
    integration_platforms:
      - nrf54l15dk/nrf54l15/cpuapp
    platform_allow:
      - nrf52dk/nrf52832
      - nrf52840dk/nrf52840
      - nrf5340dk/nrf5340/cpuapp
      - nrf5340dk/nrf5340/cpuapp/ns
      - nrf54l15dk/nrf54l05/cpuapp
      - nrf54l15dk/nrf54l10/cpuapp
      - nrf54l15dk/nrf54l15/cpuapp
      - nrf54l15dk/nrf54l15/cpuapp/ns
      - nrf54h20dk/nrf54h20/cpuapp
      - nrf54lm20dk/nrf54lm20a/cpuapp
      - nrf54lm20dk/nrf54lm20a/cpuapp/ns
      - nrf54lv10dk/nrf54lv10a/cpuapp
      - nrf54lv10dk/nrf54lv10a/cpuapp/ns
    tags:
      - bluetooth
      - ci_build
      - sysbuild
    harness: console
    harness_config:
      type: multi_line
      ordered: true
      regex:
        - "Starting Bluetooth Throughput sample"
        - "Bluetooth initialized"
    timeout: 15
```

## samples/bluetooth/throughput_many_to_one/Kconfig
```kconfig
# Copyright (c) 2025 Nordic Semiconductor ASA
# SPDX-License-Identifier: Apache-2.0

rsource "periodic_adv_rsp/Kconfig"
```

## samples/bluetooth/throughput_many_to_one/periodic_adv_rsp/Kconfig
```kconfig
# Copyright (c) 2025 Nordic Semiconductor ASA
# SPDX-License-Identifier: LicenseRef-Nordic-5-Clause

menu "Throughput many-to-one Sample"

config APP_THROUGHPUT_PAWR
	bool "Throughput many-to-one Sample Settings"
	default y
	help
	  Enable configuration options for throughput many-to-one sample using PAwR

config APP_NUM_RSP_DEVICES
	int "Number of PAwR scanner devices"
	default 2
	range 1 255
	depends on APP_THROUGHPUT_PAWR
	help
	  Number of scanner devices that will participate in the PAwR communication.
	  This affects timing calculations.

endmenu

source "Kconfig.zephyr"
```

## samples/bluetooth/throughput_many_to_one/periodic_adv_rsp/sample.yaml
```yaml
sample:
  name: Bluetooth Periodic Advertising with Responses Advertiser
tests:
  sample.bluetooth.periodic_adv_rsp:
    harness: bluetooth
    platform_allow:
      - nrf54l15dk/nrf54l15/cpuapp
    tags: bluetooth
    integration_platforms:
      - nrf54l15dk/nrf54l15/cpuapp
```

## samples/bluetooth/throughput_many_to_one/periodic_sync_rsp/sample.yaml
```yaml
sample:
  name: Bluetooth Periodic Advertising with Responses Synchronizer
tests:
  sample.bluetooth.periodic_sync_rsp:
    harness: bluetooth
    platform_allow:
      - nrf54l15dk/nrf54l15/cpuapp
    tags: bluetooth
    integration_platforms:
      - nrf54l15dk/nrf54l15/cpuapp
```

## samples/boot_chains/sample.yaml
```yaml
sample:
  description: Boot chain sample
  name: boot chain
common:
    platform_allow:
      nrf52840dk_nrf52840
      nrf5340dk_nrf5340_cpuapp
      nrf5340dk_nrf5340_cpuapp_ns
      nrf9160dk_nrf9160_ns
    harness: console
    harness_config:
      type: one_line
      regex:
        - "Hello World! (.*)"
tests:
  sample.basic.helloworld:
    tags: introduction
  sample.b:
    extra_args:
      CONFIG_SECURE_BOOT=y
  sample.c:
    extra_args:
      CONFIG_SECURE_BOOT=y
      CONFIG_BOOTLOADER_MCUBOOT=y
  sample.d:
    extra_args:
      CONFIG_BOOTLOADER_MCUBOOT=y
```

## samples/bootloader/boards/nrf5340_audio_dk_nrf5340_cpuapp.conf
```kconfig
#
# Copyright (c) 2023 Nordic Semiconductor ASA
#
# SPDX-License-Identifier: LicenseRef-Nordic-5-Clause
#

# CC3xx is currently not used for nrf53
CONFIG_HW_CC3XX=n
CONFIG_NRF_CC3XX_PLATFORM=n
# nPM1100 is not used by the bootloader
CONFIG_REGULATOR_NPM1100=n
```

## samples/bootloader/boards/nrf5340dk_nrf5340_cpuapp.conf
```kconfig
#
# Copyright (c) 2020 Nordic Semiconductor ASA
#
# SPDX-License-Identifier: LicenseRef-BSD-5-Clause-Nordic
#

# CC3xx is currently not used for nrf53
CONFIG_HW_CC3XX=n
CONFIG_NRF_CC3XX_PLATFORM=n
```

## samples/bootloader/boards/nrf54h20dk_nrf54h20_cpuapp_iron.conf
```kconfig
#
# Copyright (c) 2025 Nordic Semiconductor ASA
#
# SPDX-License-Identifier: LicenseRef-Nordic-5-Clause
#

CONFIG_BOOT_BANNER=n
CONFIG_NCS_BOOT_BANNER=n
CONFIG_FPROTECT=n
CONFIG_SOC_NRF54H20_GPD=n
CONFIG_NRFS=n
CONFIG_USE_DT_CODE_PARTITION=y
```

## samples/bootloader/boards/nrf54l15dk_nrf54l15_cpuapp.conf
```kconfig
CONFIG_CLOCK_CONTROL_NRF=n
CONFIG_NOTIFY=n
CONFIG_ONOFF=n

CONFIG_BOOT_BANNER=n
CONFIG_NCS_BOOT_BANNER=n
```

## samples/caf/Kconfig
```kconfig
#
# Copyright (c) 2021 Nordic Semiconductor ASA
#
# SPDX-License-Identifier: LicenseRef-Nordic-5-Clause
#

menu "Common Application Framework sample"
rsource "src/modules/Kconfig"
endmenu

menu "Zephyr Kernel"
source "Kconfig.zephyr"
endmenu
```

## samples/caf/Kconfig.sysbuild
```kconfig
#
# Copyright (c) 2025 Nordic Semiconductor
#
# SPDX-License-Identifier: LicenseRef-Nordic-5-Clause
#

config PARTITION_MANAGER
	default n

source "share/sysbuild/Kconfig"
```

## samples/caf/sample.yaml
```yaml
sample:
  description: Common Application Framework sample
  name: CAF
tests:
  sample.caf:
    sysbuild: true
    build_only: true
    integration_platforms:
      - nrf52840dk/nrf52840
      - nrf5340dk/nrf5340/cpuapp
    platform_allow: nrf52840dk/nrf52840 nrf5340dk/nrf5340/cpuapp
    tags: caf ci_build sysbuild
```

## samples/caf/src/modules/Kconfig
```kconfig
#
# Copyright (c) 2021 Nordic Semiconductor ASA
#
# SPDX-License-Identifier: LicenseRef-Nordic-5-Clause
#

config CAF_SAMPLE_LED_STATE
	bool "Sample LED state module"
	depends on CAF_LED_EVENTS
	depends on CAF_BUTTON_EVENTS
	help
	  If enabled, the application specific, LED state module, is included
	  in the application and controls LEDs based on buttons presses.

if CAF_SAMPLE_LED_STATE

module = CAF_SAMPLE_LED_STATE
module-str = caf sample led state
source "subsys/logging/Kconfig.template.log_config"

endif # CAF_SAMPLE_LED_STATE
```

## samples/caf_sensor_manager/Kconfig
```kconfig
#
# Copyright (c) 2022 Nordic Semiconductor ASA
#
# SPDX-License-Identifier: LicenseRef-Nordic-5-Clause
#

menu "Sensor manager sample"
rsource "src/modules/Kconfig"

config APP_INCLUDE_REMOTE_IMAGE
	bool "Include remote image build"
	depends on SOC_NRF5340_CPUAPP
	default y if (BOARD_NRF5340DK_NRF5340_CPUAPP || BOARD_NRF5340DK_NRF5340_CPUAPP_NS)
	select PARTITION_MANAGER_ENABLED
	select BOARD_ENABLE_CPUNET

config APP_REMOTE_BOARD
	string "The name of the board to be used by remote image"
	depends on APP_INCLUDE_REMOTE_IMAGE

# Disabling adding an empty net core image as we provide our own in this sample.
config NCS_SAMPLE_EMPTY_NET_CORE_CHILD_IMAGE
	bool "Add empty netcore child image"
	default n
endmenu

menu "Zephyr Kernel"
source "Kconfig.zephyr"
endmenu
```

## samples/caf_sensor_manager/Kconfig.sysbuild
```kconfig
#
# Copyright (c) 2024 Nordic Semiconductor ASA
#
# SPDX-License-Identifier: LicenseRef-Nordic-5-Clause
#

config PARTITION_MANAGER
	default n

config INCLUDE_REMOTE_IMAGE
	bool "Include CAF Sensor Manager remote image"
	default y

config REMOTE_BOARD
	string
	default "nrf5340dk/nrf5340/cpunet" if BOARD_NRF5340DK_NRF5340_CPUAPP
	default "nrf5340dk/nrf5340/cpunet" if BOARD_NRF5340DK_NRF5340_CPUAPP_NS
	default "nrf54h20dk/nrf54h20/cpuppr" if BOARD_NRF54H20DK_NRF54H20_CPUAPP

source "share/sysbuild/Kconfig"
```

## samples/caf_sensor_manager/boards/nrf5340dk_nrf5340_cpuapp.conf
```kconfig
#
# Copyright (c) 2022 Nordic Semiconductor ASA
#
# SPDX-License-Identifier: LicenseRef-Nordic-5-Clause
#
################################################################################

CONFIG_EVENT_MANAGER_PROXY=y
CONFIG_IPC_SERVICE=y
CONFIG_MBOX=y

CONFIG_OPENAMP=y
CONFIG_OPENAMP_SLAVE=n

CONFIG_CAF_SENSOR_DATA_AGGREGATOR_EVENTS=y

CONFIG_PARTITION_MANAGER_ENABLED=y
CONFIG_SOC_NRF53_CPUNET_ENABLE=y
```

## samples/caf_sensor_manager/boards/nrf5340dk_nrf5340_cpuapp_nrf5340_singlecore.conf
```kconfig
#
# Copyright (c) 2022 Nordic Semiconductor ASA
#
# SPDX-License-Identifier: LicenseRef-Nordic-5-Clause
#
################################################################################

CONFIG_INCLUDE_REMOTE_IMAGE=n
CONFIG_REMOTE_CORE_BOARD=""

CONFIG_EVENT_MANAGER_PROXY=n
CONFIG_IPC_SERVICE=n
CONFIG_MBOX=n
CONFIG_NRF53_SYNC_RTC=n
CONFIG_OPENAMP=n

CONFIG_CAF_SENSOR_MANAGER=y
CONFIG_CAF_SENSOR_DATA_AGGREGATOR=y

CONFIG_SENSOR=y
CONFIG_SENSOR_SIM=y
```

## samples/caf_sensor_manager/boards/nrf5340dk_nrf5340_cpuapp_singlecore.conf
```kconfig
#
# Copyright (c) 2022 Nordic Semiconductor ASA
#
# SPDX-License-Identifier: LicenseRef-Nordic-5-Clause
#
################################################################################

CONFIG_APP_INCLUDE_REMOTE_IMAGE=n
CONFIG_APP_REMOTE_BOARD=""

CONFIG_EVENT_MANAGER_PROXY=n
CONFIG_IPC_SERVICE=n
CONFIG_MBOX=n
CONFIG_NRF53_SYNC_RTC=n
CONFIG_OPENAMP=n

CONFIG_CAF_SENSOR_MANAGER=y
CONFIG_CAF_SENSOR_MANAGER_THREAD_STACK_SIZE=512
CONFIG_CAF_SENSOR_DATA_AGGREGATOR=y

CONFIG_SENSOR=y
CONFIG_SENSOR_STUB=y
```

## samples/caf_sensor_manager/boards/nrf54h20dk_nrf54h20_cpuapp_multicore.conf
```kconfig
#
# Copyright (c) 2024 Nordic Semiconductor ASA
#
# SPDX-License-Identifier: LicenseRef-Nordic-5-Clause
#
################################################################################

CONFIG_EVENT_MANAGER_PROXY=y
CONFIG_IPC_SERVICE=y
CONFIG_MBOX=y

CONFIG_CAF_SENSOR_DATA_AGGREGATOR_EVENTS=y
```

## samples/caf_sensor_manager/boards/nrf54h20dk_nrf54h20_cpuapp_singlecore.conf
```kconfig
#
# Copyright (c) 2024 Nordic Semiconductor ASA
#
# SPDX-License-Identifier: LicenseRef-Nordic-5-Clause
#
################################################################################

CONFIG_CAF_SENSOR_MANAGER=y
CONFIG_CAF_SENSOR_MANAGER_THREAD_STACK_SIZE=512
CONFIG_CAF_SENSOR_DATA_AGGREGATOR=y

CONFIG_SENSOR=y
CONFIG_SENSOR_STUB=y

CONFIG_CAF_INIT_LOG_SENSOR_EVENTS=y
```

## samples/caf_sensor_manager/boards/qemu_cortex_m3.conf
```kconfig
#
# Copyright (c) 2022 Nordic Semiconductor ASA
#
# SPDX-License-Identifier: LicenseRef-Nordic-5-Clause
#
################################################################################

CONFIG_SENSOR=y
CONFIG_CAF_SENSOR_MANAGER=y
```
