/*
 * Copyright (c) 2026 Nordic Semiconductor ASA
 *
 * SPDX-License-Identifier: LicenseRef-Nordic-5-Clause
 */

/* The DK buttons are on gpio4, which is missing the gpiote-instance property
 * that its siblings gpio1 and gpio3 have. Without it, GPIO interrupts return
 * -ENOTSUP and dk_buttons_init() fails, which stops the sample before
 * bt_enable() is reached.
 */
&gpio4 {
	gpiote-instance = <&gpiote20>;
};
