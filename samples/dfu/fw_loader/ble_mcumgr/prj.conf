## CMakeLists.txt
```
#
# Copyright (c) 2025 Nordic Semiconductor ASA
#
# SPDX-License-Identifier: LicenseRef-Nordic-5-Clause
#

cmake_minimum_required(VERSION 3.20.0)
find_package(Zephyr REQUIRED HINTS $ENV{ZEPHYR_BASE})
project(ble_mcumgr)

target_sources(app PRIVATE src/main.c)
```

## Kconfig.sysbuild
```
#
# Copyright (c) 2025 Nordic Semiconductor ASA
#
# SPDX-License-Identifier: LicenseRef-Nordic-5-Clause
#

if SOC_SERIES_NRF54H

config NRF_DEFAULT_IPC_RADIO
	default y

config NETCORE_IPC_RADIO_BT_HCI_IPC
	default y

endif # SOC_SERIES_NRF54H

source "${ZEPHYR_BASE}/share/sysbuild/Kconfig"
```

## sample.yaml
```
sample:
  name: Minimal Bluetooth LE SMP firmware loader sample
common:
  sysbuild: true
  build_only: true
tests:
  sample.fw_loader_ble_mcumgr:
    tags:
      - ci_samples_dfu
    platform_allow:
      - nrf54l15dk/nrf54l15/cpuapp
      - nrf54h20dk/nrf54h20/cpuapp
      - nrf7120dk/nrf7120/cpuapp
    integration_platforms:
      - nrf54l15dk/nrf54l15/cpuapp
      - nrf54h20dk/nrf54h20/cpuapp
      - nrf7120dk/nrf7120/cpuapp
    extra_args:
      - SB_CONFIG_PARTITION_MANAGER=n
      - mcuboot_CONFIG_FPROTECT=n
```

## prj.conf
```kconfig
# Enable MCUmgr and dependencies.
CONFIG_NET_BUF=y
CONFIG_ZCBOR=y
CONFIG_CRC=y
CONFIG_MCUMGR=y
CONFIG_STREAM_FLASH=y
CONFIG_FLASH_MAP=y

# Some command handlers require a large stack.
CONFIG_SYSTEM_WORKQUEUE_STACK_SIZE=2304
CONFIG_MAIN_STACK_SIZE=2176

# Ensure an MCUboot-compatible binary is generated.
CONFIG_BOOTLOADER_MCUBOOT=y

# Enable flash operations.
CONFIG_FLASH=y

# Enable most core commands.
CONFIG_IMG_MANAGER=y
CONFIG_MCUMGR_GRP_IMG=y
CONFIG_MCUMGR_GRP_OS=y
CONFIG_MCUMGR_GRP_OS_BOOTLOADER_INFO=y
CONFIG_MCUMGR_GRP_OS_ECHO=n
CONFIG_MCUMGR_GRP_OS_INFO=n

CONFIG_BT=y
CONFIG_BT_PERIPHERAL=y

# Allow for large Bluetooth data packets.
CONFIG_BT_L2CAP_TX_MTU=247
CONFIG_BT_BUF_ACL_RX_SIZE=251
CONFIG_BT_BUF_ACL_TX_SIZE=251

# Enable the Bluetooth mcumgr transport (unauthenticated).
CONFIG_MCUMGR_TRANSPORT_BT=y
CONFIG_MCUMGR_TRANSPORT_BT_CONN_PARAM_CONTROL=y

# Enable the Shell mcumgr transport.
CONFIG_BASE64=y
CONFIG_CRC=y

# Enable the mcumgr Packet Reassembly feature over Bluetooth and its configuration dependencies.
# MCUmgr buffer size is optimized to fit one SMP packet divided into five Bluetooth Write Commands,
# transmitted with the maximum possible MTU value: 247 bytes.
CONFIG_MCUMGR_TRANSPORT_BT_REASSEMBLY=y
CONFIG_MCUMGR_TRANSPORT_NETBUF_SIZE=1220
CONFIG_MCUMGR_GRP_OS_MCUMGR_PARAMS=y
CONFIG_MCUMGR_TRANSPORT_WORKQUEUE_STACK_SIZE=4608
CONFIG_BT_DEVICE_NAME="FW loader"


# Enable the storage erase command.
CONFIG_MCUMGR_GRP_ZBASIC=y
CONFIG_MCUMGR_GRP_ZBASIC_STORAGE_ERASE=y

# Disable Bluetooth ping support
CONFIG_BT_CTLR_LE_PING=n

# Disable shell commands that are not needed
CONFIG_CLOCK_CONTROL_NRF_SHELL=n
CONFIG_DEVICE_SHELL=n
CONFIG_DEVMEM_SHELL=n
CONFIG_FLASH_SHELL=n
########

# Disable unneeded drivers, peripherals and features to optimize for size
CONFIG_SIZE_OPTIMIZATIONS=y

# Enable LTO
CONFIG_LTO=y
CONFIG_ISR_TABLES_LOCAL_DECLARATION=y

CONFIG_I2C=n
CONFIG_WATCHDOG=n
CONFIG_SPI_NOR=n
CONFIG_GPIO=n

CONFIG_FPU=n

CONFIG_BOOT_BANNER=n
CONFIG_NCS_BOOT_BANNER=n
CONFIG_BOOT_DELAY=0
CONFIG_PRINTK=n

CONFIG_ARM_MPU=n

CONFIG_TIMESLICING=n
CONFIG_COMMON_LIBC_MALLOC=y
CONFIG_LOG=n
CONFIG_SERIAL=n
CONFIG_CONSOLE=n
CONFIG_UART_CONSOLE=n
CONFIG_ASSERT=n

# Disable vendor-specific HCI commands. Without them, the Bluetooth host cannot
# read the controller's device-unique static address and generates a new random
# one on each boot instead. This makes the device appear new to connected BLE
# clients and prevents attribute caching issues.
CONFIG_BT_HCI_VS=n

CONFIG_BT_DEBUG_NONE=y
CONFIG_BT_ASSERT=n
CONFIG_BT_DATA_LEN_UPDATE=n
CONFIG_BT_PHY_UPDATE=n
CONFIG_BT_GATT_CACHING=n

CONFIG_BT_GATT_ENFORCE_SUBSCRIPTION=n
CONFIG_BT_GATT_READ_MULTIPLE=n
CONFIG_BT_GATT_READ_MULT_VAR_LEN=n
CONFIG_BT_GAP_AUTO_UPDATE_CONN_PARAMS=n

CONFIG_BT_CTLR_PRIVACY=n
CONFIG_BT_CTLR_PHY_2M=n
CONFIG_BT_CTLR_LE_PING=n

CONFIG_PSA_USE_CRACEN_CIPHER_DRIVER=n
CONFIG_PSA_USE_CRACEN_AEAD_DRIVER=n
CONFIG_PSA_USE_CRACEN_MAC_DRIVER=n
CONFIG_PSA_USE_CRACEN_KEY_AGREEMENT_DRIVER=n
CONFIG_PSA_USE_CRACEN_ASYMMETRIC_ENCRYPTION_DRIVER=n
CONFIG_PSA_USE_CRACEN_KEY_MANAGEMENT_DRIVER=n
CONFIG_PSA_USE_CRACEN_KEY_DERIVATION_DRIVER=n
CONFIG_PSA_USE_CRACEN_PAKE_DRIVER=n
CONFIG_PSA_USE_CRACEN_ASYMMETRIC_SIGNATURE_DRIVER=n
CONFIG_PSA_USE_CRACEN_HASH_DRIVER=n

CONFIG_BT_GATT_SERVICE_CHANGED=n
```

## boards/nrf54lm20dongle_nrf54lm20b_cpuapp.overlay
```dts
/*
 * Copyright (c) 2026 Nordic Semiconductor ASA
 *
 * SPDX-License-Identifier: LicenseRef-Nordic-5-Clause
 */

/* This is nRF54lm20dongle_nrf54lm20b_cpuapp-specific partitioning for MCUboot and firmware loader.
 * slot0_partition defines RRAM region which can be updated by the firmware loader and booted by
 * MCUboot.
 * Beginning of the slot0_partition must match the beginning of the slot0_partition of the user
 * application, but the application can use a smaller partition and leave some space for
 * other purposes like a storage partition.
 */

/delete-node/ &storage_partition;

&cpuapp_rram {
	partitions {
		slot0_partition: partition@23000 {
			label = "image-0";
			reg = <0x23000 DT_SIZE_K(1896)>;
		};
	};
};
```

## src/main.c
```c
/*
 * Copyright (c) 2026 Nordic Semiconductor ASA
 *
 * SPDX-License-Identifier: LicenseRef-Nordic-5-Clause
 */

#include <zephyr/kernel.h>
#include <zephyr/bluetooth/bluetooth.h>
#include <zephyr/bluetooth/hci.h>
#include <zephyr/logging/log.h>
#include <zephyr/mgmt/mcumgr/transport/smp_bt.h>

#if defined(CONFIG_FW_LOADER_SETTINGS_ADV_NAME)
#include <dfu/fw_loader_settings.h>
#endif

LOG_MODULE_REGISTER(fw_loader_ble_mcumgr, CONFIG_LOG_DEFAULT_LEVEL);

static void advertising_work_handler(struct k_work *work);

static K_WORK_DEFINE(advertising_work, advertising_work_handler);

static const struct bt_data ad[] = {
	BT_DATA_BYTES(BT_DATA_FLAGS, (BT_LE_AD_GENERAL | BT_LE_AD_NO_BREDR)),
	BT_DATA_BYTES(BT_DATA_UUID128_ALL, SMP_BT_SVC_UUID_VAL),
};

#if defined(CONFIG_FW_LOADER_SETTINGS_ADV_NAME)
static char adv_name[CONFIG_FW_LOADER_SETTINGS_ADV_NAME_LEN];
static struct bt_data sd[] = {
	{
		.type = BT_DATA_NAME_COMPLETE,
		.data = adv_name,
	},
};

static void adv_name_prepare(void)
{
	int err;

	err = fw_loader_settings_adv_name_load(adv_name, sizeof(adv_name));
	if (err != 0) {
		LOG_WRN("Failed to load advertising name: %d", err);
		strncpy(adv_name, CONFIG_BT_DEVICE_NAME, sizeof(adv_name) - 1);
		adv_name[sizeof(adv_name) - 1] = '\0';
	}

	sd[0].data_len = strlen(adv_name);
}
#else
static const struct bt_data sd[] = {
	BT_DATA(BT_DATA_NAME_COMPLETE, CONFIG_BT_DEVICE_NAME, sizeof(CONFIG_BT_DEVICE_NAME) - 1),
};
#endif

static void advertising_work_handler(struct k_work *work)
{
	int err;

	ARG_UNUSED(work);

#if defined(CONFIG_FW_LOADER_SETTINGS_ADV_NAME)
	adv_name_prepare();
#endif

	err = bt_le_adv_start(BT_LE_ADV_CONN_FAST_1, ad, ARRAY_SIZE(ad), sd, ARRAY_SIZE(sd));
	if (err != 0) {
		LOG_ERR("Failed to start advertising: %d", err);
		return;
	}

	LOG_INF("Bluetooth advertising started");
}

static void advertising_start(void)
{
	int err;

	err = k_work_submit(&advertising_work);
	if (err < 0) {
		LOG_ERR("Failed to submit advertising work: %d", err);
	}
}

static void connected(struct bt_conn *conn, uint8_t conn_err)
{
	ARG_UNUSED(conn);

	if (conn_err) {
		LOG_WRN("Bluetooth connection failed, err 0x%02x %s", conn_err,
			bt_hci_err_to_str(conn_err));
		return;
	}

	struct bt_conn_info info;
	char peer[BT_ADDR_LE_STR_LEN] = "unknown";
	int rc;

	rc = bt_conn_get_info(conn, &info);
	if (rc) {
		LOG_WRN("Failed to get connection info (rc %d)", rc);
	} else {
		bt_addr_le_to_str(info.le.remote, peer, sizeof(peer));
	}

	LOG_INF("Bluetooth connected, peer %s", peer);
}

static void disconnected(struct bt_conn *conn, uint8_t reason)
{
	LOG_INF("Bluetooth disconnected: 0x%02x %s", reason, bt_hci_err_to_str(reason));
}

static void recycled(void)
{
	advertising_start();
}

BT_CONN_CB_DEFINE(conn_callbacks) = {
	.connected = connected,
	.disconnected = disconnected,
	.recycled = recycled,
};

int main(void)
{
	int err;

	err = bt_enable(NULL);
	if (err) {
		LOG_ERR("Failed to enable Bluetooth: %d", err);
		return 0;
	}
	advertising_start();

	LOG_INF("BLE MCUmgr firmware loader started");

	return 0;
}
```
