## CMakeLists.txt
```
#
# Copyright (c) 2022 Nordic Semiconductor ASA
#
# SPDX-License-Identifier: LicenseRef-Nordic-5-Clause
#

cmake_minimum_required(VERSION 3.13.1)

find_package(Zephyr REQUIRED HINTS $ENV{ZEPHYR_BASE})

project(lte_uart_update_53)

target_sources(app PRIVATE src/main.c)
```

## Kconfig
```
#
# Copyright (c) 2022 Nordic Semiconductor ASA
#
# SPDX-License-Identifier: LicenseRef-Nordic-5-Clause
#

menu "UART DFU sample"

config CLIENT_RX_BUF_SIZE
	int "Client rx buffer size"
	default 2100

module = APP
module-dep = LOG
module-str = Log level for sample
source "${ZEPHYR_BASE}/subsys/logging/Kconfig.template.log_config"

endmenu

menu "Zephyr Kernel"
source "Kconfig.zephyr"
endmenu
```

## sample.yaml
```
sample:
  name: FOTA over LTE through UART sample, remote core
tests:
  sample.dfu.nrf5340:
    build_only: true
    integration_platforms:
      - nrf5340dk_cpuapp_ns
    platform_allow: nrf5340dk_cpuapp_ns
    tags: ci_build
```

## prj.conf
```kconfig
#
# Copyright (c) 2022 Nordic Semiconductor ASA
#
# SPDX-License-Identifier: LicenseRef-Nordic-5-Clause
#

# System
CONFIG_SYSTEM_WORKQUEUE_STACK_SIZE=2048
CONFIG_RESET_ON_FATAL_ERROR=n
CONFIG_ASSERT=y

# Serial
CONFIG_SERIAL=y
CONFIG_UART_INTERRUPT_DRIVEN=y

# These have to be enabled for DFU_TARGET_MCUBOOT to be enabled
CONFIG_IMG_MANAGER=y
CONFIG_BOOTLOADER_MCUBOOT=y
CONFIG_IMG_ERASE_PROGRESSIVELY=y

CONFIG_DFU_TARGET=y
CONFIG_DFU_TARGET_UART_HOST=y
CONFIG_DFU_TARGET_UART_HOST_HANDLER_STACK_SIZE=1000

# The target will be dependent on the magic header in the start of the bin file
CONFIG_DFU_TARGET_MCUBOOT=y
CONFIG_DFU_TARGET_UART=n
CONFIG_DFU_TARGET_FULL_MODEM=n

CONFIG_UPDATEABLE_IMAGE_NUMBER=2

# -->CONFIG_IMG_ERASE_PROGRESSIVELY will select FLASH_PAGE_LAYOUT
# --> FLASH_PAGE_LAYOUT has direct dependencies FLASH_HAS_PAGE_LAYOUT && FLASH
# --> CONFIG_FLASH needs to be enabled
CONFIG_FLASH=y

CONFIG_NORDIC_QSPI_NOR=y
CONFIG_NORDIC_QSPI_NOR_FLASH_LAYOUT_PAGE_SIZE=4096
CONFIG_NORDIC_QSPI_NOR_STACK_WRITE_BUFFER_SIZE=16

CONFIG_MCUBOOT_IMAGE_VERSION="1.0.0"

CONFIG_BT=y
```

## boards/nrf5340dk_cpuapp_ns.conf
```kconfig
#
# Copyright (c) 2022 Nordic Semiconductor ASA
#
# SPDX-License-Identifier: LicenseRef-Nordic-5-Clause
#

# Logging
CONFIG_CONSOLE=y
CONFIG_LOG=y
```

## src/main.c
```c
/*
 * Copyright (c) 2022 Nordic Semiconductor ASA
 *
 * SPDX-License-Identifier: LicenseRef-Nordic-5-Clause
 */

#include <zephyr/zephyr.h>
#include <zephyr/device.h>
#include <dfu_target_uart_host.h>
#include <zephyr/logging/log.h>
#include <dfu/dfu_target_mcuboot.h>
LOG_MODULE_REGISTER(app, CONFIG_APP_LOG_LEVEL);

/* CONFIG_DOWNLOAD_CLIENT_BUF_SIZE + some room */
static uint8_t buf[CONFIG_CLIENT_RX_BUF_SIZE];

static void on_update_done(bool success)
{
	LOG_WRN("Update success: %d", success);
}

void main(void)
{
	const struct device *uart = DEVICE_DT_GET(DT_CHOSEN(sample_dfu_uart));

	LOG_WRN("Starting version " CONFIG_MCUBOOT_IMAGE_VERSION);

	if (!device_is_ready(uart)) {
		LOG_WRN("UART is not available!");
		return;
	}

	LOG_WRN("UART is available! Waiting for update");

	dfu_target_mcuboot_set_buf(buf, ARRAY_SIZE(buf));

	dfu_target_uart_host_start(uart, on_update_done);
}
```
