/*
 * Copyright (c) 2026 Nordic Semiconductor ASA
 *
 * SPDX-License-Identifier: LicenseRef-Nordic-5-Clause
 */

#include "../dts/nrf7120dk_nrf7120_cpuapp_common.dtsi"

secondary_app_partition: &slot1_partition {};
