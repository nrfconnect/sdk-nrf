/*
 * Copyright (c) 2026 Nordic Semiconductor ASA
 *
 * SPDX-License-Identifier: LicenseRef-Nordic-5-Clause
 */

#include "../sysbuild/nrf54h20dk_nrf54h20_memory_map.dtsi"
#include "../sysbuild/nrf54h20dk_nrf54h20_memory_map_ironside_se_conf.overlay"

/ {
	chosen {
		zephyr,boot-mode = &boot_request;
	};
};

secondary_app_partition: &cpuapp_slot1_partition {};
