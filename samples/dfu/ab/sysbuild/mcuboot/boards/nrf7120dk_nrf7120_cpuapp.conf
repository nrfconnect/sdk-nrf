## samples/dfu/ab/sysbuild/mcuboot/boards/nrf7120dk_nrf7120_cpuapp.conf
```kconfig
# Copyright (c) 2026 Nordic Semiconductor ASA
#
# SPDX-License-Identifier: LicenseRef-Nordic-5-Clause

CONFIG_FLASH=y
CONFIG_SPI_NOR=n
CONFIG_FPROTECT=n
CONFIG_BOOT_WATCHDOG_FEED=n

# Use retained RAM for MCUboot boot-request storage.
CONFIG_RETAINED_MEM=y
CONFIG_RETENTION=y
```

## samples/dfu/ab_split/Kconfig
```kconfig
#
# Copyright (c) 2025 Nordic Semiconductor ASA
#
# SPDX-License-Identifier: LicenseRef-Nordic-5-Clause
#

config N_BLINKS
	int "Number of fast blinks"
	default 1

config EMULATE_APP_HEALTH_CHECK_FAILURE
	bool "Blocks confirmation of being healthy after the update"

source "Kconfig.zephyr"
```

## samples/dfu/ab_split/sample.yaml
```yaml
sample:
  name: A/B with MCUboot and separated slots sample
common:
  sysbuild: true
  build_only: true
  tags:
    - dfu_ab
    - ci_samples_dfu

tests:
  sample.dfu.ab_split:
    extra_configs:
      - CONFIG_MCUMGR_GRP_IMG_ALLOW_CONFIRM_NON_ACTIVE_IMAGE_ANY=y
    platform_allow:
      - nrf54h20dk/nrf54h20/cpuapp
    integration_platforms:
      - nrf54h20dk/nrf54h20/cpuapp

  sample.dfu.ab_split.load_periphconf:
    extra_configs:
      - CONFIG_MCUMGR_GRP_IMG_ALLOW_CONFIRM_NON_ACTIVE_IMAGE_ANY=y
    platform_allow:
      - nrf54h20dk/nrf54h20/cpuapp
    integration_platforms:
      - nrf54h20dk/nrf54h20/cpuapp
    extra_args:
      - SB_CONFIG_NCS_MCUBOOT_LOAD_PERIPHCONF=y
```

## samples/dfu/compressed_update/Kconfig.sysbuild
```kconfig
#
# Copyright (c) 2025 Nordic Semiconductor
#
# SPDX-License-Identifier: LicenseRef-Nordic-5-Clause
#

config PARTITION_MANAGER
	default n if SOC_SERIES_NRF52 || SOC_NRF54L15 || SOC_NRF54LM20A || SOC_NRF54LV10A

if SOC_NRF54LS05B
# LS05 has limited HW resources - adjust compression parameters accordingly
config NCS_MCUBOOT_LZMA_MAX_DICT_SIZE
	default 4096

config NCS_MCUBOOT_LZMA_LC
	default 0

config NCS_MCUBOOT_LZMA_LP
	default 0

config NCS_MCUBOOT_LZMA_MAX_LC_LP
	default 0
endif # SOC_NRF54LS05B

source "share/sysbuild/Kconfig"
```

## samples/dfu/compressed_update/sysbuild/mcuboot/boards/nrf54ls05dk_nrf54ls05b_cpuapp.conf
```kconfig
#
# Copyright (c) 2026 Nordic Semiconductor ASA
#
# SPDX-License-Identifier: LicenseRef-Nordic-5-Clause
#

CONFIG_FPROTECT=n

CONFIG_NRF_OBERON=y
CONFIG_BOOT_ECDSA_NRF_OBERON=y

CONFIG_NRF_COMPRESS=y
CONFIG_NRF_COMPRESS_DECOMPRESSION=y
CONFIG_NRF_COMPRESS_LZMA=y
CONFIG_NRF_COMPRESS_ARM_THUMB=y
```

## samples/dfu/dfu_multi_image/Kconfig.sysbuild
```kconfig
#
# Copyright (c) 2025 Nordic Semiconductor
#
# SPDX-License-Identifier: LicenseRef-Nordic-5-Clause
#

config SOC_SERIES_NRF53
	select MCUBOOT_NRF53_MULTI_IMAGE_UPDATE
	select SECURE_BOOT_NETCORE
	select NETCORE_APP_UPDATE

if SOC_SERIES_NRF53

choice MCUBOOT_MODE
	default MCUBOOT_MODE_OVERWRITE_ONLY
endchoice

endif # SOC_SERIES_NRF53

source "${ZEPHYR_BASE}/share/sysbuild/Kconfig"
```

## samples/dfu/dfu_multi_image/modules/net_build_time_log/zephyr/Kconfig
```kconfig
#
# Copyright (c) 2025 Nordic Semiconductor
#
# SPDX-License-Identifier: LicenseRef-Nordic-5-Clause
#

config NET_BUILD_TIME_LOG
	bool "Makes the net core log print its build time at startup"
```

## samples/dfu/dfu_multi_image/sample.yaml
```yaml
#
# Copyright (c) 2025 Nordic Semiconductor ASA
#
# SPDX-License-Identifier: LicenseRef-Nordic-5-Clause
#

sample:
  description: DFU multi image sample application
  name: dfu_multi_image sample
common:
  platform_allow: nrf5340dk/nrf5340/cpuapp
  build_only: true
  sysbuild: true
tests:
  sample.dfu.dfu_multi_image:
    tags:
      - dfu_multi_image
      - ci_samples_dfu
    integration_platforms:
      - nrf5340dk/nrf5340/cpuapp
  sample.dfu.dfu_multi_image.save_progress:
    extra_configs:
      - CONFIG_DFU_TARGET_STREAM_SAVE_PROGRESS=y
      - CONFIG_DFU_MULTI_IMAGE_SAVE_PROGRESS=y
      - CONFIG_SETTINGS=y
      - CONFIG_NVS=y
    tags:
      - dfu_multi_image
      - ci_samples_dfu
    integration_platforms:
      - nrf5340dk/nrf5340/cpuapp
```

## samples/dfu/dfu_multi_image/sysbuild/mcuboot/boards/nrf5340dk_nrf5340_cpuapp.conf
```kconfig
# Copyright (c) 2025 Nordic Semiconductor ASA
#
# SPDX-License-Identifier: LicenseRef-Nordic-5-Clause
#

CONFIG_BOOT_MAX_IMG_SECTORS_AUTO=n
CONFIG_BOOT_MAX_IMG_SECTORS=128
```

## samples/dfu/dfu_multi_image/sysbuild/mcuboot/boards/nrf54h20dk_nrf54h20_cpuapp.conf
```kconfig
# Copyright (c) 2025 Nordic Semiconductor ASA
#
# SPDX-License-Identifier: LicenseRef-Nordic-5-Clause
#

# Ensure that Multithreading is enabled
CONFIG_MULTITHREADING=y
```

## samples/dfu/dfu_target/sample.yaml
```yaml
#
# Copyright (c) 2025 Nordic Semiconductor ASA
#
# SPDX-License-Identifier: LicenseRef-Nordic-5-Clause
#

sample:
  name: DFU target sample
common:
  platform_allow:
    - nrf52840dk/nrf52840
    - nrf54h20dk/nrf54h20/cpuapp
    - nrf54l15dk/nrf54l15/cpuapp
  build_only: true
  sysbuild: true
tests:
  sample.dfu.dfu_target:
    tags:
      - dfu_target
      - ci_samples_dfu
    integration_platforms:
      - nrf52840dk/nrf52840
      - nrf54h20dk/nrf54h20/cpuapp
      - nrf54l15dk/nrf54l15/cpuapp
```

## samples/dfu/encrypted_bootloader/sysbuild/mcuboot/boards/nrf54l15dk_nrf54l15_cpuapp.conf
```kconfig
# disable fprotect (to allow boot with bigger MCUboot)
CONFIG_FPROTECT=n
# MCUboot requires a large stack size, otherwise an MPU fault will occur
CONFIG_MAIN_STACK_SIZE=16384

# Disable partition manager
CONFIG_PM=n

# Enable flash operations
CONFIG_FLASH=y

CONFIG_BOOT_MAX_IMG_SECTORS=256

CONFIG_MULTITHREADING=y

CONFIG_LOG=y
CONFIG_LOG_MODE_MINIMAL=y
### Ensure Zephyr logging changes don't use more resources
CONFIG_LOG_DEFAULT_LEVEL=0
### Use info log level by default
CONFIG_MCUBOOT_LOG_LEVEL_INF=y
### Decrease footprint by ~4 KB in comparison to CBPRINTF_COMPLETE=y
CONFIG_CBPRINTF_NANO=y
### Use picolibc to reduce flash usage
CONFIG_PICOLIBC=y
### Disable malloc arena because we don't need it
CONFIG_COMMON_LIBC_MALLOC_ARENA_SIZE=0

CONFIG_FW_INFO_FIRMWARE_VERSION=2

# NCS boot banner
CONFIG_NCS_APPLICATION_BOOT_BANNER_STRING="MCUboot"
```

## samples/dfu/fw_loader/ble_mcumgr/Kconfig.sysbuild
```kconfig
#
# Copyright (c) 2025 Nordic Semiconductor ASA
#
# SPDX-License-Identifier: LicenseRef-Nordic-5-Clause
#

if SOC_SERIES_NRF54H

config NRF_DEFAULT_IPC_RADIO
	default y

config NETCORE_IPC_RADIO_BT_HCI_IPC
	default y

endif # SOC_SERIES_NRF54H

source "${ZEPHYR_BASE}/share/sysbuild/Kconfig"
```

## samples/dfu/fw_loader/ble_mcumgr/sample.yaml
```yaml
sample:
  description: Minimal Bluetooth LE SMP firmware loader
  name: ble_mcumgr
common:
  sysbuild: true
  build_only: true
tests:
  sample.fw_loader_ble_mcumgr:
    tags:
      - ci_samples_dfu
    platform_allow:
      - nrf54l15dk/nrf54l15/cpuapp
      - nrf54h20dk/nrf54h20/cpuapp
    integration_platforms:
      - nrf54l15dk/nrf54l15/cpuapp
      - nrf54h20dk/nrf54h20/cpuapp
    extra_args:
      - SB_CONFIG_PARTITION_MANAGER=n
```

## samples/dfu/fw_loader/usb_mcumgr/boards/nrf54lm20dongle_nrf54lm20b_cpuapp.conf
```kconfig
#
# Copyright (c) 2026 Nordic Semiconductor ASA
#
# SPDX-License-Identifier: LicenseRef-Nordic-5-Clause
#
CONFIG_CDC_ACM_SERIAL_VID=0x1915
CONFIG_CDC_ACM_SERIAL_PID=0x541A
CONFIG_CDC_ACM_SERIAL_MANUFACTURER_STRING="Nordic Semiconductor ASA"
CONFIG_CDC_ACM_SERIAL_PRODUCT_STRING="nRF54LM20 Dongle Bootloader"
CONFIG_MCUMGR_GRP_ZBASIC_STORAGE_ERASE=n
```

## samples/dfu/fw_loader/usb_mcumgr/sample.yaml
```yaml
sample:
  name: Minimal USB CDC-ACM SMP firmware loader sample
common:
  sysbuild: true
  build_only: true
tests:
  sample.fw_loader_usb_mcumgr:
    tags:
      - ci_samples_dfu
    platform_allow:
      - nrf54lm20dk/nrf54lm20a/cpuapp
      - nrf54lm20dongle/nrf54lm20b/cpuapp
      - nrf54lm20dk/nrf54lm20b/cpuapp
    integration_platforms:
      - nrf54lm20dk/nrf54lm20a/cpuapp
      - nrf54lm20dongle/nrf54lm20b/cpuapp
      - nrf54lm20dk/nrf54lm20b/cpuapp
```

## samples/dfu/mcuboot_with_encryption/Kconfig.sysbuild
```kconfig
#
# Copyright (c) 2025 Nordic Semiconductor
#
# SPDX-License-Identifier: LicenseRef-Nordic-5-Clause
#

config SAMPLE_MCUBOOT_ENCRYPTION_KMU
	bool "Use KMU instead of compiled in keys"
	depends on SOC_SERIES_NRF54LX
	help
	  Compile in KMU support and provision KMU with sample keys.
	  Remember to flash sample with:
	    west flash --erase -d <sample_build_dir>
	  to provision the keys with software.

config MCUBOOT_SIGNATURE_USING_KMU
	default y if SAMPLE_MCUBOOT_ENCRYPTION_KMU

config MCUBOOT_GENERATE_DEFAULT_KMU_KEYFILE
	default y if SAMPLE_MCUBOOT_ENCRYPTION_KMU

source "share/sysbuild/Kconfig"
```

## samples/dfu/mcuboot_with_encryption/boards/nrf54lv10dk_nrf54lv10a_cpuapp.conf
```kconfig
# Cutting down some of the features to fit onto the platform.
CONFIG_STATS=n
CONFIG_STATS_NAMES=n

# Disable the LittleFS file system.
CONFIG_FILE_SYSTEM=n
CONFIG_FILE_SYSTEM_LITTLEFS=n

# Disable file system commands
CONFIG_MCUMGR_GRP_FS=n

# Disable shell commands that are not needed
CONFIG_CLOCK_CONTROL_NRF_SHELL=n
CONFIG_DEVICE_SHELL=n
CONFIG_DEVMEM_SHELL=n
CONFIG_FLASH_SHELL=n

CONFIG_MCUMGR_GRP_OS_TASKSTAT=n
```

## samples/dfu/mcuboot_with_encryption/sample.yaml
```yaml
sample:
  name: MCUboot with encryption enabled sample
common:
  sysbuild: true
  tags:
    - mcuboot_with_encryption
    - ci_samples_dfu
tests:
  sample.mcuboot_with_encryption:
    build_only: true
    extra_args:
      - SB_EXTRA_CONF_FILE=sysbuild_kmu.conf
    platform_allow:
      - nrf54l15dk/nrf54l15/cpuapp
      - nrf54lm20dk/nrf54lm20a/cpuapp
      - nrf54lm20dk/nrf54lm20b/cpuapp
      - nrf54lv10dk/nrf54lv10a/cpuapp
    integration_platforms:
      - nrf54l15dk/nrf54l15/cpuapp
      - nrf54lm20dk/nrf54lm20a/cpuapp
      - nrf54lm20dk/nrf54lm20b/cpuapp
      - nrf54lv10dk/nrf54lv10a/cpuapp

  sample.mcuboot_with_encryption.multicore:
    build_only: true
    extra_args:
      - SB_CONFIG_NETCORE_IPC_RADIO=y
      - SB_CONFIG_NETCORE_IPC_RADIO_BT_HCI_IPC=y
      - mcuboot_CONFIG_NRF_SECURITY=y
    extra_configs:
      - CONFIG_MCUMGR_GRP_IMG_ALLOW_CONFIRM_NON_ACTIVE_IMAGE_ANY=y
    platform_allow:
      - nrf54h20dk/nrf54h20/cpuapp
    integration_platforms:
      - nrf54h20dk/nrf54h20/cpuapp

  sample.mcuboot_with_encryption.multicore.its:
    build_only: true
    extra_args:
      - SB_EXTRA_CONF_FILE=sysbuild_its.conf
      - SB_CONFIG_NETCORE_IPC_RADIO=y
      - SB_CONFIG_NETCORE_IPC_RADIO_BT_HCI_IPC=y
      - mcuboot_CONFIG_NRF_SECURITY=y
    extra_configs:
      - CONFIG_MCUMGR_GRP_IMG_ALLOW_CONFIRM_NON_ACTIVE_IMAGE_ANY=y
    platform_allow:
      - nrf54h20dk/nrf54h20/cpuapp
    integration_platforms:
      - nrf54h20dk/nrf54h20/cpuapp
```

## samples/dfu/mcuboot_with_encryption/sysbuild/mcuboot/boards/nrf54lv10dk_nrf54lv10a_cpuapp.conf
```kconfig
#
# Copyright (c) 2025 Nordic Semiconductor ASA
#
# SPDX-License-Identifier: LicenseRef-Nordic-5-Clause
#

CONFIG_SPI_NOR=n
CONFIG_SPI=n
# FPROTECT is only disabled because sample MCUBoot, with all the debug
# logging enabled will not fit into continuous region of 62k, which
# is max this platform can set protection for.
CONFIG_FPROTECT=n
```

## samples/dfu/mcuboot_with_encryption/sysbuild/mcuboot/boards/nrf7120dk_nrf7120_cpuapp.conf
```kconfig
# Copyright (c) 2026 Nordic Semiconductor ASA
#
# SPDX-License-Identifier: LicenseRef-Nordic-5-Clause

CONFIG_FLASH=y
CONFIG_SPI_NOR=n
CONFIG_FPROTECT=n
CONFIG_BOOT_WATCHDOG_FEED=n
```

## samples/dfu/nrf5340/Kconfig
```kconfig
#
# Copyright (c) 2022 Nordic Semiconductor ASA
#
# SPDX-License-Identifier: LicenseRef-Nordic-5-Clause
#

menu "UART DFU sample"

config CLIENT_RX_BUF_SIZE
	int "Client rx buffer size"
	default 2100

module = APP
module-dep = LOG
module-str = Log level for sample
source "${ZEPHYR_BASE}/subsys/logging/Kconfig.template.log_config"

endmenu

menu "Zephyr Kernel"
source "Kconfig.zephyr"
endmenu
```

## samples/dfu/nrf5340/boards/nrf5340dk_cpuapp_ns.conf
```kconfig
#
# Copyright (c) 2022 Nordic Semiconductor ASA
#
# SPDX-License-Identifier: LicenseRef-Nordic-5-Clause
#

# Logging
CONFIG_CONSOLE=y
CONFIG_LOG=y
```

## samples/dfu/nrf5340/sample.yaml
```yaml
sample:
  name: FOTA over LTE through UART sample, remote core
tests:
  sample.dfu.nrf5340:
    build_only: true
    integration_platforms:
      - nrf5340dk_cpuapp_ns
    platform_allow: nrf5340dk_cpuapp_ns
    tags: ci_build
```
