## tests/benchmarks/memory_access/Kconfig
```kconfig
config TEST_WRITE_FROBIDDEN_MEMORY_AREA
	bool "Test write access to the write forbidden memory area"

source "Kconfig.zephyr"
```

## tests/benchmarks/memory_access/testcase.yaml
```yaml
common:
  tags:
    - ci_tests_benchmarks_memory

tests:
  benchmarks.memory_access:
    platform_allow:
      - nrf54h20dk/nrf54h20/cpuapp
      - nrf54h20dk/nrf54h20/cpurad
      - nrf54h20dk/nrf54h20/cpuppr
      - nrf54l15dk/nrf54l15/cpuapp
      - nrf54l15dk/nrf54l15/cpuflpr
      - nrf54lm20dk/nrf54lm20a/cpuapp
      - nrf54lm20dk/nrf54lm20a/cpuflpr
      - nrf54lm20dk/nrf54lm20b/cpuapp
      - nrf54lm20dk/nrf54lm20b/cpuflpr
      - nrf7120dk/nrf7120/cpuapp
      - nrf7120dk/nrf7120/cpuflpr
      - nrf54lv10dk/nrf54lv10a/cpuapp
      - nrf54lc10dk/nrf54lc10a/cpuapp
      - nrf54ls05dk/nrf54ls05a/cpuapp
      - nrf54ls05dk/nrf54ls05b/cpuapp
      - nrf9251dk/nrf9251/cpuapp
      - nrf9251dk/nrf9251/cpuppr
    integration_platforms:
      - nrf54l15dk/nrf54l15/cpuapp
    harness: console
    harness_config:
      type: one_line
      ordered: true
      regex:
        - "Test PASS"

  benchmarks.memory_access.forbidden:
    platform_allow:
      - nrf54h20dk/nrf54h20/cpuapp
      - nrf54h20dk/nrf54h20/cpurad
      - nrf54h20dk/nrf54h20/cpuppr
      - nrf54l15dk/nrf54l15/cpuapp
      - nrf54l15dk/nrf54l15/cpuflpr
      - nrf54lm20dk/nrf54lm20a/cpuapp
      - nrf54lm20dk/nrf54lm20a/cpuflpr
      - nrf54lm20dk/nrf54lm20b/cpuapp
      - nrf54lm20dk/nrf54lm20b/cpuflpr
      - nrf7120dk/nrf7120/cpuapp
      - nrf7120dk/nrf7120/cpuflpr
      - nrf54lv10dk/nrf54lv10a/cpuapp
      - nrf54lc10dk/nrf54lc10a/cpuapp
      - nrf54ls05dk/nrf54ls05a/cpuapp
      - nrf54ls05dk/nrf54ls05b/cpuapp
    integration_platforms:
      - nrf54l15dk/nrf54l15/cpuapp
    extra_configs:
      - CONFIG_TEST_WRITE_FROBIDDEN_MEMORY_AREA=y
    harness: console
    harness_config:
      type: one_line
      ordered: true
      regex:
        - "BUS FAULT|mcause: 7, Store/AMO access fault"
```

## tests/code_extender/Kconfig
```kconfig
#
# Copyright (c) 2026 Nordic Semiconductor ASA
#
# SPDX-License-Identifier: LicenseRef-Nordic-5-Clause
#

config TEST_CODE_EXTENDER
	bool "Expand code size"
	help
	  This module is used to measure the performance of boot and update
	  process, in function of application size.

if TEST_CODE_EXTENDER

config TEST_CODE_EXTENDER_SIZE
	int "Extended code size (in bytes)"
	default 524288

endif # TEST_CODE_EXTENDER
```

## tests/drivers/can/multidut/testcase.yaml
```yaml
common:
  tags:
    - drivers
    - can
    - ci_tests_drivers_can
  timeout: 7200

tests:
  drivers.can.multidut.peer:
    build_only: true
    platform_allow:
      - nrf54h20dk/nrf54h20/cpuapp
    integration_platforms:
      - nrf54h20dk/nrf54h20/cpuapp

  drivers.can.multidut.classic:
    harness: pytest
    platform_allow:
      - nrf54l15dk/nrf54l15/cpuapp
    integration_platforms:
      - nrf54l15dk/nrf54l15/cpuapp
    harness_config:
      pytest_dut_scope: session
      fixture:
        - can
        - scan
      required_devices:
        - application: drivers.can.multidut.peer
          path: $ZEPHYR_NRF_MODULE_DIR/tests/drivers/can/multidut
          platform: nrf54h20dk/nrf54h20/cpuapp
          fixture:
            - can
            - mcan
```

## tests/drivers/gpio/hpf_gpio_basic_api/dts/bindings/test-hpf-gpio.yaml
```yaml
#
# Copyright (c) 2024 Nordic Semiconductor ASA
#
# SPDX-License-Identifier: LicenseRef-Nordic-5-Clause
#

description: |
    This binding provides resources required to build and run the
    tests/drivers/gpio/hpf_gpio_basic_api test in Zephyr.

compatible: "test-hpf-gpio"

properties:
  out-gpios:
    type: phandle-array
    required: true
    description: |
      Identity of HPF GPIOs that will be configured as outputs.
      These must be on GPIO instances to which FLPR has access.
      Each entry must be physically connected to the in-gpios entry
      at the same index.

  in-gpios:
    type: phandle-array
    required: true
    description: |
      Identity of hardware GPIOs that will be configured as inputs.
      Each entry must be physically connected to the out-gpios entry
      at the same index.
```
