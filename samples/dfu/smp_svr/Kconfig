## samples/net/azure_iot_hub/Kconfig
```kconfig
#
# Copyright (c) 2022 Nordic Semiconductor ASA
#
# SPDX-License-Identifier: LicenseRef-Nordic-5-Clause
#

menu "Azure IoT Hub sample"

module = AZURE_IOT_HUB_SAMPLE
module-str = Azure IoT Hub sample
source "$(ZEPHYR_BASE)/subsys/logging/Kconfig.template.log_config"

config AZURE_IOT_HUB_SAMPLE_DEVICE_ID_USE_HW_ID
	bool "Use HW ID as device ID"
	select HW_ID_LIBRARY
	help
	  Use the devices's hardware ID as device ID when connecting to Azure IOT Hub

config SAMPLE_RECONNECT_DELAY_SECONDS
	int "Reconnect delay in seconds"
	default 30
	help
	  Delay before retrying a failed connection to Azure IoT Hub.
	  A change in network readiness ends the delay early.

endmenu

menu "Zephyr Kernel"
source "Kconfig.zephyr"
endmenu
```

## samples/peripheral/vpr_offloading/Kconfig.sysbuild
```kconfig
#
# Copyright (c) 2026 Nordic Semiconductor ASA
#
# SPDX-License-Identifier: LicenseRef-Nordic-5-Clause
#

choice NETCORE
	default NETCORE_EMPTY

endchoice

if SUPPORT_PPRCORE

choice PPRCORE
	default PPRCORE_REMOTE

config PPRCORE_REMOTE
	bool "remote image"

endchoice

config PPRCORE_IMAGE_NAME
	default "remote" if PPRCORE_REMOTE

config PPRCORE_IMAGE_PATH
	default "$(APP_DIR)/remote" if PPRCORE_REMOTE

endif # SUPPORT_PPRCORE

if SUPPORT_FLPRCORE && (!SUPPORT_PPRCORE || SOC_NRF9251)

choice FLPRCORE
	default FLPRCORE_REMOTE if !SUPPORT_PPRCORE

config FLPRCORE_REMOTE
	bool "remote image"

endchoice

config FLPRCORE_IMAGE_NAME
	default "remote" if FLPRCORE_REMOTE

config FLPRCORE_IMAGE_PATH
	default "$(APP_DIR)/remote" if FLPRCORE_REMOTE

endif # SUPPORT_FLPRCORE && (!SUPPORT_PPRCORE || SOC_NRF9251)

source "share/sysbuild/Kconfig"
```

## samples/sensor/bme68x_iaq/sample.yaml
```yaml
sample:
  name: BME68X Sensor Sample
tests:
  sample.sensor.bme68x.i2c:
    sysbuild: true
    depends_on: i2c
    harness: sensor
    integration_platforms:
      - thingy91x/nrf9151
      - thingy91x/nrf9151/ns
    platform_allow:
      - thingy91x/nrf9151
      - thingy91x/nrf9151/ns
    tags:
      - sensors
      - sysbuild
      - ci_samples_sensor
  sample.sensor.bme68x.polling:
    sysbuild: true
    depends_on: i2c
    integration_platforms:
      - thingy91x/nrf9151
      - thingy91x/nrf9151/ns
    extra_args: CONFIG_APP_TRIGGER=n
    platform_allow:
      - thingy91x/nrf9151
      - thingy91x/nrf9151/ns
    tags:
      - sensors
      - sysbuild
      - ci_samples_sensor
    harness: console
    harness_config:
      type: multi_line
      ordered: true
      regex:
        - "(\\d+\\.\\d+); press: (\\d+\\.\\d+); humidity: (\\d+\\.\\d+); iaq: (\\\
        d+)"
```

## samples/tfm/provisioning_image/Kconfig.sysbuild
```kconfig
#
# Copyright (c) 2026 Nordic Semiconductor
#
# SPDX-License-Identifier: LicenseRef-Nordic-5-Clause
#

# Bundle provisioning_image_net_core when building for nRF5340 application core.

if SOC_NRF5340_CPUAPP

choice NETCORE
	default NETCORE_PROVISIONING_IMAGE_NET_CORE

config NETCORE_PROVISIONING_IMAGE_NET_CORE
	bool "provisioning_image_net_core"
	help
	  Include the TF-M provisioning image for the network core, which locks
	  network-core debug access (UICR APPROTECT).

endchoice

config NETCORE_IMAGE_NAME
	default "provisioning_image_net_core" if NETCORE_PROVISIONING_IMAGE_NET_CORE

config NETCORE_IMAGE_PATH
	default "$(ZEPHYR_NRF_MODULE_DIR)/samples/tfm/provisioning_image_net_core" if NETCORE_PROVISIONING_IMAGE_NET_CORE

endif # SOC_NRF5340_CPUAPP

source "share/sysbuild/Kconfig"
```

## samples/zephyr/net/mqtt_sn_publisher/sample.yaml
```yaml
sample:
  description: MQTT-SN publisher sample application
  name: MQTT-SN publisher
tests:
  nrf.extended.sample.net.mqtt_sn_publisher.wifi-ipv4:
    tags:
      - ci_build
      - sysbuild
      - ci_samples_net
    extra_args:
      - SNIPPET=wifi-ipv4
      # HostAP crypto still uses the deprecated legacy MbedTLS symbols.
      - CONFIG_DEPRECATED_KCONFIGS_AS_ERRORS=n
    platform_allow:
      - nrf7002dk/nrf5340/cpuapp
      - nrf7120dk/nrf7120/cpuapp
    integration_platforms:
      - nrf7002dk/nrf5340/cpuapp
      - nrf7120dk/nrf7120/cpuapp
```

## samples/zephyr/net/sockets/coap_server/sample.yaml
```yaml
sample:
  description: BSD Sockets API CoAP server example
  name: socket_coap_server
tests:
  nrf.extended.sample.net.sockets.coap_server.wifi-ipv4:
    tags:
      - ci_build
      - sysbuild
      - ci_samples_net
    extra_args:
      - SNIPPET=wifi-ipv4
      # HostAP crypto still uses the deprecated legacy MbedTLS symbols.
      - CONFIG_DEPRECATED_KCONFIGS_AS_ERRORS=n
    platform_allow:
      - nrf7002dk/nrf5340/cpuapp
      - nrf7120dk/nrf7120/cpuapp
    integration_platforms:
      - nrf7002dk/nrf5340/cpuapp
      - nrf7120dk/nrf7120/cpuapp
  nrf.extended.sample.net.sockets.coap_server.wifi-ipv4.dtls:
    tags:
      - ci_build
      - sysbuild
      - ci_samples_net
    extra_args:
      - SNIPPET=wifi-ipv4
      - EXTRA_CONF_FILE="overlay-dtls.conf"
      # HostAP crypto still uses the deprecated legacy MbedTLS symbols.
      - CONFIG_DEPRECATED_KCONFIGS_AS_ERRORS=n
    platform_allow:
      - nrf7002dk/nrf5340/cpuapp
      - nrf7120dk/nrf7120/cpuapp
    integration_platforms:
      - nrf7002dk/nrf5340/cpuapp
      - nrf7120dk/nrf7120/cpuapp
  nrf.extended.sample.net.sockets.coap_server.wifi-ipv6:
    tags:
      - ci_build
      - sysbuild
      - ci_samples_net
    extra_args:
      - SNIPPET=wifi-ipv6
      # HostAP crypto still uses the deprecated legacy MbedTLS symbols.
      - CONFIG_DEPRECATED_KCONFIGS_AS_ERRORS=n
    platform_allow:
      - nrf7002dk/nrf5340/cpuapp
      - nrf7120dk/nrf7120/cpuapp
    integration_platforms:
      - nrf7002dk/nrf5340/cpuapp
      - nrf7120dk/nrf7120/cpuapp
  nrf.extended.sample.net.sockets.coap_server.wifi-ipv6.dtls:
    tags:
      - ci_build
      - sysbuild
      - ci_samples_net
    extra_args:
      - SNIPPET=wifi-ipv6
      - EXTRA_CONF_FILE="overlay-dtls.conf"
      # HostAP crypto still uses the deprecated legacy MbedTLS symbols.
      - CONFIG_DEPRECATED_KCONFIGS_AS_ERRORS=n
    platform_allow:
      - nrf7002dk/nrf5340/cpuapp
      - nrf7120dk/nrf7120/cpuapp
    integration_platforms:
      - nrf7002dk/nrf5340/cpuapp
      - nrf7120dk/nrf7120/cpuapp
```

## subsys/bluetooth/host_extensions/Kconfig
```kconfig
#
# Copyright (c) 2024 Nordic Semiconductor
#
# SPDX-License-Identifier: LicenseRef-Nordic-5-Clause
#

config BT_RADIO_NOTIFICATION_CONN_CB
	bool "Radio Notification connection callback"
	depends on BT_LL_SOFTDEVICE || \
		   (BT_LL_SOFTDEVICE_HEADERS_INCLUDE && !SOC_COMPATIBLE_NRF5340_CPUAPP)
	select BT_HCI_VS_EVT_USER
	select BT_CTLR_SDC_CONN_ANCHOR_POINT_REPORT
	help
	  Enables the support for setting up a radio notification
	  callback to trigger a configurable amount of time before the
	  connection event starts.
	  This feature can be used to synchronize data sampling
	  with on-air data transmission.

config BT_NRF_CONN_SET_LTK
	bool "Custom LTK support"
	depends on BT_SMP
	help
	  Enables the bt_nrf_conn_set_ltk() API.

config BT_NRF_LE_POWER_CONTROL_EXT
	bool "LE Power Control extensions [EXPERIMENTAL]"
	depends on BT_TRANSMIT_POWER_CONTROL || BT_CTLR_LE_POWER_CONTROL
	depends on !BT_LL_SOFTDEVICE || BT_LL_SOFTDEVICE_MULTIROLE
	select EXPERIMENTAL
	help
	  Enables the bt_conn_set_conn_power_control_request_params(),
	  bt_conn_set_tx_power_bounds() and bt_nrf_power_control_rsp_report_enable() APIs,
	  and the vendor-specific HCI command that they use in the SoftDevice Controller.
	  Only the multirole library of the SoftDevice Controller supports it.
	  When the host and the controller are built as separate images, enable this option in
	  both images.
```

## subsys/bluetooth/mesh/Kconfig.node_reset_button
```kconfig
#
# Copyright (c) 2026 Nordic Semiconductor
#
# SPDX-License-Identifier: LicenseRef-Nordic-5-Clause
#

menuconfig BT_MESH_NODE_RESET_BUTTON
	bool "Node reset using a button"
	depends on DK_LIBRARY
	help
	  Allow a Bluetooth Mesh application to reset the node by
	  holding a button on the development kit. The application enables this
	  and calls bt_mesh_node_reset_button_init().

if BT_MESH_NODE_RESET_BUTTON

config BT_MESH_NODE_RESET_BUTTON_INDEX
	int "Button used to reset the node"
	default 0 if BOARD_NRF54L15TAG
	default 3
	range 0 3
	help
	  Index of the button, counting from 0. This is the position in the
	  button list of the board (sw0 is 0, sw3 is 3), not the number printed
	  on the DK: index 3 is Button 3 on the nRF54L DKs and Button 4 on the
	  nRF5340 DK. The default is the highest button of the board. Set a lower
	  index when the highest button has another function in the application,
	  for example the EMDS store in the Light Control sample.

config BT_MESH_NODE_RESET_BUTTON_HOLD_MS
	int "Button hold time in milliseconds"
	default 10000
	range 1000 60000
	help
	  How long the reset button must be held before the node is reset.

endif # BT_MESH_NODE_RESET_BUTTON
```

## subsys/bluetooth/mesh/Kconfig.rpl
```kconfig
#
# Copyright (c) 2022 Nordic Semiconductor ASA
#
# SPDX-License-Identifier: LicenseRef-Nordic-5-Clause
#

# Option enabled when the NCS implementation of RPL should be used instead of
# the Zephyr one.
config BT_MESH_RPL_NCS
	bool

choice BT_MESH_RPL_STORAGE_MODE
	default BT_MESH_RPL_STORAGE_MODE_EMDS if EMDS

config BT_MESH_RPL_STORAGE_MODE_EMDS
	bool "Persistent storage of RPL in Emergency Data Storage"
	depends on EMDS
	select BT_MESH_RPL_NCS
	help
	  Persistent storage of RPL in Emergency Data Storage.

config BT_MESH_NRF_RPL_STORAGE_MODE_ZMS
	bool "Persistent storage of RPL in Zephyr Memory Storage [EXPERIMENTAL]"
	depends on ZMS
	depends on !ZMS_ID_64BIT
	depends on FLASH_PAGE_LAYOUT
	depends on FLASH_MAP
	select BT_MESH_RPL_NCS
	select BT_MESH_PENDING_STORE
	select CRC
	select EXPERIMENTAL
	help
	  Persistent storage of RPL directly in a dedicated ZMS partition.
	  This approach does not use the Settings subsystem for RPL storage.

	  ZMS uses the partition with the devicetree node label rpl_partition,
	  and needs at least two sectors. The partition with the node label
	  rpl_backup_partition holds a backup of the RPL, which keeps the RPL
	  safe across a power loss while it is rewritten after an IV Index
	  update. The backup partition must hold a 6 byte header and 8 bytes
	  per BT_MESH_CRPL entry, each rounded up to the flash write block
	  size. For example, with 16 byte write blocks and BT_MESH_CRPL=255,
	  that is 16 + 2048 = 2064 bytes. The partition layout usually can't
	  change in a firmware update, so size it for the largest BT_MESH_CRPL
	  any future firmware may use. Init fails if the partition is too small.

endchoice

if BT_MESH_RPL_STORAGE_MODE_EMDS

config BT_MESH_RPL_INDEX
	int "Unique index for the storage of RPL data"
	default 999
	help
	  This value defines the storage index for the RPL data in Emergency
	  Data Storage, and can not overlap with any other index in the
	  Emergency Data Storage.

endif # BT_MESH_RPL_STORAGE_MODE_EMDS
```

## subsys/bootloader/bl_mpc/Kconfig
```kconfig
#
# Copyright (c) 2026 Nordic Semiconductor ASA
#
# SPDX-License-Identifier: LicenseRef-Nordic-5-Clause
#

config BL_MPC
	bool "Lock MPC protection before hand-off"
	depends on SOC_NRF54L_CPUAPP_COMMON
	depends on IS_BOOTLOADER_IMG
	depends on !TRUSTED_EXECUTION_NONSECURE
	help
	  Programs MPC00 override regions and locks all software-configurable
	  overrides until reset. Intended for the last bootloader stage.
```

## subsys/event_manager_proxy/Kconfig
```kconfig
#
# Copyright (c) 2022 Nordic Semiconductor
#
# SPDX-License-Identifier: LicenseRef-Nordic-5-Clause
#

menuconfig EVENT_MANAGER_PROXY
	depends on APP_EVENT_MANAGER
	bool "Event manager proxy"
	depends on IPC_SERVICE
	select EVENTS
	select APP_EVENT_MANAGER_PROVIDE_EVENT_SIZE
	select APP_EVENT_MANAGER_POSTPROCESS_HOOKS
	help
	  Event manager proxy would take care of passing the events between the different cores.

if EVENT_MANAGER_PROXY

config EVENT_MANAGER_PROXY_CH_COUNT
	int "Number of IPC instances to be used"
	range 1 32
	default 1
	help
	  Number of the communication channels to be supported.
	  It covers the information with how many cores we wish to communicate.

config EVENT_MANAGER_PROXY_BIND_TIMEOUT_MS
	int "Timeout while waiting for the endpoint to bind in ms"
	range 1 5000
	default 100
	help
	  Miliseconds to wait for endpoint binding.
	  This timeout depends on the time to initialize all the cores
	  the event proxy manager is going to communicate.

config EVENT_MANAGER_PROXY_SEND_RETRIES
	int "Number IPC transmission retries"
	range 0 100
	default 5
	help
	  Number of retries if an error occurs when transmitting event to the core.

config EVENT_MANAGER_PROXY_REMOTE_EVENTS_COUNT
	int "Number of remote events that can be held at the same time"
	default 16
	help
	  Number of remote events to be supported which can be held at the same time. It is using
	  the IPC service RX buffer holding feature. If number of pending events is greater than
	  this value, then incoming events are copied into the heap which is slower.
	  Set to 0 to disable the feature and use the heap instead.

	  When enabled, the event manager proxy implements app_event_manager_free so user cannot
	  implement custom free function.

endif # EVENT_MANAGER_PROXY
```

## subsys/net/lib/tls_credentials_keygen_kmu/Kconfig
```kconfig
#
# Copyright (c) 2026 Nordic Semiconductor ASA
#
# SPDX-License-Identifier: LicenseRef-Nordic-5-Clause
#

# Store the generated keys in the KMU on devices that have one.
choice TLS_CREDENTIALS_KEYGEN_KEY_STORE
	default TLS_CREDENTIALS_KEYGEN_KEY_STORE_CUSTOM if CRACEN_KMU
endchoice

menuconfig TLS_CREDENTIALS_KEYGEN_KMU
	bool "Store the generated TLS keys in the KMU [EXPERIMENTAL]"
	depends on TLS_CREDENTIALS_KEYGEN_KEY_STORE_CUSTOM
	depends on CRACEN_KMU
	default y
	select EXPERIMENTAL
	help
	  Key store of the TLS credentials key generation (TLS_CREDENTIALS_KEYGEN) that stores the
	  generated private keys in the CRACEN Key Management Unit (KMU). The private keys are not
	  stored in the TLS credentials storage, and they cannot be exported.

	  The library owns the KMU slots that are set with TLS_CREDENTIALS_KEYGEN_KMU_SLOT_FIRST
	  and TLS_CREDENTIALS_KEYGEN_KMU_KEY_COUNT. A key in these slots that no security tag is
	  registered for is not destroyed, and its slots are not used for a new key.

if TLS_CREDENTIALS_KEYGEN_KMU

choice TLS_CREDENTIALS_KEYGEN_KMU_SCHEME
	prompt "KMU key usage scheme"
	default TLS_CREDENTIALS_KEYGEN_KMU_SCHEME_ENCRYPTED
	help
	  The scheme is a part of the key ID. Do not change it after keys are generated, for
	  example in a firmware update. Delete the keys with tls_credential_keygen_delete() first.

config TLS_CREDENTIALS_KEYGEN_KMU_SCHEME_ENCRYPTED
	bool "Encrypted"
	select CRACEN_IKG
	select PSA_WANT_KEY_TYPE_AES
	select PSA_WANT_AES_KEY_SIZE_256
	select PSA_WANT_ALG_GCM
	select PSA_WANT_ALG_CMAC
	select PSA_WANT_ALG_ECB_NO_PADDING
	select PSA_WANT_ALG_SP800_108_COUNTER_CMAC
	help
	  The key is stored encrypted with a key that is derived from the CRACEN IKG seed. Each
	  key uses a block of 5 KMU slots, which fits a P-384 key.

config TLS_CREDENTIALS_KEYGEN_KMU_SCHEME_RAW
	bool "Raw"
	help
	  The key is stored in plaintext in the KMU. Each key uses a block of 3 KMU slots, which
	  fits a P-384 key.

endchoice

config TLS_CREDENTIALS_KEYGEN_KMU_SLOT_FIRST
	int "First KMU slot"
	range 0 179
	default 100
	help
	  First KMU slot of the keys. Each key uses a block of slots that fits a P-384 key. The
	  slots must not be used by anything else.

	  The slot is a part of the key ID. Do not change it after keys are generated, for example
	  in a firmware update. Delete the keys with tls_credential_keygen_delete() first.

config TLS_CREDENTIALS_KEYGEN_KMU_KEY_COUNT
	int "Number of keys"
	range 1 36
	default 2
	help
	  Maximum number of generated keys, one for each security tag.

endif # TLS_CREDENTIALS_KEYGEN_KMU
```
