/*
 * Copyright (c) 2026 Nordic Semiconductor ASA
 *
 * SPDX-License-Identifier: LicenseRef-Nordic-5-Clause
 */

#include "../sysbuild/nrf54lm20_nrf54lm20_cpuapp_memory_map_ram_load.dtsi"

/ {
	chosen {
		zephyr,bootloader-info = &boot_info0;
	};
};
