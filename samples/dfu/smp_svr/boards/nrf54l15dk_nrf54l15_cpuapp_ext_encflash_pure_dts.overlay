/*
 * Copyright (c) 2026 Nordic Semiconductor ASA
 *
 * SPDX-License-Identifier: LicenseRef-Nordic-5-Clause
 */

#include "../dts/nrf54l15dk_nrf54l15_memory_map_ext_encflash.dtsi"
#include "../dts/nrf54l15dk_nrf54l15_bootchain.dtsi"

&mx25r64 {
	status = "okay";
};
