/*
 * Copyright (c) 2026 Nordic Semiconductor ASA
 *
 * SPDX-License-Identifier: LicenseRef-Nordic-5-Clause
 */

#include "../dts/nrf5340dk_nrf5340_cpuapp_memory_map_nrf5340_bt.dtsi"
#include "../app_nrf5340_bt.overlay"
