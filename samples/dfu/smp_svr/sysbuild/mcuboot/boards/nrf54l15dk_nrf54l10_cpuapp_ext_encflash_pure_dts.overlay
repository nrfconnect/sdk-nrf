/*
 * Copyright (c) 2026 Nordic Semiconductor ASA
 *
 * SPDX-License-Identifier: LicenseRef-Nordic-5-Clause
 */

#include "../../nrf54l15dk_nrf54l10_memory_map_ext_encflash.dtsi"
#include "../../nrf54l15dk_nrf54l10_bootchain.dtsi"

/ {
	chosen {
		zephyr,code-partition = &boot_partition;
	};
};

&mx25r64 {
	status = "okay";
};
