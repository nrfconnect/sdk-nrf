/*
 * Copyright (c) 2026 Nordic Semiconductor ASA
 *
 * SPDX-License-Identifier: LicenseRef-Nordic-5-Clause
 */

#include "../../../boards/nrf5340dk_nrf5340_cpuapp_nrf5340_shared_slot.overlay"

/ {
	chosen {
		zephyr,code-partition = &boot_partition;
	};
};
