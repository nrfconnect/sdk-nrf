/*
 * Copyright (c) 2026 Nordic Semiconductor ASA
 *
 * SPDX-License-Identifier: LicenseRef-Nordic-5-Clause
 */

#include "nrf54h20dk_nrf54h20_memory_map_ext_flash.dtsi"
#include "nrf54h20dk_nrf54h20_bootchain_bt.dtsi"
