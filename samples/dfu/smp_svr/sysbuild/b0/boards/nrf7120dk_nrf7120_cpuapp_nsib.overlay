/*
 * Copyright (c) 2026 Nordic Semiconductor ASA
 *
 * SPDX-License-Identifier: LicenseRef-Nordic-5-Clause
 */

#include "../../../boards/nrf7120dk_nrf7120_cpuapp_nsib.overlay"

/ {
	chosen {
		zephyr,code-partition = &b0_partition;
	};
};
