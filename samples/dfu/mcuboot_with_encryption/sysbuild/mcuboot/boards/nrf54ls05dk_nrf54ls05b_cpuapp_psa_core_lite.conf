## samples/dfu/mcuboot_with_encryption/sysbuild/mcuboot/boards/nrf54ls05dk_nrf54ls05b_cpuapp_psa_core_lite.conf
```kconfig
#
# Copyright (c) 2026 Nordic Semiconductor ASA
#
# SPDX-License-Identifier: LicenseRef-Nordic-5-Clause
#

CONFIG_SPI_NOR=n
CONFIG_SPI=n
CONFIG_FPROTECT=n
CONFIG_FAULT_DUMP=0
CONFIG_ARM_MPU=n

CONFIG_PSA_CRYPTO=y
CONFIG_PSA_CORE_LITE=y
CONFIG_BOOT_ECDSA_PSA=y

CONFIG_ISR_TABLES_LOCAL_DECLARATION=y
CONFIG_LTO=y
```

## samples/dfu/single_slot/Kconfig
```kconfig
#
# Copyright (c) 2026 Nordic Semiconductor ASA
#
# SPDX-License-Identifier: LicenseRef-Nordic-5-Clause
#

source "Kconfig.zephyr"

if SETTINGS

config ZMS
	default y if (SOC_FLASH_NRF_RRAM || SOC_FLASH_NRF_MRAM)

config NVS
	default y if !(SOC_FLASH_NRF_RRAM || SOC_FLASH_NRF_MRAM)

endif # SETTINGS
```

## samples/dfu/single_slot/Kconfig.sysbuild
```kconfig
#
# Copyright (c) 2025 Nordic Semiconductor ASA
#
# SPDX-License-Identifier: LicenseRef-Nordic-5-Clause
#

config PARTITION_MANAGER
	default n

config MCUBOOT_SIGNATURE_USING_KMU
	default y if SOC_SERIES_NRF54L && !(SOC_NRF54LS05A || SOC_NRF54LS05B)

config MCUBOOT_GENERATE_DEFAULT_KEY_FILE
	default y if SOC_SERIES_NRF54L && !(SOC_NRF54LS05A || SOC_NRF54LS05B)

config MCUBOOT_IMAGES_ROM_END_OFFSET_AUTO
	default "single_slot;fw_loader_ipc_radio" if MCUBOOT_SIGN_MERGED_BINARY && SUPPORT_NETCORE

# The pure variant requires ED25519 and both slots in internal storage, so targets outside these
# SoC series keep the MCUboot default signature type.
config BOOT_SIGNATURE_TYPE_PURE
	default y if (SOC_SERIES_NRF54L || SOC_SERIES_NRF54H || SOC_SERIES_NRF71) && \
		BOOT_SIGNATURE_TYPE_ED25519

choice BOOT_SIGNATURE_TYPE
	default BOOT_SIGNATURE_TYPE_ECDSA_P256 if SOC_NRF54LS05A || SOC_NRF54LS05B
	default BOOT_SIGNATURE_TYPE_ED25519 if SOC_SERIES_NRF54L || SOC_SERIES_NRF54H || \
		SOC_SERIES_NRF71
endchoice

source "share/sysbuild/Kconfig"
```

## samples/dfu/single_slot/sample.yaml
```yaml
##
# Copyright (c) 2025 Nordic Semiconductor ASA
#
# SPDX-License-Identifier: LicenseRef-Nordic-5-Clause
#

sample:
  name: Single-slot DFU with MCUboot sample
common:
  sysbuild: true
  harness: console
  harness_config:
    type: one_line
    regex:
      - "Starting single_slot sample"
tests:
  sample.dfu.single_slot:
    tags:
      - dfu_single_slot
      - ci_samples_dfu
    platform_allow:
      - nrf52840dk/nrf52840
      - nrf54l15dk/nrf54l15/cpuapp
      - nrf54h20dk/nrf54h20/cpuapp
      - nrf54lm20dk/nrf54lm20a/cpuapp
      - nrf54ls05dk/nrf54ls05b/cpuapp
      - nrf54ls05dk/nrf54ls05a/cpuapp
      - nrf54lm20dk/nrf54lm20b/cpuapp
      - nrf7120dk/nrf7120/cpuapp
    integration_platforms:
      - nrf52840dk/nrf52840
      - nrf54l15dk/nrf54l15/cpuapp
      - nrf54h20dk/nrf54h20/cpuapp
      - nrf54lm20dk/nrf54lm20a/cpuapp
      - nrf54ls05dk/nrf54ls05b/cpuapp
      - nrf54ls05dk/nrf54ls05a/cpuapp
      - nrf54lm20dk/nrf54lm20b/cpuapp
      - nrf7120dk/nrf7120/cpuapp
  sample.dfu.single_slot.ble_enter:
    tags:
      - dfu_single_slot
      - ci_samples_dfu
      - bluetooth
    platform_allow:
      - nrf52840dk/nrf52840
      - nrf54l15dk/nrf54l15/cpuapp
    integration_platforms:
      - nrf52840dk/nrf52840
      - nrf54l15dk/nrf54l15/cpuapp
    extra_args:
      - FILE_SUFFIX=ble_enter
    harness_config:
      type: multi_line
      regex:
        - "Bluetooth initialized"
        - "Advertising successfully started"
  sample.dfu.single_slot.usb:
    tags:
      - dfu_single_slot
      - ci_samples_dfu
    platform_allow:
      - nrf54lm20dk/nrf54lm20a/cpuapp
    integration_platforms:
      - nrf54lm20dk/nrf54lm20a/cpuapp
    extra_args:
      - FILE_SUFFIX=usb
  sample.dfu.single_slot.usb_enter:
    tags:
      - dfu_single_slot
      - ci_samples_dfu
    platform_allow:
      - nrf54lm20dk/nrf54lm20a/cpuapp
      - nrf54lm20dk/nrf54lm20b/cpuapp
    integration_platforms:
      - nrf54lm20dk/nrf54lm20a/cpuapp
      - nrf54lm20dk/nrf54lm20b/cpuapp
    extra_args:
      - FILE_SUFFIX=usb_enter
    harness_config:
      fixture: usb_connected
      type: one_line
      regex:
        - "Starting single_slot sample"
  sample.dfu.single_slot.usb_enter_dongle:
    tags:
      - dfu_single_slot
      - ci_samples_dfu
    platform_allow:
      - nrf54lm20dongle/nrf54lm20b/cpuapp
    integration_platforms:
      - nrf54lm20dongle/nrf54lm20b/cpuapp
    extra_args:
      - FILE_SUFFIX=usb_enter_dongle
  sample.dfu.single_slot.fw_loader_update.nrf54l15:
    extra_args:
      - SB_CONFIG_FIRMWARE_LOADER_UPDATE=y
      - installer_CONFIG_REBOOT=y
    tags:
      - dfu_single_slot
      - ci_samples_dfu
    platform_allow:
      - nrf54l15dk/nrf54l15/cpuapp
    integration_platforms:
      - nrf54l15dk/nrf54l15/cpuapp
  sample.dfu.single_slot.fw_loader_update.nrf54h20:
    extra_args:
      - SB_CONFIG_FIRMWARE_LOADER_UPDATE=y
      - installer_CONFIG_REBOOT=y
    tags:
      - dfu_single_slot
      - ci_samples_dfu
    platform_allow:
      - nrf54h20dk/nrf54h20/cpuapp
    integration_platforms:
      - nrf54h20dk/nrf54h20/cpuapp
  sample.dfu.single_slot.fw_loader_update.fw_loader_entrance_pin_reset:
    build_only: true
    extra_args:
      - SB_CONFIG_FIRMWARE_LOADER_UPDATE=y
      - installer_CONFIG_REBOOT=y
      - mcuboot_CONFIG_BOOT_FIRMWARE_LOADER_PIN_RESET=y
    tags:
      - dfu_single_slot
      - ci_samples_dfu
    platform_allow:
      - nrf54l15dk/nrf54l15/cpuapp
      - nrf54h20dk/nrf54h20/cpuapp
      - nrf54lm20dk/nrf54lm20a/cpuapp
      - nrf54lm20dk/nrf54lm20b/cpuapp
      - nrf54ls05dk/nrf54ls05b/cpuapp
    integration_platforms:
      - nrf54l15dk/nrf54l15/cpuapp
      - nrf54h20dk/nrf54h20/cpuapp
      - nrf54lm20dk/nrf54lm20b/cpuapp
      - nrf54ls05dk/nrf54ls05b/cpuapp
  sample.dfu.single_slot.fw_loader_update.fw_loader_entrance_boot_mode.nrf54l15:
    extra_args:
      - SB_CONFIG_FIRMWARE_LOADER_UPDATE=y
      - installer_CONFIG_INSTALLER_FW_LOADER_ENTRANCE_BOOT_MODE=y
      - installer_CONFIG_RETAINED_MEM=y
      - installer_CONFIG_RETENTION=y
      - installer_CONFIG_RETENTION_BOOT_MODE=y
      - installer_CONFIG_REBOOT=y
      - mcuboot_CONFIG_RETAINED_MEM=y
      - mcuboot_CONFIG_RETENTION=y
      - mcuboot_CONFIG_RETENTION_BOOT_MODE=y
      - mcuboot_CONFIG_BOOT_FIRMWARE_LOADER_BOOT_MODE=y
    tags:
      - dfu_single_slot
      - ci_samples_dfu
    platform_allow:
      - nrf54l15dk/nrf54l15/cpuapp
    integration_platforms:
      - nrf54l15dk/nrf54l15/cpuapp
  sample.dfu.single_slot.fw_loader_update.fw_loader_entrance_boot_req.nrf54l15:
    extra_args:
      - SB_CONFIG_FIRMWARE_LOADER_UPDATE=y
      - FILE_SUFFIX=boot_req
      - installer_CONFIG_INSTALLER_FW_LOADER_ENTRANCE_BOOT_REQ=y
      - installer_CONFIG_RETAINED_MEM=y
      - installer_CONFIG_RETENTION=y
      - installer_CONFIG_NRF_MCUBOOT_BOOT_REQUEST=y
      - installer_CONFIG_IMG_MANAGER=y
      - installer_CONFIG_REBOOT=y
    tags:
      - dfu_single_slot
      - ci_samples_dfu

    platform_allow:
      - nrf54l15dk/nrf54l15/cpuapp
    integration_platforms:
      - nrf54l15dk/nrf54l15/cpuapp
  sample.dfu.single_slot.fw_loader_update.fw_loader_entrance_boot_req.nrf54h20:
    extra_args:
      - SB_CONFIG_FIRMWARE_LOADER_UPDATE=y
      - FILE_SUFFIX=boot_req
      - installer_CONFIG_INSTALLER_FW_LOADER_ENTRANCE_BOOT_REQ=y
      - installer_CONFIG_NRF_MCUBOOT_BOOT_REQUEST=y
      - installer_CONFIG_IMG_MANAGER=y
      - installer_CONFIG_REBOOT=y
    tags:
      - dfu_single_slot
      - ci_samples_dfu
    platform_allow:
      - nrf54h20dk/nrf54h20/cpuapp
    integration_platforms:
      - nrf54h20dk/nrf54h20/cpuapp
```

## samples/drivers/audio/tac5112/Kconfig
```kconfig
#
# Copyright (c) 2024 Nordic Semiconductor ASA
#
# SPDX-License-Identifier: LicenseRef-Nordic-5-Clause
#

menu "Logging"

module = TAC5112_DRIVER
module-str = tac5112-driver
source "subsys/logging/Kconfig.template.log_config"

endmenu # Log levels

source "Kconfig.zephyr"
```

## samples/drivers/audio/tac5112/sample.yaml
```yaml
sample:
  name: TAC5112 audio codec
  description: >
    Configure and drive a TI TAC5112 stereo audio codec through the Zephyr
    audio codec API: tone playback and an ADC-to-DAC loopback. Runs on the
    Nordic nRF54LM20 DK (TDM) against a real codec.

common:
  tags:
    - audio
    - codec
  harness: console
  harness_config:
    type: one_line
    regex:
      - "TAC5112 sample complete"
  fixtures:
      - nrf_audio_eb_shield:exp_p17
      - analog_input_cable:line_in
      - analog_output_cable:headset_1

tests:
  sample.drivers.audio.tac5112:
    sysbuild: true
    build_only: true
    extra_args: SHIELD=nrf_audio_eb
    platform_allow:
      - nrf54lm20dk/nrf54lm20a/cpuapp
    integration_platforms:
      - nrf54lm20dk/nrf54lm20a/cpuapp
```

## samples/esb/esb_prx_ble/Kconfig.sysbuild
```kconfig
#
# Copyright (c) 2025 Nordic Semiconductor ASA
#
# SPDX-License-Identifier: LicenseRef-Nordic-5-Clause
#

config NRF_DEFAULT_EMPTY
	default y if SOC_SERIES_NRF53

source "share/sysbuild/Kconfig"
```

## samples/event_manager_proxy/Kconfig.sysbuild
```kconfig
#
# Copyright (c) 2023 Nordic Semiconductor ASA
#
# SPDX-License-Identifier: LicenseRef-Nordic-5-Clause
#

if SUPPORT_PPRCORE

choice PPRCORE
	default PPRCORE_REMOTE

config PPRCORE_REMOTE
	bool "remote image"

endchoice

config PPRCORE_IMAGE_NAME
	default "remote" if PPRCORE_REMOTE

config PPRCORE_IMAGE_PATH
	default "$(APP_DIR)/remote" if PPRCORE_REMOTE

endif # SUPPORT_PPRCORE

if SUPPORT_FLPRCORE && !SUPPORT_PPRCORE

choice FLPRCORE
	default FLPRCORE_REMOTE

config FLPRCORE_REMOTE
	bool "remote image"

endchoice

config FLPRCORE_IMAGE_NAME
	default "remote" if FLPRCORE_REMOTE

config FLPRCORE_IMAGE_PATH
	default "$(APP_DIR)/remote" if FLPRCORE_REMOTE

endif # SUPPORT_FLPRCORE && !SUPPORT_PPRCORE

if SUPPORT_NETCORE && !SUPPORT_FLPRCORE && !SUPPORT_PPRCORE

choice NETCORE
	default NETCORE_REMOTE

config NETCORE_REMOTE
	bool "remote image"

endchoice

config NETCORE_IMAGE_NAME
	default "remote" if NETCORE_REMOTE

config NETCORE_IMAGE_PATH
	default "$(APP_DIR)/remote" if NETCORE_REMOTE

endif # SUPPORT_NETCORE && !SUPPORT_FLPRCORE && !SUPPORT_PPRCORE

source "share/sysbuild/Kconfig"
```

## samples/event_manager_proxy/sample.yaml
```yaml
sample:
  description: Sample showing usage of sending the events to another core via Event
    Manager Proxy
  name: Event Manager proxy sample

common:
  sysbuild: true
  tags:
    - ipc
    - ci_build
    - ci_samples_event_manager_proxy
  harness: console
  harness_config:
    type: multi_line
    ordered: false
    regex:
      - "Event Manager Proxy demo started"
      - "main: Event manager proxy started"
      - "main: All remotes ready"
      - "app_event_manager: e:config_event"
      - "main: Initialization finished successfully"
      - "app_event_manager: e:measurement_event"
      - "app_event_manager: e: control_event"
      - "stats: Control event count:"
      - "stats: Average value3:"

tests:
  sample.event_manager_proxy:
    platform_allow:
      - nrf5340dk/nrf5340/cpuapp
      - nrf54l15dk/nrf54l15/cpuapp
      - nrf54h20dk/nrf54h20/cpuapp
      - nrf9251dk/nrf9251/cpuapp
      - nrf54lm20dk/nrf54lm20a/cpuapp
      - nrf54lm20dk/nrf54lm20b/cpuapp
      - nrf54lv10dk/nrf54lv10a/cpuapp
      - nrf54lc10dk/nrf54lc10a/cpuapp
      - nrf7120dk/nrf7120/cpuapp
    integration_platforms:
      - nrf5340dk/nrf5340/cpuapp
      - nrf54l15dk/nrf54l15/cpuapp
    extra_args:
      - platform:nrf54h20dk:event_manager_proxy_SNIPPET=nordic-ppr
      - platform:nrf9251dk:event_manager_proxy_SNIPPET=nordic-ppr
      - platform:nrf54l:event_manager_proxy_SNIPPET=nordic-flpr
      - platform:nrf7120dk:event_manager_proxy_SNIPPET=nordic-flpr
    timeout: 20
```

## samples/ipc/ipc_service/Kconfig.sysbuild
```kconfig
#
# Copyright (c) 2024 Nordic Semiconductor ASA
#
# SPDX-License-Identifier: LicenseRef-Nordic-5-Clause
#

if SUPPORT_PPRCORE

choice PPRCORE
	default PPRCORE_REMOTE if SOC_SERIES_NRF92
	default PPRCORE_NONE

config PPRCORE_REMOTE
	bool "remote image"

endchoice

config PPRCORE_IMAGE_NAME
	default "remote" if PPRCORE_REMOTE

config PPRCORE_IMAGE_PATH
	default "${APP_DIR}/remote" if PPRCORE_REMOTE

endif # SUPPORT_PPRCORE

if SUPPORT_NETCORE

choice NETCORE
	default NETCORE_REMOTE

config NETCORE_REMOTE
	bool "remote image"

endchoice

config NETCORE_IMAGE_NAME
	default "remote" if NETCORE_REMOTE

config NETCORE_IMAGE_PATH
	default "${APP_DIR}/remote" if NETCORE_REMOTE

endif # SUPPORT_NETCORE

if SUPPORT_FLPRCORE && !SOC_SERIES_NRF92 && !SUPPORT_PPRCORE

choice FLPRCORE
	default FLPRCORE_REMOTE

config FLPRCORE_REMOTE
	bool "remote image"

endchoice

config FLPRCORE_IMAGE_NAME
	default "remote" if FLPRCORE_REMOTE

config FLPRCORE_IMAGE_PATH
	default "${APP_DIR}/remote" if FLPRCORE_REMOTE

endif # SUPPORT_FLPRCORE && !SOC_SERIES_NRF92 && !SUPPORT_PPRCORE

source "share/sysbuild/Kconfig"
```

## samples/mpsl/timeslot/Kconfig.sysbuild
```kconfig
if SOC_NRF5340_CPUNET

choice APPCORE
	default APPCORE_EMPTY

endchoice

endif # SOC_NRF5340_CPUNET

source "share/sysbuild/Kconfig"
```

## samples/net/aws_iot/Kconfig
```kconfig
#
# Copyright (c) 2020 Nordic Semiconductor ASA
#
# SPDX-License-Identifier: LicenseRef-Nordic-5-Clause
#

menu "AWS IoT Sample Settings"

config AWS_IOT_SAMPLE_APP_VERSION
	string "Application version"
	default "v1.0.0"
	help
	  Application version reported to AWS IoT.

config AWS_IOT_SAMPLE_JSON_MESSAGE_SIZE_MAX
	int "Maximum size of JSON messages"
	default 200
	help
	  Maximum size of JSON messages that are sent to AWS IoT.

config AWS_IOT_SAMPLE_PUBLICATION_INTERVAL_SECONDS
	int "Interval in seconds that the sample will publish data"
	default 60
	help
	  Time interval between each message publication.

config AWS_IOT_SAMPLE_CONNECTION_RETRY_TIMEOUT_SECONDS
	int "Number of seconds between each AWS IoT connection retry"
	default 30
	help
	  If the connection is lost, the sample tries to reconnect at this interval.

config AWS_IOT_SAMPLE_DEVICE_ID_USE_HW_ID
	bool "Use HW ID as device ID"
	depends on HW_ID_LIBRARY
	help
	  Use the hardware ID as the device ID in the MQTT connection.
	  The hardware ID source is selected by the HW_ID_LIBRARY_SOURCE choice.

module = AWS_IOT_SAMPLE
module-str = AWS IoT sample
source "$(ZEPHYR_BASE)/subsys/logging/Kconfig.template.log_config"

endmenu

menu "Zephyr Kernel"
source "Kconfig.zephyr"
endmenu
```

## samples/net/azure_iot_hub/Kconfig
```kconfig
#
# Copyright (c) 2022 Nordic Semiconductor ASA
#
# SPDX-License-Identifier: LicenseRef-Nordic-5-Clause
#

menu "Azure IoT Hub sample"

module = AZURE_IOT_HUB_SAMPLE
module-str = Azure IoT Hub sample
source "$(ZEPHYR_BASE)/subsys/logging/Kconfig.template.log_config"

config AZURE_IOT_HUB_SAMPLE_DEVICE_ID_USE_HW_ID
	bool "Use HW ID as device ID"
	select HW_ID_LIBRARY
	help
	  Use the devices's hardware ID as device ID when connecting to Azure IOT Hub

config AZURE_IOT_HUB_SAMPLE_CONNECTION_RETRY_TIMEOUT_SECONDS
	int "Number of seconds between each Azure IoT Hub connection retry"
	default 30
	help
	  If the connection fails, the sample tries to connect again at this interval.

endmenu

menu "Zephyr Kernel"
source "Kconfig.zephyr"
endmenu
```
