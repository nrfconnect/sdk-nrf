## samples/net/coap_client/Kconfig
```kconfig
#
# Copyright (c) 2019 Nordic Semiconductor ASA
#
# SPDX-License-Identifier: LicenseRef-Nordic-5-Clause
#

menu "CoAP client sample"

config COAP_SAMPLE_RESOURCE
	string "CoAP resource - defaults to Californium observable resource"
	default "obs"

config COAP_SAMPLE_SERVER_HOSTNAME
	string "CoAP server hostname"
	default "californium.eclipseprojects.io"

config COAP_SAMPLE_SERVER_PORT
	int "CoAP server port"
	default 5684 if COAP_SAMPLE_DTLS
	default 5683

config COAP_SAMPLE_REQUEST_INTERVAL_SECONDS
	int "Request interval in seconds"
	default 5

config COAP_SAMPLE_DTLS
	bool "Enable DTLS (CoAPS) with mutual X.509 authentication"
	select NET_SOCKETS_SOCKOPT_TLS
	select NET_SOCKETS_ENABLE_DTLS
	select TLS_CREDENTIALS
	help
	  Enable DTLS for CoAP (CoAPS) using mutual X.509 certificate
	  authentication.  When enabled, the default server port changes to
	  5684 and the socket is created with IPPROTO_DTLS_1_2.

if COAP_SAMPLE_DTLS

config COAP_SAMPLE_DTLS_SEC_TAG
	int "DTLS security tag"
	default 42
	help
	  Security tag used to store the DTLS credentials.

config COAP_SAMPLE_DTLS_HANDSHAKE_TIMEOUT_MAX_MS
	int "Maximum DTLS handshake retransmission timeout in milliseconds"
	default 5000
	help
	  Caps the DTLS handshake retransmission backoff, to avoid blocking
	  for up to a minute.

config COAP_SAMPLE_CA_CERT_FILE
	string "CA certificate file (PEM)"
	default "cert/cf-ca.pem"
	help
	  Path to the CA certificate used to verify the server.
	  Relative to the sample root directory.

config COAP_SAMPLE_CLIENT_CERT_FILE
	string "Client certificate file (PEM)"
	default "cert/cf-client.pem"
	help
	  Path to the client certificate presented during mutual TLS.

config COAP_SAMPLE_CLIENT_KEY_FILE
	string "Client private key file (PEM)"
	default "cert/cf-client-key.pem"
	help
	  Path to the client private key.

endif # COAP_SAMPLE_DTLS

endmenu

menu "Zephyr Kernel"
source "Kconfig.zephyr"
endmenu

module = COAP_CLIENT_SAMPLE
module-str = CoAP client sample
source "$(ZEPHYR_BASE)/subsys/logging/Kconfig.template.log_config"
```

## samples/net/download/Kconfig
```kconfig
menu "Download sample"

config SAMPLE_SECURE_SOCKET
	bool "Use TLS/DTLS"
	default y

if SAMPLE_SECURE_SOCKET

config SAMPLE_SEC_TAG
	int "Security tag"
	default 42

config SAMPLE_PROVISION_CERT
	bool "Provision root CA certificate"
	default y
	help
	  Provision the root CA certificate for the server to the device. This is needed for secure
	  connections.
	  Disable this option to avoid overwriting an existing root CA certificate already stored in
	  the device.

config SAMPLE_CERT_FILE
	string "Certificate file name"
	default "cert/file-example.pem"
	depends on SAMPLE_PROVISION_CERT

config SAMPLE_PROVISION_CLIENT_CERT
	bool "Provision client certificate and key for mutual TLS"
	depends on SAMPLE_PROVISION_CERT
	depends on !MODEM_KEY_MGMT
	help
	  Provision a client certificate and private key in addition to the CA certificate.
	  Required for DTLS/TLS mutual authentication (e.g. with the Californium interop server).
	  Only supported when using the Zephyr TLS credentials store. Not available together with
	  CONFIG_MODEM_KEY_MGMT yet.

config SAMPLE_CLIENT_CERT_FILE
	string "Client certificate file"
	default "cert/cf-client.pem"
	depends on SAMPLE_PROVISION_CLIENT_CERT

config SAMPLE_CLIENT_KEY_FILE
	string "Client private key file"
	default "cert/cf-client-key.pem"
	depends on SAMPLE_PROVISION_CLIENT_CERT

endif

choice SAMPLE_FILE
	prompt "Test file"

config SAMPLE_FILE_HTTP
	bool "HTTP test file"
	depends on !SAMPLE_SECURE_SOCKET
config SAMPLE_FILE_HTTPS
	bool "HTTPS test file"
	depends on SAMPLE_SECURE_SOCKET
config SAMPLE_FILE_CUSTOM
	bool "Custom test file"

endchoice

config SAMPLE_FILE_URL
	string "URL of resource to download" if SAMPLE_FILE_CUSTOM
	default "http://nrfconnectsdk.s3.eu-central-1.amazonaws.com/sample-img-100kb.png" if SAMPLE_FILE_HTTP
	default "https://nrfconnectsdk.s3.eu-central-1.amazonaws.com/sample-img-100kb.png" if SAMPLE_FILE_HTTPS

config SAMPLE_COMPUTE_HASH
	bool "Compute sha256 hash"
	select PSA_CRYPTO
	select PSA_WANT_ALG_SHA_256
	default y

config SAMPLE_COMPARE_HASH
	bool "Compare hash"
	depends on SAMPLE_COMPUTE_HASH
	default y

config SAMPLE_SHA256_HASH
	string "sha256 hash"
	depends on SAMPLE_COMPARE_HASH
	default "344577d739dc0e9f9498c13be2fbc7fb947abd291e9e57db9e9ca4a89ccd5f63" if SAMPLE_FILE_HTTP || SAMPLE_FILE_HTTPS

endmenu

# Default the TLS credentials backend by build type: NS builds use Protected
# Storage, secure-only builds fall back to the volatile backend. nRF91 keeps
# its own NRF_MODEM backend default.
choice TLS_CREDENTIALS_BACKEND
	default TLS_CREDENTIALS_BACKEND_PROTECTED_STORAGE if BUILD_WITH_TFM && !NRF_MODEM_LIB
endchoice

menu "Zephyr Kernel"
source "Kconfig.zephyr"
endmenu
```

## samples/net/download/sample.yaml
```yaml
sample:
  name: Download sample
tests:
  sample.net.downloader:
    sysbuild: true
    build_only: true
    integration_platforms:
      - native_sim
    platform_allow:
      - nrf9161dk/nrf9161/ns
      - native_sim
    tags:
      - ci_build
      - sysbuild
      - ci_samples_net
  sample.net.downloader.wifi:
    sysbuild: true
    build_only: true
    integration_platforms:
      - nrf7002dk/nrf5340/cpuapp/ns
      - nrf7120dk/nrf7120/cpuapp/ns
    platform_allow:
      - nrf7002dk/nrf5340/cpuapp/ns
      - nrf7120dk/nrf7120/cpuapp/ns
    tags:
      - ci_build
      - sysbuild
      - ci_samples_net
    extra_args:
      - download_EXTRA_CONF_FILE=wifi.conf
  sample.net.downloader.wifi.dtls_cert:
    sysbuild: true
    build_only: true
    integration_platforms:
      - nrf7002dk/nrf5340/cpuapp/ns
      - nrf7120dk/nrf7120/cpuapp/ns
    platform_allow:
      - nrf7002dk/nrf5340/cpuapp/ns
      - nrf7120dk/nrf7120/cpuapp/ns
    tags:
      - ci_build
      - sysbuild
      - ci_samples_net
    extra_args:
      - download_EXTRA_CONF_FILE="wifi.conf;wifi-mutual-dtls.conf"
  sample.net.downloader.wifi.tls_cert:
    sysbuild: true
    build_only: true
    integration_platforms:
      - nrf7002dk/nrf5340/cpuapp/ns
      - nrf7120dk/nrf7120/cpuapp/ns
    platform_allow:
      - nrf7002dk/nrf5340/cpuapp/ns
      - nrf7120dk/nrf7120/cpuapp/ns
    extra_args:
      - download_EXTRA_CONF_FILE=wifi.conf
    # No real mutual-TLS-enabled HTTPS server is used; this reuses the sample's
    # example Californium client certificate purely for Twister build coverage.
    extra_configs:
      - CONFIG_SAMPLE_PROVISION_CLIENT_CERT=y
    tags:
      - ci_build
      - sysbuild
      - ci_samples_net
  sample.net.downloader.nrf54lm20_nrf7002eb2.wifi:
    sysbuild: true
    tags:
      - ci_build
      - sysbuild
      - ci_samples_net
    build_only: true
    integration_platforms:
      - nrf54lm20dk/nrf54lm20a/cpuapp
      - nrf54lm20dk/nrf54lm20b/cpuapp
    platform_allow:
      - nrf54lm20dk/nrf54lm20a/cpuapp
      - nrf54lm20dk/nrf54lm20b/cpuapp
    extra_args:
      - download_SHIELD="nrf7002eb2"
      - download_SNIPPET=wifi-credentials
      - download_EXTRA_CONF_FILE="wifi.conf"
  sample.net.downloader.nrf54lm20_nrf7002eb2.wifi.dtls_cert:
    sysbuild: true
    tags:
      - ci_build
      - sysbuild
      - ci_samples_net
    build_only: true
    integration_platforms:
      - nrf54lm20dk/nrf54lm20a/cpuapp
      - nrf54lm20dk/nrf54lm20b/cpuapp
    platform_allow:
      - nrf54lm20dk/nrf54lm20a/cpuapp
      - nrf54lm20dk/nrf54lm20b/cpuapp
    extra_args:
      - download_SHIELD="nrf7002eb2"
      - download_SNIPPET=wifi-credentials
      - download_EXTRA_CONF_FILE="wifi.conf;wifi-mutual-dtls.conf"
  sample.net.downloader.nrf54lm20_nrf7002eb2.wifi.tls_cert:
    sysbuild: true
    tags:
      - ci_build
      - sysbuild
      - ci_samples_net
    build_only: true
    integration_platforms:
      - nrf54lm20dk/nrf54lm20a/cpuapp
      - nrf54lm20dk/nrf54lm20b/cpuapp
    platform_allow:
      - nrf54lm20dk/nrf54lm20a/cpuapp
      - nrf54lm20dk/nrf54lm20b/cpuapp
    extra_args:
      - download_SHIELD="nrf7002eb2"
      - download_SNIPPET=wifi-credentials
      - download_EXTRA_CONF_FILE=wifi.conf
    # No real mutual-TLS-enabled HTTPS server is used; this reuses the sample's
    # example Californium client certificate purely for Twister build coverage.
    extra_configs:
      - CONFIG_SAMPLE_PROVISION_CLIENT_CERT=y
```
