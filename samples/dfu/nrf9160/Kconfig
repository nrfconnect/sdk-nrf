## samples/dfu/smp_svr/sysbuild/mcuboot/boards/nrf7120dk_nrf7120_cpuapp.conf
```kconfig
# Copyright (c) 2025 Nordic Semiconductor ASA
#
# SPDX-License-Identifier: LicenseRef-Nordic-5-Clause

CONFIG_SPI_NOR=n
CONFIG_FPROTECT=n
CONFIG_BOOT_WATCHDOG_FEED=n
# MCUboot requires a large stack size, otherwise an MPU fault will occur
CONFIG_MAIN_STACK_SIZE=16384

# Enable flash operations
CONFIG_FLASH=y

CONFIG_MULTITHREADING=y

CONFIG_LOG=y
CONFIG_LOG_MODE_MINIMAL=y
CONFIG_LOG_DEFAULT_LEVEL=0
CONFIG_MCUBOOT_LOG_LEVEL_INF=y
# Decrease footprint by ~4 KB in comparison to CBPRINTF_COMPLETE=y
CONFIG_CBPRINTF_NANO=y

# NCS boot banner
CONFIG_NCS_APPLICATION_BOOT_BANNER_STRING="MCUboot"
```

## samples/dfu/smp_svr_mini_boot/sysbuild/mcuboot/boards/nrf54ls05dk_nrf54ls05a_cpuapp.conf
```kconfig
CONFIG_FLASH=y
CONFIG_MAIN_STACK_SIZE=10240
CONFIG_FPROTECT=n

# NOTE: To enable mcuboot logs...
# NOTE: ... these lines should be commented...
CONFIG_SERIAL=n
CONFIG_CONSOLE=n
CONFIG_UART_CONSOLE=n
# NOTE: ... and these lines should not be commented
# CONFIG_LOG=y
# CONFIG_LOG_MODE_MINIMAL=y
# CONFIG_LOG_DEFAULT_LEVEL=0
# CONFIG_MCUBOOT_LOG_LEVEL_DBG=y
# CONFIG_SERIAL=y
# CONFIG_CONSOLE=y
# CONFIG_UART_CONSOLE=y

CONFIG_NRF_OBERON=y
CONFIG_BOOT_ECDSA_NRF_OBERON=y

CONFIG_NCS_BOOT_BANNER=n
CONFIG_MCUBOOT_BOOT_BANNER=n
CONFIG_BOOT_BANNER=n
CONFIG_PRINTK=n
CONFIG_MINIMAL_LIBC=y
CONFIG_SYS_CLOCK_EXISTS=n
CONFIG_GPIO=n

CONFIG_ISR_TABLES_LOCAL_DECLARATION=y
CONFIG_LTO=y
```

## samples/edge_impulse/data_forwarder/sample.yaml
```yaml
sample:
  description: Sample showing Edge Impulse data forwarder usage
  name: Edge Impulse data forwarder sample
tests:
  sample.ei_data_forwarder:
    sysbuild: true
    build_only: true
    platform_allow:
      - nrf52dk/nrf52832
      - nrf52840dk/nrf52840
      - nrf5340dk/nrf5340/cpuapp
      - nrf5340dk/nrf5340/cpuapp/ns
      - nrf9160dk/nrf9160/ns
      - thingy91x/nrf9151/ns
    integration_platforms:
      - nrf52dk/nrf52832
      - nrf52840dk/nrf52840
      - nrf5340dk/nrf5340/cpuapp
      - nrf5340dk/nrf5340/cpuapp/ns
      - nrf9160dk/nrf9160/ns
    platform_exclude: native_posix qemu_x86 qemu_cortex_m3
    tags: ci_build sysbuild
```

## samples/edge_impulse/wrapper/sample.yaml
```yaml
sample:
  description: Sample showing Edge Impulse wrapper usage
  name: Edge Impulse wrapper sample
common:
  harness: console
  harness_config:
    ordered: true
    regex:
      - "Classification results"
      - "Value: (1[.]0[0-9]+)|(0[.]9[0-9]+)\tLabel: sine"
      - "Value: 0[.]0[0-9]+\tLabel: triangle"
      - "Value: 0[.]0[0-9]+\tLabel: idle"
      - "Anomaly: (-[0-9]+[.][0-9]+)|(0[.]0[0-9]+)"
    type: multi_line
  platform_allow:
    - nrf52dk/nrf52832
    - nrf52840dk/nrf52840
    - nrf5340dk/nrf5340/cpuapp
    - nrf5340dk/nrf5340/cpuapp/ns
    - nrf9160dk/nrf9160/ns
    - qemu_cortex_m3
    - thingy91x/nrf9151/ns
  integration_platforms:
    - nrf52dk/nrf52832
    - nrf52840dk/nrf52840
    - nrf5340dk/nrf5340/cpuapp
    - nrf5340dk/nrf5340/cpuapp/ns
    - nrf9160dk/nrf9160/ns
    - qemu_cortex_m3
  platform_exclude: native_posix qemu_x86
tests:
  sample.edge_impulse.wrapper:
    sysbuild: true
    build_only: false
    tags: sysbuild
```

## samples/ei_wrapper/sample.yaml
```yaml
sample:
  description: Sample showing Edge Impulse wrapper usage
  name: Edge Impulse wrapper sample
```

## samples/esb/esb_monitor/Kconfig
```kconfig
#
# Copyright (c) 2025 Nordic Semiconductor
#
# SPDX-License-Identifier: LicenseRef-Nordic-5-Clause
#

source "Kconfig.zephyr"

menu "Enhanced ShockBurst: Monitor"

config LED_ENABLE
	bool "LED changes when receiving packets"
	default y
	help
	  Turns on led updates when receiving packets from PTX sample.

config ESB_SNIFFER
	bool "Turn sample into a functional ESB sniffer"
	select USE_SEGGER_RTT
	select SHELL
	help
	  Enable sniffer functionality with RTT backend and runtime configuration updates through UART shell.
	  Disable logging received packets through UART.

if ESB_SNIFFER
config ESB_SNIFFER_RTT_DATA_CHANNEL
	int "RTT up channel number for data transfer"
	range 0 3
	default 1

config ESB_SNIFFER_RTT_CMD_RET_CHANNEL
	int "RTT up channel number for sniffer command returns"
	range 0 3
	default 2

config ESB_SNIFFER_RTT_CMD_CHANNEL
	int "RTT down channel number for sniffer commands"
	range 0 3
	default 1

config ESB_SNIFFER_RTT_DATA_BUF_SZ
	int "RTT data buffer size"
	default 45000

config ESB_SNIFFER_RTT_CMD_RET_BUF_SZ
	int "RTT commands return buffer size"
	default 128

config ESB_SNIFFER_RTT_CMD_BUF_SZ
	int "RTT commands buffer size"
	default 128

config ESB_SNIFFER_THREAD_PRIORITY
	int "ESB sniffer thread priority"
	default 10

config ESB_SNIFFER_THREAD_STACK_SZ
	int "ESB sniffer thread stack size"
	default 1024
endif

module = ESB_MONITOR_APP
module-str = "ESB Monitor app"
source "$(ZEPHYR_BASE)/subsys/logging/Kconfig.template.log_config"

endmenu
```

## samples/esb/esb_monitor/Kconfig.sysbuild
```kconfig
#
# Copyright (c) 2025 Nordic Semiconductor ASA
#
# SPDX-License-Identifier: LicenseRef-Nordic-5-Clause
#

config PARTITION_MANAGER
	default n

config NRF_DEFAULT_EMPTY
	default y if SOC_SERIES_NRF53X

source "share/sysbuild/Kconfig"
```

## samples/esb/esb_monitor/sample.yaml
```yaml
sample:
  name: ESB Monitor Sample
common:
  harness: console
  harness_config:
    type: multi_line
    ordered: true
    regex:
      - "Enhanced ShockBurst monitor sample"
      - "Initialization complete"
      - "Start receiving packets"
  timeout: 15

tests:
  sample.esb.monitor:
    sysbuild: true
    filter: CONFIG_UART_CONSOLE and CONFIG_SERIAL_SUPPORT_INTERRUPT
    integration_platforms:
      - nrf52dk/nrf52832
      - nrf52840dk/nrf52840
      - nrf5340dk/nrf5340/cpunet
      - nrf54l15dk/nrf54l05/cpuapp
      - nrf54l15dk/nrf54l10/cpuapp
      - nrf54l15dk/nrf54l15/cpuapp
      - nrf54lm20dk/nrf54lm20a/cpuapp
    platform_allow:
      - nrf52dk/nrf52832
      - nrf52840dk/nrf52840
      - nrf5340dk/nrf5340/cpunet
      - nrf54l15dk/nrf54l05/cpuapp
      - nrf54l15dk/nrf54l10/cpuapp
      - nrf54l15dk/nrf54l15/cpuapp
      - nrf54lm20dk/nrf54lm20a/cpuapp
    tags:
      - esb
      - samples
      - console
      - sysbuild
      - ci_samples_esb
  sample.esb.monitor.dynamic_irq:
    sysbuild: true
    extra_configs:
      - CONFIG_ESB_DYNAMIC_INTERRUPTS=y
      - CONFIG_DYNAMIC_INTERRUPTS=y
      - CONFIG_DYNAMIC_DIRECT_INTERRUPTS=y
      - CONFIG_MPSL_DYNAMIC_INTERRUPTS=y
    integration_platforms:
      - nrf5340dk/nrf5340/cpunet
      - nrf52840dk/nrf52840
      - nrf54l15dk/nrf54l05/cpuapp
      - nrf54l15dk/nrf54l10/cpuapp
      - nrf54l15dk/nrf54l15/cpuapp
      - nrf54lm20dk/nrf54lm20a/cpuapp
    platform_allow:
      - nrf5340dk/nrf5340/cpunet
      - nrf52840dk/nrf52840
      - nrf54l15dk/nrf54l05/cpuapp
      - nrf54l15dk/nrf54l10/cpuapp
      - nrf54l15dk/nrf54l15/cpuapp
      - nrf54lm20dk/nrf54lm20a/cpuapp
    tags:
      - esb
      - ci_build
      - sysbuild
      - ci_samples_esb
```

## samples/esb/esb_prx/Kconfig
```kconfig
#
# Copyright (c) 2020 Nordic Semiconductor
#
# SPDX-License-Identifier: LicenseRef-Nordic-5-Clause
#

source "Kconfig.zephyr"

menu "Enhanced ShockBurst: Receiver"

config ESB_PRX_APP_LOG_LEVEL
	int "Log level for the ESB PRX sample"
	default 4

endmenu
```

## samples/esb/esb_prx/sample.yaml
```yaml
sample:
  name: ESB prx Sample
common:
  harness: console
  harness_config:
    type: multi_line
    ordered: true
    regex:
      - "Enhanced ShockBurst prx sample"
      - "Initialization complete"
      - "Setting up for packet receiption"
  timeout: 15

tests:
  sample.esb.prx:
    sysbuild: true
    filter: CONFIG_UART_CONSOLE and CONFIG_SERIAL_SUPPORT_INTERRUPT
    integration_platforms:
      - nrf52dk/nrf52832
      - nrf52840dk/nrf52840
      - nrf52dk/nrf52810
    platform_allow:
      - nrf52dk/nrf52832
      - nrf52840dk/nrf52840
      - nrf52dk/nrf52810
    tags:
      - esb
      - samples
      - console
      - sysbuild
      - ci_samples_esb
  sample.esb.prx.build:
    sysbuild: true
    integration_platforms:
      - nrf21540dk/nrf52840
      - nrf52833dk/nrf52833
      - nrf52840dk/nrf52840
      - nrf52dk/nrf52810
      - nrf52dk/nrf52832
      - nrf5340dk/nrf5340/cpunet
      - nrf54h20dk/nrf54h20/cpurad
      - nrf54l15dk/nrf54l05/cpuapp
      - nrf54l15dk/nrf54l10/cpuapp
      - nrf54l15dk/nrf54l15/cpuapp
      - nrf54lm20dk/nrf54lm20a/cpuapp
      - nrf54lv10dk/nrf54lv10a/cpuapp
    platform_allow:
      - nrf21540dk/nrf52840
      - nrf52833dk/nrf52833
      - nrf52840dk/nrf52840
      - nrf52dk/nrf52810
      - nrf52dk/nrf52832
      - nrf5340dk/nrf5340/cpunet
      - nrf54h20dk/nrf54h20/cpurad
      - nrf54l15dk/nrf54l05/cpuapp
      - nrf54l15dk/nrf54l10/cpuapp
      - nrf54l15dk/nrf54l15/cpuapp
      - nrf54lm20dk/nrf54lm20a/cpuapp
      - nrf54ls05dk/nrf54ls05b/cpuapp
      - nrf54lv10dk/nrf54lv10a/cpuapp
      - nrf54lv10dk/nrf54lv10a/cpuapp/ns
    tags:
      - esb
      - ci_build
      - sysbuild
      - ci_samples_esb
  sample.esb.prx.dynamic_irq:
    sysbuild: true
    extra_configs:
      - CONFIG_ESB_DYNAMIC_INTERRUPTS=y
      - CONFIG_DYNAMIC_INTERRUPTS=y
      - CONFIG_DYNAMIC_DIRECT_INTERRUPTS=y
      - CONFIG_MPSL_DYNAMIC_INTERRUPTS=y
    integration_platforms:
      - nrf5340dk/nrf5340/cpunet
      - nrf52840dk/nrf52840
      - nrf54l15dk/nrf54l15/cpuapp
      - nrf54h20dk/nrf54h20/cpurad
    platform_allow:
      - nrf5340dk/nrf5340/cpunet
      - nrf52840dk/nrf52840
      - nrf54l15dk/nrf54l15/cpuapp
      - nrf54h20dk/nrf54h20/cpurad
    tags:
      - esb
      - ci_build
      - sysbuild
      - ci_samples_esb
  sample.esb.prx.nrf5340_nrf21540:
    sysbuild: true
    extra_args: SHIELD=nrf21540ek
    integration_platforms:
      - nrf5340dk/nrf5340/cpunet
    platform_allow:
      - nrf5340dk/nrf5340/cpunet
    tags:
      - esb
      - ci_build
      - sysbuild
      - ci_samples_esb
  sample.esb.prx.fast_switching:
    sysbuild: true
    extra_configs:
      - CONFIG_ESB_FAST_SWITCHING=y
      - CONFIG_ESB_FAST_CHANNEL_SWITCHING=y
    integration_platforms:
      - nrf54h20dk/nrf54h20/cpurad
    platform_allow:
      - nrf54h20dk/nrf54h20/cpurad
    tags:
      - esb
      - ci_build
      - sysbuild
      - ci_samples_esb
```

## samples/esb/esb_prx_ble/Kconfig
```kconfig
#
# Copyright (c) 2025 Nordic Semiconductor
#
# SPDX-License-Identifier: LicenseRef-Nordic-5-Clause
#

source "Kconfig.zephyr"

menu "Enhanced ShockBurst: Receiver BLE"

module = ESB_PRX_BLE
module-str = "ESB_PRX_BLE"
source "$(ZEPHYR_BASE)/subsys/logging/Kconfig.template.log_config"

endmenu
```

## samples/esb/esb_prx_ble/boards/nrf54lm20dk_nrf54lm20a_cpuapp.conf
```kconfig
#
# Copyright (c) 2025 Nordic Semiconductor
#
# SPDX-License-Identifier: LicenseRef-Nordic-5-Clause
#

# Enable DPPI driver
CONFIG_NRFX_DPPI10=y
```

## samples/esb/esb_prx_ble/sample.yaml
```yaml
sample:
  name: ESB prx BLE Sample
common:
  harness: console
  harness_config:
    type: multi_line
    ordered: true
    regex:
      - "Starting Enhanced ShockBurst prx with Peripheral LBS sample"
      - "Bluetooth initialized"
      - "Advertising successfully started"
      - "ESB initialized"
      - "Setting up for packet reception"
      - "Initialization complete"
  timeout: 15

tests:
  sample.esb.prx.ble.build:
    sysbuild: true
    integration_platforms:
      - nrf54h20dk/nrf54h20/cpurad
      - nrf54l15dk/nrf54l05/cpuapp
      - nrf54l15dk/nrf54l10/cpuapp
      - nrf54l15dk/nrf54l15/cpuapp
      - nrf54lm20dk/nrf54lm20a/cpuapp
      - nrf54lv10dk/nrf54lv10a/cpuapp
    platform_allow:
      - nrf54h20dk/nrf54h20/cpurad
      - nrf54l15dk/nrf54l05/cpuapp
      - nrf54l15dk/nrf54l10/cpuapp
      - nrf54l15dk/nrf54l15/cpuapp
      - nrf54lm20dk/nrf54lm20a/cpuapp
      - nrf54lv10dk/nrf54lv10a/cpuapp
    tags:
      - esb
      - ci_build
      - sysbuild
      - ci_samples_esb
```

## samples/esb/esb_ptx/sample.yaml
```yaml
sample:
  name: ESB ptx Sample
common:
  harness: console
  harness_config:
    type: multi_line
    ordered: true
    regex:
      - "Enhanced ShockBurst ptx sample"
      - "Initialization complete"
      - "Sending test packet"
  timeout: 15

tests:
  sample.esb.ptx:
    sysbuild: true
    filter: CONFIG_UART_CONSOLE and CONFIG_SERIAL_SUPPORT_INTERRUPT
    integration_platforms:
      - nrf52dk/nrf52832
      - nrf52840dk/nrf52840
      - nrf52dk/nrf52810
    platform_allow:
      - nrf52dk/nrf52832
      - nrf52840dk/nrf52840
      - nrf52dk/nrf52810
    tags:
      - esb
      - samples
      - console
      - sysbuild
      - ci_samples_esb
  sample.esb.ptx.build:
    sysbuild: true
    integration_platforms:
      - nrf21540dk/nrf52840
      - nrf5340dk/nrf5340/cpunet
      - nrf54h20dk/nrf54h20/cpurad
      - nrf54l15dk/nrf54l05/cpuapp
      - nrf54l15dk/nrf54l10/cpuapp
      - nrf54l15dk/nrf54l15/cpuapp
      - nrf54lm20dk/nrf54lm20a/cpuapp
      - nrf54lv10dk/nrf54lv10a/cpuapp
    platform_allow:
      - nrf21540dk/nrf52840
      - nrf52833dk/nrf52833
      - nrf52840dk/nrf52840
      - nrf52dk/nrf52810
      - nrf52dk/nrf52832
      - nrf5340dk/nrf5340/cpunet
      - nrf54h20dk/nrf54h20/cpurad
      - nrf54l15dk/nrf54l05/cpuapp
      - nrf54l15dk/nrf54l10/cpuapp
      - nrf54l15dk/nrf54l15/cpuapp
      - nrf54lm20dk/nrf54lm20a/cpuapp
      - nrf54lv10dk/nrf54lv10a/cpuapp
    tags:
      - esb
      - ci_build
      - sysbuild
      - ci_samples_esb
  sample.esb.ptx.dynamic_irq:
    sysbuild: true
    extra_configs:
      - CONFIG_ESB_DYNAMIC_INTERRUPTS=y
      - CONFIG_DYNAMIC_INTERRUPTS=y
      - CONFIG_DYNAMIC_DIRECT_INTERRUPTS=y
      - CONFIG_MPSL_DYNAMIC_INTERRUPTS=y
    integration_platforms:
      - nrf5340dk/nrf5340/cpunet
      - nrf52840dk/nrf52840
      - nrf54l15dk/nrf54l15/cpuapp
      - nrf54h20dk/nrf54h20/cpurad
    platform_allow:
      - nrf5340dk/nrf5340/cpunet
      - nrf52840dk/nrf52840
      - nrf54l15dk/nrf54l15/cpuapp
      - nrf54h20dk/nrf54h20/cpurad
    tags:
      - esb
      - ci_build
      - sysbuild
      - ci_samples_esb
  sample.esb.ptx.nrf5340_nrf21540:
    sysbuild: true
    extra_args: SHIELD=nrf21540ek
    integration_platforms:
      - nrf5340dk/nrf5340/cpunet
    platform_allow:
      - nrf5340dk/nrf5340/cpunet
    tags:
      - esb
      - ci_build
      - sysbuild
      - ci_samples_esb
  sample.esb.ptx.fast_switching:
    sysbuild: true
    extra_configs:
      - CONFIG_ESB_FAST_SWITCHING=y
      - CONFIG_ESB_FAST_CHANNEL_SWITCHING=y
    integration_platforms:
      - nrf54h20dk/nrf54h20/cpurad
    platform_allow:
      - nrf54h20dk/nrf54h20/cpurad
    tags:
      - esb
      - ci_build
      - sysbuild
      - ci_samples_esb
```

## samples/esb/esb_ptx_ble/Kconfig
```kconfig
#
# Copyright (c) 2025 Nordic Semiconductor
#
# SPDX-License-Identifier: LicenseRef-Nordic-5-Clause
#

menu "Enhanced ShockBurst: Transmitter with BLE"

module = ESB_PTX_BLE
module-str = "ESB_PTX_BLE"
source "$(ZEPHYR_BASE)/subsys/logging/Kconfig.template.log_config"

endmenu

source "Kconfig.zephyr"
```
