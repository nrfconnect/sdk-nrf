## samples/dfu/nrf9160/Kconfig
```kconfig
#
# Copyright (c) 2022 Nordic Semiconductor ASA
#
# SPDX-License-Identifier: LicenseRef-Nordic-5-Clause
#

menu "DFU target type UART sample"

config DOWNLOAD_HOST
	string "Application update host name"
	help
	  Host part of URL to application update binary. For example
	  if the file is stored in http://foo.bar/update.bin the value
	  of this configuration should be 'foo.bar'

config DOWNLOAD_FILE
	string "Application downgrade file name (application version 1)"
	help
	  File part of URL to application update binary version 1. For example
	  if the file is stored in http://foo.bar/downgrade.bin the value
	  of this configuration should be 'downgrade.bin'

config APPLICATION_VERSION
	int "Application version"
	default 1

module = APP
module-dep = LOG
module-str = Log level for sample
source "${ZEPHYR_BASE}/subsys/logging/Kconfig.template.log_config"

endmenu

menu "Zephyr Kernel"
source "Kconfig.zephyr"
endmenu
```

## samples/dfu/nrf9160/boards/nrf9160dk_nrf9160_ns.conf
```kconfig
#
# Copyright (c) 2022 Nordic Semiconductor ASA
#
# SPDX-License-Identifier: LicenseRef-Nordic-5-Clause
#

# Logging
CONFIG_CONSOLE=y
CONFIG_LOG=y

# Download target
CONFIG_DOWNLOAD_HOST="0.0.0.0"
CONFIG_DOWNLOAD_FILE="app_update_uart.bin"
CONFIG_APPLICATION_VERSION=1
```

## samples/dfu/nrf9160/sample.yaml
```yaml
sample:
  name: FOTA over LTE through UART sample, host core
tests:
  sample.dfu.nrf9160:
    build_only: true
    integration_platforms:
      - nrf9160dk_nrf9160_ns
    platform_allow: nrf9160dk_nrf9160_ns
    tags: ci_build
```

## samples/dfu/single_slot/sysbuild/mcuboot/boards/nrf54h20dk_nrf54h20_cpuapp.conf
```kconfig
#
# Copyright (c) 2025 Nordic Semiconductor ASA
#
# SPDX-License-Identifier: LicenseRef-Nordic-5-Clause
#

CONFIG_POWER_DOMAIN=n

CONFIG_NRF_SECURITY=y
CONFIG_MULTITHREADING=y
```

## samples/dfu/single_slot/sysbuild/mcuboot/boards/nrf54h20dk_nrf54h20_cpuapp_boot_req.conf
```kconfig
#
# Copyright (c) 2026 Nordic Semiconductor ASA
#
# SPDX-License-Identifier: LicenseRef-Nordic-5-Clause
#

CONFIG_POWER_DOMAIN=n

CONFIG_PSA_CRYPTO=y
CONFIG_MULTITHREADING=y

CONFIG_NRF_BOOT_FIRMWARE_LOADER_BOOT_REQ=y
CONFIG_NRF_MCUBOOT_BOOT_REQUEST=y
CONFIG_CRC=y
```

## samples/dfu/single_slot/sysbuild/mcuboot/boards/nrf54l15dk_nrf54l15_cpuapp.conf
```kconfig
#
# Copyright (c) 2025 Nordic Semiconductor ASA
#
# SPDX-License-Identifier: LicenseRef-Nordic-5-Clause
#
CONFIG_SYS_CLOCK_EXISTS=n
CONFIG_NRF_GRTC_TIMER=n
CONFIG_PSA_CORE_LITE=y
CONFIG_CRACEN_IKG=n

# Disable run-time CRACEN provisioning of TRNG data.
# KMU slots 248, 249 shall be pre-provisioned while programming with secret TRNG values instead.
CONFIG_CRACEN_PROVISION_PROT_RAM_INV_SLOTS_ON_INIT=n

CONFIG_BOOT_WATCHDOG_FEED=n

CONFIG_BOOT_MAX_IMG_SECTORS=256
CONFIG_NRF_RRAM_WRITE_BUFFER_SIZE=32
```

## samples/dfu/single_slot/sysbuild/mcuboot/boards/nrf54ls05dk_nrf54ls05b_cpuapp.conf
```kconfig
CONFIG_FLASH=y
CONFIG_MAIN_STACK_SIZE=10240
CONFIG_FPROTECT=n

CONFIG_SERIAL=n
CONFIG_CONSOLE=n
CONFIG_UART_CONSOLE=n

CONFIG_NRF_OBERON=y
CONFIG_BOOT_ECDSA_NRF_OBERON=y

CONFIG_NCS_BOOT_BANNER=n
CONFIG_MCUBOOT_BOOT_BANNER=n
CONFIG_BOOT_BANNER=n
CONFIG_PRINTK=n
CONFIG_MINIMAL_LIBC=y
CONFIG_SYS_CLOCK_EXISTS=n
CONFIG_GPIO=n

CONFIG_ISR_TABLES_LOCAL_DECLARATION=y
CONFIG_LTO=y
```
