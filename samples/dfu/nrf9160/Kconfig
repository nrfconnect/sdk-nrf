## samples/dfu/smp_svr/sample.yaml
```yaml
sample:
  description: Simple Management Protocol sample
  name: MCUboot SMP Server sample
common:
  sysbuild: true
  harness: console
  harness_config:
    type: multi_line
    ordered: false
    regex:
      - "Starting .*bootloader"
      - "Jumping to the .*image slot"
      - "smp_sample: build time"
  timeout: 15
  tags:
    - ci_samples_zephyr_subsys_mgmt_mcumgr_smp_svr

tests:
  sample.dfu.smp_svr.bt:
    harness: bluetooth
    tags: bluetooth
    extra_args: EXTRA_CONF_FILE="overlay-bt.conf"
    platform_allow:
      - nrf52840dk/nrf52840
      - nrf5340dk/nrf5340/cpuapp
      - nrf54l15dk/nrf54l15/cpuapp
      - nrf54l15dk/nrf54l10/cpuapp
      - nrf54h20dk/nrf54h20/cpuapp
      - nrf54lm20dk/nrf54lm20a/cpuapp
      - nrf54lv10dk/nrf54lv10a/cpuapp
    integration_platforms:
      - nrf52840dk/nrf52840
      - nrf5340dk/nrf5340/cpuapp
      - nrf54l15dk/nrf54l15/cpuapp
      - nrf54l15dk/nrf54l10/cpuapp
      - nrf54h20dk/nrf54h20/cpuapp
      - nrf54lm20dk/nrf54lm20a/cpuapp
      - nrf54lv10dk/nrf54lv10a/cpuapp
  sample.dfu.smp_svr.serial:
    platform_allow:
      - nrf52840dk/nrf52840
      - nrf5340dk/nrf5340/cpuapp
      - nrf54l15dk/nrf54l15/cpuapp
      - nrf54l15dk/nrf54l10/cpuapp
      - nrf54h20dk/nrf54h20/cpuapp
      - nrf54lm20dk/nrf54lm20a/cpuapp
      - nrf54lv10dk/nrf54lv10a/cpuapp
      - nrf54ls05dk/nrf54ls05b/cpuapp
    integration_platforms:
      - nrf54h20dk/nrf54h20/cpuapp
      - nrf54l15dk/nrf54l15/cpuapp
  sample.dfu.smp_svr.mcuboot_flags.direct_xip_withrevert:
    extra_args:
      - SB_CONFIG_MCUBOOT_MODE_DIRECT_XIP_WITH_REVERT=y
    platform_allow:
      - nrf52840dk/nrf52840
      - nrf54l15dk/nrf54l15/cpuapp
      - nrf54l15dk/nrf54l10/cpuapp
      - nrf54lm20dk/nrf54lm20a/cpuapp
      - nrf54lv10dk/nrf54lv10a/cpuapp
      - nrf54ls05dk/nrf54ls05b/cpuapp
    integration_platforms:
      - nrf54l15dk/nrf54l15/cpuapp
  sample.dfu.smp_svr.encryption.rsa:
    platform_allow:
      - nrf52840dk/nrf52840
      - nrf5340dk/nrf5340/cpuapp
      - nrf54l15dk/nrf54l15/cpuapp
      - nrf54lm20dk/nrf54lm20a/cpuapp
      - nrf54lv10dk/nrf54lv10a/cpuapp
      - nrf54ls05dk/nrf54ls05b/cpuapp
    integration_platforms:
      - nrf54l15dk/nrf54l15/cpuapp
    tags:
      - encryption
    extra_args:
      - SB_CONFIG_BOOT_ENCRYPTION=y
      - SB_CONFIG_BOOT_SIGNATURE_TYPE_RSA=y
      - mcuboot_CONFIG_MCUBOOT_DOWNGRADE_PREVENTION=y
      - FILE_SUFFIX=larger_mcuboot

  sample.dfu.smp_svr.encryption.ecdsa_p256:
    platform_allow:
      - nrf5340dk/nrf5340/cpuapp
      - nrf54l15dk/nrf54l15/cpuapp
      - nrf54h20dk/nrf54h20/cpuapp
      - nrf54lm20dk/nrf54lm20a/cpuapp
      - nrf54lv10dk/nrf54lv10a/cpuapp
      - nrf54ls05dk/nrf54ls05b/cpuapp
    integration_platforms:
      - nrf54l15dk/nrf54l15/cpuapp
    tags:
      - encryption
    extra_args:
      - SB_CONFIG_BOOT_ENCRYPTION=y
      - SB_CONFIG_BOOT_SIGNATURE_TYPE_ECDSA_P256=y
      - FILE_SUFFIX=larger_mcuboot

  sample.dfu.smp_svr.encryption.ed25519:
    platform_allow:
      - nrf52840dk/nrf52840
      - nrf5340dk/nrf5340/cpuapp
      - nrf54l15dk/nrf54l15/cpuapp
      - nrf54lm20dk/nrf54lm20a/cpuapp
      - nrf54lv10dk/nrf54lv10a/cpuapp
      - nrf54ls05dk/nrf54ls05b/cpuapp
    integration_platforms:
      - nrf54l15dk/nrf54l15/cpuapp
    tags:
      - encryption
    extra_args:
      - FILE_SUFFIX=larger_mcuboot
      - SB_CONFIG_BOOT_ENCRYPTION=y
      - SB_CONFIG_BOOT_SIGNATURE_TYPE_ED25519=y

  sample.dfu.smp_svr.signature.none:
    platform_allow:
      - nrf52840dk/nrf52840
      - nrf5340dk/nrf5340/cpuapp
      - nrf54l15dk/nrf54l15/cpuapp
      - nrf54h20dk/nrf54h20/cpuapp
      - nrf54lm20dk/nrf54lm20a/cpuapp
      - nrf54lv10dk/nrf54lv10a/cpuapp
      - nrf54ls05dk/nrf54ls05b/cpuapp
    integration_platforms:
      - nrf54l15dk/nrf54l15/cpuapp
    tags:
      - signature
    extra_args:
      - SB_CONFIG_BOOT_SIGNATURE_TYPE_NONE=y

  sample.dfu.smp_svr.signature.ed25519:
    platform_allow:
      - nrf54l15dk/nrf54l15/cpuapp
      - nrf54lm20dk/nrf54lm20a/cpuapp
      - nrf54lv10dk/nrf54lv10a/cpuapp
      - nrf54h20dk/nrf54h20/cpuapp
      - nrf54ls05dk/nrf54ls05b/cpuapp
    integration_platforms:
      - nrf54l15dk/nrf54l15/cpuapp
    tags:
      - signature
    extra_args:
      - SB_CONFIG_BOOT_SIGNATURE_TYPE_ED25519=y

  sample.dfu.smp_svr.signature.ecdsa_p256:
    platform_allow:
      - nrf54h20dk/nrf54h20/cpuapp
      - nrf54ls05dk/nrf54ls05b/cpuapp
    tags:
      - signature
    extra_args:
      - SB_CONFIG_BOOT_SIGNATURE_TYPE_ECDSA_P256=y

  sample.dfu.smp_svr.signature.pure:
    platform_allow:
      - nrf54l15dk/nrf54l15/cpuapp
      - nrf54h20dk/nrf54h20/cpuapp
      - nrf54ls05dk/nrf54ls05b/cpuapp
    tags:
      - signature
    extra_args:
      - SB_CONFIG_BOOT_SIGNATURE_TYPE_ED25519=y
      - SB_CONFIG_BOOT_SIGNATURE_TYPE_PURE=y

  sample.dfu.smp_svr.kmu.basic:
    platform_allow:
      - nrf54l15dk/nrf54l15/cpuapp
      - nrf54l15dk/nrf54l10/cpuapp
      - nrf54l15dk/nrf54l05/cpuapp
      - nrf54lm20dk/nrf54lm20a/cpuapp
      - nrf54lv10dk/nrf54lv10a/cpuapp
    integration_platforms:
      - nrf54l15dk/nrf54l15/cpuapp
    tags: kmu
    extra_args:
      - SB_CONFIG_MCUBOOT_SIGNATURE_USING_KMU=y
      - SB_CONFIG_BOOT_SIGNATURE_TYPE_ED25519=y

  sample.dfu.smp_svr.nsib.kmu.basic:
    platform_allow:
      - nrf54l15dk/nrf54l15/cpuapp
      - nrf54lm20dk/nrf54lm20a/cpuapp
      - nrf54lv10dk/nrf54lv10a/cpuapp
    integration_platforms:
      - nrf54l15dk/nrf54l15/cpuapp
    tags:
      - kmu
      - nsib
    extra_args:
      - SB_CONFIG_SECURE_BOOT_APPCORE=y
      - SB_CONFIG_MCUBOOT_SIGNATURE_USING_KMU=y
      - SB_CONFIG_BOOT_SIGNATURE_TYPE_ED25519=y

  sample.dfu.smp_svr.kmu.revocation:
    platform_allow:
      - nrf54l15dk/nrf54l15/cpuapp
      - nrf54lm20dk/nrf54lm20a/cpuapp
      - nrf54lv10dk/nrf54lv10a/cpuapp
    integration_platforms:
      - nrf54l15dk/nrf54l15/cpuapp
    tags: kmu
    extra_args:
      - SB_CONFIG_MCUBOOT_SIGNATURE_USING_KMU=y
      - SB_CONFIG_BOOT_SIGNATURE_TYPE_ED25519=y
      - mcuboot_CONFIG_BOOT_SIGNATURE_KMU_SLOTS=3
      - mcuboot_CONFIG_BOOT_KEYS_REVOCATION=y

  sample.dfu.smp_svr.nrf_compress.basic:
    tags:
      - nrf_compress
    platform_allow:
      - nrf52840dk/nrf52840
      - nrf5340dk/nrf5340/cpuapp
      - nrf54l15dk/nrf54l15/cpuapp
      - nrf54h20dk/nrf54h20/cpuapp
      - nrf54lm20dk/nrf54lm20a/cpuapp
      - nrf54lv10dk/nrf54lv10a/cpuapp
    integration_platforms:
      - nrf54l15dk/nrf54l15/cpuapp
    extra_args:
      - SB_CONFIG_MCUBOOT_MODE_OVERWRITE_ONLY=y
      - SB_CONFIG_MCUBOOT_COMPRESSED_IMAGE_SUPPORT=y
      - FILE_SUFFIX=larger_mcuboot

  sample.dfu.smp_svr.nrf_compress.encryption_rsa:
    platform_allow:
      - nrf52840dk/nrf52840
      - nrf5340dk/nrf5340/cpuapp
    tags:
      - encryption
      - nrf_compress
    extra_args:
      - SB_CONFIG_MCUBOOT_MODE_OVERWRITE_ONLY=y
      - SB_CONFIG_MCUBOOT_COMPRESSED_IMAGE_SUPPORT=y
      - SB_CONFIG_BOOT_ENCRYPTION=y
      - SB_CONFIG_BOOT_SIGNATURE_TYPE_RSA=y
      - FILE_SUFFIX=larger_mcuboot

  sample.dfu.smp_svr.nrf_compress.encryption_ecdsa_p256:
    platform_allow:
      - nrf5340dk/nrf5340/cpuapp
      - nrf54l15dk/nrf54l15/cpuapp
      - nrf54h20dk/nrf54h20/cpuapp
      - nrf54lm20dk/nrf54lm20a/cpuapp
      - nrf54lv10dk/nrf54lv10a/cpuapp
    integration_platforms:
      - nrf54l15dk/nrf54l15/cpuapp
      - nrf54h20dk/nrf54h20/cpuapp
    tags:
      - encryption
      - nrf_compress
    extra_args:
      - SB_CONFIG_MCUBOOT_MODE_OVERWRITE_ONLY=y
      - SB_CONFIG_MCUBOOT_COMPRESSED_IMAGE_SUPPORT=y
      - SB_CONFIG_BOOT_ENCRYPTION=y
      - SB_CONFIG_BOOT_SIGNATURE_TYPE_ECDSA_P256=y
      - FILE_SUFFIX=larger_mcuboot

  sample.dfu.smp_svr.nrf_compress.encryption_ed25519:
    platform_allow:
      - nrf52840dk/nrf52840
      - nrf5340dk/nrf5340/cpuapp
      - nrf54l15dk/nrf54l15/cpuapp
      - nrf54lm20dk/nrf54lm20a/cpuapp
      - nrf54lv10dk/nrf54lv10a/cpuapp
    integration_platforms:
      - nrf54l15dk/nrf54l15/cpuapp
    tags:
      - encryption
      - nrf_compress
    extra_args:
      - SB_CONFIG_MCUBOOT_MODE_OVERWRITE_ONLY=y
      - SB_CONFIG_MCUBOOT_COMPRESSED_IMAGE_SUPPORT=y
      - SB_CONFIG_BOOT_ENCRYPTION=y
      - SB_CONFIG_BOOT_SIGNATURE_TYPE_ED25519=y
      - FILE_SUFFIX=larger_mcuboot

  sample.dfu.smp_svr.bt.nrf5340dk.ext_flash:
    sysbuild: true
    extra_args:
      - FILE_SUFFIX=nrf5340_bt
    platform_allow:
      - nrf5340dk/nrf5340/cpuapp
    integration_platforms:
      - nrf5340dk/nrf5340/cpuapp
    harness_config: &bt_harness_config
      type: multi_line
      ordered: false
      regex:
        - "Starting .*bootloader"
        - "Jumping to the .*image slot"
        - "smp_sample: build time"
        - "smp_bt_sample: Advertising successfully started"

  sample.dfu.smp_svr.bt.nrf54l15:
    tags: bluetooth
    extra_args: EXTRA_CONF_FILE="overlay-bt.conf"
    platform_allow:
      - nrf54l15dk/nrf54l15/cpuapp
      - nrf54l15dk/nrf54l10/cpuapp
    integration_platforms:
      - nrf54l15dk/nrf54l15/cpuapp
    harness_config: *bt_harness_config

  sample.dfu.smp_svr.bt.nrf54l15dk.ext_flash:
    extra_args:
      - OVERLAY_CONFIG="overlay-bt.conf"
      - FILE_SUFFIX=ext_flash
      - DTC_OVERLAY_FILE="boards/nrf54l15dk_ext_flash.overlay"
      - mcuboot_EXTRA_DTC_OVERLAY_FILE="boards/nrf54l15dk_ext_flash.overlay"
      - SB_CONFIG_PM_OVERRIDE_EXTERNAL_DRIVER_CHECK=y
      - SB_CONFIG_PM_EXTERNAL_FLASH_MCUBOOT_SECONDARY=y
    platform_allow:
      - nrf54l15dk/nrf54l15/cpuapp
      - nrf54l15dk/nrf54l10/cpuapp
    integration_platforms:
      - nrf54l15dk/nrf54l15/cpuapp
    harness_config: *bt_harness_config

  sample.dfu.smp_svr.bt.nrf54l15dk.ext_flash.pure_dts:
    extra_args:
      - OVERLAY_CONFIG="overlay-bt.conf"
      - FILE_SUFFIX=ext_flash_pure_dts
      - SB_CONFIG_PARTITION_MANAGER=n
    platform_allow:
      - nrf54l15dk/nrf54l15/cpuapp
      - nrf54l15dk/nrf54l10/cpuapp
      - nrf54l15dk/nrf54l05/cpuapp
    integration_platforms:
      - nrf54l15dk/nrf54l15/cpuapp
      - nrf54l15dk/nrf54l10/cpuapp
      - nrf54l15dk/nrf54l05/cpuapp
    harness_config: *bt_harness_config

  sample.dfu.smp_svr.bt.nrf54l15dk.ext_flash.sqspi:
    extra_args:
      - OVERLAY_CONFIG="overlay-bt.conf"
      - FILE_SUFFIX=ext_flash_sqspi
      - SB_CONFIG_PARTITION_MANAGER=n
    platform_allow:
      - nrf54l15dk/nrf54l15/cpuapp
    integration_platforms:
      - nrf54l15dk/nrf54l15/cpuapp
    harness_config: *bt_harness_config

  sample.dfu.smp_svr.bt.nrf54h20dk:
    sysbuild: true
    extra_args:
      - EXTRA_CONF_FILE="overlay-bt.conf"
      - SB_CONFIG_NETCORE_IPC_RADIO=y
      - SB_CONFIG_NETCORE_IPC_RADIO_BT_HCI_IPC=y
      - mcuboot_CONFIG_NRF_SECURITY=y
      - mcuboot_CONFIG_MULTITHREADING=y
      - CONFIG_MCUMGR_GRP_IMG_ALLOW_CONFIRM_NON_ACTIVE_IMAGE_ANY=y
    platform_allow:
      - nrf54h20dk/nrf54h20/cpuapp
    integration_platforms:
      - nrf54h20dk/nrf54h20/cpuapp
    harness_config: *bt_harness_config

  sample.dfu.smp_svr.bt.nrf54h20dk.direct_xip_withrevert:
    sysbuild: true
    extra_args:
      - FILE_SUFFIX="merged_slot"
      - EXTRA_CONF_FILE="overlay-bt.conf"
      - SB_CONFIG_NETCORE_IPC_RADIO=y
      - SB_CONFIG_NETCORE_IPC_RADIO_BT_HCI_IPC=y
      - SB_CONFIG_MCUBOOT_MODE_DIRECT_XIP_WITH_REVERT=y
      - mcuboot_CONFIG_NRF_SECURITY=y
      - mcuboot_CONFIG_MULTITHREADING=y
    platform_allow:
      - nrf54h20dk/nrf54h20/cpuapp
    integration_platforms:
      - nrf54h20dk/nrf54h20/cpuapp
    harness_config: *bt_harness_config

  sample.dfu.smp_svr.serial.nrf54h20dk.ecdsa:
    sysbuild: true
    extra_args:
      - SB_CONFIG_BOOT_SIGNATURE_TYPE_ECDSA_P256=y
      - mcuboot_CONFIG_NRF_SECURITY=y
      - mcuboot_CONFIG_MULTITHREADING=y
    platform_allow:
      - nrf54h20dk/nrf54h20/cpuapp
    integration_platforms:
      - nrf54h20dk/nrf54h20/cpuapp

  sample.dfu.smp_svr.bt.nrf54h20dk.direct_xip_withrequests:
    sysbuild: true
    extra_args:
      - FILE_SUFFIX="requests"
      - EXTRA_CONF_FILE="overlay-bt.conf"
      - SB_CONFIG_NETCORE_IPC_RADIO=y
      - SB_CONFIG_NETCORE_IPC_RADIO_BT_HCI_IPC=y
      - SB_CONFIG_MCUBOOT_MODE_DIRECT_XIP_WITH_REVERT=y
      - mcuboot_CONFIG_NRF_SECURITY=y
      - mcuboot_CONFIG_MULTITHREADING=y
    platform_allow:
      - nrf54h20dk/nrf54h20/cpuapp
    integration_platforms:
      - nrf54h20dk/nrf54h20/cpuapp
    harness_config: *bt_harness_config

  sample.dfu.smp_svr.bt.nrf54h20dk.ext_flash:
    extra_args:
      - FILE_SUFFIX="ext_flash"
      - EXTRA_CONF_FILE="overlay-bt.conf"
      - mcuboot_CONFIG_MULTITHREADING=y
      - mcuboot_CONFIG_NRF_SECURITY=y
      - mcuboot_CONFIG_BOOT_IMG_HASH_DIRECTLY_ON_STORAGE=n
      - mcuboot_CONFIG_BOOT_MAX_IMG_SECTORS_AUTO=n
      - mcuboot_CONFIG_BOOT_MAX_IMG_SECTORS=512
      - mcuboot_CONFIG_FLASH_MSPI_NOR_LAYOUT_PAGE_SIZE=4096
      - SB_CONFIG_NETCORE_IPC_RADIO=y
      - SB_CONFIG_NETCORE_IPC_RADIO_BT_HCI_IPC=y
      - CONFIG_MCUMGR_GRP_IMG_ALLOW_CONFIRM_NON_ACTIVE_IMAGE_ANY=y
    platform_allow:
      - nrf54h20dk/nrf54h20/cpuapp
    integration_platforms:
      - nrf54h20dk/nrf54h20/cpuapp
    harness_config: *bt_harness_config

  sample.dfu.smp_svr.ram_load:
    extra_args:
      - FILE_SUFFIX="ram_load"
    platform_allow:
      - nrf54lm20dk/nrf54lm20a/cpuapp

  sample.dfu.smp_svr.ram_load.kmu:
    extra_args:
      - FILE_SUFFIX="ram_load"
      - SB_CONFIG_MCUBOOT_SIGNATURE_USING_KMU=y
      - SB_CONFIG_BOOT_SIGNATURE_TYPE_ED25519=y
    platform_allow:
      - nrf54lm20dk/nrf54lm20a/cpuapp
```

## samples/dfu/smp_svr/sysbuild/mcuboot/boards/nrf54l15dk_nrf54l10_cpuapp_ext_flash.conf
```kconfig
# Enable flash operations
CONFIG_FLASH=y

CONFIG_BOOT_MAX_IMG_SECTORS=512
CONFIG_PM_PARTITION_SIZE_MCUBOOT=0x13e00

CONFIG_MULTITHREADING=y

CONFIG_LOG=y
CONFIG_LOG_MODE_MINIMAL=y
CONFIG_LOG_DEFAULT_LEVEL=0
CONFIG_MCUBOOT_LOG_LEVEL_INF=y
# Decrease footprint by ~4 KB in comparison to CBPRINTF_COMPLETE=y
CONFIG_CBPRINTF_NANO=y
# Use minimal C library instead of the Picolib
CONFIG_MINIMAL_LIBC=y

CONFIG_FW_INFO_FIRMWARE_VERSION=2

CONFIG_MCUBOOT_DOWNGRADE_PREVENTION=y
# SPI
CONFIG_SPI=y
CONFIG_SPI_NOR=y
CONFIG_SPI_NOR_FLASH_LAYOUT_PAGE_SIZE=4096
CONFIG_SPI_NRFX_RAM_BUFFER_SIZE=32

# disable fprotect (to allow boot with bigger MCUboot)
CONFIG_FPROTECT=n
# MCUboot requires a large stack size, otherwise an MPU fault will occur
CONFIG_MAIN_STACK_SIZE=16384

# Enable Link Time Optimizations
CONFIG_LTO=y
CONFIG_ISR_TABLES_LOCAL_DECLARATION=y
```

## samples/dfu/smp_svr/sysbuild/mcuboot/boards/nrf54lm20dk_nrf54lm20a_cpuapp_ram_load.conf
```kconfig
# from mcuboot/boot/zephyr/boards
CONFIG_SPI_NOR=n
CONFIG_FPROTECT=n
CONFIG_BOOT_WATCHDOG_FEED=n
# MCUboot requires a large stack size, otherwise an MPU fault will occur
CONFIG_MAIN_STACK_SIZE=16384

# Enable flash operations
CONFIG_FLASH=y

CONFIG_BOOT_MAX_IMG_SECTORS=256

CONFIG_MULTITHREADING=y

CONFIG_LOG=y
CONFIG_LOG_MODE_MINIMAL=y
CONFIG_LOG_DEFAULT_LEVEL=0
CONFIG_MCUBOOT_LOG_LEVEL_INF=y
# Decrease footprint by ~4 KB in comparison to CBPRINTF_COMPLETE=y
CONFIG_CBPRINTF_NANO=y
# Use minimal C library instead of the Picolib
CONFIG_MINIMAL_LIBC=y

CONFIG_FW_INFO_FIRMWARE_VERSION=2

# NCS boot banner
CONFIG_NCS_APPLICATION_BOOT_BANNER_STRING="MCUboot"

# Set according to the configuration of the cpuapp_sram_app_rxm_region DTS node.
CONFIG_BOOT_IMAGE_EXECUTABLE_RAM_START=0x20000800
CONFIG_BOOT_IMAGE_EXECUTABLE_RAM_SIZE=492544
```
