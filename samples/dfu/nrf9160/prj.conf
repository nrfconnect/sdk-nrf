## CMakeLists.txt
```
#
# Copyright (c) 2022 Nordic Semiconductor ASA
#
# SPDX-License-Identifier: LicenseRef-Nordic-5-Clause
#

cmake_minimum_required(VERSION 3.13.1)

find_package(Zephyr REQUIRED HINTS $ENV{ZEPHYR_BASE})
project(lte_uart_dfu_91)

# Add sources
target_sources(app PRIVATE src/main.c)
```

## Kconfig
```
#
# Copyright (c) 2022 Nordic Semiconductor ASA
#
# SPDX-License-Identifier: LicenseRef-Nordic-5-Clause
#

menu "DFU target type UART sample"

config DOWNLOAD_HOST
	string "Application update host name"
	help
	  Host part of URL to application update binary. For example
	  if the file is stored in http://foo.bar/update.bin the value
	  of this configuration should be 'foo.bar'

config DOWNLOAD_FILE
	string "Application downgrade file name (application version 1)"
	help
	  File part of URL to application update binary version 1. For example
	  if the file is stored in http://foo.bar/downgrade.bin the value
	  of this configuration should be 'downgrade.bin'

config APPLICATION_VERSION
	int "Application version"
	default 1

module = APP
module-dep = LOG
module-str = Log level for sample
source "${ZEPHYR_BASE}/subsys/logging/Kconfig.template.log_config"

endmenu

menu "Zephyr Kernel"
source "Kconfig.zephyr"
endmenu
```

## sample.yaml
```
sample:
  name: FOTA over LTE through UART sample, host core
tests:
  sample.dfu.nrf9160:
    build_only: true
    integration_platforms:
      - nrf9160dk_nrf9160_ns
    platform_allow: nrf9160dk_nrf9160_ns
    tags: ci_build
```

## prj.conf
```kconfig
#
# Copyright (c) 2022 Nordic Semiconductor ASA
#
# SPDX-License-Identifier: LicenseRef-Nordic-5-Clause
#

CONFIG_REBOOT=y
CONFIG_NEWLIB_LIBC=y
CONFIG_RESET_ON_FATAL_ERROR=n
CONFIG_ASSERT=y

# Network
CONFIG_NETWORKING=y
CONFIG_NET_SOCKETS=y
CONFIG_NET_NATIVE=n

# LTE link control
CONFIG_LTE_LINK_CONTROL=y
CONFIG_LTE_AUTO_INIT_AND_CONNECT=n

# Modem library
CONFIG_NRF_MODEM_LIB=y
CONFIG_NRF_MODEM_LIB_SYS_INIT=n

# Heap and stacks
CONFIG_HEAP_MEM_POOL_SIZE=2048
CONFIG_MAIN_STACK_SIZE=8192

# FOTA library
CONFIG_FOTA_DOWNLOAD=y

# Download client
CONFIG_DOWNLOAD_CLIENT=y
CONFIG_DOWNLOAD_CLIENT_STACK_SIZE=4096
CONFIG_DOWNLOAD_CLIENT_LOG_LEVEL_ERR=y

# DFU Target
CONFIG_SERIAL=y
CONFIG_UART_INTERRUPT_DRIVEN=y

CONFIG_DFU_TARGET=y
# For nRF5340 update
CONFIG_DFU_TARGET_UART=y
CONFIG_DFU_TARGET_UART_TIMEOUT=1000

# Multi-image
CONFIG_DFU_MULTI_IMAGE=n
# nRF9160 application + nRF5340
CONFIG_DFU_MULTI_IMAGE_MAX_IMAGE_COUNT=2
# For nRF9160 update
CONFIG_DFU_TARGET_MCUBOOT=n
```

## boards/nrf9160dk_nrf9160_ns.conf
```kconfig
#
# Copyright (c) 2022 Nordic Semiconductor ASA
#
# SPDX-License-Identifier: LicenseRef-Nordic-5-Clause
#

# Logging
CONFIG_CONSOLE=y
CONFIG_LOG=y

# Download target
CONFIG_DOWNLOAD_HOST="0.0.0.0"
CONFIG_DOWNLOAD_FILE="app_update_uart.bin"
CONFIG_APPLICATION_VERSION=1
```

## boards/nrf9160dk_nrf9160_ns.overlay
```dts
/*
 * Copyright (c) 2022 Nordic Semiconductor ASA
 *
 * SPDX-License-Identifier: LicenseRef-Nordic-5-Clause
 */

/ {
	chosen {
		sample,dfu_uart = &uart0;
	};
};
```

## src/main.c
```c
/*
 * Copyright (c) 2022 Nordic Semiconductor ASA
 *
 * SPDX-License-Identifier: LicenseRef-Nordic-5-Clause
 */

#include <zephyr/kernel.h>
#include <zephyr/dfu/mcuboot.h>
#include <modem/nrf_modem_lib.h>
#include <net/fota_download.h>
#include <modem/lte_lc.h>
#include <dfu/dfu_target_uart.h>
#include <zephyr/device.h>
#include <zephyr/logging/log.h>
LOG_MODULE_REGISTER(app, CONFIG_APP_LOG_LEVEL);

/**
 * @typedef update_start_cb
 *
 * @brief Signature for callback invoked when button is pressed.
 */
typedef void (*update_start_cb)(void);

/**
 * @brief Initialization struct.
 */

static struct k_work fota_work;
static update_start_cb update_start;
static char filename[128] = {0};

BUILD_ASSERT(!IS_ENABLED(CONFIG_LTE_AUTO_INIT_AND_CONNECT),
	     "This sample does not support auto init and connect");

struct update_sample_init_params {
	/* Callback invoked when the button is pressed */
	update_start_cb update_start;

	/* Update file to download */
	const char *filename;
};

static struct dfu_target_uart_remote remotes[] = {
	{
		.identifier = 1,
		.device = DEVICE_DT_GET(DT_CHOSEN(sample_dfu_uart))
	}
};

static uint8_t out_buffer[CONFIG_DOWNLOAD_CLIENT_BUF_SIZE + 50] = {0};

static struct dfu_target_uart_params config = {
	.remote_count = ARRAY_SIZE(remotes),
	.remotes = remotes,
	.buffer = out_buffer,
	.buf_size = ARRAY_SIZE(out_buffer)
};

static void fota_work_cb(struct k_work *work)
{
	ARG_UNUSED(work);

	if (update_start != NULL) {
		update_start();
	}
}

static void modem_configure(void)
{
	int err;

	err = lte_lc_init_and_connect();
	__ASSERT(err == 0, "LTE link could not be established.");
}

static int update_sample_init(struct update_sample_init_params *params)
{
	if (params == NULL || params->update_start == NULL || params->filename == NULL) {
		return -EINVAL;
	}

	k_work_init(&fota_work, fota_work_cb);

	update_start = params->update_start;
	strcpy(filename, params->filename);

	modem_configure();

	return 0;
}

static void update_sample_done(void)
{
	lte_lc_deinit();
}

static void fota_dl_handler(const struct fota_download_evt *evt)
{
	switch (evt->id) {
	case FOTA_DOWNLOAD_EVT_ERROR:
		LOG_ERR("Received error from fota_download\n");
		break;

	case FOTA_DOWNLOAD_EVT_FINISHED:
		update_sample_done();
		break;

	case FOTA_DOWNLOAD_EVT_PROGRESS:
		LOG_DBG("Progress: %d %%\n", evt->progress);
		break;

	default:
		break;
	}
}

static void update_sample_start(void)
{
	int err;

	/* Functions for getting the host and file */
	err = fota_download_start(CONFIG_DOWNLOAD_HOST, filename, -1, 0, 0);
	if (err != 0) {
		LOG_ERR("fota_download_start() failed, err %d\n", err);
	}
}

void main(void)
{
	int err;

	LOG_DBG("HTTP application update sample started\n");

	err = nrf_modem_lib_init(NORMAL_MODE);
	if (err) {
		LOG_ERR("Failed to initialize modem library!");
		return;
	}

	dfu_target_uart_cfg(&config);

	err = fota_download_init(fota_dl_handler);
	if (err) {
		LOG_ERR("fota_download_init() failed, err %d\n", err);
		return;
	}

	err = update_sample_init(&(struct update_sample_init_params) {
		.update_start = update_sample_start,
		.filename = CONFIG_DOWNLOAD_FILE
	});
	if (err) {
		LOG_ERR("update_sample_init() failed, err %d\n", err);
		return;
	}

	k_work_submit(&fota_work);
}
```
