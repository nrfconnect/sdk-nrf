/*
 * Copyright (c) 2025 Nordic Semiconductor ASA
 *
 * SPDX-License-Identifier: LicenseRef-Nordic-5-Clause
 */

#include "../../nrf54h20.overlay"

/ {
	chosen {
		zephyr,code-partition = &boot_partition;
	};

	aliases {
		mcuboot-button0 = &button0;
	};
};
