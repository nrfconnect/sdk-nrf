/*
 * Copyright (c) 2026 Nordic Semiconductor ASA
 *
 * SPDX-License-Identifier: LicenseRef-Nordic-5-Clause
 */

#include "../../../boards/nrf54l15dk_nrf54l15_cpuapp_boot_req.overlay"

/ {
	chosen {
		zephyr,code-partition = &boot_partition;
	};
};

/ {
	aliases {
		mcuboot-button0 = &button0;
	};
};
