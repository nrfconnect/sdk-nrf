/*
 * Copyright (c) 2026 Nordic Semiconductor ASA
 *
 * SPDX-License-Identifier: LicenseRef-Nordic-5-Clause
 */

/ {
	aliases {
		/*
		 * Reuse image-1 as helper buffer region when fixed partitions
		 * are used without Partition Manager.
		 */
		dfu-target-helper = &slot1_partition;
	};
};
