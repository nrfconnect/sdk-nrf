## samples/Kconfig
```kconfig
#
# Copyright (c) 2018 Nordic Semiconductor
#
# SPDX-License-Identifier: LicenseRef-Nordic-5-Clause
#

config NCS_SAMPLES_DEFAULTS
	bool "Enable NCS sample default settings"
	imply LOG
	imply LOG_DEFAULT_MINIMAL
	imply ASSERT
	imply ASSERT_NO_COND_INFO
	imply ASSERT_NO_MSG_INFO
	imply HW_STACK_PROTECTION if ARCH_HAS_STACK_PROTECTION
	imply RESET_ON_FATAL_ERROR if !DEBUG && !BOARD_NATIVE_SIM && !QEMU_TARGET && !TEST
	help
	  Use the default configuration for NCS samples.

menu "Image build variants"

# These are set by CMake, and they need a prompt.
# Keep them in a separate menu to avoid cluttering the top-level menu

config NCS_MCUBOOT_IN_BUILD
	bool "MCUBoot is included in the build [READ ONLY]"
	help
	  Helper option used to communicate to images that MCUboot is included in the build.

endmenu

rsource "common/Kconfig"
```

## samples/Kconfig.mcumgr_bt_ota_dfu
```kconfig
#
# Copyright (c) 2023 Nordic Semiconductor
#
# SPDX-License-Identifier: LicenseRef-Nordic-5-Clause
#

DT_CHOSEN_EXT_FLASH:= nordic,pm-ext-flash

config NCS_SAMPLE_MCUMGR_BT_OTA_DFU
	bool "MCUmgr OTA DFU over Bluetooth"
	select MCUMGR
	select MCUMGR_SMP_BT
	imply MCUMGR_SMP_BT_CONN_PARAM_CONTROL
	imply MCUMGR_CMD_IMG_MGMT
	imply MCUMGR_CMD_OS_MGMT
	imply MCUMGR_SMP_REASSEMBLY_BT
	imply NORDIC_QSPI_NOR if $(dt_chosen_enabled,$(DT_CHOSEN_EXT_FLASH))
	imply NCS_SAMPLE_MCUMGR_BT_OTA_DFU_SPEEDUP
	depends on BT_PERIPHERAL
	depends on BOOTLOADER_MCUBOOT
	help
	  Enable this option to include MCUmgr in the build which will enable
	  the Bluetooth transport and image management group, which allows
	  for firmware over the air update support of the device.

if NCS_SAMPLE_MCUMGR_BT_OTA_DFU

config MCUMGR_SMP_BT_AUTHEN
	default n

config IMG_ERASE_PROGRESSIVELY
	default y

if MCUMGR_SMP_REASSEMBLY_BT

config MCUMGR_BUF_SIZE
	default 2475

config OS_MGMT_MCUMGR_PARAMS
	default y

endif # MCUMGR_SMP_REASSEMBLY_BT

if (SETTINGS_FCB || SETTINGS_NVS)

# Enable support for the storage erase operation only when the storage
# partition is created by the Partition Manager.

config MCUMGR_GRP_ZEPHYR_BASIC
	default y

config MCUMGR_GRP_BASIC_CMD_STORAGE_ERASE
	default y

endif # (SETTINGS_FCB || SETTINGS_NVS)

if NORDIC_QSPI_NOR

config NORDIC_QSPI_NOR_FLASH_LAYOUT_PAGE_SIZE
	default 4096

config NORDIC_QSPI_NOR_STACK_WRITE_BUFFER_SIZE
	default 16

endif # NORDIC_QSPI_NOR

# Align supported targets with their default MCUboot configuration.

# nRF53 series
if SOC_SERIES_NRF53X

# Thingy53: mcuboot/boot/zephyr/boards/thingy53_nrf5340_cpuapp.conf
if BOARD_THINGY53_NRF5340_CPUAPP || BOARD_THINGY53_NRF5340_CPUAPP_NS

config UPDATEABLE_IMAGE_NUMBER
	default 2

config NRF53_UPGRADE_NETWORK_CORE
	default y

endif # BOARD_THINGY53_NRF5340_CPUAPP || BOARD_THINGY53_NRF5340_CPUAPP_NS

# nRF5340 DK and the rest of the targets from the nRF53 series: mcuboot/boot/zephyr/prj.conf
# Defaults below for the nRF53 series are overridden by the target-specific
# defaults that are defined above (e.g. for the Thingy:53 target).
config NRF53_UPGRADE_NETWORK_CORE
	default n

endif # SOC_SERIES_NRF53X

endif # NCS_SAMPLE_MCUMGR_BT_OTA_DFU

config NCS_SAMPLE_MCUMGR_BT_OTA_DFU_SPEEDUP
	bool "MCUmgr OTA DFU speedup"
	depends on BT_CTLR || (NCS_SAMPLE_HCI_RPMSG_CHILD_IMAGE || NCS_SAMPLE_MULTIPROTOCOL_RPMSG_CHILD_IMAGE)
	help
	  Enable this option to speed up the OTA DFU transfer over Bluetooth.
	  This option extends the Bluetooth buffers to extend Bluetooth MTU
	  size. The buffer configuration should be the same in the Network Core
	  and Application Core image.

	  This configuration option is automatically applied for the Network
	  Core child image if the NCS_SAMPLE_MCUMGR_BT_OTA_DFU_SPEEDUP option is
	  enabled in the main image.

if NCS_SAMPLE_MCUMGR_BT_OTA_DFU_SPEEDUP

config BT_L2CAP_TX_MTU
	default 498 if BT_HCI_HOST

config BT_BUF_ACL_TX_SIZE
	default 251

config BT_BUF_ACL_RX_SIZE
	default 502

config BT_CTLR_DATA_LENGTH_MAX
	default 251 if BT_CTLR

endif # NCS_SAMPLE_MCUMGR_BT_OTA_DFU_SPEEDUP
```

## samples/adafruit/lcd/sample.yaml
```yaml
sample:
  description: nRF52 / nRF91 Adafruit LCD LittlevGL demo
  name: adafruit_lcd
tests:
  test_build:
    build_only: true
    build_on_all: true
    platform_whitelist: nrf52840_pca10056 nrf9160_pca10090
    tags: ci_build
```

## samples/anjay_lwm2m_client/Kconfig
```kconfig
menu "anjay-zephyr-client-app"

config ANJAY_CLIENT_BUILD_MCUBOOT_AUTOMATICALLY
	bool "Build MCUboot as part of the main build process"
	depends on BOOTLOADER_MCUBOOT
	depends on !PARTITION_MANAGER_ENABLED
	select MCUBOOT_GENERATE_CONFIRMED_IMAGE
	default y

endmenu

source "Kconfig.zephyr"
```

## samples/anjay_lwm2m_client/boards/nrf52840dk_nrf52840.conf
```kconfig
# anjay-zephyr-client
CONFIG_ANJAY_ZEPHYR_DEVICE_MANUFACTURER="Nordic Semiconductor"
CONFIG_ANJAY_ZEPHYR_MODEL_NUMBER="nRF52840DK"

# Anjay Settings
CONFIG_ANJAY_COMPAT_TIME=y
CONFIG_ANJAY_COMPAT_MBEDTLS=y
CONFIG_ANJAY_COMPAT_NET=y

# General Settings
CONFIG_MAIN_STACK_SIZE=2048
CONFIG_SYSTEM_WORKQUEUE_STACK_SIZE=2048

# Logging
CONFIG_LOG_BLOCK_IN_THREAD=y
CONFIG_LOG_MODE_DEFERRED=y

# Clock synchronization
CONFIG_DATE_TIME=y
CONFIG_DATE_TIME_AUTO_UPDATE=n

# Networking
CONFIG_NET_IPV4=n
CONFIG_NET_IPV6=y
CONFIG_NET_IPV6_NBR_CACHE=n
CONFIG_NET_IPV6_MLD=n
CONFIG_NET_CONFIG_NEED_IPV4=n
CONFIG_NET_MGMT_EVENT_INFO=y
CONFIG_NET_L2_OPENTHREAD=y

# DNS
CONFIG_DNS_RESOLVER=y
CONFIG_DNS_SERVER_IP_ADDRESSES=y
CONFIG_DNS_SERVER1="fdaa:bb:1::2"

# OpenThread
CONFIG_OPENTHREAD_JOINER=y
CONFIG_OPENTHREAD_JOINER_AUTOSTART=y
CONFIG_OPENTHREAD_MANUAL_START=y
CONFIG_OPENTHREAD_SLAAC=y
CONFIG_OPENTHREAD_JOINER_PSKD="J01NME"
CONFIG_OPENTHREAD_FTD=y

# MbedTLS and security
CONFIG_MBEDTLS=y
CONFIG_MBEDTLS_KEY_EXCHANGE_PSK_ENABLED=y
CONFIG_MBEDTLS_KEY_EXCHANGE_ECDHE_ECDSA_ENABLED=y
CONFIG_MBEDTLS_DTLS=y
CONFIG_MBEDTLS_ENTROPY_ENABLED=y

# Shell settings
CONFIG_SHELL_MINIMAL=y
CONFIG_SHELL_WILDCARD=n
CONFIG_SHELL_VT100_COMMANDS=y
CONFIG_SHELL_VT100_COLORS=n
CONFIG_SHELL_STATS=n
CONFIG_SHELL_CMDS=n
CONFIG_SHELL_TAB=y
CONFIG_SHELL_TAB_AUTOCOMPLETION=y
CONFIG_SHELL_CMDS_RESIZE=n
CONFIG_DEVICE_SHELL=n
CONFIG_DATE_SHELL=n
CONFIG_DEVMEM_SHELL=n
CONFIG_MCUBOOT_SHELL=n
CONFIG_KERNEL_SHELL=y
CONFIG_OPENTHREAD_SHELL=y
```

## samples/anjay_lwm2m_client/boards/nrf9160dk_nrf9160_ns.conf
```kconfig
# anjay-zephyr-client
CONFIG_ANJAY_ZEPHYR_DEVICE_MANUFACTURER="Nordic Semiconductor"
CONFIG_ANJAY_ZEPHYR_MODEL_NUMBER="nRF9160DK"
CONFIG_ANJAY_ZEPHYR_GPS_NRF=y
CONFIG_ANJAY_ZEPHYR_GPS_NRF_A_GPS=y

CONFIG_ANJAY_ZEPHYR_FOTA=y

# Anjay Settings
CONFIG_ANJAY_COMPAT_ZEPHYR_TLS=y
CONFIG_ANJAY_COMPAT_NET=y
CONFIG_ANJAY_COMPAT_TIME=y
CONFIG_ANJAY_LOG_LEVEL_INF=y
CONFIG_ANJAY_WITH_NET_STATS=n
CONFIG_ANJAY_WITH_SENML_JSON=y
CONFIG_ANJAY_WITH_TRACE_LOGS=n
CONFIG_ANJAY_WITH_ACCESS_CONTROL=n

# General Settings
CONFIG_MAIN_STACK_SIZE=2048
CONFIG_SYSTEM_WORKQUEUE_STACK_SIZE=4096
CONFIG_LOG_RUNTIME_FILTERING=n
CONFIG_LOG_CMDS=n
CONFIG_LOG_MAX_LEVEL=3
CONFIG_HWINFO=n

# Networking
CONFIG_NET_NATIVE=n
CONFIG_NET_IF_MAX_IPV4_COUNT=2
CONFIG_NET_TCP_ISN_RFC6528=n
CONFIG_NET_LOG=n

# nRF LTE
CONFIG_NRF_MODEM_LIB=y
CONFIG_MODEM_INFO=y
CONFIG_LTE_LINK_CONTROL=y
CONFIG_LTE_NETWORK_MODE_LTE_M_GPS=y
CONFIG_LTE_AUTO_INIT_AND_CONNECT=n
CONFIG_LTE_NETWORK_TIMEOUT=600
CONFIG_NRF_CLOUD_AGPS=y
CONFIG_NRF_CLOUD_GPS_LOG_LEVEL_INF=y

# Clock synchronization
CONFIG_DATE_TIME=y
CONFIG_DATE_TIME_UPDATE_INTERVAL_SECONDS=600
CONFIG_DATE_TIME_TOO_OLD_SECONDS=600
CONFIG_DATE_TIME_NTP_QUERY_TIME_SECONDS=5

# File system
CONFIG_FLASH_PAGE_LAYOUT=y
CONFIG_MPU_ALLOW_FLASH_WRITE=y

# Heap
CONFIG_HEAP_MEM_POOL_SIZE=2048

# MCUboot
CONFIG_BOOTLOADER_MCUBOOT=y
CONFIG_IMG_MANAGER=y
CONFIG_IMG_ERASE_PROGRESSIVELY=y
# TODO: consider a deploy script, which will fill in the release version into config variable below
# Warning: MCUBoot's imgtool doesn't allow leading zeros in version string components, that may be a bug
CONFIG_MCUBOOT_IMAGE_VERSION="22.12.0"

# Shell settings
CONFIG_SHELL_MINIMAL=y
CONFIG_SHELL_WILDCARD=n
CONFIG_SHELL_VT100_COMMANDS=y
CONFIG_SHELL_VT100_COLORS=n
CONFIG_SHELL_STATS=n
CONFIG_SHELL_CMDS=n
CONFIG_SHELL_TAB=y
CONFIG_SHELL_TAB_AUTOCOMPLETION=y
CONFIG_SHELL_CMDS_RESIZE=n
CONFIG_DEVICE_SHELL=n
CONFIG_DATE_SHELL=n
CONFIG_DEVMEM_SHELL=n
CONFIG_MCUBOOT_SHELL=n
CONFIG_KERNEL_SHELL=y
```

## samples/anjay_lwm2m_client/child_image/mcuboot/boards/nrf9160dk_nrf9160_extflash.conf
```kconfig
# Before reading notice below, please refer to nRF Connect SDK docs.
# https://developer.nordicsemi.com/nRF_Connect_SDK/doc/1.9.1/nrf/ug_multi_image.html#image-specific-variables
# This is file (F) by notation used in doc above.

# Because we need to set some board-dependent variables in MCUBoot child image,
# (F) file was created. (F) requires (H) to exist, and (H) completely replaces (B),
# thus (H) was created by copying (B) file. Keep in mind, that if a (D) file exists
# for some board, the (F) file should also be based on (D).

### anjay-zephyr-client
CONFIG_PM_PARTITION_SIZE_MCUBOOT=0x10000
CONFIG_PM_PARTITION_SIZE_MCUBOOT_PAD=0x200
CONFIG_PM_PARTITION_SIZE_MCUBOOT_SCRATCH=0x10000

# External flash config
CONFIG_SPI=y
CONFIG_SPI_NOR=y
CONFIG_SPI_NOR_FLASH_LAYOUT_PAGE_SIZE=4096
CONFIG_SPI_NOR_SFDP_DEVICETREE=y
```

## samples/anjay_lwm2m_client/sample.yaml
```yaml
sample:
  name: Anjay LwM2M client
tests:
  sample.anjay_lwm2m_client:
    build_only: true
    integration_platforms:
      - nrf9160dk_nrf9160_ns
      - thingy91_nrf9160_ns
      - nrf52840dk_nrf52840
    platform_allow: nrf9160dk_nrf9160_ns thingy91_nrf9160_ns nrf52840dk_nrf52840
    tags: ci_build
```

## samples/app_event_manager/sample.yaml
```yaml
sample:
  description: Sample showing Application Event Manager usage
  name: Application Event Manager sample
common:
  harness: console
  harness_config:
    ordered: false
    regex:
      - "config_event"
      - "measurement_event"
      - "control_event"
      - "ack_event"
      - "Average value3: 45"
    type: multi_line
tests:
  sample.app_event_manager:
    sysbuild: true
    build_only: false
    platform_allow:
      - qemu_cortex_m3
      - nrf52dk/nrf52832
      - nrf52840dk/nrf52840
      - nrf5340dk/nrf5340/cpuapp
      - nrf5340dk/nrf5340/cpuapp/ns
      - nrf9160dk/nrf9160/ns
      - nrf21540dk/nrf52840
      - nrf54h20dk/nrf54h20/cpuapp
    integration_platforms:
      - qemu_cortex_m3
      - nrf52dk/nrf52832
      - nrf52840dk/nrf52840
      - nrf5340dk/nrf5340/cpuapp
      - nrf5340dk/nrf5340/cpuapp/ns
      - nrf9160dk/nrf9160/ns
      - nrf21540dk/nrf52840
      - nrf54h20dk/nrf54h20/cpuapp
    tags:
      - sysbuild
      - ci_samples_app_event_manager
  sample.app_event_manager_shell:
    sysbuild: true
    build_only: false
    platform_allow:
      - qemu_cortex_m3
      - nrf52dk/nrf52832
      - nrf52840dk/nrf52840
      - nrf5340dk/nrf5340/cpuapp
      - nrf5340dk/nrf5340/cpuapp/ns
      - nrf9160dk/nrf9160/ns
      - nrf21540dk/nrf52840
      - nrf54h20dk/nrf54h20/cpuapp
    integration_platforms:
      - qemu_cortex_m3
      - nrf52dk/nrf52832
      - nrf52840dk/nrf52840
      - nrf5340dk/nrf5340/cpuapp
      - nrf5340dk/nrf5340/cpuapp/ns
      - nrf9160dk/nrf9160/ns
      - nrf21540dk/nrf52840
      - nrf54h20dk/nrf54h20/cpuapp
    extra_configs:
      - CONFIG_SHELL=y
    platform_exclude: native_sim
    tags:
      - sysbuild
      - ci_samples_app_event_manager
  sample.app_event_manager_shell.native_sim:
    sysbuild: true
    build_only: false
    extra_configs:
      - CONFIG_SHELL=y
      - CONFIG_NATIVE_UART_0_ON_STDINOUT=y
    platform_allow: native_sim
    integration_platforms:
      - native_sim
    tags:
      - sysbuild
      - ci_samples_app_event_manager
```

## samples/app_event_manager_profiler_tracer/sample.yaml
```yaml
sample:
  description: Sample showing usage of profiling Application Event Manager events
  name: Application Event Manager profiler tracer sample
tests:
  sample.app_event_manager_profiler_tracer:
    sysbuild: true
    build_only: true
    platform_exclude: native_posix
    platform_allow:
      - nrf52dk/nrf52832
      - nrf52840dk/nrf52840
      - nrf9160dk/nrf9160/ns
      - nrf21540dk/nrf52840
    integration_platforms:
      - nrf52dk/nrf52832
      - nrf52840dk/nrf52840
      - nrf9160dk/nrf9160/ns
      - nrf21540dk/nrf52840
    tags: ci_build sysbuild
```

## samples/app_jwt/Kconfig
```kconfig
#
# Copyright (c) 2024 Nordic Semiconductor ASA
#
# SPDX-License-Identifier: LicenseRef-Nordic-5-Clause
#

menu "Application JWT"

module = APPLICATION_JWT
module-str = Application JWT
source "$(ZEPHYR_BASE)/subsys/logging/Kconfig.template.log_config"

endmenu

menu "Zephyr Kernel"
source "Kconfig.zephyr"
endmenu
```

## samples/app_jwt/sample.yaml
```yaml
sample:
  name: Application JWT Sample
  description: |
    Sample demonstrating how to generate a JSON web token (JWT).

common:
  build_only: true
  tags:
    - sysbuild
    - ci_build
    - ci_samples_app_jwt

tests:
  sample.app_jwt:
    sysbuild: true
    platform_allow:
      - nrf54h20dk/nrf54h20/cpuapp
      - nrf9251dk/nrf9251/cpuapp
    integration_platforms:
      - nrf54h20dk/nrf54h20/cpuapp
      - nrf9251dk/nrf9251/cpuapp
```

## samples/basic/blinky/sample.yaml
```yaml
sample:
  name: Blinky Sample
common:
  tags:
    - LED
    - gpio
    - ci_tests_drivers_sdp
  depends_on: gpio
tests:

  nrf.extended.sample.basic.blinky.sdp.gpio.icmsg:
    sysbuild: true
    platform_allow:
      - nrf54l15dk/nrf54l15/cpuapp
    integration_platforms:
      - nrf54l15dk/nrf54l15/cpuapp
    extra_args:
      - SB_CONFIG_SDP=y
      - SB_CONFIG_SDP_GPIO=y
      - SB_CONFIG_SDP_GPIO_BACKEND_ICMSG=y
      - SB_CONFIG_PARTITION_MANAGER=n
      - EXTRA_DTC_OVERLAY_FILE="./boards/nrf54l15dk_nrf54l15_cpuapp_egpio.overlay"
    harness: console
    harness_config:
      type: multi_line
      ordered: true
      regex:
        - "LED state: ON"
        - "LED state: OFF"

  nrf.extended.sample.basic.blinky.sdp.gpio.mbox:
    sysbuild: true
    platform_allow:
      - nrf54l15dk/nrf54l15/cpuapp
    integration_platforms:
      - nrf54l15dk/nrf54l15/cpuapp
    extra_args:
      - SB_CONFIG_SDP=y
      - SB_CONFIG_SDP_GPIO=y
      - SB_CONFIG_SDP_GPIO_BACKEND_MBOX=y
      - SB_CONFIG_PARTITION_MANAGER=n
      - EXTRA_DTC_OVERLAY_FILE="./boards/nrf54l15dk_nrf54l15_cpuapp_egpio.overlay"
    harness: console
    harness_config:
      type: multi_line
      ordered: true
      regex:
        - "LED state: ON"
        - "LED state: OFF"

  nrf.extended.sample.basic.blinky.sdp.gpio.icbmsg:
    sysbuild: true
    platform_allow:
      - nrf54l15dk/nrf54l15/cpuapp
    integration_platforms:
      - nrf54l15dk/nrf54l15/cpuapp
    extra_args:
      - SB_CONFIG_SDP=y
      - SB_CONFIG_SDP_GPIO=y
      - SB_CONFIG_SDP_GPIO_BACKEND_ICBMSG=y
      - SB_CONFIG_PARTITION_MANAGER=n
      - EXTRA_DTC_OVERLAY_FILE="./boards/nrf54l15dk_nrf54l15_cpuapp_egpio.overlay"
    harness: console
    harness_config:
      type: multi_line
      ordered: true
      regex:
        - "LED state: ON"
        - "LED state: OFF"
```

## samples/basic/empty/sample.yaml
```yaml
sample:
  description: Minimal configuration sample that works as empty network (or other) core image.
  name: Empty firmware for multicore MCUs
tests:
  sample.basic.empty:
    sysbuild: true
    build_only: true
    integration_platforms:
      - nrf5340dk/nrf5340/cpunet
      - thingy53/nrf5340/cpunet
      - nrf54l15dk/nrf54l15/cpuflpr
      - nrf54h20dk/nrf54h20/cpuflpr
      - nrf54h20dk/nrf54h20/cpuppr
    platform_allow:
      - nrf5340dk/nrf5340/cpunet
      - thingy53/nrf5340/cpunet
      - nrf54l15dk/nrf54l15/cpuflpr
      - nrf54h20dk/nrf54h20/cpuflpr
      - nrf54h20dk/nrf54h20/cpuppr
    tags:
      - ci_build
      - sysbuild
      - ci_samples_nrf5340
```
