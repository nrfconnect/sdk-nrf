## samples/benchmarks/coremark/Kconfig
```kconfig
#
# Copyright (c) 2024 Nordic Semiconductor ASA
#
# SPDX-License-Identifier: LicenseRef-Nordic-5-Clause
#

menu "CoreMark sample"

config APP_BUTTON_AND_LED_SUPPORTED
	bool
	default y if $(dt_alias_enabled,button) && $(dt_alias_enabled,led)

config APP_MODE_FLASH_AND_RUN
	bool "Run CoreMark benchmark on start up" if APP_BUTTON_AND_LED_SUPPORTED
	default y if !APP_BUTTON_AND_LED_SUPPORTED
	help
	  If enabled, CoreMark will start execution immediately after the CPU starts up.
	  It also disables LEDs and buttons.
	  Otherwise, it will wait for the button press.

endmenu

menu "Zephyr Kernel"
	source "Kconfig.zephyr"
endmenu
```

## samples/benchmarks/coremark/Kconfig.sysbuild
```kconfig
#
# Copyright (c) 2024 Nordic Semiconductor ASA
#
# SPDX-License-Identifier: LicenseRef-Nordic-5-Clause
#

config PARTITION_MANAGER
	default n

config APP_CPUFLPR_RUN
	bool "Run the CoreMark benchmark on the FLPR core"
	depends on SUPPORT_FLPRCORE
	default y

config APP_CPUNET_RUN
	bool "Run the CoreMark benchmark on the network or radio core"
	depends on SUPPORT_NETCORE
	default y

config APP_CPUPPR_RUN
	bool "Run the CoreMark benchmark on the PPR core"
	depends on SUPPORT_PPRCORE
	default y

source "share/sysbuild/Kconfig"
```

## samples/benchmarks/coremark/boards/Kconfig.sysbuild_boards
```kconfig
#
# Copyright (c) 2024 Nordic Semiconductor ASA
#
# SPDX-License-Identifier: LicenseRef-Nordic-5-Clause
#

if BOARD_NRF5340DK_NRF5340_CPUAPP

config APP_CPUNET_RUN
	bool "Run the CoreMark benchmark on the nRF5340 network core"
	default y

config IMAGE_2_BOARD
	default "nrf5340dk/nrf5340/cpunet" if APP_CPUNET_RUN

endif

if BOARD_NRF54H20DK_NRF54H20_CPUAPP

config APP_CPUNET_RUN
	bool "Run the CoreMark benchmark on the nRF54H20 radio core"
	default y

config APP_CPUPPR_RUN
	bool "Run the CoreMark benchmark on the nRF54H20 PPR core"
	depends on !APP_CPUNET_RUN
	help
	  Due to the limited number of UART ports, you can run the CoreMark benchmark only on two
	  cores at a time; application core and either radio core or PPR core.

	  PPR code is run from MRAM with the execution in place (XIP) method. You must use the
	  "nordic-ppr-xip" snippet for the application core to be able to boot the PPR core.
	  You need to provide the "coremark_SNIPPET=nordic-ppr-xip" build argument.

config IMAGE_2_BOARD
	default "nrf54h20dk/nrf54h20/cpurad" if APP_CPUNET_RUN

config IMAGE_3_BOARD
	default "nrf54h20dk/nrf54h20/cpuppr" if APP_CPUPPR_RUN

endif
```

## samples/benchmarks/coremark/boards/nrf5340dk_nrf5340_cpuapp.conf
```kconfig
#
# Copyright (c) 2024 Nordic Semiconductor ASA
#
# SPDX-License-Identifier: LicenseRef-Nordic-5-Clause

CONFIG_SOC_NRF53_CPUNET_ENABLE=y

CONFIG_LOG_MODE_IMMEDIATE=y
```

## samples/benchmarks/coremark/boards/nrf54h20dk_nrf54h20_cpuapp.conf
```kconfig
#
# Copyright (c) 2024 Nordic Semiconductor ASA
#
# SPDX-License-Identifier: LicenseRef-Nordic-5-Clause

CONFIG_COREMARK_ITERATIONS=10000

# Kconfigs required for the STM standalone logging, imported from the nordic-log-stm snippet.
CONFIG_TEST_LOGGING_DEFAULTS=n
CONFIG_LOG_FRONTEND=y
CONFIG_LOG_FRONTEND_ONLY=y
CONFIG_LOG_FRONTEND_STMESP=y
CONFIG_LOG_FRONTEND_STMESP_FSC=y

CONFIG_UART_ASYNC_API=y
```

## samples/benchmarks/coremark/boards/nrf54h20dk_nrf54h20_cpuflpr.conf
```kconfig
#
# Copyright (c) 2025 Nordic Semiconductor ASA
#
# SPDX-License-Identifier: LicenseRef-Nordic-5-Clause

CONFIG_COREMARK_ITERATIONS=10000

# Disable the UART console Kconfig to be consistent with the DTS configuration.
CONFIG_UART_CONSOLE=n

# Kconfigs required for the STM standalone logging, imported from the nordic-log-stm snippet.
CONFIG_TEST_LOGGING_DEFAULTS=n
CONFIG_LOG_FRONTEND=y
CONFIG_LOG_FRONTEND_ONLY=y
CONFIG_LOG_FRONTEND_STMESP=y
CONFIG_LOG_FRONTEND_STMESP_FSC=y

# Disable the NCS boot banner - the application core is responsible for printing the boot banner.
CONFIG_NCS_BOOT_BANNER=n
CONFIG_BOOT_BANNER=n

# Reduce speed optimizations to fit the sample into the TCM of the FLPR core.
# Removed the following options from the default configuration (prj.conf):
# -funroll-loops
CONFIG_COMPILER_OPT="-O3 -fno-lto"
```

## samples/benchmarks/coremark/boards/nrf54h20dk_nrf54h20_cpurad.conf
```kconfig
#
# Copyright (c) 2024 Nordic Semiconductor ASA
#
# SPDX-License-Identifier: LicenseRef-Nordic-5-Clause

CONFIG_COREMARK_ITERATIONS=10000

# Disable the UART console Kconfig to be consistent with the DTS configuration.
CONFIG_UART_CONSOLE=n

# Kconfigs required for the STM standalone logging, imported from the nordic-log-stm snippet.
CONFIG_TEST_LOGGING_DEFAULTS=n
CONFIG_LOG_FRONTEND=y
CONFIG_LOG_FRONTEND_ONLY=y
CONFIG_LOG_FRONTEND_STMESP=y
CONFIG_LOG_FRONTEND_STMESP_FSC=y

# Disable the NCS boot banner - the application core is responsible for printing the boot banner.
CONFIG_NCS_BOOT_BANNER=n
CONFIG_BOOT_BANNER=n
```

## samples/benchmarks/coremark/boards/nrf54l15dk_nrf54l05_cpuapp.conf
```kconfig
#
# Copyright (c) 2024 Nordic Semiconductor ASA
#
# SPDX-License-Identifier: LicenseRef-Nordic-5-Clause

CONFIG_COREMARK_ITERATIONS=4000

CONFIG_LOG_MODE_IMMEDIATE=y
```

## samples/benchmarks/coremark/boards/nrf9251dk_nrf9251_cpuppr.conf
```kconfig
#
# Copyright (c) 2026 Nordic Semiconductor ASA
#
# SPDX-License-Identifier: LicenseRef-Nordic-5-Clause

# The PPR core runs at a lower clock frequency, so fewer iterations are needed
# to reach the minimum run time required for valid results.
CONFIG_COREMARK_ITERATIONS=500

# The PPR core has no dedicated button and LED, so run the benchmark on start up.
CONFIG_APP_MODE_FLASH_AND_RUN=y

CONFIG_LOG_MODE_IMMEDIATE=y

# The application core is responsible for printing the boot banner.
CONFIG_NCS_BOOT_BANNER=n
CONFIG_BOOT_BANNER=n

# Reduce speed optimizations to fit the sample into the PPR core TCM.
# Removed the following options from the default configuration (prj.conf):
# -funroll-loops
CONFIG_COMPILER_OPT="-O3 -fno-lto"
```

## samples/benchmarks/coremark/sample.yaml
```yaml
sample:
  name: CoreMark Benchmark
  description: CoreMark sample for the CPU performance evaluation. Sample runs the
    CoreMark benchmark that measures the CPU efficiency performing different algorithms
    like state machine, CRC calculation, matrix manipulation and list processing (find
    and sort).
tests:
  sample.benchmark.coremark:
    sysbuild: true
    build_only: true
    platform_allow:
      - nrf52833dk/nrf52833
      - nrf52840dk/nrf52840
      - nrf52dk/nrf52832
      - nrf5340dk/nrf5340/cpuapp
      - nrf54h20dk/nrf54h20/cpuapp
      - nrf54l15dk/nrf54l05/cpuapp
      - nrf54l15dk/nrf54l10/cpuapp
      - nrf54l15dk/nrf54l15/cpuapp
      - nrf54lm20dk/nrf54lm20a/cpuapp
      - nrf54lv10dk/nrf54lv10a/cpuapp
      - nrf54ls05dk/nrf54ls05b/cpuapp
    integration_platforms:
      - nrf52840dk/nrf52840
      - nrf5340dk/nrf5340/cpuapp
      - nrf54h20dk/nrf54h20/cpuapp
      - nrf54l15dk/nrf54l15/cpuapp
      - nrf54lm20dk/nrf54lm20a/cpuapp
      - nrf54lv10dk/nrf54lv10a/cpuapp
      - nrf54ls05dk/nrf54ls05b/cpuapp
    tags:
      - ci_build
      - sysbuild
      - ci_samples_benchmarks
  sample.benchmark.coremark.flash_and_run:
    sysbuild: true
    build_only: false
    platform_allow:
      - nrf52833dk/nrf52833
      - nrf52840dk/nrf52840
      - nrf52dk/nrf52832
      - nrf5340dk/nrf5340/cpuapp
      - nrf54h20dk/nrf54h20/cpuapp
      - nrf54l15dk/nrf54l05/cpuapp
      - nrf54l15dk/nrf54l10/cpuapp
      - nrf54l15dk/nrf54l15/cpuapp
      - nrf54lm20dk/nrf54lm20a/cpuapp
      - nrf54lv10dk/nrf54lv10a/cpuapp
      - nrf54ls05dk/nrf54ls05b/cpuapp
    integration_platforms:
      - nrf52840dk/nrf52840
      - nrf5340dk/nrf5340/cpuapp
      - nrf54h20dk/nrf54h20/cpuapp
      - nrf54l15dk/nrf54l05/cpuapp
      - nrf54l15dk/nrf54l10/cpuapp
      - nrf54l15dk/nrf54l15/cpuapp
      - nrf54lm20dk/nrf54lm20a/cpuapp
      - nrf54lv10dk/nrf54lv10a/cpuapp
      - nrf54ls05dk/nrf54ls05b/cpuapp
    tags:
      - ci_build
      - sysbuild
      - ci_samples_benchmarks
    harness: console
    harness_config:
      ordered: false
      regex:
        - "CoreMark started!"
        - "Correct operation validated."
      type: multi_line
    extra_args: FILE_SUFFIX=flash_and_run
  sample.benchmark.coremark.flash_and_run.nrf7120:
    sysbuild: true
    build_only: false
    platform_allow:
      - nrf7120dk/nrf7120/cpuapp
    integration_platforms:
      - nrf7120dk/nrf7120/cpuapp
    tags:
      - ci_build
      - sysbuild
      - ci_samples_benchmarks
    harness: console
    harness_config:
      ordered: false
      regex:
        - "CoreMark started!"
        - "Correct operation validated."
      type: multi_line
    timeout: 180
    extra_args: FILE_SUFFIX=flash_and_run
  sample.benchmark.coremark.heap_memory:
    sysbuild: true
    build_only: true
    platform_allow:
      - nrf52833dk/nrf52833
      - nrf52840dk/nrf52840
      - nrf52dk/nrf52832
      - nrf5340dk/nrf5340/cpuapp
      - nrf54h20dk/nrf54h20/cpuapp
      - nrf54l15dk/nrf54l05/cpuapp
      - nrf54l15dk/nrf54l10/cpuapp
      - nrf54l15dk/nrf54l15/cpuapp
      - nrf54lm20dk/nrf54lm20a/cpuapp
      - nrf54lv10dk/nrf54lv10a/cpuapp
      - nrf54ls05dk/nrf54ls05b/cpuapp
    integration_platforms:
      - nrf52840dk/nrf52840
      - nrf54ls05dk/nrf54ls05b/cpuapp
    tags:
      - ci_build
      - sysbuild
      - ci_samples_benchmarks
    extra_args: FILE_SUFFIX=heap_memory
  sample.benchmark.coremark.static_memory:
    sysbuild: true
    build_only: true
    platform_allow:
      - nrf52833dk/nrf52833
      - nrf52840dk/nrf52840
      - nrf52dk/nrf52832
      - nrf5340dk/nrf5340/cpuapp
      - nrf54h20dk/nrf54h20/cpuapp
      - nrf54l15dk/nrf54l05/cpuapp
      - nrf54l15dk/nrf54l10/cpuapp
      - nrf54l15dk/nrf54l15/cpuapp
      - nrf54lm20dk/nrf54lm20a/cpuapp
      - nrf54lv10dk/nrf54lv10a/cpuapp
      - nrf54ls05dk/nrf54ls05b/cpuapp
    integration_platforms:
      - nrf52840dk/nrf52840
      - nrf54ls05dk/nrf54ls05b/cpuapp
    tags:
      - ci_build
      - sysbuild
      - ci_samples_benchmarks
    extra_args: FILE_SUFFIX=static_memory
  sample.benchmark.coremark.multiple_threads:
    sysbuild: true
    build_only: true
    platform_allow:
      - nrf52833dk/nrf52833
      - nrf52840dk/nrf52840
      - nrf52dk/nrf52832
      - nrf5340dk/nrf5340/cpuapp
      - nrf54h20dk/nrf54h20/cpuapp
      - nrf54l15dk/nrf54l05/cpuapp
      - nrf54l15dk/nrf54l10/cpuapp
      - nrf54l15dk/nrf54l15/cpuapp
      - nrf54lm20dk/nrf54lm20a/cpuapp
      - nrf54lv10dk/nrf54lv10a/cpuapp
      - nrf54ls05dk/nrf54ls05b/cpuapp
    integration_platforms:
      - nrf52840dk/nrf52840
      - nrf54ls05dk/nrf54ls05b/cpuapp
    tags:
      - ci_build
      - sysbuild
      - ci_samples_benchmarks
    extra_args: FILE_SUFFIX=multiple_threads
```

## samples/blinky_mcuboot/sample.yaml
```yaml
sample:
  description: Zigbee Blinky sample for upgrading nrf5340 APP+NET 
  name: Zigbee Blinky mcuboot
tests:
  sample.zigbee.shell:
    build_only: true
    sysbuild: false
    integration_platforms:
      - nrf5340dk/nrf5340/cpuapp
      - nrf5340dk/nrf5340/cpuapp/ns
    platform_allow: nrf5340dk/nrf5340/cpuapp nrf5340dk/nrf5340/cpuapp/ns
    tags: ci_build
```
