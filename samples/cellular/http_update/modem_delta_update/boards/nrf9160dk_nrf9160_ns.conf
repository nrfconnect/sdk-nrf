## samples/cellular/lwm2m_client/boards/thingy91x_nrf9151_ns.conf
```kconfig
## Thingy:91 X specific config settings ##
# App
CONFIG_APP_GNSS=y
CONFIG_APP_LIGHT_CONTROL=y
CONFIG_APP_PUSH_BUTTON=y
CONFIG_APP_ENV_SENSOR=y
CONFIG_APP_GAS_RES_SENSOR=y
CONFIG_APP_HUMID_SENSOR=y
CONFIG_APP_PRESS_SENSOR=y
CONFIG_APP_TEMP_SENSOR=y

# UI
CONFIG_UI_LED_USE_PWM=y

# External flash
CONFIG_SPI=y
CONFIG_SPI_NOR=y
CONFIG_STREAM_FLASH_ERASE=y
CONFIG_FLASH=y

# Sensors
CONFIG_BME680=y

# IPSO
CONFIG_LWM2M_IPSO_PUSH_BUTTON_INSTANCE_COUNT=1
CONFIG_LWM2M_IPSO_LIGHT_CONTROL_INSTANCE_COUNT=1
CONFIG_LWM2M_IPSO_PUSH_BUTTON_VERSION_1_1=y
CONFIG_LWM2M_IPSO_GENERIC_SENSOR_VERSION_1_1=y
CONFIG_LWM2M_IPSO_HUMIDITY_SENSOR_VERSION_1_1=y
CONFIG_LWM2M_IPSO_PRESSURE_SENSOR_VERSION_1_1=y
CONFIG_LWM2M_IPSO_TEMP_SENSOR_VERSION_1_1=y
# CONFIG_LWM2M_IPSO_ACCELEROMETER_VERSION_1_1=y

# Sensor module
CONFIG_SENSOR_MODULE=y
CONFIG_SENSOR_MODULE_TEMP=y
CONFIG_SENSOR_MODULE_PRESS=y
CONFIG_SENSOR_MODULE_HUMID=y
CONFIG_SENSOR_MODULE_GAS_RES=y
```

## samples/cellular/lwm2m_client/dts/bindings/pwm-buzzer.yaml
```yaml
# Copyright (c) 2022 Nordic Semiconductor
#
# SPDX-License-Identifier: LicenseRef-Nordic-5-Clause

description: |
    This is a representation of a buzzer controlled by a PWM signal. Example
    usage:

      buzzer {
        compatible = "pwm-buzzer";
        pwms = <&pwm0 0 PWM_HZ(440) PWM_POLARITY_NORMAL>;
      };

compatible: "pwm-buzzer"

include: base.yaml

properties:
  pwms:
    type: phandle-array
    required: true
```

## samples/cellular/lwm2m_client/src/fota_external/Kconfig
```kconfig
#
# Copyright (c) 2023 Nordic Semiconductor ASA
#
# SPDX-License-Identifier: LicenseRef-Nordic-5-Clause
#

config APP_SMP_CLIENT_FOTA_EXTERNAL
	bool "Enable SMP FOTA external client"
	depends on NRF_MCUMGR_SMP_CLIENT

if APP_SMP_CLIENT_FOTA_EXTERNAL

config APP_SMP_SERVER_RECOVERY_MODE
	bool "Enable Reset line for activate MCUBoot recovery"

endif # APP_SMP_CLIENT_FOTA_EXTERNAL
```

## samples/cellular/lwm2m_client/src/ipso/Kconfig.ipso_colour_sensor
```kconfig
#
# Copyright (c) 2021 Nordic Semiconductor ASA
#
# SPDX-License-Identifier: LicenseRef-Nordic-5-Clause
#

config LWM2M_IPSO_APP_COLOUR_SENSOR
	bool
	help
	  This IPSO object should be used to report the measured value of a colour sensor in some colour
	  space described by the units resource.

if LWM2M_IPSO_APP_COLOUR_SENSOR
config LWM2M_IPSO_APP_COLOUR_SENSOR_INSTANCE_COUNT
	int
	default 2
	help
	  Total count of IPSO Colour instances available to the LWM2M client.

choice
	prompt "Select IPSO Colour object version"
	default LWM2M_IPSO_APP_COLOUR_SENSOR_VERSION_1_0

config LWM2M_IPSO_APP_COLOUR_SENSOR_VERSION_1_0
	bool "Version 1.0"

config LWM2M_IPSO_APP_COLOUR_SENSOR_VERSION_1_1
	bool "Version 1.1"
endchoice # IPSO Colour object version
endif # LWM2M_IPSO_APP_COLOUR_SENSOR
```

## samples/cellular/lwm2m_client/src/lwm2m/Kconfig
```kconfig
#
# Copyright (c) 2021 Nordic Semiconductor ASA
#
# SPDX-License-Identifier: LicenseRef-Nordic-5-Clause
#

config LWM2M_APP_ACCELEROMETER
	bool
	select LWM2M_IPSO_ACCELEROMETER
	select ACCELEROMETER
	help
	  Create LWM2M accelerometer object.

config LWM2M_APP_PUSH_BUTTON
	bool
	select LWM2M_IPSO_PUSH_BUTTON
	select UI_INPUT
	help
	  Create button LWM2M object(s).
	  The nRF91 series DK will have two object instances, one for each push button.

config LWM2M_APP_ONOFF_SWITCH
	bool
	select LWM2M_IPSO_ONOFF_SWITCH
	select UI_INPUT
	help
	  Create two on/off switch LWM2M objects.

config LWM2M_APP_BUZZER
	bool
	select LWM2M_IPSO_BUZZER
	depends on UI_BUZZER
	help
	  Create a buzzer LWM2M object.
	  Should not be enabled on the nRF91 series DK, as it has no buzzer.

config LWM2M_APP_TEMP_SENSOR
	bool
	depends on LWM2M_IPSO_TEMP_SENSOR
	help
	  Create temperature sensor LwM2M object.

config LWM2M_APP_PRESS_SENSOR
	bool
	depends on LWM2M_IPSO_PRESSURE_SENSOR
	help
	  Create air pressure sensor LwM2M object.

config LWM2M_APP_HUMID_SENSOR
	bool
	depends on LWM2M_IPSO_HUMIDITY_SENSOR
	help
	  Create air humidity sensor LwM2M object.

config LWM2M_APP_GAS_RES_SENSOR
	bool
	depends on LWM2M_IPSO_GENERIC_SENSOR
	help
	  Create gas resistance sensor LwM2M object.

config LWM2M_APP_LIGHT_CONTROL
	bool
	depends on LWM2M_IPSO_LIGHT_CONTROL
	depends on UI_LED
	help
	  Create light control LWM2M object(s).
	  The nRF91 series DK will have multiple object instances (one for each LED), if UI_LED_USE_GPIO is
	  chosen.

config LWM2M_APP_LIGHT_SENSOR
	bool
	depends on LWM2M_IPSO_APP_COLOUR_SENSOR
	depends on LIGHT_SENSOR
	help
	  Create LWM2M light sensor objects.
	  It uses the IPSO Colour object.
```

## samples/cellular/lwm2m_client/src/sensors/Kconfig.accelerometer
```kconfig
#
# Copyright (c) 2021 Nordic Semiconductor ASA
#
# SPDX-License-Identifier: LicenseRef-Nordic-5-Clause
#

config ACCELEROMETER
	bool
	help
	  Enable accelerometer

if ACCELEROMETER

config ACCEL_CALIBRATE_ON_STARTUP
	bool "Calibrate the accelerometer on startup"
	default y
	help
	  Calibrate the accelerometer on a flat surface to filter away static measurement offset that
	  could affect orientation detection.

if ACCEL_CALIBRATE_ON_STARTUP
config ACCEL_CALIBRATION_ITERATIONS
	int "Number of measurements per channel during calibration"
	default 5
	help
	  Number of measurements taken during calibration.
	  Higher number will give more accurate calibration, but takes longer time.
endif # ACCEL_CALIBRATE_ON_STARTUP
endif # ACCELEROMETER
```

## samples/cellular/lwm2m_client/src/sensors/Kconfig.env_sensor
```kconfig
#
# Copyright (c) 2021 Nordic Semiconductor ASA
#
# SPDX-License-Identifier: LicenseRef-Nordic-5-Clause
#

config ENVIRONMENT_SENSOR
	bool
	help
	  Enable the environment sensor device.

if ENVIRONMENT_SENSOR

config ENV_SENSOR_GAS_RES_SIM_BASE
	int "Base value of simulated gas resistance value"
	default 10000
	help
	  Gas resistance in Ohm that will be used as a baseline when simulating
	  gas resistance data.

config ENV_SENSOR_GAS_RES_SIM_MAX_DIFF
	int "Max difference from base value of simulated gas resistance"
	default 1000
	help
	  Maximum difference from the base value when simulating gas resistance
	  data.

endif # ENVIRONMENT_SENSOR
```

## samples/cellular/lwm2m_client/src/sensors/Kconfig.gnss
```kconfig
#
# Copyright (c) 2021 Nordic Semiconductor ASA
#
# SPDX-License-Identifier: LicenseRef-Nordic-5-Clause
#

config GNSS
	bool
	help
	  Enable GNSS

if GNSS

config GNSS_SEARCH_INTERVAL_TIME
	int "GNSS search interval [s]"
	default 300
	help
	  Length of time between GNSS searches in seconds.

config GNSS_SEARCH_TIMEOUT_TIME
	int "GNSS search timeout [s]"
	default 150
	help
	  Length of time the GNSS can spend looking for a fix in seconds.
	  In areas with poor connection, this should be increased.

config GNSS_PRIORITY_ON_FIRST_FIX
	bool "Give GNSS priority when looking for first fix"
	help
	  Gives the GNSS priority while it is performing its first search.
	  Enabling this will make it significantly easier for the GNSS module to find a position, but
	  will also affect performance for the rest of the app.
	  Subsequent fixes are much quicker and therefore no priority is needed.

endif #GNSS
```

## samples/cellular/lwm2m_client/src/sensors/Kconfig.light_sensor
```kconfig
#
# Copyright (c) 2021 Nordic Semiconductor ASA
#
# SPDX-License-Identifier: LicenseRef-Nordic-5-Clause
#

config LIGHT_SENSOR
	bool
	help
	  Enable the light sensor device.

if LIGHT_SENSOR

config LIGHT_SENSOR_LIGHT_MEASUREMENT_MAX_VALUE
	int "Max expected light sensor output value"
	default 500
	help
	  Maximum value expected from the light sensor.
	  Used to scale each color measurement to an 8-bit, unsigned integer.
	  Reasonable values will depend on the sensors environment.
	  Max of a series of raw measurements during particular use conditions can give a good estimate
	  (for that condition).

config LIGHT_SENSOR_COLOUR_MEASUREMENT_MAX_VALUE
	int "Max expected colour sensor output value"
	default 500
	help
	  Maximum value expected from the colour sensor.
	  Used to scale each color measurement to an 8-bit, unsigned integer.
	  Reasonable values will depend on the sensors environment.
	  Max of a series of raw measurements during particular use conditions can give a good estimate
	  (for that condition).

config LIGHT_SENSOR_LIGHT_SIM_VAL
	int "Base value of simulated light values"
	default 250
	help
	  Baseline of simulated light value.
	  Note: Baseline value + max variance value < max expected value.

config LIGHT_SENSOR_COLOUR_SIM_VAL
	int "Base value of simulated colour values"
	default 250
	help
	  Baseline of simulated colour value.
	  Note: Baseline value + max variance value < max expected value.

config LIGHT_SENSOR_LIGHT_SIM_MAX_DIFF
	int "Max difference from light base value of simulated light value"
	default 250
	help
	  Maximum difference from the base value when simulating light data.

config LIGHT_SENSOR_COLOUR_SIM_MAX_DIFF
	int "Max difference from colour base value of simulated colour value"
	default 250
	help
	  Maximum difference from the base value when simulating colour data.

endif # LIGHT_SENSOR
```

## samples/cellular/lwm2m_client/src/ui/Kconfig.ui_led
```kconfig
#
# Copyright (c) 2021 Nordic Semiconductor ASA
#
# SPDX-License-Identifier: LicenseRef-Nordic-5-Clause
#

if UI_LED
choice
	prompt "Select LED device"
	default UI_LED_USE_GPIO
	help
	  Select which device is used for controlling the LEDs.

config UI_LED_USE_PWM
	bool "Use PWM to control LEDs"
	select PWM
	select PWM_0
	help
	  If enabled, LEDs will be controlled with PWM.

config UI_LED_USE_GPIO
	bool "Use GPIO to control LEDs"
	select GPIO
	help
	  If enabled, LEDs will be controlled with GPIO.
endchoice # LED device
endif # UI_LED
```
