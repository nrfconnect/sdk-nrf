## samples/cellular/http_update/modem_delta_update/boards/nrf9160dk_nrf9160_ns.conf
```kconfig
# Copyright (c) 2023 Nordic Semiconductor ASA
#
# SPDX-License-Identifier: LicenseRef-Nordic-5-Clause
#

# Modem firmware version configuration
CONFIG_SUPPORTED_BASE_VERSION="mfw_nrf9160_1.3.6"
CONFIG_DOWNLOAD_FILE_BASE_TO_FOTA_TEST="mfw_nrf9160_update_from_1.3.6_to_1.3.6-FOTA-TEST.bin"
CONFIG_DOWNLOAD_FILE_FOTA_TEST_TO_BASE="mfw_nrf9160_update_from_1.3.6-FOTA-TEST_to_1.3.6.bin"
```

## samples/cellular/http_update/modem_delta_update/boards/nrf9161dk_nrf9161_ns.conf
```kconfig
# Copyright (c) 2023-2024 Nordic Semiconductor ASA
#
# SPDX-License-Identifier: LicenseRef-Nordic-5-Clause
#

# Modem firmware version configuration
CONFIG_SUPPORTED_BASE_VERSION="mfw_nrf91x1_2.0.0"
CONFIG_DOWNLOAD_FILE_BASE_TO_FOTA_TEST="mfw_nrf91x1_update_from_2.0.0_to_2.0.0-FOTA-TEST.bin"
CONFIG_DOWNLOAD_FILE_FOTA_TEST_TO_BASE="mfw_nrf91x1_update_from_2.0.0-FOTA-TEST_to_2.0.0.bin"
```

## samples/cellular/http_update/modem_full_update/boards/nrf9160dk_nrf9160_ns.conf
```kconfig
# Copyright (c) 2021-2023 Nordic Semiconductor ASA
#
# SPDX-License-Identifier: LicenseRef-Nordic-5-Clause
#

CONFIG_SPI=y
CONFIG_SPI_NOR=y

# Modem firmware version configuration
CONFIG_DOWNLOAD_MODEM_0_FILE="fmfu_1.3.5.cbor"
CONFIG_DOWNLOAD_MODEM_0_VERSION="mfw_nrf9160_1.3.5"

CONFIG_DOWNLOAD_MODEM_1_FILE="fmfu_1.3.6.cbor"
```

## samples/cellular/http_update/modem_full_update/boards/nrf9161dk_nrf9161_ns.conf
```kconfig
# Copyright (c) 2021-2024 Nordic Semiconductor ASA
#
# SPDX-License-Identifier: LicenseRef-Nordic-5-Clause
#

CONFIG_SPI=y
CONFIG_SPI_NOR=y

# Modem firmware version configuration
CONFIG_DOWNLOAD_MODEM_0_FILE="fmfu_2.0.0-77.beta.cbor"
CONFIG_DOWNLOAD_MODEM_0_VERSION="mfw_nrf91x1_2.0.0-77"

CONFIG_DOWNLOAD_MODEM_1_FILE="fmfu_2.0.0.cbor"
```

## samples/cellular/location/Kconfig
```kconfig
#
# Copyright (c) 2021 Nordic Semiconductor ASA
#
# SPDX-License-Identifier: LicenseRef-Nordic-5-Clause
#

menu "Location sample"

endmenu

menu "Zephyr Kernel"
source "Kconfig.zephyr"
endmenu
```

## samples/cellular/location/sample.yaml
```yaml
sample:
  name: location Sample
tests:
  sample.cellular.location:
    sysbuild: true
    build_only: true
    integration_platforms:
      - nrf9151dk/nrf9151/ns
      - nrf9160dk/nrf9160/ns
      - nrf9161dk/nrf9161/ns
      - thingy91/nrf9160/ns
      - thingy91x/nrf9151/ns
    platform_allow:
      - nrf9151dk/nrf9151/ns
      - nrf9160dk/nrf9160/ns
      - nrf9161dk/nrf9161/ns
      - thingy91/nrf9160/ns
      - thingy91x/nrf9151/ns
    tags: ci_build sysbuild ci_samples_cellular
  sample.cellular.location.pgps:
    sysbuild: true
    build_only: true
    extra_args: OVERLAY_CONFIG=overlay-pgps.conf
    integration_platforms:
      - nrf9151dk/nrf9151/ns
      - nrf9160dk/nrf9160/ns
      - nrf9161dk/nrf9161/ns
    platform_allow:
      - nrf9151dk/nrf9151/ns
      - nrf9160dk/nrf9160/ns
      - nrf9161dk/nrf9161/ns
    tags: ci_build sysbuild ci_samples_cellular
  sample.cellular.location.nrf7002ek_wifi:
    sysbuild: true
    build_only: true
    integration_platforms:
      - nrf9151dk/nrf9151/ns
      - nrf9160dk/nrf9160/ns
      - nrf9161dk/nrf9161/ns
    platform_allow:
      - nrf9151dk/nrf9151/ns
      - nrf9160dk/nrf9160/ns
      - nrf9161dk/nrf9161/ns
    extra_args: SHIELD=nrf7002ek_nrf7000 OVERLAY_CONFIG=overlay-nrf700x-wifi-scan-only.conf
                SB_CONFIG_WIFI_NRF70=y SB_CONFIG_WIFI_NRF70_SCAN_ONLY=y
    tags: ci_build sysbuild ci_samples_cellular
  sample.cellular.location.nrf7000ek_wifi:
    sysbuild: true
    build_only: true
    integration_platforms:
      - nrf9151dk/nrf9151/ns
      - nrf9160dk/nrf9160/ns
      - nrf9161dk/nrf9161/ns
    platform_allow:
      - nrf9151dk/nrf9151/ns
      - nrf9160dk/nrf9160/ns
      - nrf9161dk/nrf9161/ns
    extra_args: SHIELD=nrf7002ek_nrf7000 OVERLAY_CONFIG=overlay-nrf700x-wifi-scan-only.conf
                CONFIG_WIFI_NM_WPA_SUPPLICANT=n SB_CONFIG_WIFI_NRF70=y
                SB_CONFIG_WIFI_NRF70_SCAN_ONLY=y
    tags: ci_build sysbuild ci_samples_cellular
  sample.cellular.location.thingy91x_wifi:
    sysbuild: true
    build_only: true
    integration_platforms:
      - thingy91x/nrf9151/ns
    platform_allow:
      - thingy91x/nrf9151/ns
    extra_args: OVERLAY_CONFIG=overlay-nrf700x-wifi-scan-only.conf
                DTC_OVERLAY_FILE=thingy91x_wifi.overlay
                SB_CONFIG_WIFI_NRF70=y SB_CONFIG_WIFI_NRF70_SCAN_ONLY=y
    tags: ci_build sysbuild ci_samples_cellular

  # Configuration which will be used by the CI positioning integration job to verify PRs
  sample.cellular.location.integration_config_positioning:
    sysbuild: true
    build_only: true
    extra_configs:
      - CONFIG_MODEM_ANTENNA_GNSS_EXTERNAL=y
      - CONFIG_LOG_BUFFER_SIZE=2048
    extra_args: location_SNIPPET="nrf91-modem-trace-uart"
    integration_platforms:
      - nrf9151dk/nrf9151/ns
    platform_allow:
      - nrf9151dk/nrf9151/ns
    tags: ci_build sysbuild ci_samples_cellular
```

## samples/cellular/lte_ble_gateway/boards/nrf9160dk_nrf9160_ns.conf
```kconfig
CONFIG_NRF_SW_LPUART=y
CONFIG_NRF_SW_LPUART_INT_DRIVEN=y

CONFIG_UART_2_ASYNC=y
CONFIG_UART_2_INTERRUPT_DRIVEN=n
CONFIG_UART_2_NRF_HW_ASYNC=y
CONFIG_UART_2_NRF_HW_ASYNC_TIMER=2
```

## samples/cellular/lte_ble_gateway/boards/thingy91_nrf9160_ns.conf
```kconfig
CONFIG_NRF_SW_LPUART=y
CONFIG_NRF_SW_LPUART_INT_DRIVEN=y

CONFIG_UART_1_ASYNC=y
CONFIG_UART_1_INTERRUPT_DRIVEN=n
CONFIG_UART_1_NRF_HW_ASYNC=y
CONFIG_UART_1_NRF_HW_ASYNC_TIMER=2

CONFIG_USE_SEGGER_RTT=y
CONFIG_RTT_CONSOLE=y
CONFIG_UART_CONSOLE=n
CONFIG_LOG_BACKEND_RTT=y

CONFIG_AT_HOST_LIBRARY=n

CONFIG_LTE_LOCK_BANDS=y
# Enable band 2, 3, 4, 8, 12, 13 ,20 and 28
CONFIG_LTE_LOCK_BAND_MASK="1000000010000001100010001110"
```

## samples/cellular/lte_ble_gateway/sample.yaml
```yaml
sample:
  name: LTE-Bluetooth LE gateway sample
tests:
  sample.cellular.lte_ble_gateway:
    sysbuild: true
    build_only: true
    integration_platforms:
      - nrf9160dk/nrf9160/ns
    platform_allow: nrf9160dk/nrf9160/ns
    tags: ci_build sysbuild ci_samples_cellular
```

## samples/cellular/lwm2m_carrier/Kconfig
```kconfig
#
# Copyright (c) 2022 Nordic Semiconductor ASA
#
# SPDX-License-Identifier: LicenseRef-Nordic-5-Clause
#

menu "Custom PSK"
config CARRIER_APP_PSK
	string "LwM2M Pre-Shared Key (PSK)"
	default ""
	help
	  Hexadecimal PSK used to connect to the LwM2M server.

endmenu

menu "Zephyr Kernel"
source "Kconfig.zephyr"
endmenu
```

## samples/cellular/lwm2m_carrier/sample.yaml
```yaml
sample:
  name: LwM2M carrier sample
tests:
  sample.cellular.lwm2m_carrier:
    sysbuild: true
    build_only: true
    integration_platforms:
      - nrf9151dk/nrf9151/ns
      - nrf9160dk/nrf9160/ns
      - nrf9161dk/nrf9161/ns
    platform_allow:
      - nrf9151dk/nrf9151/ns
      - nrf9160dk/nrf9160/ns
      - nrf9161dk/nrf9161/ns
    tags:
      - ci_build
      - sysbuild
      - ci_samples_cellular
  sample.cellular.lwm2m_carrier.shell:
    sysbuild: true
    build_only: true
    integration_platforms:
      - nrf9151dk/nrf9151/ns
      - nrf9160dk/nrf9160/ns
    platform_allow:
      - nrf9151dk/nrf9151/ns
      - nrf9160dk/nrf9160/ns
    extra_args: EXTRA_CONF_FILE="overlay-shell.conf"
    tags:
      - ci_build
      - sysbuild
      - ci_samples_cellular
  sample.cellular.lwm2m_carrier.softbank:
    sysbuild: true
    build_only: true
    integration_platforms:
      - nrf9151dk/nrf9151/ns
      - nrf9160dk/nrf9160/ns
    platform_allow:
      - nrf9151dk/nrf9151/ns
      - nrf9160dk/nrf9160/ns
    extra_args:
      - EXTRA_CONF_FILE="overlay-softbank.conf"
      - SB_EXTRA_CONF_FILE="sysbuild-softbank.conf"
    tags:
      - ci_build
      - sysbuild
      - ci_samples_cellular
  sample.cellular.lwm2m_carrier.lgu:
    sysbuild: true
    build_only: true
    integration_platforms:
      - nrf9151dk/nrf9151/ns
      - nrf9160dk/nrf9160/ns
    platform_allow:
      - nrf9151dk/nrf9151/ns
      - nrf9160dk/nrf9160/ns
    extra_args:
      - EXTRA_CONF_FILE="overlay-lgu.conf"
      - SB_EXTRA_CONF_FILE="sysbuild-lgu.conf"
    tags:
      - ci_build
      - sysbuild
      - ci_samples_cellular
```

## samples/cellular/lwm2m_client/Kconfig
```kconfig
#
# Copyright (c) 2018 Nordic Semiconductor ASA
#
# SPDX-License-Identifier: LicenseRef-Nordic-5-Clause
#

menu "Application sample"

rsource "src/ui/Kconfig"
rsource "src/modules/Kconfig"
rsource "src/lwm2m/Kconfig"
rsource "src/fota_external/Kconfig"
menu "LwM2M objects"
config APP_PUSH_BUTTON
	bool "Enable button(s)"
	select UI_INPUT
	select LWM2M_IPSO_PUSH_BUTTON
	select LWM2M_APP_PUSH_BUTTON


config APP_ONOFF_SWITCH
	bool "Enable switches"
	depends on BOARD_NRF9160DK_NRF9160_NS || BOARD_NRF9161DK_NRF9161_NS
	select UI_INPUT
	select LWM2M_IPSO_ONOFF_SWITCH
	select LWM2M_APP_ONOFF_SWITCH


menuconfig APP_LIGHT_CONTROL
	bool "Enable LED(s)"
	select UI_LED
	select LWM2M_IPSO_LIGHT_CONTROL
	select LWM2M_APP_LIGHT_CONTROL

if APP_LIGHT_CONTROL
	rsource "src/ui/Kconfig.ui_led"
endif # APP_LIGHT_CONTROL


menuconfig APP_BUZZER
	bool "Enable buzzer"
	depends on BOARD_THINGY91_NRF9160_NS
	select UI_BUZZER
	select LWM2M_APP_BUZZER


menuconfig APP_LIGHT_SENSOR
	bool "Enable light sensor"
	select LIGHT_SENSOR
	select LWM2M_IPSO_APP_COLOUR_SENSOR
	select LWM2M_APP_LIGHT_SENSOR

if APP_LIGHT_SENSOR
	rsource "src/sensors/Kconfig.light_sensor"
	rsource "src/ipso/Kconfig.ipso_colour_sensor"
endif # APP_LIGHT_SENSOR


menuconfig APP_ENV_SENSOR
	bool "Enable environment sensors"
	select ENVIRONMENT_SENSOR
	help
	  Enables options for enabling temperature, pressure, humidity and gas resistance sensors.

if APP_ENV_SENSOR
rsource "src/sensors/Kconfig.env_sensor"

config APP_TEMP_SENSOR
	bool "Enable temperature sensor"
	select LWM2M_IPSO_TEMP_SENSOR
	select LWM2M_APP_TEMP_SENSOR

config APP_PRESS_SENSOR
	bool "Enable air pressure sensor"
	select LWM2M_IPSO_PRESSURE_SENSOR
	select LWM2M_APP_PRESS_SENSOR

config APP_HUMID_SENSOR
	bool "Enable humidity sensor"
	select LWM2M_IPSO_HUMIDITY_SENSOR
	select LWM2M_APP_HUMID_SENSOR

config APP_GAS_RES_SENSOR
	bool "Enable gas resistance sensor"
	select LWM2M_IPSO_GENERIC_SENSOR
	select LWM2M_APP_GAS_RES_SENSOR
endif # APP_ENV_SENSOR


menuconfig APP_ACCELEROMETER
	bool "Enable accelerometer"
	select ACCELEROMETER
	select LWM2M_IPSO_ACCELEROMETER
	select LWM2M_APP_ACCELEROMETER

if APP_ACCELEROMETER
	rsource "src/sensors/Kconfig.accelerometer"
endif # APP_ACCELEROMETER

menuconfig APP_GNSS
	bool "Enable GNSS"
	select GNSS
	select LWM2M_LOCATION_OBJ_SUPPORT

if APP_GNSS
	rsource "src/sensors/Kconfig.gnss"
endif # APP_GNSS

endmenu # LwM2M objects

config APP_LWM2M_PSK
	string "LwM2M pre-shared key for communication"
	default "000102030405060708090a0b0c0d0e0f"
	help
	  Pre Shared Key must be identical to the PSK registered with the device on the LwM2M server.
	  Use the hexadecimal representation.

config APP_ENDPOINT_PREFIX
	string "Prefix used in the endpoint name"
	default "urn:imei:"
	help
	  Sets the prefix of the endpoint name used when connecting to the LwM2M server.
menu "Device info"
config APP_MANUFACTURER
	string "Board manufacturer"
	default	"Nordic Semiconductor ASA"

config APP_DEVICE_TYPE
	string "Device type"
	default	"OMA-LWM2M Client"
endmenu

config APP_CUSTOM_VERSION
	string "Application version. Leave empty to use NCS version"

config APP_NEIGHBOUR_CELL_SCAN_INTERVAL
	int "Interval time [s] between neighbour cell scans"
	depends on LWM2M_CLIENT_UTILS_SIGNAL_MEAS_INFO_OBJ_SUPPORT
	default 600
	help
	  Low value on interval may reduce the performance of the system.

config APP_LWM2M_CONFORMANCE_TESTING
	bool "Send test payload periodically"
	help
	  Enable functionality that uses LwM2M SEND operation to deliver test payload.
	  This allows testing of SEND operation itself as well as "mute-send" resource.

module = APP
module-dep = LOG
module-str = Log level for sample
source "${ZEPHYR_BASE}/subsys/logging/Kconfig.template.log_config"
endmenu # Application sample


menu "Zephyr Kernel"
source "Kconfig.zephyr"
endmenu # Zephyr Kernel
```

## samples/cellular/lwm2m_client/boards/nrf9160dk_nrf9160_ns.conf
```kconfig
## nRF9160DK-specific config settings ##
# App
CONFIG_APP_GNSS=y
CONFIG_APP_LIGHT_CONTROL=y
CONFIG_APP_ONOFF_SWITCH=y
CONFIG_APP_PUSH_BUTTON=y

# IPSO
CONFIG_LWM2M_IPSO_PUSH_BUTTON_INSTANCE_COUNT=2
CONFIG_LWM2M_IPSO_ONOFF_SWITCH_INSTANCE_COUNT=2
CONFIG_LWM2M_IPSO_LIGHT_CONTROL_INSTANCE_COUNT=4
CONFIG_LWM2M_IPSO_ONOFF_SWITCH_VERSION_1_1=y
CONFIG_LWM2M_IPSO_PUSH_BUTTON_VERSION_1_1=y

# Sensor module
CONFIG_SENSOR_MODULE=n

# External flash
CONFIG_SPI=y
CONFIG_SPI_NOR=y
CONFIG_STREAM_FLASH_ERASE=y
CONFIG_FLASH=y

# Full modem update
CONFIG_DFU_TARGET_FULL_MODEM=y
CONFIG_FMFU_FDEV=y
CONFIG_ZCBOR=y
CONFIG_MODEM_INFO=y
CONFIG_FMFU_FDEV_SKIP_PREVALIDATION=n

# Crypto
CONFIG_PSA_CRYPTO=y
CONFIG_PSA_WANT_ALG_SHA_256=y
```

## samples/cellular/lwm2m_client/boards/nrf9161dk_nrf9161_ns.conf
```kconfig
## nRF9161DK-specific config settings ##
# App
CONFIG_APP_GNSS=y
CONFIG_APP_LIGHT_CONTROL=y
CONFIG_APP_ONOFF_SWITCH=y
CONFIG_APP_PUSH_BUTTON=y

# IPSO
CONFIG_LWM2M_IPSO_PUSH_BUTTON_INSTANCE_COUNT=2
CONFIG_LWM2M_IPSO_ONOFF_SWITCH_INSTANCE_COUNT=2
CONFIG_LWM2M_IPSO_LIGHT_CONTROL_INSTANCE_COUNT=4
CONFIG_LWM2M_IPSO_ONOFF_SWITCH_VERSION_1_1=y
CONFIG_LWM2M_IPSO_PUSH_BUTTON_VERSION_1_1=y

# Sensor module
CONFIG_SENSOR_MODULE=n

# Enable external flash
CONFIG_FLASH=y
CONFIG_FLASH_PAGE_LAYOUT=y
CONFIG_MPU_ALLOW_FLASH_WRITE=y
CONFIG_PM_EXTERNAL_FLASH_MCUBOOT_SECONDARY=n

CONFIG_SPI_NOR=y
CONFIG_SPI_NOR_SFDP_DEVICETREE=y
CONFIG_PM_OVERRIDE_EXTERNAL_DRIVER_CHECK=y

# Full modem update
CONFIG_DFU_TARGET_FULL_MODEM=y
CONFIG_FMFU_FDEV=y
CONFIG_ZCBOR=y
CONFIG_MODEM_INFO=y
CONFIG_FMFU_FDEV_SKIP_PREVALIDATION=n

# Crypto
CONFIG_OBERON_BACKEND=y
CONFIG_NORDIC_SECURITY_BACKEND=y
# Disable all non-used crypto
CONFIG_MBEDTLS_CHACHA20_C=n
CONFIG_MBEDTLS_POLY1305_C=n
CONFIG_MBEDTLS_ECP_C=n
CONFIG_MBEDTLS_RSA_C=n
CONFIG_MBEDTLS_DHM_C=n
CONFIG_MBEDTLS_SHA1_C=n
CONFIG_MBEDTLS_SHA384_C=n
CONFIG_MBEDTLS_SHA512_C=n
# This is the one we need
CONFIG_MBEDTLS_SHA256_C=y
```

## samples/cellular/lwm2m_client/boards/thingy91_nrf9160_ns.conf
```kconfig
## Thingy:91-specific config settings ##
# UI
CONFIG_UI_LED_USE_PWM=y
CONFIG_UI_SENSE_LED=y

# Sensors
CONFIG_I2C=y
CONFIG_BME680=y
CONFIG_ADXL362=y
CONFIG_ADXL362_ACCEL_RANGE_2G=y
CONFIG_ACCEL_CALIBRATE_ON_STARTUP=y
CONFIG_BH1749=y
CONFIG_LIGHT_SENSOR_LIGHT_MEASUREMENT_MAX_VALUE=2000
CONFIG_LIGHT_SENSOR_COLOUR_MEASUREMENT_MAX_VALUE=3000

# App LwM2M
CONFIG_APP_ACCELEROMETER=y
CONFIG_APP_BUZZER=y
CONFIG_APP_ENV_SENSOR=y
CONFIG_APP_GAS_RES_SENSOR=y
CONFIG_APP_GNSS=y
CONFIG_APP_HUMID_SENSOR=y
CONFIG_APP_LIGHT_CONTROL=y
CONFIG_APP_LIGHT_SENSOR=y
CONFIG_APP_PRESS_SENSOR=y
CONFIG_APP_PUSH_BUTTON=y
CONFIG_APP_TEMP_SENSOR=y

# Sensor module
CONFIG_SENSOR_MODULE=y

# IPSO v1.1
CONFIG_LWM2M_IPSO_ACCELEROMETER_VERSION_1_1=y
CONFIG_LWM2M_IPSO_APP_COLOUR_SENSOR_VERSION_1_1=y
CONFIG_LWM2M_IPSO_GENERIC_SENSOR_VERSION_1_1=y
CONFIG_LWM2M_IPSO_HUMIDITY_SENSOR_VERSION_1_1=y
CONFIG_LWM2M_IPSO_PRESSURE_SENSOR_VERSION_1_1=y
CONFIG_LWM2M_IPSO_PUSH_BUTTON_VERSION_1_1=y
CONFIG_LWM2M_IPSO_TEMP_SENSOR_VERSION_1_1=y
CONFIG_LWM2M_IPSO_BUZZER_VERSION_1_1=y
```
