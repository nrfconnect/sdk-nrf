## CMakeLists.txt
```
#
# Copyright (c) 2025 Nordic Semiconductor
#
# SPDX-License-Identifier: LicenseRef-Nordic-5-Clause
#

cmake_minimum_required(VERSION 3.20.0)

find_package(Zephyr REQUIRED HINTS $ENV{ZEPHYR_BASE})
project(nrf_cloud_mqtt_cell_location_sample)

target_sources(app PRIVATE src/main.c)
```

## Kconfig
```
#
# Copyright (c) 2025 Nordic Semiconductor ASA
#
# SPDX-License-Identifier: LicenseRef-Nordic-5-Clause
#

menu "nRF Cloud MQTT Cellular Location Sample"

config MQTT_CELL_DEFAULT_DOREPLY_VAL
	bool "Default value for the do_reply configuration flag"
	default y

config MQTT_CELL_DEFAULT_FALLBACK_VAL
	bool "Default value for the fallback configuration flag"
	default y

config MQTT_CELL_DEFAULT_HICONF_VAL
	bool "Default value for the hi_conf configuration flag"

module = NRF_CLOUD_MQTT_CELL_LOCATION_SAMPLE
module-str = nRF Cloud MQTT Cellular Location Sample
source "$(ZEPHYR_BASE)/subsys/logging/Kconfig.template.log_config"

endmenu

if BUILD_WITH_TFM

choice TFM_PROFILE_TYPE
	default TFM_PROFILE_TYPE_MINIMAL
endchoice

endif # BUILD_WITH_TFM

menu "Zephyr Kernel"
source "Kconfig.zephyr"
endmenu
```

## sample.yaml
```
sample:
  name: nRF Cloud MQTT cellular location
tests:
  sample.cellular.nrf_cloud_mqtt_cell_location:
    sysbuild: true
    build_only: true
    integration_platforms:
      - nrf9151dk/nrf9151/ns
      - nrf9251dk/nrf9251/cpuapp
    platform_allow:
      - nrf9151dk/nrf9151/ns
      - nrf9251dk/nrf9251/cpuapp
      - thingy91x/nrf9151/ns
    tags:
      - ci_build
      - sysbuild
      - ci_samples_cellular
```

## prj.conf
```kconfig
#
# Copyright (c) 2025 Nordic Semiconductor ASA
#
# SPDX-License-Identifier: LicenseRef-Nordic-5-Clause
#

# nRF Cloud MQTT
CONFIG_NRF_CLOUD=y
CONFIG_NRF_CLOUD_MQTT=y
CONFIG_NRF_CLOUD_CHECK_CREDENTIALS=y
CONFIG_NRF_CLOUD_LOCATION=y

# MQTT
CONFIG_MQTT_KEEPALIVE=120

# LTE link control
CONFIG_LTE_LC_PSM_MODULE=y
CONFIG_LTE_LINK_CONTROL=y
CONFIG_LTE_LC_NEIGHBOR_CELL_MEAS_MODULE=y

# Location library
CONFIG_LOCATION=y
CONFIG_LOCATION_SERVICE_EXTERNAL=y
CONFIG_LOCATION_METHOD_GNSS=n
CONFIG_LOCATION_METHOD_CELLULAR=y

# Networking
CONFIG_NETWORKING=y
CONFIG_NET_SOCKETS=y
CONFIG_NET_SOCKETS_OFFLOAD=y

# Enable LTE Connectivity using Connection Manager
CONFIG_NET_IPV4=y
CONFIG_NET_IPV6=y
CONFIG_NET_IPV6_NBR_CACHE=n
CONFIG_NET_IPV6_MLD=n
CONFIG_NET_CONNECTION_MANAGER=y
CONFIG_NRF_MODEM_LIB=y
CONFIG_NRF_MODEM_LIB_NET_IF=y
CONFIG_NRF_MODEM_LIB_NET_IF_AUTO_DOWN=y
CONFIG_NRF_MODEM_LIB_NET_IF_DOWN_DEFAULT_LTE_DISCONNECT=y
CONFIG_NET_CONNECTION_MANAGER_MONITOR_STACK_SIZE=1024
CONFIG_NET_MGMT_EVENT_STACK_SIZE=1024

# System
CONFIG_HEAP_MEM_POOL_SIZE=19000
CONFIG_MAIN_STACK_SIZE=3072
CONFIG_SYSTEM_WORKQUEUE_STACK_SIZE=2048
CONFIG_ASSERT=y
CONFIG_REBOOT=y
CONFIG_FPU=y
CONFIG_PICOLIBC_IO_FLOAT=y
CONFIG_EVENTS=y
CONFIG_POSIX_API=y

# Logging
CONFIG_LOG=y
CONFIG_LOG_MODE_DEFERRED=y
CONFIG_UART_INTERRUPT_DRIVEN=y

# Needed for time-stamping messages
CONFIG_DATE_TIME=y
CONFIG_DATE_TIME_NTP=y
CONFIG_PRINTK=y

# AT Host
CONFIG_AT_HOST_LIBRARY=y
CONFIG_AT_MONITOR_HEAP_SIZE=4096
CONFIG_AT_HOST_STACK_SIZE=2048

# Enable settings storage
CONFIG_SETTINGS=y
CONFIG_SETTINGS_FCB=y
CONFIG_FCB=y
CONFIG_FLASH_MAP=y
CONFIG_FLASH=y
CONFIG_FLASH_PAGE_LAYOUT=y

# Modem info
CONFIG_MODEM_INFO=y
CONFIG_MODEM_INFO_ADD_DEVICE=y
CONFIG_MODEM_INFO_ADD_NETWORK=y

# Modem key management
CONFIG_MODEM_KEY_MGMT=y
CONFIG_NRF_CLOUD_SEC_TAG=16842753
```

## boards/nrf9251dk_nrf9251_cpuapp.conf
```kconfig
#
# Copyright (c) 2026 Nordic Semiconductor ASA
#
# SPDX-License-Identifier: LicenseRef-Nordic-5-Clause
#

# Use ZMS instead of FCB for settings storage, because it's better suited for MRAM
CONFIG_ZMS=y
CONFIG_SETTINGS_ZMS=y
CONFIG_FCB=n
```

## src/main.c
```c
/*
 * Copyright (c) 2025 Nordic Semiconductor ASA
 *
 * SPDX-License-Identifier: LicenseRef-Nordic-5-Clause
 */

#include <string.h>
#include <zephyr/kernel.h>
#include <nrf_modem_at.h>
#include <modem/lte_lc.h>
#include <modem/location.h>
#include <modem/nrf_modem_lib.h>
#include <date_time.h>
#include <zephyr/logging/log.h>
#include <net/nrf_cloud.h>
#include <net/nrf_cloud_codec.h>
#include <net/nrf_cloud_defs.h>
#include <zephyr/app_version.h>

LOG_MODULE_REGISTER(nrf_cloud_mqtt_cell_location_sample,
		    CONFIG_NRF_CLOUD_MQTT_CELL_LOCATION_SAMPLE_LOG_LEVEL);

static K_SEM_DEFINE(location_event, 0, 1);

static K_SEM_DEFINE(lte_connected, 0, 1);

static K_SEM_DEFINE(time_update_finished, 0, 1);

static K_SEM_DEFINE(cloud_ready, 0, 1);

/* Structure to hold configuration flags. */
static struct nrf_cloud_location_config config = {
	.hi_conf = IS_ENABLED(CONFIG_MQTT_CELL_DEFAULT_HICONF_VAL),
	.fallback = IS_ENABLED(CONFIG_MQTT_CELL_DEFAULT_FALLBACK_VAL),
	.do_reply = IS_ENABLED(CONFIG_MQTT_CELL_DEFAULT_DOREPLY_VAL)};

static void date_time_evt_handler(const struct date_time_evt *evt)
{
	k_sem_give(&time_update_finished);
}

static void lte_event_handler(const struct lte_lc_evt *const evt)
{
	switch (evt->type) {
	case LTE_LC_EVT_NW_REG_STATUS:
		if ((evt->nw_reg_status == LTE_LC_NW_REG_REGISTERED_HOME) ||
		    (evt->nw_reg_status == LTE_LC_NW_REG_REGISTERED_ROAMING)) {
			LOG_INF("Connected to network");
			k_sem_give(&lte_connected);
		}
		break;
	default:
		break;
	}
}

static void print_location(double latitude, double longitude, uint32_t accuracy)
{
	LOG_INF("Lat: %f, Lon: %f, Uncertainty: %u m", latitude, longitude, accuracy);
	LOG_INF("Google maps URL: https://maps.google.com/?q=%.06f,%.06f", latitude, longitude);
}

static void cloud_service_location_ready_cb(const struct nrf_cloud_location_result *const result)
{
	if (!result) {
		return;
	}

	if (result->err == NRF_CLOUD_ERROR_NONE) {
		const char *type_str = (result->type == LOCATION_TYPE_SINGLE_CELL)  ? "single-cell"
				       : (result->type == LOCATION_TYPE_MULTI_CELL) ? "multi-cell"
										    : "unknown";
		LOG_INF("Cellular location request fulfilled with %s", type_str);
		print_location(result->lat, result->lon, result->unc);

	} else {
		LOG_ERR("Unable to determine location from cloud service, error: %d", result->err);
	}
}

static void handle_cloud_location_request(const struct lte_lc_cells_info *cell_info)
{
	int err = 0;

	/* Send location request to nRF Cloud */
	err = nrf_cloud_location_request(cell_info, NULL, &config, cloud_service_location_ready_cb);
	if (err == -EACCES) {
		LOG_ERR("Cloud connection is not established");
	} else if (err) {
		LOG_ERR("Failed to request positioning data, error: %d", err);
	}
}

static void location_event_handler(const struct location_event_data *event_data)
{
	switch (event_data->id) {
	case LOCATION_EVT_LOCATION:
		LOG_INF("Got location from location library");
		print_location((double)event_data->location.latitude,
			       (double)event_data->location.longitude,
			       (uint32_t)event_data->location.accuracy);
		break;

	case LOCATION_EVT_TIMEOUT:
		LOG_DBG("Getting location timed out");
		break;

	case LOCATION_EVT_ERROR:
		LOG_DBG("Getting location failed");
		break;

	case LOCATION_EVT_GNSS_ASSISTANCE_REQUEST:
		LOG_DBG("Getting location assistance requested (A-GNSS)");
		break;

	case LOCATION_EVT_GNSS_PREDICTION_REQUEST:
		LOG_DBG("Getting location assistance requested (P-GPS)");
		break;

	case LOCATION_EVT_CLOUD_LOCATION_EXT_REQUEST:
		LOG_DBG("Cloud location request received from location library");
		handle_cloud_location_request(event_data->cloud_location_request.cell_data);
		break;

	default:
		LOG_ERR("Getting location: Unknown event");
		break;
	}

	k_sem_give(&location_event);
}

static void location_event_wait(void)
{
	k_sem_take(&location_event, K_FOREVER);
}

/**
 * @brief Retrieve location with default configuration.
 *
 * @details This is achieved by not passing configuration at all to location_request().
 */
static void location_default_get(void)
{
	int err;

	LOG_INF("Requesting location with the default configuration...");

	err = location_request(NULL);
	if (err) {
		LOG_ERR("Requesting location failed, error: %d", err);
		return;
	}

	location_event_wait();
}

/* Handler for events from nRF Cloud Lib. */
static void cloud_event_handler(const struct nrf_cloud_evt *nrf_cloud_evt)
{
	switch (nrf_cloud_evt->type) {
	case NRF_CLOUD_EVT_TRANSPORT_CONNECT_ERROR:
		LOG_ERR("NRF_CLOUD_EVT_TRANSPORT_CONNECT_ERROR: %d", nrf_cloud_evt->status);
		break;
	case NRF_CLOUD_EVT_READY:
		LOG_INF("Connection to nRF Cloud ready");
		k_sem_give(&cloud_ready);
		break;
	case NRF_CLOUD_EVT_TRANSPORT_DISCONNECTED:
		LOG_ERR("NRF_CLOUD_EVT_TRANSPORT_DISCONNECTED");
		break;
	case NRF_CLOUD_EVT_RX_DATA_DISCON:
		LOG_ERR("Device was removed from your account.");
		break;
	case NRF_CLOUD_EVT_ERROR:
		LOG_ERR("NRF_CLOUD_EVT_ERROR: %d", nrf_cloud_evt->status);
		break;
	case NRF_CLOUD_EVT_TRANSPORT_CONNECTED:
	case NRF_CLOUD_EVT_TRANSPORT_CONNECTING:
	case NRF_CLOUD_EVT_USER_ASSOCIATION_REQUEST:
	case NRF_CLOUD_EVT_USER_ASSOCIATED:
	case NRF_CLOUD_EVT_SENSOR_DATA_ACK:
	case NRF_CLOUD_EVT_RX_DATA_SHADOW:
	case NRF_CLOUD_EVT_FOTA_START:
	case NRF_CLOUD_EVT_FOTA_DONE:
	case NRF_CLOUD_EVT_FOTA_ERROR:
		LOG_DBG("Cloud event: %d", nrf_cloud_evt->type);
		break;
	default:
		LOG_DBG("Unknown event type: %d", nrf_cloud_evt->type);
		break;
	}
}

int main(void)
{
	int err;

	LOG_INF("nRF Cloud MQTT Cellular Location Sample, version: %s", APP_VERSION_STRING);

	err = nrf_modem_lib_init();
	if (err) {
		LOG_ERR("Modem library initialization failed, error: %d", err);
		return err;
	}

	if (IS_ENABLED(CONFIG_DATE_TIME)) {
		/* Registering early for date_time event handler to avoid missing
		 * the first event after LTE is connected.
		 */
		date_time_register_handler(date_time_evt_handler);
	}

	LOG_INF("Connecting to LTE...");

	lte_lc_register_handler(lte_event_handler);

	lte_lc_connect();

	k_sem_take(&lte_connected, K_FOREVER);

	/* Waiting for valid time. */
	if (IS_ENABLED(CONFIG_DATE_TIME)) {
		LOG_INF("Waiting for current time");

		/* Wait for an event from the Date Time library. */
		k_sem_take(&time_update_finished, K_MINUTES(10));

		if (!date_time_is_valid()) {
			LOG_ERR("Failed to get current time. Continuing anyway.");
		}
	}

	/* nRF Cloud MQTT requires login */
	struct nrf_cloud_init_param params = {.event_handler = cloud_event_handler,
					      .application_version = APP_VERSION_STRING};
	err = nrf_cloud_init(&params);
	if (err) {
		LOG_ERR("nRF Cloud library could not be initialized, error: %d", err);
		return err;
	}

	err = nrf_cloud_connect();
	if (err != 0) {
		LOG_ERR("Could not connect to nRF Cloud, error: %d", err);
		return err;
	}

	k_sem_take(&cloud_ready, K_FOREVER);

	err = location_init(location_event_handler);
	if (err) {
		LOG_ERR("Initializing the Location library failed, error: %d", err);
		return -1;
	}

	location_default_get();

	return 0;
}
```
