## CMakeLists.txt
```
#
# Copyright (c) 2023 Nordic Semiconductor ASA
#
# SPDX-License-Identifier: LicenseRef-Nordic-5-Clause
#

cmake_minimum_required(VERSION 3.20.0)

find_package(Zephyr REQUIRED HINTS $ENV{ZEPHYR_BASE})
project(nrf_cloud_coap_multi_service)
zephyr_compile_definitions(PROJECT_NAME=${PROJECT_NAME})

# NORDIC SDK APP START
target_sources(app PRIVATE src/main.c)
target_sources(app PRIVATE src/application.c)
target_sources(app PRIVATE src/connection.c)
target_sources(app PRIVATE src/temperature.c)
target_sources_ifdef(CONFIG_NRF_CLOUD_FOTA app PRIVATE src/handle_fota.c)
target_sources(app PRIVATE src/led_control.c)
target_sources(app PRIVATE src/location_tracking.c)

# NORDIC SDK APP END

zephyr_include_directories(src)
```

## Kconfig
```
#
# Copyright (c) 2023 Nordic Semiconductor ASA
#
# SPDX-License-Identifier: LicenseRef-Nordic-5-Clause
#

menu "CoAP Multi Service Sample Settings"

config APP_VERSION
	string "CoAP Multi Service Sample version"
	default "1.0.0"

config LTE_INIT_RETRY_TIMEOUT_SECONDS
	int "LTE initialization retry timeout (seconds)"
	default 30
	help
	  Sets the number of seconds between each LTE modem initialization
	  retry.

config CLOUD_CONNECTION_RETRY_TIMEOUT_SECONDS
	int "Cloud connection retry timeout (seconds)"
	default 30
	help
	  If connecting to nRF Cloud takes longer than this timeout, it will be
	  reattempted.

config CLOUD_CONNECTION_REESTABLISH_DELAY_SECONDS
	int "Cloud connection reestablishment delay (seconds)"
	default 5
	help
	  After the connection to nRF Cloud has been reset, wait this amount of
	  time before attempting to connect again.

config CLOUD_READY_TIMEOUT_SECONDS
	int "Cloud readiness timeout (seconds)"
	default 600
	help
	  If the connection to nRF Cloud does not become ready within this
	  timeout, the sample will reset its connection and try again.

config DATE_TIME_ESTABLISHMENT_TIMEOUT_SECONDS
	int "Modem date and time establishment timeout (seconds)"
	default 300
	help
	  The sample will wait this many seconds for the modem to determine the
	  current date and time before giving up and moving on.

config APPLICATION_THREAD_STACK_SIZE
	int "Application Thread Stack Size (bytes)"
	default 2048
	help
	  Sets the stack size (in bytes) for the application thread of the
	  sample.

config CONNECTION_THREAD_STACK_SIZE
	int "Connection Thread Stack Size (bytes)"
	default 2048
	help
	  Sets the stack size (in bytes) for the connection thread of the
	  sample.

config MESSAGE_THREAD_STACK_SIZE
	int "Message Queue Thread Stack Size (bytes)"
	default 2048
	help
	  Sets the stack size (in bytes) for the message queue processing
	  thread of the sample.

config LED_THREAD_STACK_SIZE
	int "LED Thread Stack Size (bytes)"
	default 512
	help
	  Sets the stack size (in bytes) for the LED thread.

config MAX_OUTGOING_MESSAGES
	int "Outgoing message maximum"
	default 64
	help
	  Sets the maximum number of device messages which may be enqueued
	  before further messages are dropped.

config MAX_CONSECUTIVE_SEND_FAILURES
	int "Max outgoing consecutive send failures"
	default 5
	help
	  Sets the maximum number of device messages which may fail to send
	  before a connection reset and cooldown is triggered.

config CONSECUTIVE_SEND_FAILURE_COOLDOWN_SECONDS
	int "Cooldown after max consecutive send failures exceeded"
	default 10
	help
	  If a connection reset is triggered by too many failed device
	  messages, the sample will wait this long (in seconds) before trying
	  again.

config SENSOR_SAMPLE_INTERVAL_SECONDS
	int "Sensor sampling interval (seconds)"
	default 60
	help
	  Sets the time to wait between each sensor sample.

config LOCATION_TRACKING_SAMPLE_INTERVAL_SECONDS
	int "Location sampling interval (seconds)"
	default 60
	help
	  Sets the location sampling interval in seconds.

config LOCATION_TRACKING_GNSS
	bool "Use GNSS method for location tracking"
	default y
	depends on LOCATION_METHOD_GNSS
	help
	  Disable all location tracking methods to completely disable location tracking.

config LOCATION_TRACKING_CELLULAR
	bool "Use cellular method for location tracking"
	default y
	depends on LOCATION_METHOD_CELLULAR
	help
	  Disable all location tracking methods to completely disable location tracking.

config LOCATION_TRACKING_WIFI
	bool "Use Wi-Fi method for location tracking"
	default n
	depends on LOCATION_METHOD_WIFI
	help
	  Requires the use of an nRF7002 companion chip.
	  Disable all location tracking methods to completely disable location tracking.

config TEMP_DATA_USE_SENSOR
	bool "Use genuine temperature data"
	depends on BOARD_THINGY91_NRF9160_NS
	default y if BOARD_THINGY91_NRF9160_NS
	select SENSOR
	select BME680
	help
	  Sets whether to take genuine temperature measurements from a
	  connected BME680 sensor, or just simulate sensor data.

config TEMP_TRACKING
	bool "Track temperature"
	default y
	help
	  Sets whether to take temperature measurements.

config TEMP_ALERT_LIMIT
	int "Temperature limit to send alert"
	default 30
	help
	  Sets the temperature in degrees C over which a temperature alert will
	  be sent to the cloud.

choice
	prompt "LED indication"
	default LED_INDICATION_PWM if BOARD_THINGY91_NRF9160_NS
	default LED_INDICATION_GPIO if BOARD_NRF9160DK_NRF9160_NS || BOARD_NRF9161DK_NRF9161_NS || $(dt_compat_enabled,gpio-leds)
	default LED_INDICATION_DISABLED

	config LED_INDICATION_PWM
		select LED
		select LED_PWM
		select PWM
		bool "Enable LED indication using the pwm-leds driver"

	config LED_INDICATION_GPIO
		select LED
		select LED_GPIO
		bool "Enable LED indication using the gpio-leds driver"

	config LED_INDICATION_DISABLED
		bool "Disable LED indication"
endchoice

choice
	prompt "LED indication LED type"
	depends on !LED_INDICATION_DISABLED
	default LED_INDICATOR_RGB if BOARD_THINGY91_NRF9160_NS && LED_INDICATION_PWM
	default LED_INDICATOR_4LED if !LED_INDICATION_DISABLED
	default LED_INDICATOR_NONE

	config LED_INDICATOR_RGB
		depends on LED_INDICATION_PWM
		bool "A single RGB LED"

	config LED_INDICATOR_4LED
		depends on !LED_INDICATION_DISABLED
		bool "Four binary LEDs"

	config LED_INDICATOR_NONE
		depends on LED_INDICATION_DISABLED
		bool "No indicator LEDs"

endchoice

config LED_VERBOSE_INDICATION
	depends on !LED_INDICATION_DISABLED
	bool "Enables extra LED status indications"
	default y

config LED_CONTINUOUS_INDICATION
	depends on !LED_INDICATION_DISABLED
	bool "Show an idle pattern instead of turning LEDs off"
	default y

config GNSS_FIX_TIMEOUT_SECONDS
	int "GNSS Fix timeout"
	default 40
	help
	  On each location sample, try for this long to achieve a GNSS fix
	  before falling back to cellular positioning.
	  Set this to 20 or so seconds below the sensor sample interval so
	  that there is time left over to perform cellular positioning.
	  Otherwise, location samples may occur at a longer interval than
	  requested.

config TEST_COUNTER
	bool "Sets whether the test counter is enabled"

config AT_CMD_REQUESTS
	bool "Enables remote execution of AT commands using device messages"
	default y

config AT_CMD_REQUEST_RESPONSE_BUFFER_LENGTH
	int "Max length (in bytes) for Modem responses during AT command requests"
	help
	  Responses to modem AT commands are stored in a buffer of this length before being sent to
	  nRF Cloud. If a response from the modem exceeds this length, it will be dropped, and an
	  error code sent in its place (-NRF_E2BIG). Cannot be less than 40 bytes.
	default 200

config COAP_FOTA_DL_TIMEOUT_MIN
	int "The time (minutes) allotted for a FOTA download to complete"
	default 15
	help
	  If the FOTA download does not complete in the allotted time,
	  the download will be cancelled and the job status will be
	  set as failed.

config COAP_FOTA_USE_NRF_CLOUD_SETTINGS_AREA
	bool "Use the same settings area as the nRF Cloud FOTA library"
	default y
	help
	  Using the same settings area as the nRF Cloud FOTA library will
	  allow this sample to perform application-FOTA updates to applications
	  built with CONFIG_NRF_CLOUD_FOTA enabled.

config COAP_FOTA_SETTINGS_NAME
	depends on !COAP_FOTA_USE_NRF_CLOUD_SETTINGS_AREA
	string "Settings identifier for the COAP FOTA sample"
	default "coap_fota_sample"
	help
	  The root settings identifier for this application.
	  For application-FOTA, this value should also be found in your target application
	  so that the FOTA status can be properly reported to nRF Cloud.

config COAP_FOTA_SETTINGS_KEY_PENDING_JOB
	depends on !COAP_FOTA_USE_NRF_CLOUD_SETTINGS_AREA
	string "Settings item key for pending FOTA job info"
	default "pending_job"
	help
	  The settings item key where pending FOTA job info will be stored.
	  For application-FOTA, this value should also be found in your target application
	  so that the FOTA status can be properly reported to nRF Cloud.

config COAP_FOTA_USE_THREAD
	bool "Use a thread to process FOTA in the background"
	help
	  If not enabled, call the handle_fota_process() periodically. Otherwise, a
	  thread will process based on COAP_FOTA_JOB_CHECK_RATE_MIN.

config COAP_FOTA_THREAD_STACK_SIZE
	int "CoAP FOTA Thread Stack Size (bytes)"
	default 2048
	help
	  Sets the stack size (in bytes) for the CoAP FOTA thread of the
	  sample.

endmenu

module = COAP_MULTI_SERVICE
module-str = CoAP Multi Service
source "${ZEPHYR_BASE}/subsys/logging/Kconfig.template.log_config"

menu "Zephyr Kernel"
source "Kconfig.zephyr"
endmenu
```

## sample.yaml
```
sample:
  name: nRF Cloud CoAP Multi Service Sample
tests:
  sample.nrf9160.nrf_cloud_coap_multi_service:
    build_only: true
    platform_allow: nrf9160dk_nrf9160_ns thingy91_nrf9160_ns
    integration_platforms:
      - nrf9160dk_nrf9160_ns
      - thingy91_nrf9160_ns
    tags: ci_build
```

## prj.conf
```kconfig
#
# Copyright (c) 2022 Nordic Semiconductor ASA
#
# SPDX-License-Identifier: LicenseRef-Nordic-5-Clause
#

# Log level
# For more verbose and detailed log output, set the log level to
# CONFIG_COAP_MULTI_SERVICE_LOG_LEVEL_DBG=y instead.
CONFIG_COAP_MULTI_SERVICE_LOG_LEVEL_DBG=y
CONFIG_LOG=y
CONFIG_NET_LOG=y
CONFIG_LOG_PRINTK=y
CONFIG_COAP_LOG_LEVEL_INF=y
CONFIG_LOCATION_LOG_LEVEL_DBG=y
CONFIG_DATE_TIME_LOG_LEVEL_DBG=y
CONFIG_NRF_CLOUD_COAP_LOG_LEVEL_DBG=y

# General config
CONFIG_FPU=y
CONFIG_EVENTS=y
CONFIG_NEWLIB_LIBC=y
CONFIG_NEWLIB_LIBC_FLOAT_PRINTF=y
CONFIG_RESET_ON_FATAL_ERROR=y
#CONFIG_NCS_SAMPLES_DEFAULTS=y
CONFIG_NEWLIB_LIBC_NANO=n

#LED indication
# Uncomment these to minimize LED state indication when power savings are necessary
# CONFIG_LED_VERBOSE_INDICATION=n
# CONFIG_LED_CONTINUOUS_INDICATION=n

# Or, uncomment this to completely disable LED state indication
# CONFIG_LED_INDICATION_DISABLED=y

# Improved Logging
# CONFIG_LOG_MODE_DEFERRED allows logging from multiple threads simultaneously without creating
# splintered log entries, at the cost of needing a buffer for storing logs.
CONFIG_LOG_MODE_DEFERRED=y

# CONFIG_LOG_BUFFER_SIZE is the aforementioned buffer. A size of 4096 bytes is useful for debugging
# and prototyping, but is probably more than necessary for production-ready firmware.
CONFIG_LOG_BUFFER_SIZE=4096

# Heap and stacks
# Extended memory heap size needed both for PGPS and for encoding JSON-based nRF Cloud Device Messages.
CONFIG_HEAP_MEM_POOL_SIZE=24576
CONFIG_SYSTEM_WORKQUEUE_STACK_SIZE=3072

# Network
CONFIG_NETWORKING=y
CONFIG_NET_NATIVE=n
CONFIG_NET_CONFIG_NEED_IPV6=n
CONFIG_NET_IPV4=y
CONFIG_NET_SOCKETS=y
CONFIG_NET_SOCKETS_OFFLOAD=y
CONFIG_NET_SOCKETS_POSIX_NAMES=y

# Modem library
CONFIG_NRF_MODEM_LIB=y
CONFIG_NRF_MODEM_LIB_LOG_FW_VERSION_UUID=n

# AT commands interface
CONFIG_UART_INTERRUPT_DRIVEN=y
CONFIG_AT_HOST_LIBRARY=y
CONFIG_AT_MONITOR_HEAP_SIZE=4096

# nRF Cloud
CONFIG_NRF_CLOUD_COAP=y
CONFIG_COAP_CLIENT_BLOCK_SIZE=1024
CONFIG_COAP_CLIENT_STACK_SIZE=6144
CONFIG_COAP_CLIENT_THREAD_PRIORITY=0
CONFIG_COAP_EXTENDED_OPTIONS_LEN_VALUE=40
CONFIG_NRF_CLOUD_PGPS=y
CONFIG_NRF_CLOUD_PGPS_REPLACEMENT_THRESHOLD=0
CONFIG_NRF_CLOUD_PGPS_NUM_PREDICTIONS=4
CONFIG_NRF_CLOUD_PGPS_REQUEST_UPON_INIT=y

# Networking
CONFIG_NET_NATIVE=n
CONFIG_NET_OFFLOAD=y
CONFIG_NET_SOCKETS_TLS_SET_MAX_FRAGMENT_LENGTH=y

# Configure for using offloaded UDP and TLS
CONFIG_NET_SOCKETS_OFFLOAD_PRIORITY=40
CONFIG_MODEM_KEY_MGMT=y

# Generate JWTs in the modem
CONFIG_MODEM_JWT=y

# MCUBOOT - Needed by FOTA
CONFIG_BOOTLOADER_MCUBOOT=y
CONFIG_IMG_MANAGER=y
CONFIG_MCUBOOT_IMG_MANAGER=y
CONFIG_STREAM_FLASH_ERASE=y
CONFIG_IMG_ERASE_PROGRESSIVELY=y

# Location Services configuration
CONFIG_LOCATION=y
CONFIG_LOCATION_METHOD_GNSS=y
CONFIG_LOCATION_METHOD_CELLULAR=y
CONFIG_LOCATION_DATA_DETAILS=y
CONFIG_NRF_CLOUD_AGPS=y
CONFIG_NRF_CLOUD_LOCATION=y
CONFIG_MODEM_INFO=y
CONFIG_MODEM_INFO_ADD_DEVICE=y
CONFIG_MODEM_INFO_ADD_NETWORK=y
CONFIG_MODEM_INFO_ADD_DATE_TIME=n
CONFIG_MODEM_INFO_ADD_SIM=n
CONFIG_MODEM_INFO_ADD_SIM_ICCID=n
CONFIG_MODEM_INFO_ADD_SIM_IMSI=n

# Date Time lib - Used by PGPS and main application
CONFIG_DATE_TIME=y
CONFIG_DATE_TIME_AUTO_UPDATE=y
CONFIG_DATE_TIME_MODEM=y
CONFIG_DATE_TIME_NTP=y

# LTE link control - used by PGPS and main application
CONFIG_LTE_LINK_CONTROL=y
CONFIG_LTE_NETWORK_MODE_LTE_M_GPS=y
CONFIG_NET_L2_VIRTUAL=y

# Settings - used by nRF Cloud library and PGPS
CONFIG_SETTINGS=y
CONFIG_SETTINGS_FCB=y
CONFIG_FCB=y

# Download Client - used by FOTA and PGPS
CONFIG_DOWNLOAD_CLIENT=y
CONFIG_DOWNLOAD_CLIENT_HTTP_FRAG_SIZE_1024=y
CONFIG_DOWNLOAD_CLIENT_STACK_SIZE=4096
CONFIG_DOWNLOAD_CLIENT_BUF_SIZE=2300
CONFIG_DOWNLOAD_CLIENT_MAX_HOSTNAME_SIZE=128

# FOTA download
CONFIG_FOTA_DOWNLOAD=y
CONFIG_FOTA_DOWNLOAD_PROGRESS_EVT=y
CONFIG_DFU_TARGET=y
CONFIG_DOWNLOAD_CLIENT=y

# Flash - Used by FOTA and PGPS
CONFIG_FLASH=y
CONFIG_FLASH_PAGE_LAYOUT=y
CONFIG_FLASH_MAP=y
CONFIG_STREAM_FLASH=y
CONFIG_MPU_ALLOW_FLASH_WRITE=y
CONFIG_PM_EXTERNAL_FLASH_MCUBOOT_SECONDARY=n
CONFIG_NRF_CLOUD_ALERT=n
#CONFIG_NRF_CLOUD_LOG_DIRECT=n
#CONFIG_NRF_CLOUD_LOG_OUTPUT_LEVEL=3
```

## overlay-nrf7002ek-wifi-scan-only.conf
```kconfig
#
# Copyright (c) 2023 Nordic Semiconductor ASA
#
# SPDX-License-Identifier: LicenseRef-Nordic-5-Clause
#

# Overlay to use nRF7002 EK on top of nrf9160 DK for Wi-Fi scanning

# Enable the Wi-Fi location method:
CONFIG_LOCATION_TRACKING_WIFI=y
CONFIG_LOCATION_METHOD_WIFI=y
# Align this with CONFIG_NRF700X_SCAN_LIMIT.
# Also see comments for CONFIG_HEAP_MEM_POOL_SIZE.
CONFIG_LOCATION_METHOD_WIFI_SCANNING_RESULTS_MAX_CNT=20
CONFIG_LOCATION_WORKQUEUE_STACK_SIZE=8192

# Enable Wi-Fi drivers, (and the native NET stack so that the location library can access them)
CONFIG_WIFI=y
CONFIG_WIFI_NRF700X=y
# Align this with CONFIG_LOCATION_METHOD_WIFI_SCANNING_RESULTS_MAX_CNT.
# Also see comments for CONFIG_HEAP_MEM_POOL_SIZE.
CONFIG_NRF700X_SCAN_LIMIT=20
CONFIG_NET_L2_ETHERNET=y
CONFIG_NET_NATIVE=y

# But disable the supplicant and local networking features, since we don't need connectivity
CONFIG_WPA_SUPP=n
CONFIG_MBEDTLS=n
CONFIG_NET_IPV4=n
CONFIG_NET_IPV6=n
CONFIG_NET_UDP=n
CONFIG_NET_TCP=n
CONFIG_NORDIC_SECURITY_BACKEND=n

# Stack/heap tweaks needed to support Wi-Fi.
# Wi-Fi shell sample has 25000 heap size. We need a bit more for location request purposes.
# Heap allocation should be changed when CONFIG_LOCATION_METHOD_WIFI_SCANNING_RESULTS_MAX_CNT
# and CONFIG_NRF700X_SCAN_LIMIT (which should be the same value) are changed.
CONFIG_HEAP_MEM_POOL_SIZE=40000
CONFIG_MAIN_STACK_SIZE=2048
CONFIG_NET_MGMT_EVENT_STACK_SIZE=2048

# NET tweaks needed to support Wi-FI
CONFIG_NET_BUF_RX_COUNT=8
CONFIG_NET_BUF_TX_COUNT=8
CONFIG_NET_PKT_RX_COUNT=1
CONFIG_NET_PKT_TX_COUNT=1
CONFIG_NET_TX_STACK_SIZE=4096
CONFIG_NET_RX_STACK_SIZE=4096
CONFIG_NET_TC_TX_COUNT=1
CONFIG_NET_MAX_CONTEXTS=5

# Disable LED patterns, enabling WiFi scanning takes control of two LEDs
CONFIG_LED_INDICATION_DISABLED=y
```

## src/main.c
```c
/* Copyright (c) 2022 Nordic Semiconductor ASA
 *
 * SPDX-License-Identifier: LicenseRef-Nordic-5-Clause
 */

#include <zephyr/kernel.h>
#include <stdio.h>
#include <zephyr/logging/log.h>
#include "application.h"
#include "connection.h"
#include "led_control.h"

LOG_MODULE_REGISTER(main, CONFIG_COAP_MULTI_SERVICE_LOG_LEVEL);

/* Here, we start the various threads that our application will run in */

#ifndef CONFIG_LED_INDICATION_DISABLED
/* Define, and automatically start the LED animation thread. See led_control.c */
K_THREAD_DEFINE(led_thread, CONFIG_LED_THREAD_STACK_SIZE, led_animation_thread_fn,
		NULL, NULL, NULL, 0, 0, 0);
#endif

/* Define, and automatically start the main application thread. See application.c */
K_THREAD_DEFINE(app_thread, CONFIG_APPLICATION_THREAD_STACK_SIZE, main_application_thread_fn,
		NULL, NULL, NULL, 0, 0, 0);

/* Define, and automatically start the message queue thread. See connection.c */
K_THREAD_DEFINE(msg_thread, CONFIG_MESSAGE_THREAD_STACK_SIZE, message_queue_thread_fn,
		NULL, NULL, NULL, 0, 0, 0);

/* Define, and automatically start the connection management thread. See connection.c
 *
 * The connection thread is given higher priority (-1) so that it can preempt the other threads,
 * for instance in the event of a call to disconnect_cloud().
 *
 * Priority -1 is also a non-preeemptible priority level, so other threads, even of higher
 * priority, cannot interrupt the connection thread until it yields.
 */
K_THREAD_DEFINE(con_thread, CONFIG_CONNECTION_THREAD_STACK_SIZE, connection_management_thread_fn,
		NULL, NULL, NULL, -1, 0, 0);

/* main() is called from the main thread, which defaults to priority zero,
 * but for illustrative purposes we don't use it. main_application() could be called directly
 * from this function, rather than given its own dedicated thread.
 */
int main(void)
{
	LOG_INF("nRF Cloud CoAP multi-service sample has started, version: %s", CONFIG_APP_VERSION);
	return 0;
}
```

## src/application.c
```c
/* Copyright (c) 2022 Nordic Semiconductor ASA
 *
 * SPDX-License-Identifier: LicenseRef-Nordic-5-Clause
 */

#include <zephyr/kernel.h>
#include <zephyr/logging/log.h>
#include <modem/location.h>
#include <net/nrf_cloud_coap.h>
#include <net/nrf_cloud_log.h>
#include <net/nrf_cloud_alert.h>
#include <date_time.h>
#include <stdio.h>

#include "application.h"
#include "temperature.h"
#include "connection.h"

#include "handle_fota.h"
#include "location_tracking.h"
#include "led_control.h"

LOG_MODULE_REGISTER(application, CONFIG_COAP_MULTI_SERVICE_LOG_LEVEL);

/* Timer used to time the sensor sampling rate. */
static K_TIMER_DEFINE(sensor_sample_timer, NULL, NULL);

/* Temperature alert limits. */
#define TEMP_ALERT_LIMIT ((float)CONFIG_TEMP_ALERT_LIMIT)
#define TEMP_ALERT_HYSTERESIS 1.5f
#define TEMP_ALERT_LOWER_LIMIT (TEMP_ALERT_LIMIT - TEMP_ALERT_HYSTERESIS)

/**
 * @brief Transmit a collected GNSS sample to nRF Cloud.
 *
 * @param loc_gnss - GNSS location data.
 * @return int - 0 on success, negative error code otherwise.
 */
static int send_gnss(const struct location_event_data * const loc_gnss)
{
	if (!loc_gnss || (loc_gnss->method != LOCATION_METHOD_GNSS)) {
		return -EINVAL;
	}

	int ret = 0;
	struct nrf_cloud_gnss_data gnss_pvt = {
		.type = NRF_CLOUD_GNSS_TYPE_PVT,
		.ts_ms = NRF_CLOUD_NO_TIMESTAMP,
		.pvt = {
			.lon		= loc_gnss->location.longitude,
			.lat		= loc_gnss->location.latitude,
			.accuracy	= loc_gnss->location.accuracy,
			.has_alt	= 0,
			.has_speed	= 0,
			.has_heading	= 0
		}
	};
	struct nrf_cloud_sensor_data data = {
		.data.ptr = &gnss_pvt,
		.data.len = sizeof(gnss_pvt),
		.data_type = NRF_CLOUD_DATA_TYPE_BLOCK,
		.type = NRF_CLOUD_SENSOR_GNSS
	};

	LOG_INF("Sending GNSS location...");
	ret = send_device_message(&data);

	return ret;
}

/**
 * @brief Callback to receive periodic location updates from location_tracking.c and forward them
 * to nRF Cloud.
 *
 * Note that cellular positioning (MCELL/Multi-Cell and SCELL/Single-Cell) is sent to nRF
 * Cloud automatically (since the Location library and nRF Cloud must work together to
 * determine them in the first place). GNSS positions, on the other hand, must be
 * sent manually, since they are determined entirely on-device.
 *
 * @param location_data - The received location update.
 *
 */
static void on_location_update(const struct location_event_data * const location_data)
{
	LOG_INF("Location Updated: %.06f N %.06f W, accuracy: %.01f m, Method: %s",
		location_data->location.latitude,
		location_data->location.longitude,
		location_data->location.accuracy,
		location_method_str(location_data->method));

	/* If the position update was derived using GNSS, send it onward to nRF Cloud. */
	if (location_data->method == LOCATION_METHOD_GNSS) {
		LOG_INF("GNSS Position Update! Sending to nRF Cloud...");
		send_gnss(location_data);
	}
}

/** @brief Check whether temperature is acceptable.
 * If the device exceeds a temperature limit, send the temperature alert one time.
 * Once the temperature falls below a lower limit, re-enable the temperature alert
 * so it will be sent if limit is exceeded again.
 *
 * The difference between the two limits should be sufficient to prevent sending
 * new alerts if the temperature value oscillates between two nearby values.
 *
 * @param temp - The current device temperature.
 */
static void monitor_temperature(double temp)
{
	static bool temperature_alert_active;

	if ((temp > TEMP_ALERT_LIMIT) && !temperature_alert_active) {
		temperature_alert_active = true;
		(void)nrf_cloud_alert_send(ALERT_TYPE_TEMPERATURE, (float)temp,
					   "Temperature over limit!");
		LOG_INF("Temperature limit %f C exceeded: now %f C.",
			TEMP_ALERT_LIMIT, temp);
	} else if ((temp < TEMP_ALERT_LOWER_LIMIT) && temperature_alert_active) {
		temperature_alert_active = false;
		LOG_INF("Temperature now below limit: %f C.", temp);
	}
}

static void check_shadow(void)
{
	int err;
	char buf[512];

	buf[0] = '\0';
	LOG_INF("Checking for shadow delta...");
	err = nrf_cloud_coap_shadow_get(buf, sizeof(buf), true);
	if (err) {
		LOG_ERR("Failed to request shadow delta: %d", err);
	} else {
		size_t len = strlen(buf);

		LOG_INF("Delta: len:%zd, %s", len, len ? buf : "None");
		/* Do something with the shadow delta's JSON data, such
		 * as parse it and use the decoded information to change a
		 * behavior.
		 */

		/* Acknowledge it so we do not receive it again. */
		if (len) {
			err = nrf_cloud_coap_shadow_state_update(buf);
			if (err) {
				LOG_ERR("Failed to acknowledge delta: %d", err);
			} else {
				LOG_INF("Delta acknowledged");
			}
		}
	}
}

void main_application_thread_fn(void)
{
	/* Wait for first connection before starting the application. */
	LOG_INF("Waiting for connection");
	(void)await_connection(K_FOREVER);

	(void)nrf_cloud_alert_send(ALERT_TYPE_DEVICE_NOW_ONLINE, 0, NULL);

	/* Wait for the date and time to become known.
	 * This is needed both for location services and for sensor sample timestamping.
	 */
	LOG_INF("Waiting for modem to determine current date and time");
	if (!await_date_time_known(K_SECONDS(CONFIG_DATE_TIME_ESTABLISHMENT_TIMEOUT_SECONDS))) {
		LOG_WRN("Failed to determine valid date time. Proceeding anyways");
	} else {
		LOG_INF("Current date and time determined");
	}

#if 0
	nrf_cloud_log_init();
	/* Send a direct log to the nRF Cloud web portal indicating the sample has started up. */
	nrf_cloud_log_send(LOG_LEVEL_INF, "nRF Cloud COAP multi-service sample v%s",
			   CONFIG_APP_VERSION);
#endif
	LOG_INF("Starting location tracking.");

	/* Begin tracking location at the configured interval. */
	(void)start_location_tracking(on_location_update,
					CONFIG_LOCATION_TRACKING_SAMPLE_INTERVAL_SECONDS);

	/* Begin sampling sensors. */
	while (true) {
		/* Start the sensor sample interval timer.
		 * We use a timer here instead of merely sleeping the thread, because the
		 * application thread can be preempted by other threads performing long tasks
		 * (such as periodic location acquisition), and we want to account for these
		 * delays when metering the sample send rate.
		 */
		k_timer_start(&sensor_sample_timer,
			K_SECONDS(CONFIG_SENSOR_SAMPLE_INTERVAL_SECONDS), K_FOREVER);

		if (IS_ENABLED(CONFIG_TEMP_TRACKING)) {
			struct nrf_cloud_sensor_data data = {
				.type = NRF_CLOUD_SENSOR_TEMP,
				.data_type = NRF_CLOUD_DATA_TYPE_DOUBLE,
				.double_val = -1,
				.data.ptr = NULL,
				.data.len = 0
			};

			if (get_temperature(&data.double_val) == 0) {
				LOG_INF("Temperature is %d degrees C", (int)data.double_val);
				LOG_INF("Sending temperature...");
				(void)send_device_message(&data);
				LOG_INF("Monitor temperature...");
				monitor_temperature(data.double_val);
			}
		}
#if defined(CONFIG_NRF_CLOUD_FOTA)
		if (handle_fota_process() != -EAGAIN) {
			LOG_INF("FOTA check completed.");
		}
#endif
		check_shadow();

		/* Wait out any remaining time on the sample interval timer. */
		k_timer_status_sync(&sensor_sample_timer);
	}
}
```

## src/connection.c
```c
/* Copyright (c) 2023 Nordic Semiconductor ASA
 *
 * SPDX-License-Identifier: LicenseRef-Nordic-5-Clause
 */

#include <zephyr/kernel.h>
#include <stdio.h>
#include <zephyr/net/socket.h>
#include <net/nrf_cloud.h>
#include <net/nrf_cloud_coap.h>
#include <date_time.h>
#include <zephyr/logging/log.h>
#include <modem/nrf_modem_lib.h>

#include "connection.h"

#include "nrf_cloud_codec_internal.h"
#include "handle_fota.h"
#include "location_tracking.h"
#include "led_control.h"

LOG_MODULE_REGISTER(connection, CONFIG_COAP_MULTI_SERVICE_LOG_LEVEL);

/* Flow control event identifiers */

/* LTE either is connected or isn't */
#define LTE_CONNECTED			(1 << 1)

/* CLOUD_CONNECTED is fired when we first connect to the nRF Cloud.
 * CLOUD_READY is fired when the connection is fully associated and ready to send device messages.
 * CLOUD_DISCONNECTED is fired when disconnection is detected or requested, and will trigger
 *				a total reset of the nRF cloud connection, and the event flag state.
 */
#define CLOUD_CONNECTED			(1 << 1)
#define CLOUD_READY			(1 << 2)
#define CLOUD_DISCONNECTED		(1 << 3)

/* Time either is or is not known. This is only fired once, and is never cleared. */
#define DATE_TIME_KNOWN			(1 << 1)

/* Flow control event objects for waiting for key events. */
static K_EVENT_DEFINE(lte_connection_events);
static K_EVENT_DEFINE(cloud_connection_events);
static K_EVENT_DEFINE(datetime_connection_events);

/* Message Queue for enqueing outgoing messages during offline periods. */
K_MSGQ_DEFINE(device_message_queue,
	      sizeof(struct nrf_cloud_sensor_data *),
	      CONFIG_MAX_OUTGOING_MESSAGES,
	      sizeof(struct nrf_cloud_sensor_data *));

/* Tracks the number of consecutive message-send failures. A total count greater than
 * CONFIG_MAX_CONSECUTIVE_SEND_FAILURES will trigger a connection reset and cooldown.
 * Resets on every successful device message send.
 */
static int send_failure_count;

static dev_msg_handler_cb_t general_dev_msg_handler;

/* Modem info struct used for modem FW version and cell info used for single-cell requests */
#if defined(CONFIG_MODEM_INFO)
static struct modem_param_info mdm_param;
#endif

static void free_queued_dev_msg_message(struct nrf_cloud_sensor_data *msg);

/**
 * @brief Notify that LTE connection has been established.
 */
static void notify_lte_connected(void)
{
	k_event_post(&lte_connection_events, LTE_CONNECTED);
}

/**
 * @brief Reset the LTE connection event flag.
 */
static void clear_lte_connected(void)
{
	k_event_set(&lte_connection_events, 0);
}

bool await_lte_connection(k_timeout_t timeout)
{
	LOG_DBG("Awaiting LTE Connection");
	return k_event_wait_all(&lte_connection_events, LTE_CONNECTED, false, timeout) != 0;
}

/**
 * @brief Notify that the current date and time have become known.
 */
static void notify_date_time_known(void)
{
	k_event_post(&datetime_connection_events, DATE_TIME_KNOWN);
}

bool await_date_time_known(k_timeout_t timeout)
{
	return k_event_wait(&datetime_connection_events, DATE_TIME_KNOWN, false, timeout) != 0;
}

/**
 * @brief Notify that connection to nRF Cloud has been established.
 */
static void notify_cloud_connected(void)
{
	k_event_post(&cloud_connection_events, CLOUD_CONNECTED);
}

/**
 * @brief Notify that cloud connection is ready.
 */
static void notify_cloud_ready(void)
{
	k_event_post(&cloud_connection_events, CLOUD_READY);
}

/**
 * @brief Clear nRF Cloud connection events.
 */
static void clear_cloud_connection_events(void)
{
	k_event_set(&cloud_connection_events, 0);
}

/**
 * @brief Await a connection to nRF Cloud (ignoring LTE connection state and cloud readiness).
 *
 * @param timeout - The time to wait before timing out.
 * @return true if occurred.
 * @return false if timed out.
 */
static bool await_cloud_connected(k_timeout_t timeout)
{
	LOG_DBG("Awaiting Cloud Connection");
	return k_event_wait(&cloud_connection_events, CLOUD_CONNECTED, false, timeout) != 0;
}

/**
 * @brief Wait for nRF Cloud readiness.
 *
 * @param timeout - The time to wait before timing out.
 * @param timeout_on_disconnection - Should cloud disconnection events count as a timeout?
 * @return true if occurred.
 * @return false if timed out.
 */
static bool await_cloud_ready(k_timeout_t timeout, bool timeout_on_disconnection)
{
	LOG_DBG("Awaiting Cloud Ready");
	int await_condition = CLOUD_READY;

	if (timeout_on_disconnection) {
		await_condition |= CLOUD_DISCONNECTED;
	}

	return k_event_wait(&cloud_connection_events, await_condition,
			    false, timeout) == CLOUD_READY;
}

/*
 * This is really a convenience callback to help keep this sample clean and modular. You could
 * implement device message handling directly in the cloud_event_handler if desired.
 */
void register_general_dev_msg_handler(dev_msg_handler_cb_t handler_cb)
{
	general_dev_msg_handler = handler_cb;
}

bool await_connection(k_timeout_t timeout)
{
	return await_lte_connection(timeout) && await_cloud_ready(timeout, false);
}

bool cloud_is_connected(void)
{
	return k_event_wait(&cloud_connection_events, CLOUD_CONNECTED, false, K_NO_WAIT) != 0;
}

void disconnect_cloud(void)
{
	k_event_post(&cloud_connection_events, CLOUD_DISCONNECTED);
}

bool await_cloud_disconnection(k_timeout_t timeout)
{
	return k_event_wait(&cloud_connection_events, CLOUD_DISCONNECTED, false, timeout) != 0;
}

bool cloud_is_disconnecting(void)
{
	return k_event_wait(&cloud_connection_events, CLOUD_DISCONNECTED, false, K_NO_WAIT) != 0;
}

/**
 * @brief Handler for date_time events. Used exclusively to detect when we have obtained
 * a valid modem time.
 *
 * @param date_time_evt - The date_time event. Ignored.
 */
static void date_time_evt_handler(const struct date_time_evt *date_time_evt)
{
	if (date_time_is_valid()) {
		notify_date_time_known();
	}
}

/**
 * @brief Handler for LTE events coming from modem.
 *
 * @param evt Events from modem.
 */
static void lte_event_handler(const struct lte_lc_evt *const evt)
{
	switch (evt->type) {
	case LTE_LC_EVT_NW_REG_STATUS:
		LOG_DBG("LTE_EVENT: Network registration status %d, %s", evt->nw_reg_status,
			evt->nw_reg_status == LTE_LC_NW_REG_NOT_REGISTERED ?	  "Not Registered" :
			evt->nw_reg_status == LTE_LC_NW_REG_REGISTERED_HOME ?	 "Registered Home" :
			evt->nw_reg_status == LTE_LC_NW_REG_SEARCHING ?		       "Searching" :
			evt->nw_reg_status == LTE_LC_NW_REG_REGISTRATION_DENIED ?
									     "Registration Denied" :
			evt->nw_reg_status == LTE_LC_NW_REG_UNKNOWN ?			 "Unknown" :
			evt->nw_reg_status == LTE_LC_NW_REG_REGISTERED_ROAMING ?
									      "Registered Roaming" :
			evt->nw_reg_status == LTE_LC_NW_REG_REGISTERED_EMERGENCY ?
									    "Registered Emergency" :
			evt->nw_reg_status == LTE_LC_NW_REG_UICC_FAIL ?		       "UICC Fail" :
											 "Invalid");

		if ((evt->nw_reg_status != LTE_LC_NW_REG_REGISTERED_HOME) &&
		     (evt->nw_reg_status != LTE_LC_NW_REG_REGISTERED_ROAMING)) {
			/* Clear connected status. */
			clear_lte_connected();

			/* Also reset the nRF Cloud connection if we were currently connected
			 * Failing to do this will result in nrf_cloud_send stalling upon connection
			 * re-establishment.
			 *
			 * We check cloud_is_disconnecting solely to avoid double-printing the
			 * LTE connection lost message. This check has no other effect.
			 */
			if (cloud_is_connected() && !cloud_is_disconnecting()) {
				LOG_INF("LTE connection lost. Disconnecting from nRF Cloud too...");
				disconnect_cloud();
			}
		} else {
			/* Notify we are connected to LTE. */
			notify_lte_connected();
		}

		break;
	case LTE_LC_EVT_PSM_UPDATE:
		LOG_DBG("LTE_EVENT: PSM parameter update: TAU: %d, Active time: %d",
			evt->psm_cfg.tau, evt->psm_cfg.active_time);
		break;
	case LTE_LC_EVT_EDRX_UPDATE: {
		/* This check is necessary to silence compiler warnings by
		 * sprintf when debug logs are not enabled.
		 */
		if (IS_ENABLED(CONFIG_COAP_MULTI_SERVICE_LOG_LEVEL_DBG)) {
			char log_buf[60];
			ssize_t len;

			len = snprintf(log_buf, sizeof(log_buf),
				"LTE_EVENT: eDRX parameter update: eDRX: %f, PTW: %f",
				evt->edrx_cfg.edrx, evt->edrx_cfg.ptw);
			if (len > 0) {
				LOG_DBG("%s", log_buf);
			}
		}
		break;
	}
	case LTE_LC_EVT_RRC_UPDATE:
		LOG_DBG("LTE_EVENT: RRC mode: %s",
			evt->rrc_mode == LTE_LC_RRC_MODE_CONNECTED ?
			"Connected" : "Idle");
		break;
	case LTE_LC_EVT_CELL_UPDATE:
		LOG_DBG("LTE_EVENT: LTE cell changed: Cell ID: %d, Tracking area: %d",
			evt->cell.id, evt->cell.tac);
		break;
	case LTE_LC_EVT_LTE_MODE_UPDATE:
		LOG_DBG("LTE_EVENT: Active LTE mode changed: %s",
			evt->lte_mode == LTE_LC_LTE_MODE_NONE ? "None" :
			evt->lte_mode == LTE_LC_LTE_MODE_LTEM ? "LTE-M" :
			evt->lte_mode == LTE_LC_LTE_MODE_NBIOT ? "NB-IoT" :
			"Unknown");
		break;
	case LTE_LC_EVT_MODEM_EVENT:
		LOG_DBG("LTE_EVENT: Modem domain event, type: %s",
			evt->modem_evt == LTE_LC_MODEM_EVT_LIGHT_SEARCH_DONE ?
				"Light search done" :
			evt->modem_evt == LTE_LC_MODEM_EVT_SEARCH_DONE ?
				"Search done" :
			evt->modem_evt == LTE_LC_MODEM_EVT_RESET_LOOP ?
				"Reset loop detected" :
			evt->modem_evt == LTE_LC_MODEM_EVT_BATTERY_LOW ?
				"Low battery" :
			evt->modem_evt == LTE_LC_MODEM_EVT_OVERHEATED ?
				"Modem is overheated" :
				"Unknown");
		break;
	default:
		break;
	}
}

/**
 * @brief Updates the nRF Cloud shadow with information about supported capabilities, current
 *  firmware running, FOTA support, and so on.
 */
static void update_shadow(void)
{
	int err;
	struct nrf_cloud_svc_info_fota fota_info = {
		.application = nrf_cloud_fota_is_type_enabled(NRF_CLOUD_FOTA_APPLICATION),
		.bootloader = nrf_cloud_fota_is_type_enabled(NRF_CLOUD_FOTA_BOOTLOADER),
		.modem = nrf_cloud_fota_is_type_enabled(NRF_CLOUD_FOTA_MODEM_DELTA),
		.modem_full = nrf_cloud_fota_is_type_enabled(NRF_CLOUD_FOTA_MODEM_FULL)
	};
	struct nrf_cloud_svc_info_ui ui_info = {
		.gnss = location_tracking_enabled(),
		.temperature = IS_ENABLED(CONFIG_TEMP_TRACKING),
		.log = IS_ENABLED(CONFIG_NRF_CLOUD_LOG_BACKEND) &&
		       IS_ENABLED(CONFIG_LOG_BACKEND_NRF_CLOUD_OUTPUT_TEXT),
		.dictionary_log = IS_ENABLED(CONFIG_NRF_CLOUD_LOG_BACKEND) &&
				  IS_ENABLED(CONFIG_LOG_BACKEND_NRF_CLOUD_OUTPUT_DICTIONARY)
	};
	struct nrf_cloud_svc_info service_info = {
		.fota = &fota_info,
		.ui = &ui_info
	};
	struct nrf_cloud_modem_info modem_info = {
		.device = NRF_CLOUD_INFO_SET,
		.network = NRF_CLOUD_INFO_SET,
		.sim = IS_ENABLED(CONFIG_MODEM_INFO_ADD_SIM) ? NRF_CLOUD_INFO_SET : 0,
		/* Use the modem info already obtained */
#if defined(CONFIG_MODEM_INFO)
		.mpi = &mdm_param,
#endif
		/* Include the application version */
		.application_version = CONFIG_APP_VERSION
	};
	struct nrf_cloud_device_status device_status = {
		.modem = &modem_info,
		.svc = &service_info
	};

	err = nrf_cloud_coap_shadow_device_status_update(&device_status);
	if (err) {
		LOG_ERR("Failed to update device shadow, error: %d", err);
	}
}

static struct nrf_cloud_sensor_data *allocate_dev_msg_for_queue(struct nrf_cloud_sensor_data *
								msg_to_copy)
{
	struct nrf_cloud_sensor_data *new_msg = k_malloc(sizeof(struct nrf_cloud_sensor_data));

	LOG_INF("type:%d, data_type:%d", msg_to_copy->type, msg_to_copy->data_type);
	if (new_msg == NULL) {
		LOG_ERR("Out of memory error");
	} else if (msg_to_copy) {
		*new_msg = *msg_to_copy;
		if (msg_to_copy->data_type == NRF_CLOUD_DATA_TYPE_BLOCK) {
			uint8_t *new_data = k_malloc(msg_to_copy->data.len);

			if (new_data != NULL) {
				memcpy(new_data, msg_to_copy->data.ptr, msg_to_copy->data.len);
				new_msg->data.ptr = new_data;
			} else {
				LOG_ERR("Out of memory error");
				new_msg->data.ptr = NULL;
				new_msg->data.len = 0;
				k_free(new_msg);
				new_msg = NULL;
			}
		}
	}

	return new_msg;
}

static int enqueue_device_message(struct nrf_cloud_sensor_data *const msg, const bool create_copy)
{
	if (!msg) {
		return -EINVAL;
	}

	struct nrf_cloud_sensor_data *q_msg = msg;

	if (create_copy) {
		/* Allocate a new nrf_cloud_obj structure for the message queue.
		 * Copy the contents of msg_obj, which contains a pointer to the
		 * original message data, into the new structure.
		 */
		q_msg = allocate_dev_msg_for_queue(msg);
		if (!q_msg) {
			return -ENOMEM;
		}
	}

	/* Attempt to append data onto message queue. */
	LOG_DBG("Adding device message to queue");
	if (k_msgq_put(&device_message_queue, &q_msg, K_NO_WAIT)) {
		LOG_ERR("Device message rejected, outgoing message queue is full");
		if (create_copy) {
			free_queued_dev_msg_message(q_msg);
		}
		return -ENOMEM;
	}

	return 0;
}

static void free_queued_dev_msg_message(struct nrf_cloud_sensor_data *msg)
{
	if (msg == NULL) {
		return;
	}
	/* Free the data block attached to the msg */
	if (msg->data_type == NRF_CLOUD_DATA_TYPE_BLOCK) {
		k_free((uint8_t *)msg->data.ptr);
		msg->data.ptr = NULL;
		msg->data.len = 0;
	}
	/* Free the msg itself */
	k_free(msg);
}

int consume_device_message(void)
{
	struct nrf_cloud_sensor_data *queued_msg;
	int ret;
	const char *app_id;

	LOG_DBG("Consuming an enqueued device message");

	/* Wait until a message is available to send. */
	ret = k_msgq_get(&device_message_queue, &queued_msg, K_FOREVER);
	if (ret) {
		LOG_ERR("Failed to retrieve item from outgoing message queue, error: %d", ret);
		return -ret;
	}

	app_id = nrf_cloud_sensor_app_id_lookup(queued_msg->type);
	if (app_id == NULL) {
		return -EINVAL;
	}

	/* Wait until we are able to send it. */
	LOG_DBG("Waiting for valid connection before transmitting device message");
	(void)await_connection(K_FOREVER);

	/* Attempt to send it.
	 *
	 * Note, it is possible (and better) to batch-send device messages when more than one is
	 * queued up. We limit this sample to sending individual messages mainly to keep the sample
	 * simple and accessible. See the Asset Tracker V2 application for an example of batch
	 * message sending.
	 */
	LOG_DBG("Attempting to transmit enqueued device message type:%d, data_type:%d, app_id:%s",
		queued_msg->type, queued_msg->data_type, app_id);

	/* Send message */
	switch (queued_msg->data_type) {
	case NRF_CLOUD_DATA_TYPE_BLOCK:
		if ((queued_msg->type == NRF_CLOUD_SENSOR_GNSS) &&
		    (queued_msg->data.ptr != NULL) &&
		    (queued_msg->data.len == sizeof(struct nrf_cloud_gnss_data))) {
			ret = nrf_cloud_coap_location_send((const struct nrf_cloud_gnss_data *)
							   queued_msg->data.ptr);
		}
		break;
	case NRF_CLOUD_DATA_TYPE_STR:
		/* TODO -- implement public interface for coap string messages */
		break;
	case NRF_CLOUD_DATA_TYPE_DOUBLE:
		ret = nrf_cloud_coap_sensor_send(app_id, queued_msg->double_val, queued_msg->ts_ms);
		break;
	case NRF_CLOUD_DATA_TYPE_INT:
		ret = nrf_cloud_coap_sensor_send(app_id, (double)queued_msg->int_val,
						 queued_msg->ts_ms);
		break;
	}

	if (ret) {
		LOG_ERR("Transmission of enqueued device message failed, error: %d."
			" The message will be re-enqueued and tried again later.", ret);

		/* Re-enqueue the message for later retry.
		 * No need to create a copy since we already copied the
		 * message object struct when it was first enqueued.
		 */
		ret = enqueue_device_message(queued_msg, false);
		if (ret) {
			LOG_ERR("Could not re-enqueue message, discarding.");
			free_queued_dev_msg_message(queued_msg);
		}

		/* Increment the failure counter. */
		send_failure_count += 1;

		/* If we have failed too many times in a row, there is likely a bigger problem,
		 * and we should reset our connection to nRF Cloud, and wait for a few seconds.
		 */
		if (send_failure_count > CONFIG_MAX_CONSECUTIVE_SEND_FAILURES) {
			/* Disconnect. */
			disconnect_cloud();

			/* Wait for a few seconds before trying again. */
			k_sleep(K_SECONDS(CONFIG_CONSECUTIVE_SEND_FAILURE_COOLDOWN_SECONDS));
		}
	} else {
		/* Clean up the message receive from the queue */
		free_queued_dev_msg_message(queued_msg);

		LOG_DBG("Enqueued device message consumed successfully");

		/* Either overwrite the existing pattern with a short success pattern, or just
		 * disable the previously requested pattern, depending on if we are in verbose mode.
		 */
		if (IS_ENABLED(CONFIG_LED_VERBOSE_INDICATION)) {
			short_led_pattern(LED_SUCCESS);
		} else {
			stop_led_pattern();
		}

		/* Reset the failure counter, since we succeeded. */
		send_failure_count = 0;
	}

	return ret;
}

int send_device_message(struct nrf_cloud_sensor_data *const msg)
{
	/* Enqueue the message, creating a copy to be managed by the queue. */
	int ret = enqueue_device_message(msg, true);

	if (ret) {
		LOG_ERR("Cannot add message to queue");
	}

	return ret;
}

/**
 * @brief Set up the nRF Cloud library
 * Must be called before setup_lte, so that pending FOTA jobs can be checked before LTE init.
 * @return int - 0 on success, otherwise negative error code.
 */
static int setup_cloud(void)
{
	int err;

#if defined(CONFIG_NRF_CLOUD_FOTA)
	err = handle_fota_init();
	if (err) {
		LOG_ERR("Error initializing FOTA: %d", err);
		return err;
	}
	err = handle_fota_begin();
	if (err) {
		LOG_ERR("Error initializing FOTA: %d", err);
		return err;
	}
#endif

	err = nrf_cloud_coap_init();
	if (err) {
		LOG_ERR("Failed to initialize CoAP client: %d", err);
		return err;
	}

	return err;
}

/**
 * @brief Close any connection to nRF Cloud, and reset connection status event state.
 * For internal use only. Externally, disconnect_cloud() may be used to trigger a disconnect.
 */
static void reset_cloud(void)
{
	int err;

	/* Wait for a few seconds to help residual events settle. */
	LOG_INF("Disconnecting from nRF Cloud");
	k_sleep(K_SECONDS(20));

	/* Disconnect from nRF Cloud */
	err = nrf_cloud_coap_disconnect();
	if (err) {
		LOG_ERR("Cannot disconnect from nRF Cloud, error: %d. Continuing anyways", err);
	} else {
		LOG_INF("Successfully disconnected from nRF Cloud");
	}

	/* Clear cloud connection event state (reset to initial state). */
	clear_cloud_connection_events();
}

/**
 * @brief Establish a connection to nRF Cloud (presuming we are connected to LTE).
 *
 * @return int - 0 on success, otherwise negative error code.
 */
static int connect_cloud(void)
{
	int err;

	LOG_INF("Connecting to nRF Cloud using CoAP...");

	/* Begin attempting to connect persistently. */
	while (true) {
		LOG_INF("Next connection retry in %d seconds",
			CONFIG_CLOUD_CONNECTION_RETRY_TIMEOUT_SECONDS);

		err = nrf_cloud_coap_connect();
		if (err) {
			LOG_ERR("Failed to connect and get authorized: %d", err);
		} else {
			notify_cloud_connected();
		}

		/* Wait for cloud connection success. If succeessful, break out of the loop. */
		if (await_cloud_connected(
			K_SECONDS(CONFIG_CLOUD_CONNECTION_RETRY_TIMEOUT_SECONDS))) {
			notify_cloud_ready();
			break;
		}
	}

	LOG_INF("Connected to nRF Cloud using CoAP");

	return err;
}

/**
 * @brief Set up the modem library.
 *
 * @return int - 0 on success, otherwise a negative error code.
 */
static int setup_modem(void)
{
	int ret;

	/*
	 * If there is a pending modem delta firmware update stored, nrf_modem_lib_init will
	 * attempt to install it before initializing the modem library, and return a
	 * positive value to indicate that this occurred. This code can be used to
	 * determine whether the update was successful.
	 */
	ret = nrf_modem_lib_init();

	if (ret < 0) {
		LOG_ERR("Modem library initialization failed, error: %d", ret);
		return ret;
	} else if (ret == NRF_MODEM_DFU_RESULT_OK) {
		LOG_DBG("Modem library initialized after "
			"successful modem firmware update.");
	} else if (ret > 0) {
		LOG_ERR("Modem library initialized after "
			"failed modem firmware update, error: %d", ret);
	} else {
		LOG_DBG("Modem library initialized.");
	}

	/* Register to be notified when the modem has figured out the current time. */
	date_time_register_handler(date_time_evt_handler);

	/* Modem info library is used to obtain the modem FW version
	 * and network info for single-cell requests
	 */
#if defined(CONFIG_MODEM_INFO)
	ret = modem_info_init();
	if (ret) {
		LOG_ERR("Modem info initialization failed, error: %d", ret);
		return ret;
	}

	ret = modem_info_params_init(&mdm_param);
	if (ret) {
		LOG_ERR("Modem info params initialization failed, error: %d", ret);
		return ret;
	}
#endif

	return 0;
}

static void get_modem_info(void)
{
#if defined(CONFIG_MODEM_INFO)
	int ret;

	ret = modem_info_params_get(&mdm_param);
	if (ret) {
		LOG_ERR("Modem info params reading failed, error: %d", ret);
	}

	char mfwv_str[128];

	if (modem_info_string_get(MODEM_INFO_FW_VERSION, mfwv_str, sizeof(mfwv_str)) <= 0) {
		LOG_WRN("Failed to get modem FW version");
	} else {
		LOG_INF("Modem FW version: %s", mfwv_str);
	}
#endif
}

/**
 * @brief Set up LTE and start trying to connect.
 *
 * Must be called AFTER setup_cloud to ensure proper operation of FOTA.
 * @return int - 0 on success, otherwise a negative error code.
 */
static int setup_lte(void)
{
	int err;

	/* Perform Configuration */
	LOG_INF("Requesting PSM mode");

	err = lte_lc_psm_req(true);
	if (err) {
		LOG_ERR("Failed to set PSM parameters, error: %d", err);
		return err;
	} else {
		LOG_INF("PSM mode requested");
	}

	/* Modem events must be enabled before we can receive them. */
	err = lte_lc_modem_events_enable();
	if (err) {
		LOG_ERR("lte_lc_modem_events_enable failed, error: %d", err);
		return err;
	}

	/* Init the modem, and start keeping an active connection.
	 * Note that if connection is lost, the modem will automatically attempt to
	 * re-establish it after this call.
	 */
	LOG_INF("Starting connection to LTE network...");
	err = lte_lc_init_and_connect_async(lte_event_handler);
	if (err) {
		LOG_ERR("Modem could not be configured, error: %d", err);
		return err;
	}

	return 0;
}

void message_queue_thread_fn(void)
{
	/* Continually attempt to consume device messages */
	while (true) {
		(void) consume_device_message();
	}
}

void connection_management_thread_fn(void)
{
	long_led_pattern(LED_WAITING);

	/* Enable the modem */
	LOG_INF("Setting up modem...");
	if (setup_modem()) {
		LOG_ERR("Fatal: Modem setup failed");
		long_led_pattern(LED_FAILURE);
		return;
	}

	/* The nRF Cloud library need only be initialized once, and does not need to be reset
	 * under any circumstances, even error conditions.
	 */
	LOG_INF("Setting up nRF Cloud library...");
	if (setup_cloud()) {
		LOG_ERR("Fatal: nRF Cloud library setup failed");
		long_led_pattern(LED_FAILURE);
		return;
	}

	/* Set up LTE and start trying to connect.
	 * This is done once only, since the modem handles connection persistence then after.
	 *
	 * (Once we request connection, the modem will automatically try to reconnect whenever
	 *  connection is lost).
	 */
	LOG_INF("Setting up LTE...");
	if (setup_lte()) {
		LOG_ERR("Fatal: LTE setup failed");
		long_led_pattern(LED_FAILURE);
		return;
	}

	LOG_INF("Connecting to LTE network. This may take several minutes...");
	while (true) {
		/* Wait for LTE to become connected (or re-connected if connection was lost). */
		LOG_INF("Waiting for connection to LTE network...");

		if (IS_ENABLED(CONFIG_LED_VERBOSE_INDICATION)) {
			long_led_pattern(LED_WAITING);
		}

		(void)await_lte_connection(K_FOREVER);
		LOG_INF("Connected to LTE network");

		get_modem_info();

		/* Attempt to connect to nRF Cloud. */
		if (!connect_cloud()) {
			/* If successful, update the device shadow. */
			update_shadow();

			/* and then wait patiently for a connection problem. */
			(void)await_cloud_disconnection(K_FOREVER);

			LOG_INF("Disconnected from nRF Cloud");
		} else {
			LOG_INF("Failed to connect to nRF Cloud");
		}

		/* Reset cloud connection state before trying again. */
		reset_cloud();

		/* Wait a bit before trying again. */
		k_sleep(K_SECONDS(CONFIG_CLOUD_CONNECTION_REESTABLISH_DELAY_SECONDS));
	}
}
```

## src/handle_fota.h
```c
/*
 * Copyright (c) 2023 Nordic Semiconductor ASA
 *
 * SPDX-License-Identifier: LicenseRef-Nordic-5-Clause
 */

#ifndef HANDLE_FOTA_H
#define HANDLE_FOTA_H

int handle_fota_init(void);
int handle_fota_begin(void);
int handle_fota_process(void);

#endif /* HANDLE_FOTA_H */
```

## src/location_tracking.h
```c
/* Copyright (c) 2022 Nordic Semiconductor ASA
 *
 * SPDX-License-Identifier: LicenseRef-Nordic-5-Clause
 */

#ifndef _LOCATION_TRACKING_H_
#define _LOCATION_TRACKING_H_

/* Definition found in location.h */
struct location_event_data;

/**
 * @brief Callback to receive tracked locations.
 *
 * @param[in] location_data The tracked location data.
 */
typedef void (*location_update_cb_t)(const struct location_event_data * const location_data);

/**
 * @brief Start tracking our location at the given interval in seconds.
 *
 * @param handler_cb - Handler callback to receive location updates.
 * @param interval - The interval, in seconds, at which to track our location.
 */
int start_location_tracking(location_update_cb_t handler_cb, int interval);

/**
 * @brief Check whether one of the location tracking methods is enabled
 *
 * @return bool - Whether location tracking of any form is enabled
 */
static inline bool location_tracking_enabled(void)
{
	return IS_ENABLED(CONFIG_LOCATION_TRACKING_GNSS) ||
	       IS_ENABLED(CONFIG_LOCATION_TRACKING_CELLULAR) ||
	       IS_ENABLED(CONFIG_LOCATION_TRACKING_WIFI);
}


#endif /* _LOCATION_TRACKING_H_ */
```
