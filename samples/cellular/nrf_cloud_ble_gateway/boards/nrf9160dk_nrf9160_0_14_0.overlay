/*
 * Copyright (c) 2021 Nordic Semiconductor ASA
 *
 * SPDX-License-Identifier: LicenseRef-Nordic-5-Clause
 */
/*
 * #include <nrf9160/nrf9160dk_uart1_on_if0_3.dtsi>
 * #include <nrf9160/nrf9160dk_nrf9160_common_0_14_0.dtsi>
 * #include <nrf9160/nrf9160dk_nrf52840_reset_on_if9.dtsi>
 */
#include <nrf9160/nrf9160dk_nrf9160_common_0_14_0.dtsi>

&nrf52840_reset {
	status = "okay";
};
