/*
 * Copyright (c) 2023 Nordic Semiconductor ASA
 *
 * SPDX-License-Identifier: LicenseRef-Nordic-5-Clause
 */

/ {
	chosen {
		nordic,pm-ext-flash = &gd25lb256;
	};
};

/* External flash device is disabled by default */
&gd25lb256 {
	status = "okay";
};
