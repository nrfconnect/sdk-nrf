## samples/cellular/nidd/sample.yaml
```yaml
sample:
  name: NIDD sample
tests:
  sample.cellular.nidd:
    sysbuild: true
    build_only: true
    platform_allow:
      - nrf9151dk/nrf9151/ns
      - thingy91x/nrf9151/ns
    integration_platforms:
      - nrf9151dk/nrf9151/ns
    tags:
      - ci_build
      - sysbuild
      - ci_samples_cellular
```

## samples/cellular/nrf_cloud_mqtt_cell_location/sample.yaml
```yaml
sample:
  name: nRF Cloud MQTT cellular location
tests:
  sample.cellular.nrf_cloud_mqtt_cell_location:
    sysbuild: true
    build_only: true
    integration_platforms:
      - nrf9151dk/nrf9151/ns
    platform_allow:
      - nrf9151dk/nrf9151/ns
      - thingy91x/nrf9151/ns
    tags:
      - ci_build
      - sysbuild
      - ci_samples_cellular
```

## samples/cellular/nrf_cloud_mqtt_device_message/sample.yaml
```yaml
sample:
  name: nRF Cloud MQTT Device message
tests:
  sample.cellular.nrf_cloud_mqtt_device_message:
    sysbuild: true
    build_only: true
    integration_platforms:
      - nrf9151dk/nrf9151/ns
    platform_allow:
      - nrf9151dk/nrf9151/ns
      - thingy91x/nrf9151/ns
    tags:
      - ci_build
      - sysbuild
      - ci_samples_cellular
```

## samples/cellular/nrf_cloud_mqtt_fota/sample.yaml
```yaml
sample:
  name: nRF Cloud MQTT FOTA
tests:
  sample.cellular.nrf_cloud_mqtt_fota:
    sysbuild: true
    build_only: true
    integration_platforms:
      - nrf9151dk/nrf9151/ns
      - thingy91x/nrf9151/ns
    platform_allow:
      - nrf9151dk/nrf9151/ns
      - thingy91x/nrf9151/ns
    tags:
      - ci_build
      - sysbuild
      - ci_samples_cellular
  sample.cellular.nrf_cloud_mqtt_fota_fmfu:
    sysbuild: true
    build_only: true
    integration_platforms:
      - nrf9151dk/nrf9151/ns
      - thingy91x/nrf9151/ns
    platform_allow:
      - nrf9151dk/nrf9151/ns
      - thingy91x/nrf9151/ns
    tags:
      - ci_build
      - sysbuild
      - ci_samples_cellular
    extra_args:
      - EXTRA_CONF_FILE="full_modem_fota.conf"
```

## samples/cellular/pdn/sample.yaml
```yaml
sample:
  name: pdn sample
tests:
  sample.cellular.pdn:
    sysbuild: true
    build_only: true
    integration_platforms:
      - nrf9151dk/nrf9151/ns
    platform_allow:
      - nrf9151dk/nrf9151/ns
    tags:
      - ci_build
      - sysbuild
      - ci_samples_cellular
```

## samples/cellular/system_off/Kconfig
```kconfig
#
# Copyright (c) 2026 Nordic Semiconductor ASA
#
# SPDX-License-Identifier: LicenseRef-Nordic-5-Clause
#

mainmenu "System off sample"

config SAMPLE_STATE_RETENTION
	bool "State retention in system off"
	select RETAINED_MEM
	help
	  Enable state retention in system off using retained memory driver.

config SAMPLE_GPIO_WAKEUP
	bool "Wake up from system off using a button"
	default y
	help
	  Enable wakeup from system off by pressing button 0.

config SAMPLE_GRTC_WAKEUP
	bool "Wake up from system off using GRTC"
	help
	  Enable wakeup from system off using General Real-Time Counter (GRTC).

source "Kconfig.zephyr"
```

## samples/cellular/t91x-memfault-slm-host-app/Kconfig
```kconfig
# Copyright (c) 2025 Olivier Lalonde
# SPDX-License-Identifier: Apache-2.0

mainmenu "Memfault over Serial Modem host sample"

source "Kconfig.zephyr"
```

## samples/cellular/uicc_lwm2m/sample.yaml
```yaml
sample:
  name: UICC LwM2M sample
tests:
  sample.cellular.uicc_lwm2m:
    sysbuild: true
    build_only: true
    platform_allow:
      - nrf9151dk/nrf9151/ns
      - thingy91x/nrf9151/ns
    integration_platforms:
      - nrf9151dk/nrf9151/ns
    tags:
      - ci_build
      - sysbuild
      - ci_samples_cellular
```

## samples/crypto/ml_dsa/sample.yaml
```yaml
sample:
  description: |
    This sample demonstrates ML-DSA signature verification using the PSA Crypto API.
  name: ML-DSA sample
common:
  sysbuild: true
  tags:
    - introduction
    - psa
    - sysbuild
    - ci_samples_crypto
    - crypto
  harness: console
  harness_config:
    type: multi_line
    regex:
      - ".*Example finished successfully!.*"
tests:
  sample.ml_dsa.cracen:
    tags:
      - cracen
    platform_allow:
      - nrf54l15dk/nrf54l15/cpuapp
      - nrf54lm20dk/nrf54lm20a/cpuapp
      - nrf54lm20dk/nrf54lm20a/cpuapp
      - nrf54lm20dk/nrf54lm20b/cpuapp
      - nrf54lv10dk/nrf54lv10a/cpuapp
    integration_platforms:
      - nrf54l15dk/nrf54l15/cpuapp
      - nrf54lm20dk/nrf54lm20a/cpuapp
      - nrf54lm20dk/nrf54lm20b/cpuapp
      - nrf54lv10dk/nrf54lv10a/cpuapp
  sample.ml_dsa.oberon:
    extra_args:
      - CONFIG_PSA_CRYPTO_DRIVER_OBERON=y
      - CONFIG_PSA_CRYPTO_DRIVER_CRACEN=n
    tags:
      - oberon
    platform_allow:
      - nrf54l15dk/nrf54l15/cpuapp
      - nrf54lm20dk/nrf54lm20a/cpuapp
      - nrf54lm20dk/nrf54lm20a/cpuapp
      - nrf54lm20dk/nrf54lm20b/cpuapp
      - nrf54lv10dk/nrf54lv10a/cpuapp
    integration_platforms:
      - nrf54l15dk/nrf54l15/cpuapp
```

## samples/debug/memfault/sample.yaml
```yaml
sample:
  name: Memfault sample
tests:
  sample.debug.memfault:
    sysbuild: true
    build_only: true
    extra_configs:
      - CONFIG_MEMFAULT_NCS_PROJECT_KEY="dummy-key"
    integration_platforms:
      - nrf9151dk/nrf9151/ns
      - thingy91x/nrf9151/ns
      - nrf7002dk/nrf5340/cpuapp
    platform_allow:
      - nrf9160dk/nrf9160/ns
      - nrf9161dk/nrf9161/ns
      - nrf9151dk/nrf9151/ns
      - thingy91/nrf9160/ns
      - thingy91x/nrf9151/ns
      - nrf7002dk/nrf5340/cpuapp
    tags:
      - ci_build
      - sysbuild
      - ci_samples_debug
  sample.debug.memfault.etb:
    sysbuild: true
    build_only: true
    extra_configs:
      - CONFIG_MEMFAULT_NCS_PROJECT_KEY="dummy-key"
    extra_args: OVERLAY_CONFIG=overlay-etb.conf
    integration_platforms:
      - nrf9161dk/nrf9161/ns
      - nrf9151dk/nrf9151/ns
      - thingy91x/nrf9151/ns
    platform_allow:
      - nrf9160dk/nrf9160/ns
      - nrf9161dk/nrf9161/ns
      - nrf9151dk/nrf9151/ns
      - thingy91/nrf9160/ns
      - thingy91x/nrf9151/ns
    tags:
      - ci_build
      - sysbuild
      - ci_samples_debug
  # Split off from sample.debug.memfault.etb: ETB_TRACE depends on
  # SOC_SERIES_NRF91, so on the nRF5340 the whole ETB part of overlay-etb.conf
  # was silently dropped. This variant uses an overlay without it.
  sample.debug.memfault.etb.nrf53:
    sysbuild: true
    build_only: true
    extra_configs:
      - CONFIG_MEMFAULT_NCS_PROJECT_KEY="dummy-key"
    extra_args: OVERLAY_CONFIG=overlay-etb-nrf53.conf
    integration_platforms:
      - nrf7002dk/nrf5340/cpuapp
    platform_allow:
      - nrf7002dk/nrf5340/cpuapp
    tags:
      - ci_build
      - sysbuild
      - ci_samples_debug
  sample.debug.memfault.modem_trace_to_memfault:
    sysbuild: true
    build_only: true
    extra_configs:
      - CONFIG_MEMFAULT_NCS_PROJECT_KEY="dummy-key"
    extra_args: OVERLAY_CONFIG=overlay-modem-trace-to-memfault.conf
    integration_platforms:
      - nrf9151dk/nrf9151/ns
      - thingy91x/nrf9151/ns
    platform_allow:
      - nrf9151dk/nrf9151/ns
      - thingy91x/nrf9151/ns
    tags:
      - ci_build
      - sysbuild
      - ci_samples_debug
```

## samples/dect/dect_phy/dect_shell/sample.yaml
```yaml
sample:
  name: DECT NR+ PHY Shell sample
tests:
  sample.dect.dect_phy.dect_shell:
    sysbuild: true
    build_only: true
    integration_platforms:
      - nrf9151dk/nrf9151/ns
      - thingy91x/nrf9151/ns
    platform_allow:
      - nrf9151dk/nrf9151/ns
      - thingy91x/nrf9151/ns
    tags:
      - ci_build
      - sysbuild
      - ci_samples_dect
```

## samples/dect/dect_phy/hello_dect/sample.yaml
```yaml
sample:
  name: Dect NR+ PHY Hello
tests:
  sample.dect_phy.dect_hello.eu.sysbuild:
    sysbuild: true
    build_only: true
    integration_platforms:
      - nrf9151dk/nrf9151/ns
    platform_allow:
      - nrf9151dk/nrf9151/ns
    extra_args: EXTRA_CONF_FILE="overlay-eu.conf"
    tags:
      - ci_build
      - sysbuild
      - ci_samples_dect
  sample.dect_phy.dect_hello.us.sysbuild:
    sysbuild: true
    build_only: true
    integration_platforms:
      - nrf9151dk/nrf9151/ns
    platform_allow:
      - nrf9151dk/nrf9151/ns
    extra_args: EXTRA_CONF_FILE="overlay-us.conf"
    tags:
      - ci_build
      - sysbuild
      - ci_samples_dect
```

## samples/dect/dect_rpc/Kconfig
```kconfig
#
# Copyright (c) 2026 Nordic Semiconductor ASA
#
# SPDX-License-Identifier: LicenseRef-Nordic-5-Clause
#

menu "DECT NR+ RPC sample configuration"

config SAMPLE_DECT_RPC_CLIENT_IPERF3
	bool "iPerf3 (shell command)"
	select NRF_IPERF3
	help
	  Enable the ``iperf3`` shell command.

endmenu

source "Kconfig.zephyr"
```

## samples/dect/dect_shell/Kconfig
```kconfig
#
# Copyright (c) 2026 Nordic Semiconductor ASA
#
# SPDX-License-Identifier: LicenseRef-Nordic-5-Clause
#

menu "DECT NR+ Shell config"

config SAMPLE_DESH_PRINT_BUFFER_SIZE
	int "Buffer size used when printing shell output"
	default 1024
	help
	  If the printed string exceeds this buffer, an error message is printed
	  first, and then the requested string is cut into the length of this buffer.

config SAMPLE_DESH_COMMON_WORKQ_STACK_SIZE
	int "Common workqueue stack size"
	default 3072

config SAMPLE_DESH_DECT_ICMP_PING
	bool "ICMP ping support"
	depends on NET_IPV6 && NET_NATIVE && NET_SOCKETS
	default y
	help
	  ICMPv6 ping through the Zephyr net_icmp API. DeSh ping extends net ping with
	  hostname resolution, configurable count/interval/timeout/payload,
	  per-reply and summary RTT statistics, default DECT interface binding,
	  and abort through the DeSh kill signal.

config SAMPLE_DESH_IPERF3
	bool "iPerf3"
	select NRF_IPERF3

config SAMPLE_DESH_CLOUD_MQTT
	bool "MQTT connection to nRF Cloud"
	depends on NRF_CLOUD_MQTT
	help
	  MQTT connection to nRF Cloud.

config SAMPLE_DESH_CLOUD_COAP
	bool "CoAP connection to nRF Cloud"
	depends on NRF_CLOUD_COAP
	help
	  CoAP connection to nRF Cloud.

config SAMPLE_DESH_MDNS_DNS_SD_ADVERTISE
	bool "Advertise _dect-nr._udp using DNS-SD on dect0"
	depends on MDNS_RESPONDER_DNS_SD
	depends on NET_MGMT && NET_MGMT_EVENT
	help
	  Register a DNS-SD service record for _dect-nr._udp so that peers
	  browsing through mDNS see this device. Zephyr's mdns_responder answers
	  PTR/SRV/TXT/AAAA queries using the record; this sample does not run
	  an application-level service on the advertised SRV port, and the
	  TXT record carries "status=not-implemented" to signal that.

if SAMPLE_DESH_MDNS_DNS_SD_ADVERTISE

config SAMPLE_DESH_MDNS_DNS_SD_PORT
	int "DNS-SD service port on dect0"
	default 4700
	range 1 65535
	help
	  UDP port placed in the SRV record advertised for _dect-nr._udp.
	  Reserved for a future application service (info/telemetry/CoAP/...);
	  the sample binds a placeholder UDP socket on this port so DNS-SD SRV
	  records are advertised, but no application-level service is implemented.

endif # SAMPLE_DESH_MDNS_DNS_SD_ADVERTISE

config SAMPLE_DESH_MDNS_DISCOVER
	bool "dect discover shell command"
	depends on MDNS_RESOLVER
	help
	  Discover nearby DECT NR+ devices through mDNS: browses _dect-nr._udp
	  (PTR) to find peer instances and resolves their .local hostnames
	  (AAAA) to list IPv6 addresses.

config SAMPLE_DESH_L2_SHELL
	bool "DECT NR+ Shell for nRF91 Modem MAC"
	default y
	select DECT_L2_SHELL_LIB
	help
	  Enable support for DECT NR+ Net Management interface.
	  This selects the DECT MAC L2 shell library.

menuconfig SAMPLE_DESH_AUTO_CONNECT
	bool "Auto-connect command"
	default y
	help
	  Build the "auto_connect" shell command and its event-driven worker
	  that joins (PT) or creates (FT) the DECT NR+ network automatically
	  once the configured trigger conditions are met. The runtime state is
	  persisted through the Zephyr settings subsystem. Auto-connect is
	  disabled at runtime by default; enable it using the shell or
	  SAMPLE_DESH_AUTO_CONNECT_DEFAULT_ENABLED.

	  Disable to drop both auto_connect.c and auto_connect_shell.c from the
	  build when the sample only needs manual network bring-up.

if SAMPLE_DESH_AUTO_CONNECT

config SAMPLE_DESH_AUTO_CONNECT_DEFAULT_ENABLED
	bool "Enable auto-connect by default"
	help
	  Initial value of the auto-connect setting at first boot, used until
	  the user overrides it using the "auto_connect enable|disable" shell
	  commands. The override is persisted through the Zephyr settings
	  subsystem and wins over this default on subsequent boots.

	  When enabled, the sample joins (PT) or creates (FT) the DECT NR+
	  network automatically once the trigger conditions are met
	  (see SAMPLE_DESH_AUTO_CONNECT_DEFAULT_DELAY_SECS).

config SAMPLE_DESH_AUTO_CONNECT_DEFAULT_DELAY_SECS
	int "Auto-connect delay (seconds)"
	default 0
	range 0 86400
	help
	  Initial auto-connect delay used at first boot, until the user
	  overrides it using "auto_connect delay <seconds>". The override is
	  persisted through the Zephyr settings subsystem and wins over this
	  default on subsequent boots.

	  0 selects the default trigger: when CONFIG_NET_CONNECTION_MANAGER is
	  enabled, auto_connect waits for both NET_EVENT_DECT_ACTIVATE_DONE and
	  NET_EVENT_L4_CONNECTED before firing; otherwise it fires as soon as
	  NET_EVENT_DECT_ACTIVATE_DONE arrives.

	  A non-zero value overrides the default trigger and schedules the
	  auto-connect work that many seconds after NET_EVENT_DECT_ACTIVATE_DONE,
	  independent of L4 connectivity.

endif # SAMPLE_DESH_AUTO_CONNECT

rsource "Kconfig.native_tls"

endmenu # Nordic DECT NR+ Shell config

menu "Zephyr Kernel"
source "Kconfig.zephyr"
endmenu
```

## samples/dect/dect_shell/sample.yaml
```yaml
sample:
  name: DECT NR+ Shell Sample
common:
  tags:
    - ci_build
    - sysbuild
    - ci_samples_dect
  sysbuild: true
  build_only: true
  integration_platforms:
    - nrf9151dk/nrf9151/ns
  platform_allow:
    - nrf9151dk/nrf9151/ns
tests:
  sample.dect.dect_shell: {}
  sample.dect.dect_shell.mdns_discover:
    extra_args: EXTRA_CONF_FILE=mdns-discover.conf
  sample.dect.dect_shell.ft_sink:
    extra_args: FILE_SUFFIX=sm
  sample.dect.dect_shell.iperf3_tx:
    extra_args:
      - EXTRA_CONF_FILE="iperf3-common.conf;iperf3-tx.conf"
      - EXTRA_DTC_OVERLAY_FILE="iperf3-tx.overlay"
  sample.dect.dect_shell.iperf3_rx:
    extra_args:
      - EXTRA_CONF_FILE="iperf3-common.conf;iperf3-rx.conf"
      - EXTRA_DTC_OVERLAY_FILE="iperf3-rx.overlay"
  sample.dect.dect_shell.nrf_cloud_mqtt:
    extra_args: EXTRA_CONF_FILE="nrf_cloud_mqtt.conf"
  sample.dect.dect_shell.nrf_cloud_coap:
    extra_args:
      - EXTRA_CONF_FILE="nrf_cloud_coap.conf"
      - DTC_OVERLAY_FILE="nrf_cloud_coap.overlay"
  sample.dect.dect_shell.arceli_eth_w5500:
    extra_args: SHIELD=arceli_eth_w5500 EXTRA_CONF_FILE="eth_common.conf;eth_w5500.conf" EXTRA_DTC_OVERLAY_FILE="eth-rx.overlay;w5500-static-mac.overlay"
  sample.dect.dect_shell.arceli_eth_w5500_random_mac:
    extra_args: SHIELD=arceli_eth_w5500 EXTRA_CONF_FILE="eth_common.conf;eth_w5500.conf" EXTRA_DTC_OVERLAY_FILE="eth-rx.overlay;w5500.overlay"
  sample.dect.dect_shell.seeed_eth_w5500:
    extra_args: SHIELD=seeed_w5500 EXTRA_CONF_FILE="eth_common.conf;eth_w5500.conf;eth_w5500_seeed.conf" EXTRA_DTC_OVERLAY_FILE="eth-rx.overlay;w5500-seeed-static-mac.overlay"
  sample.dect.dect_shell.seeed_eth_w5500_random_mac:
    extra_args: SHIELD=seeed_w5500 EXTRA_CONF_FILE="eth_common.conf;eth_w5500.conf;eth_w5500_seeed.conf" EXTRA_DTC_OVERLAY_FILE="eth-rx.overlay;w5500-seeed.overlay"
  sample.dect.dect_shell.arceli_eth_w5500_mdns:
    extra_args: SHIELD=arceli_eth_w5500 EXTRA_CONF_FILE="eth_common.conf;eth_w5500.conf;mdns-common.conf;mdns-discover.conf;eth_sink_mdns-discover.conf" EXTRA_DTC_OVERLAY_FILE="eth-rx.overlay;w5500-static-mac.overlay"
  sample.dect.dect_shell.seeed_eth_w5500_mdns:
    extra_args: SHIELD=seeed_w5500 EXTRA_CONF_FILE="eth_common.conf;eth_w5500.conf;eth_w5500_seeed.conf;mdns-common.conf;mdns-discover.conf" EXTRA_DTC_OVERLAY_FILE="eth-rx.overlay;w5500-seeed-static-mac.overlay"
```
