## samples/dect/dect_tether_ipv6/Kconfig
```kconfig
#
# Copyright (c) 2026 Nordic Semiconductor ASA
#
# SPDX-License-Identifier: LicenseRef-Nordic-5-Clause
#

source "Kconfig.zephyr"

config SAMPLE_DECT_TETHER_IPV6_MDNS_DNS_SD
	bool "Advertise _dect-nr._udp on dect0 (mDNS DNS-SD, like dect_shell)"
	depends on MDNS_RESPONDER_DNS_SD
	help
	  Binds a UDP socket on the DECT interface and registers mDNS DNS-SD for
	  _dect-nr._udp.local so peers on DECT can browse this device (e.g. avahi-browse).
	  Enable CONFIG_NET_HOSTNAME and stack options via mdns.conf.

if SAMPLE_DECT_TETHER_IPV6_MDNS_DNS_SD

config SAMPLE_DECT_TETHER_IPV6_MDNS_DNS_SD_PORT
	int "UDP port for mDNS DNS-SD stub socket on dect0"
	default 4700
	range 1 65535
	help
	  Port bound on dect0 so dns_sd port_in_use checks succeed. Must match dns_sd_rec.port.

endif # SAMPLE_DECT_TETHER_IPV6_MDNS_DNS_SD

module = SAMPLE_DECT_TETHER_IPV6
module-str = DECT IPv6 tethering sample
source "${ZEPHYR_BASE}/subsys/logging/Kconfig.template.log_config"
```

## samples/dfu/compressed_update/boards/nrf54lc10dk_nrf54lc10a_cpuapp_ns.conf
```kconfig
#
# Copyright (c) 2026 Nordic Semiconductor ASA
#
# SPDX-License-Identifier: LicenseRef-Nordic-5-Clause
#

CONFIG_BUILD_WITH_TFM=y
CONFIG_TFM_PROFILE_TYPE_MINIMAL=y
CONFIG_TFM_LOG_LEVEL_SILENCE=y
CONFIG_TFM_NRF_PROVISIONING=n
CONFIG_TFM_DUMMY_PROVISIONING=y
```

## samples/dfu/compressed_update/sysbuild/mcuboot/boards/nrf54lc10dk_nrf54lc10a_cpuapp_tfm.conf
```kconfig
#
# Copyright (c) 2026 Nordic Semiconductor ASA
#
# SPDX-License-Identifier: LicenseRef-Nordic-5-Clause
#

CONFIG_HW_STACK_PROTECTION=n
CONFIG_BOOT_WATCHDOG_FEED=n
CONFIG_TICKLESS_KERNEL=y
CONFIG_FPROTECT=n
CONFIG_MCUBOOT_CLEANUP_RAM=y
```

## samples/dfu/encrypted_bootloader/sample.yaml
```yaml
sample:
  description: Encrypted MCUboot update sample
  name: Encrypted MCUboot SMP Server sample
common:
  sysbuild: true
  harness: console
  harness_config:
    type: multi_line
    ordered: false
    regex:
      - "Firmware version .*"
      - "Booting .*"
      - "Starting .*bootloader"
      - "Jumping to the .*image slot"
      - "build time"
  timeout: 15
  tags:
    - mcuboot_with_encryption
    - ci_samples_dfu

tests:
  sample.dfu.encrypted_mcuboot.load_addr:
    extra_args:
      - platform:nrf54l15dk/nrf54l15/cpuapp:SB_CONFIG_SECURE_BOOT_BOOTCONF_ALLOW_UNDERSIZED=y
    platform_allow:
      - nrf54l15dk/nrf54l15/cpuapp
    integration_platforms:
      - nrf54l15dk/nrf54l15/cpuapp
    tags:
      - encryption

  sample.dfu.encrypted_mcuboot.uuid:
    platform_allow:
      - nrf54l15dk/nrf54l15/cpuapp
    integration_platforms:
      - nrf54l15dk/nrf54l15/cpuapp
    tags:
      - encryption
    extra_args:
      - platform:nrf54l15dk/nrf54l15/cpuapp:SB_CONFIG_SECURE_BOOT_BOOTCONF_ALLOW_UNDERSIZED=y
      - FILE_SUFFIX=uuid

  sample.dfu.encrypted_mcuboot.ext_flash:
    platform_allow:
      - nrf54l15dk/nrf54l15/cpuapp
    integration_platforms:
      - nrf54l15dk/nrf54l15/cpuapp
    tags:
      - encryption
    extra_args:
      - platform:nrf54l15dk/nrf54l15/cpuapp:SB_CONFIG_SECURE_BOOT_BOOTCONF_ALLOW_UNDERSIZED=y
      - FILE_SUFFIX=ext_flash
```

## samples/dfu/fw_loader/usb_mcumgr/Kconfig
```kconfig
#
# Copyright (c) 2026 Nordic Semiconductor ASA
#
# SPDX-License-Identifier: LicenseRef-Nordic-5-Clause
#

menu "USB MCUmgr firmware loader sample"

config SAMPLE_USB_MCUMGR_LED_THREAD
	bool "LED thread"
	default y if BOARD_NRF54LM20DONGLE
	depends on $(dt_alias_enabled,led0)
	select GPIO
	help
	  Start a low-priority thread that blinks the LED selected with the
	  devicetree alias "led0".

endmenu

source "Kconfig.zephyr"
```

## samples/dfu/mcuboot_with_encryption/sysbuild/mcuboot/boards/nrf54ls05dk_nrf54ls05a_cpuapp.conf
```kconfig
#
# Copyright (c) 2026 Nordic Semiconductor ASA
#
# SPDX-License-Identifier: LicenseRef-Nordic-5-Clause
#

CONFIG_SPI_NOR=n
CONFIG_SPI=n
CONFIG_FPROTECT=n
CONFIG_FAULT_DUMP=0
CONFIG_ARM_MPU=n

CONFIG_ISR_TABLES_LOCAL_DECLARATION=y
CONFIG_LTO=y
```
