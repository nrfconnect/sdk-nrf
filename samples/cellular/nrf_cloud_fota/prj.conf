## CMakeLists.txt
```
#
# Copyright (c) 2021 Nordic Semiconductor
#
# SPDX-License-Identifier: LicenseRef-Nordic-5-Clause
#

cmake_minimum_required(VERSION 3.20.0)

find_package(Zephyr REQUIRED HINTS $ENV{ZEPHYR_BASE})
project(nrf_cloud_fota_sample)
zephyr_compile_definitions(PROJECT_NAME=${PROJECT_NAME})

# NORDIC SDK APP START
target_sources(app PRIVATE src/main.c)

if(CONFIG_NRF_CLOUD_FOTA_SMP AND CONFIG_BOARD_NRF9160DK_NRF9160_NS)
  target_sources(app PRIVATE src/smp_reset.c)
endif()
# NORDIC SDK APP END
```

## Kconfig
```
#
# Copyright (c) 2021 Nordic Semiconductor ASA
#
# SPDX-License-Identifier: LicenseRef-Nordic-5-Clause
#

menu "nRF Cloud FOTA Sample"

config NRF_CLOUD_FOTA_SAMPLE_VERSION
	string "The sample's version string"
	default "1.0.0"

config NRFCLOUD_FOTA_JOB_CHECK_RATE_MIN
	int "Rate (minutes) at which this sample will check for FOTA updates"
	range 1 10080
	default 15

config NRFCLOUD_FOTA_LTE_LED_NUM
	int "LED number to use for LTE connection status"
	default 0

config NRFCLOUD_FOTA_BUTTON_EVT_NUM
	int "Button number to use for device interactions"
	default 1

endmenu

menu "Zephyr Kernel"
source "Kconfig.zephyr"
endmenu

module = NRF_CLOUD_FOTA_SAMPLE
module-str = nRF Cloud FOTA Sample
source "${ZEPHYR_BASE}/subsys/logging/Kconfig.template.log_config"
```

## sample.yaml
```
sample:
  name: nRF Cloud FOTA
tests:
  sample.cellular.nrf_cloud_fota_rest:
    sysbuild: true
    build_only: true
    integration_platforms:
      - nrf9151dk/nrf9151/ns
      - nrf9160dk/nrf9160/ns
      - nrf9161dk/nrf9161/ns
      - thingy91x/nrf9151/ns
    platform_allow:
      - nrf9151dk/nrf9151/ns
      - nrf9160dk/nrf9160/ns
      - nrf9161dk/nrf9161/ns
      - thingy91x/nrf9151/ns
    tags:
      - ci_build
      - sysbuild
      - ci_samples_cellular
  sample.cellular.nrf_cloud_fota_coap:
    sysbuild: true
    build_only: true
    integration_platforms:
      - nrf9151dk/nrf9151/ns
      - nrf9160dk/nrf9160/ns
      - nrf9161dk/nrf9161/ns
      - thingy91x/nrf9151/ns
    platform_allow:
      - nrf9151dk/nrf9151/ns
      - nrf9160dk/nrf9160/ns
      - nrf9161dk/nrf9161/ns
      - thingy91x/nrf9151/ns
    tags:
      - ci_build
      - sysbuild
      - ci_samples_cellular
    extra_args: EXTRA_CONF_FILE="overlay_coap.conf"
```

## sysbuild.conf
```
#
# Copyright (c) 2023 Nordic Semiconductor
#
# SPDX-License-Identifier: LicenseRef-Nordic-5-Clause
#

SB_CONFIG_BOOTLOADER_MCUBOOT=y
SB_CONFIG_SECURE_BOOT_APPCORE=y
```

## prj.conf
```kconfig
# Sample
CONFIG_NRF_CLOUD_FOTA_SAMPLE_LOG_LEVEL_INF=y

# nRF Cloud REST
CONFIG_NRF_CLOUD=y
CONFIG_NRF_CLOUD_REST=y
CONFIG_NRF_CLOUD_CLIENT_ID_SRC_IMEI=y
CONFIG_NRF_CLOUD_CHECK_CREDENTIALS=y

# Networking
CONFIG_NETWORKING=y
CONFIG_NET_SOCKETS=y
CONFIG_NET_SOCKETS_OFFLOAD=y

# Enable LTE Connectivity using Connection Manager
CONFIG_NET_IPV4=y
CONFIG_NET_IPV6=y
CONFIG_NET_IPV6_NBR_CACHE=n
CONFIG_NET_IPV6_MLD=n
CONFIG_NET_CONNECTION_MANAGER=y
CONFIG_NRF_MODEM_LIB=y
CONFIG_NRF_MODEM_LIB_NET_IF=y
CONFIG_NRF_MODEM_LIB_NET_IF_AUTO_DOWN=y
CONFIG_NRF_MODEM_LIB_NET_IF_DOWN_DEFAULT_LTE_DISCONNECT=y
CONFIG_NET_CONNECTION_MANAGER_MONITOR_STACK_SIZE=1024
CONFIG_NET_MGMT_EVENT_STACK_SIZE=2048

# FOTA
CONFIG_NRF_CLOUD_FOTA_POLL=y

# FOTA download
CONFIG_FOTA_DOWNLOAD=y
CONFIG_FOTA_DOWNLOAD_PROGRESS_EVT=y
CONFIG_DFU_TARGET=y
CONFIG_DOWNLOADER=y
CONFIG_DOWNLOADER_STACK_SIZE=3072

# MCUBOOT
CONFIG_BOOTLOADER_MCUBOOT=y
CONFIG_IMG_MANAGER=y
CONFIG_STREAM_FLASH=y
CONFIG_MCUBOOT_IMG_MANAGER=y
CONFIG_IMG_ERASE_PROGRESSIVELY=y
CONFIG_SECURE_BOOT=y
CONFIG_PM_EXTERNAL_FLASH_MCUBOOT_SECONDARY=n

# Settings
CONFIG_FLASH=y
CONFIG_FLASH_PAGE_LAYOUT=y
CONFIG_FLASH_MAP=y
CONFIG_FCB=y
CONFIG_SETTINGS=y
CONFIG_SETTINGS_FCB=y
CONFIG_MPU_ALLOW_FLASH_WRITE=y

# Button/LED support
CONFIG_DK_LIBRARY=y

# LTE Link
CONFIG_LTE_LINK_CONTROL=y

# AT Host library - Used to send AT commands directy from an UART terminal and to allow
#		    integration with nRF Connect for Desktop applications.
CONFIG_AT_HOST_LIBRARY=y
# Extended AT host stack size since some nrf_cloud credentials are longer than 1024 bytes.
CONFIG_AT_MONITOR_HEAP_SIZE=4096
CONFIG_AT_HOST_STACK_SIZE=2048

# Modem info
CONFIG_MODEM_INFO=y
CONFIG_MODEM_INFO_ADD_DEVICE=y
CONFIG_MODEM_INFO_ADD_NETWORK=y
CONFIG_MODEM_INFO_ADD_SIM=y
CONFIG_MODEM_INFO_ADD_SIM_ICCID=y
CONFIG_MODEM_INFO_ADD_SIM_IMSI=y

# System
CONFIG_HEAP_MEM_POOL_SIZE=8192
CONFIG_MAIN_STACK_SIZE=3072
CONFIG_SYSTEM_WORKQUEUE_STACK_SIZE=2048
CONFIG_ASSERT=y
CONFIG_REBOOT=y
CONFIG_FPU=y
CONFIG_PICOLIBC_IO_FLOAT=y
CONFIG_EVENTS=y
CONFIG_POSIX_API=y

# Logging
CONFIG_LOG=y
CONFIG_LOG_MODE_IMMEDIATE=y
CONFIG_UART_INTERRUPT_DRIVEN=y

# Modem key management
CONFIG_MODEM_KEY_MGMT=y
CONFIG_MODEM_JWT=y
CONFIG_NRF_CLOUD_REST_AUTOGEN_JWT=y
CONFIG_NRF_CLOUD_SEC_TAG=16842753
```

## overlay_coap.conf
```kconfig
#
# Copyright (c) 2025 Nordic Semiconductor ASA
#
# SPDX-License-Identifier: LicenseRef-Nordic-5-Clause
#

CONFIG_NRF_CLOUD_REST=n
CONFIG_NRF_CLOUD_REST_AUTOGEN_JWT=n
CONFIG_REST_CLIENT_LOG_LEVEL_ERR=n

CONFIG_LTE_LC_PSM_MODULE=y
CONFIG_LTE_LINK_CONTROL=y

CONFIG_NRF_CLOUD_COAP=y
CONFIG_NRF_CLOUD_COAP_DOWNLOADS=n

# CoAP Client
CONFIG_COAP_CLIENT_BLOCK_SIZE=1024
CONFIG_COAP_CLIENT_STACK_SIZE=6144
CONFIG_COAP_CLIENT_THREAD_PRIORITY=0
CONFIG_COAP_EXTENDED_OPTIONS_LEN_VALUE=40
```

## overlay_fota_test.conf
```kconfig
#
# Copyright (c) 2019 Nordic Semiconductor ASA
#
# SPDX-License-Identifier: LicenseRef-Nordic-5-Clause
#

# Build with this overlay to produce an application with a different version string.
# The verion string is printed on startup.
CONFIG_NRF_CLOUD_FOTA_SAMPLE_VERSION="v1.0.0-FOTA-TEST"
```

## overlay_full_modem_fota.conf
```kconfig
# Copyright (c) 2021 Nordic Semiconductor ASA
#
# SPDX-License-Identifier: LicenseRef-Nordic-5-Clause
#

# Full Modem FOTA
CONFIG_NRF_CLOUD_FOTA_FULL_MODEM_UPDATE=y
CONFIG_SPI=y
CONFIG_SPI_NOR=y
CONFIG_SPI_NOR_FLASH_LAYOUT_PAGE_SIZE=4096
CONFIG_PM_OVERRIDE_EXTERNAL_DRIVER_CHECK=y

# FMFU requires additional heap space.
# If the heap is too small, a boot loop can occur when the full modem image is installed.
CONFIG_HEAP_MEM_POOL_SIZE=47250

CONFIG_REST_FOTA_DL_TIMEOUT_MIN=30
CONFIG_NRFCLOUD_FOTA_JOB_CHECK_RATE_MIN=1
CONFIG_IMG_ERASE_PROGRESSIVELY=n
CONFIG_SPI_NOR_SFDP_MINIMAL=n
CONFIG_SPI_NOR_SFDP_DEVICETREE=y
```

## overlay_smp_fota.conf
```kconfig
#
# Copyright (c) 2024 Nordic Semiconductor ASA
#
# SPDX-License-Identifier: LicenseRef-Nordic-5-Clause
#
CONFIG_NRF_CLOUD_FOTA_SMP=y
CONFIG_NRF_MCUMGR_SMP_CLIENT=y
CONFIG_MCUMGR_GRP_IMG=y
CONFIG_MCUMGR_GRP_OS=y
CONFIG_MCUMGR_TRANSPORT_UART=y
CONFIG_UART_MCUMGR_RX_BUF_COUNT=4
CONFIG_SMP_CMD_RETRY_TIME=1000

# Enable MCUboot util library
CONFIG_MCUBOOT_IMG_MANAGER=y
CONFIG_DFU_TARGET_SMP=y
```

## boards/thingy91x_nrf9151_ns.conf
```kconfig
#
# Copyright (c) 2025 Nordic Semiconductor ASA
#
# SPDX-License-Identifier: LicenseRef-Nordic-5-Clause
#

# Configuration file for Thingy:91 X.
# This file is merged with prj.conf in the application folder, and options
# set here will take precedence if they are present in both files.

# Use UUID as client ID
CONFIG_NRF_CLOUD_CLIENT_ID_SRC_INTERNAL_UUID=y

# Enable external flash
CONFIG_SPI_NOR_SFDP_DEVICETREE=y
CONFIG_PM_OVERRIDE_EXTERNAL_DRIVER_CHECK=y
CONFIG_PM_EXTERNAL_FLASH_MCUBOOT_SECONDARY=y
```

## boards/thingy91x_nrf9151_ns.overlay
```dts
/*
 * Copyright (c) 2025 Nordic Semiconductor ASA
 *
 * SPDX-License-Identifier: LicenseRef-Nordic-5-Clause
 */

/ {
	aliases {
		ext-flash = &flash_ext;
	};
};
```

## src/main.c
```c
/*
 * Copyright (c) 2021 Nordic Semiconductor ASA
 *
 * SPDX-License-Identifier: LicenseRef-Nordic-5-Clause
 */

#include <zephyr/kernel.h>
#include <zephyr/settings/settings.h>
#include <zephyr/sys/reboot.h>
#include <zephyr/logging/log.h>
#include <zephyr/logging/log_ctrl.h>
#include <nrf_modem_at.h>
#include <modem/nrf_modem_lib.h>
#include <modem/lte_lc.h>
#include <modem/modem_info.h>
#include <net/nrf_cloud.h>
#include <net/nrf_cloud_fota_poll.h>
#include <net/nrf_cloud_defs.h>
#include <net/fota_download.h>
#include <date_time.h>

#include <dk_buttons_and_leds.h>
#include <zephyr/net/conn_mgr_connectivity.h>
#include "smp_reset.h"

#if defined(CONFIG_NRF_CLOUD_REST)
#include <net/nrf_cloud_rest.h>
#elif defined(CONFIG_NRF_CLOUD_COAP)
#include <net/nrf_cloud_coap.h>
#define COAP_SHADOW_MAX_SIZE 512
#endif /* CONFIG_NRF_CLOUD_COAP */

LOG_MODULE_REGISTER(nrf_cloud_fota_sample, CONFIG_NRF_CLOUD_FOTA_SAMPLE_LOG_LEVEL);

#define BTN_NUM		       CONFIG_NRFCLOUD_FOTA_BUTTON_EVT_NUM
#define LTE_LED_NUM	       CONFIG_NRFCLOUD_FOTA_LTE_LED_NUM
#define REST_FOTA_CFG_INTERVAL "fotaInterval"
#define INTERVAL_MINUTES_MAX   10080
#define REBOOT_DELAY_REQUIRED 5
#define REBOOT_DELAY_SUCCESS 10
#define REBOOT_DELAY_ERROR 30
#define LED_ON 1
#define LED_OFF 0

/* For simplicity, just build the JSON string here and add the interval with snprintk */
#define REP_CFG_TMPLT "{\"" NRF_CLOUD_JSON_KEY_REP "\":{" \
				"\"" NRF_CLOUD_JSON_KEY_CFG "\":{" \
					"\"" REST_FOTA_CFG_INTERVAL "\":%u}}}"

/* The transform is just a dotted string of the JSON keys */
#define TRANSFORM_DESIRED_CFG_INTERVAL	NRF_CLOUD_JSON_KEY_STATE "." \
					NRF_CLOUD_JSON_KEY_DES "." \
					NRF_CLOUD_JSON_KEY_CFG "." \
					REST_FOTA_CFG_INTERVAL

/* Size of the template plus three additional chars for the number value */
#define REP_CFG_BUFF_SZ (sizeof(REP_CFG_TMPLT) + 3)

/* The interval (in minutes) at which to check for FOTA jobs */
static uint32_t fota_check_rate = CONFIG_NRFCLOUD_FOTA_JOB_CHECK_RATE_MIN;

/* Network states */
#define NETWORK_UP BIT(0)
#define EVENT_MASK (NET_EVENT_L4_CONNECTED | NET_EVENT_L4_DISCONNECTED)

/* Semaphore to indicate a button has been pressed */
static K_EVENT_DEFINE(button_press_event);
#define BUTTON_PRESSED BIT(0)

/* Connection event */
static K_EVENT_DEFINE(connection_events);

/* nRF Cloud device ID */
static char device_id[NRF_CLOUD_CLIENT_ID_MAX_LEN + 1];

/* Modem info */
static struct modem_param_info mdm_param;

#if defined(CONFIG_NRF_CLOUD_REST)

#define REST_RX_BUF_SZ 2100
/* Buffer used for REST calls */
static char rx_buf[REST_RX_BUF_SZ];

/* nRF Cloud REST context */
static struct nrf_cloud_rest_context rest_ctx = {
	.connect_socket = -1,
	.keep_alive = true,
	.rx_buf = rx_buf,
	.rx_buf_len = sizeof(rx_buf),
};

#endif /* CONFIG_NRF_CLOUD_REST */

static void sample_reboot(enum nrf_cloud_fota_reboot_status status);

/* FOTA support context */
static struct nrf_cloud_fota_poll_ctx fota_ctx = {
#if defined(CONFIG_NRF_CLOUD_REST)
	.rest_ctx = &rest_ctx,
#endif
	.device_id = device_id,
	.reboot_fn = sample_reboot,
#if SMP_FOTA_ENABLED
	.smp_reset_cb = nrf52840_reset_api
#endif
};

static void modem_time_wait(void)
{
	int err = 0;
	char time_buf[64];

	LOG_INF("Waiting for modem to acquire network time...");

	do {
		k_sleep(K_SECONDS(3));

		err = nrf_modem_at_cmd(time_buf, sizeof(time_buf), "AT%%CCLK?");
		if (err) {
			LOG_DBG("AT Clock Command Error %d... Retrying in 3 seconds.", err);
		}
	} while (err != 0);

	LOG_INF("Network time obtained");
}

static void get_modem_info(void)
{
	int err = modem_info_params_get(&mdm_param);

	if (err) {
		LOG_WRN("Unable to obtain modem info, error: %d", err);
	}
}

static void send_device_status(void)
{
	int err;
	/* Enable FOTA for bootloader, modem and application */
	struct nrf_cloud_svc_info_fota fota = {
		.bootloader = 1,
		.modem = 1,
		.application = 1,
		.modem_full = fota_ctx.full_modem_fota_supported,
		.smp = SMP_FOTA_ENABLED
	};

	struct nrf_cloud_svc_info svc_inf = {
		.fota = &fota,
		/* Deprecated: The "ui" section is no longer used by nRF Cloud */
		.ui = NULL
	};

	struct nrf_cloud_modem_info mdm_inf = {
		/* Include all available modem info */
		.device = NRF_CLOUD_INFO_SET,
		.network = NRF_CLOUD_INFO_SET,
		.sim = NRF_CLOUD_INFO_SET,
		/* Use the modem info already obtained */
		.mpi = &mdm_param,
		/* Include the application version */
		.application_version = CONFIG_NRF_CLOUD_FOTA_SAMPLE_VERSION
	};

	struct nrf_cloud_device_status dev_status = {
		.modem = &mdm_inf,
		.svc = &svc_inf,
		.conn_inf = NRF_CLOUD_INFO_SET
	};

	LOG_INF("Sending device status...");
#if defined(CONFIG_NRF_CLOUD_REST)
	err = nrf_cloud_rest_shadow_device_status_update(&rest_ctx, device_id, &dev_status);
#elif defined(CONFIG_NRF_CLOUD_COAP)
	err = nrf_cloud_coap_shadow_device_status_update(&dev_status);
#endif /* CONFIG_NRF_CLOUD_COAP */
	if (err) {
		LOG_ERR("Failed to send device status, FOTA not enabled; error: %d", err);
	} else {
		LOG_INF("FOTA enabled in device shadow");
	}
}

static bool process_desired_check_rate(long desired_check_rate)
{
		if (desired_check_rate > INTERVAL_MINUTES_MAX) {
			LOG_INF("Desired interval exceeds max value, setting to %d",
				INTERVAL_MINUTES_MAX);
			desired_check_rate = INTERVAL_MINUTES_MAX;
		} else if (desired_check_rate <= 0) {
			LOG_INF("Desired interval must be greater than zero, setting to %d",
				CONFIG_NRFCLOUD_FOTA_JOB_CHECK_RATE_MIN);
			desired_check_rate = CONFIG_NRFCLOUD_FOTA_JOB_CHECK_RATE_MIN;
		}
		/* Use the desired value */
		fota_check_rate = (uint32_t)desired_check_rate;
		/* Update the reported value if changed */
		return (fota_check_rate != desired_check_rate);
}

#if defined(CONFIG_NRF_CLOUD_REST)
static void check_config(void)
{
	/* Ensure the reported section gets sent once */
	static bool reported_sent;
	static char cfg_buf[REP_CFG_BUFF_SZ];
	long desired_check_rate = 0;
	bool update_reported = false;
	int err;

	/* Check if there is a value in the desired config */
	err = nrf_cloud_rest_shadow_transform_request(&rest_ctx, device_id,
						      TRANSFORM_DESIRED_CFG_INTERVAL);
	if (err) {
		LOG_ERR("Failed to request desired FOTA interval, error: %u", err);
	} else if ((rest_ctx.response_len == 0) || !rest_ctx.response) {
		err = -ENOMSG;
		LOG_DBG("No desired FOTA interval exists");
	} else {
		char *endptr;

		/* Parse the desired interval */
		desired_check_rate = strtol(rest_ctx.response, &endptr, 10);
		if ((endptr == rest_ctx.response) || (errno)) {
			LOG_ERR("Failed to parse desired FOTA interval value");
			err = -EIO;
		}
	}

	if (!err) {
		/* Validate desired interval */
		LOG_INF("Desired interval: %ld", desired_check_rate);

		update_reported = process_desired_check_rate(desired_check_rate);
	}

	if (update_reported || !reported_sent) {
		/* Format the JSON for the reported config */
		err = snprintk(cfg_buf, REP_CFG_BUFF_SZ, REP_CFG_TMPLT, fota_check_rate);

		if ((err < 0) || (err >= REP_CFG_BUFF_SZ)) {
			LOG_ERR("Could not format reported config JSON");
		} else {
			/* Update the shadow's reported config with the interval value */
			err = nrf_cloud_rest_shadow_state_update(&rest_ctx, device_id, cfg_buf);
			if (!err) {
				reported_sent = true;
			} else {
				LOG_ERR("Failed to update reported config, error: %d", err);
			}
		}
	}
}
#elif defined(CONFIG_NRF_CLOUD_COAP)
int shadow_support_coap_obj_send(struct nrf_cloud_obj *const shadow_obj, const bool reported)
{
	/* Encode the data for the cloud */
	int err = nrf_cloud_obj_cloud_encode(shadow_obj);

	/* Free the object */
	(void)nrf_cloud_obj_free(shadow_obj);

	if (!err) {
		/* Send the encoded data */
		if (!reported) {
			err = nrf_cloud_coap_shadow_desired_update(shadow_obj->encoded_data.ptr);
		} else {
			err = nrf_cloud_coap_shadow_state_update(shadow_obj->encoded_data.ptr);
		}
	} else {
		LOG_ERR("Failed to encode cloud data, err: %d", err);
		return err;
	}

	/* Free the encoded data */
	(void)nrf_cloud_obj_cloud_encoded_free(shadow_obj);

	return err;
}

static void send_initial_config(void)
{
	NRF_CLOUD_OBJ_JSON_DEFINE(root_obj);
	NRF_CLOUD_OBJ_JSON_DEFINE(cfg_obj);
	int err;

	err = nrf_cloud_obj_init(&root_obj);
	if (err) {
		LOG_ERR("Failed to initialize root object: %d", err);
		goto cleanup;
	}

	err = nrf_cloud_obj_init(&cfg_obj);
	if (err) {
		LOG_ERR("Failed to initialize config object: %d", err);
		(void)nrf_cloud_obj_free(&root_obj);
		goto cleanup;
	}

	/* Create the config object */
	err = nrf_cloud_obj_num_add(&cfg_obj, REST_FOTA_CFG_INTERVAL,
		(double)fota_check_rate, false);
		if (err) {
			LOG_ERR("Failed to add reported FOTA interval, error: %d", err);
			goto cleanup;
		}

	/* Add the config object to the root object */
	err = nrf_cloud_obj_object_add(&root_obj, NRF_CLOUD_JSON_KEY_CFG, &cfg_obj, false);
	if (err) {
		LOG_ERR("Failed to add config object to root object: %d", err);
		goto cleanup;
	}

	/* Send the initial config */
	err = shadow_support_coap_obj_send(&root_obj, true);
	if (err) {
		LOG_ERR("Failed to send initial config, error: %d", err);
	} else {
		LOG_INF("Initial config sent");
	}
cleanup:
	(void)nrf_cloud_obj_free(&cfg_obj);
	(void)nrf_cloud_obj_free(&root_obj);
}

static void check_config(void)
{

	/* Ensure the reported section gets sent once */
	static bool reported_sent;
	/* Only request full shadow the first time */
	static bool request_delta;
	char buf[COAP_SHADOW_MAX_SIZE] = {0};
	size_t buf_len = sizeof(buf);
	double desired_check_rate = 0;
	bool update_reported = false;
	struct nrf_cloud_data in_data = {
		.ptr = buf
	};
	struct nrf_cloud_obj delta_obj = {0};
	int err;

	LOG_INF("Checking for shadow delta...");
	err = nrf_cloud_coap_shadow_get(buf, &buf_len, false, COAP_CONTENT_FORMAT_APP_JSON);
	if (err == -EACCES) {
		LOG_DBG("Not connected yet.");
		goto exit;
	} else if (err) {
		LOG_ERR("Failed to request shadow delta: %d", err);
		goto exit;
	}
	LOG_DBG("Shadow: len:%zd, %s", strnlen(buf, buf_len), buf);
	request_delta = true;
	in_data.len = buf_len;

	if (strnlen(buf, buf_len) == 0) {
		LOG_DBG("No shadow delta available");
		goto exit;
	}

	/* Convert string into nrf_cloud_obj */
	err = nrf_cloud_coap_shadow_delta_process(&in_data, &delta_obj);
	if (err < 0) {
		LOG_ERR("Failed to process shadow delta, err: %d", err);
		goto exit;
	} else if (err == 0) {
		/* No application specific delta data */
		goto exit;
	}

	NRF_CLOUD_OBJ_JSON_DEFINE(cfg_obj);

	/* Get the config object */
	err = nrf_cloud_obj_object_detach(&delta_obj, NRF_CLOUD_JSON_KEY_CFG, &cfg_obj);
	if (err == -ENODEV) {
		/* No config in the delta */
		goto exit;
	}

	/* Process incoming config */
	err = nrf_cloud_obj_num_get(&cfg_obj, REST_FOTA_CFG_INTERVAL, &desired_check_rate);
	if (err) {
		LOG_ERR("Failed to get desired FOTA interval, error: %d", err);
	} else {
		LOG_INF("Desired interval: %lf", desired_check_rate);
		update_reported = process_desired_check_rate((long)desired_check_rate);
	}

	/* Create config object for response */
	/* Note: this is simpler than trying to handle unsupported entries directly. */
	nrf_cloud_obj_free(&cfg_obj);
	nrf_cloud_obj_init(&cfg_obj);
	err = nrf_cloud_obj_num_add(&cfg_obj, REST_FOTA_CFG_INTERVAL,
				    (double)fota_check_rate, false);
	if (err) {
		LOG_ERR("Failed to add reported FOTA interval, error: %d", err);
		goto exit;
	}

	/* Add current config data */
	if (nrf_cloud_obj_object_add(&delta_obj, NRF_CLOUD_JSON_KEY_CFG, &cfg_obj, false)) {
		goto exit;
	}

	/* Send Shadow update */
	if (update_reported || !reported_sent) {
		err = shadow_support_coap_obj_send(&delta_obj, update_reported);

		if (err) {
			LOG_ERR("Failed to send updated shadow delta, error: %d", err);
		} else {
			reported_sent = true;
			LOG_INF("Updated shadow delta sent");
		}
	}
exit:
	/* Free the objects */
	nrf_cloud_obj_free(&cfg_obj);
	nrf_cloud_obj_free(&delta_obj);

	/* If the reported section was not sent, send the initial config */
	if (!reported_sent) {
		send_initial_config();
	}
}

#endif /* CONFIG_NRF_CLOUD_COAP */


static bool cred_check(struct nrf_cloud_credentials_status *const cs)
{
	int ret = 0;

	ret = nrf_cloud_credentials_check(cs);
	if (ret) {
		LOG_ERR("nRF Cloud credentials check failed, error: %d", ret);
		return false;
	}

	/* Since this is a REST sample, we only need two credentials:
	 *  - a CA for the TLS connections
	 *  - a private key to sign the JWT
	 */

	if (!cs->ca || !cs->ca_aws || !cs->prv_key) {
		LOG_WRN("Missing required nRF Cloud credential(s) in sec tag %u:", cs->sec_tag);
	}
	if (!cs->ca || !cs->ca_aws) {
		LOG_WRN("\t-CA Cert");
	}
	if (!cs->prv_key) {
		LOG_WRN("\t-Private Key");
	}

	return (cs->ca && cs->ca_aws && cs->prv_key);
}

static void await_credentials(void)
{
	struct nrf_cloud_credentials_status cs;

	while (!cred_check(&cs)) {
		LOG_INF("Waiting for credentials to be installed...");
		LOG_INF("Press the reset button once the credentials are installed");
		k_sleep(K_FOREVER);
	}

	LOG_INF("nRF Cloud credentials detected!");
}

static int set_led(const int state)
{
	int err = dk_set_led(LTE_LED_NUM, state);

	if (err) {
		LOG_ERR("Failed to set LED, error: %d", err);
		return err;
	}
	return 0;
}

static void button_handler(uint32_t button_states, uint32_t has_changed)
{
	if (has_changed & button_states & BIT(BTN_NUM - 1)) {
		LOG_DBG("Button %d pressed", BTN_NUM);
		k_event_post(&button_press_event, BUTTON_PRESSED);
	}
}

static int init_led(void)
{
	int err = dk_leds_init();

	if (err) {
		LOG_ERR("LED init failed, error: %d", err);
		return err;
	}
	(void)set_led(LED_OFF);
	return 0;
}

static int init(void)
{
	int err = 0;
	enum nrf_cloud_fota_type pending_job_type = NRF_CLOUD_FOTA_TYPE__INVALID;

	err = init_led();
	if (err) {
		LOG_ERR("LED initialization failed: %d", err);
		return err;
	}

	err = nrf_modem_lib_init();
	if (err) {
		LOG_ERR("Failed to initialize modem library: 0x%X", err);
		return -EFAULT;
	}

	err = nrf_cloud_fota_poll_init(&fota_ctx);
	if (err) {
		LOG_ERR("FOTA support init failed: %d", err);
		return err;
	}

	/* This function may perform a reboot if a FOTA update is in progress */
	err = nrf_cloud_fota_poll_process_pending(&fota_ctx);
	if (err < 0) {
		LOG_ERR("Failed to process pending FOTA job, error: %d", err);
		return err;
	}
	pending_job_type = (enum nrf_cloud_fota_type)err;

	err = modem_info_init();
	if (err) {
		LOG_WRN("Modem info initialization failed, error: %d", err);
		return err;
	}

	err = modem_info_params_init(&mdm_param);
	if (!err) {
		LOG_INF("Application Name: %s", mdm_param.device.app_name);
		LOG_INF("nRF Connect SDK version: %s", mdm_param.device.app_version);
	} else {
		LOG_WRN("Modem info params initialization failed, error: %d", err);
	}

	err = nrf_cloud_client_id_get(device_id, sizeof(device_id));
	if (err) {
		LOG_ERR("Failed to get device ID, error: %d", err);
		return err;
	}

	err = dk_buttons_init(button_handler);
	if (err) {
		LOG_ERR("Failed to initialize button: error: %d", err);
		return err;
	}

	/* Ensure device has credentials installed before proceeding */
	await_credentials();

	/* Initiate Connection */
	LOG_INF("Enabling connectivity...");
	conn_mgr_all_if_connect(true);
	k_event_wait(&connection_events, NETWORK_UP, false, K_FOREVER);

	/* Now that the device is connected to the network, get the modem info */
	get_modem_info();

	/* Modem must have valid time/date in order to generate JWTs with
	 * an expiration time
	 */
	modem_time_wait();

	return err;
}

static void sample_reboot(enum nrf_cloud_fota_reboot_status status)
{
	int seconds;

	switch (status) {
	case FOTA_REBOOT_REQUIRED:
		LOG_INF("Rebooting...");
		seconds = REBOOT_DELAY_REQUIRED;
		break;
	case FOTA_REBOOT_SUCCESS:
		seconds = REBOOT_DELAY_SUCCESS;
		LOG_INF("Rebooting in %ds to complete FOTA update...", seconds);
		break;
	case FOTA_REBOOT_SYS_ERROR:
	default:
		seconds = REBOOT_DELAY_ERROR;
		LOG_INF("Rebooting in %ds...", seconds);
	}
#if defined(CONFIG_NRF_CLOUD_REST)
	(void)nrf_cloud_rest_disconnect(&rest_ctx);
#elif defined(CONFIG_NRF_CLOUD_COAP)
	(void)nrf_cloud_coap_disconnect();
#endif /* CONFIG_NRF_CLOUD_COAP */

	/* We must do this before we reboot, otherwise we might trip LTE boot loop
	 * prevention, and the modem will be temporarily disable itself.
	 */
	(void)lte_lc_power_off();

	LOG_PANIC();
	k_sleep(K_SECONDS(seconds));
	sys_reboot(SYS_REBOOT_COLD);
}

/* Callback to track network connectivity */
static struct net_mgmt_event_callback l4_callback;
static void l4_event_handler(struct net_mgmt_event_callback *cb, uint32_t event,
			     struct net_if *iface)
{
	if ((event & EVENT_MASK) != event) {
		return;
	}

	if (event == NET_EVENT_L4_CONNECTED) {
		/* Mark network as up. */
		(void)set_led(LED_ON);
		LOG_INF("Connected to LTE");
		k_event_post(&connection_events, NETWORK_UP);
	}

	if (event == NET_EVENT_L4_DISCONNECTED) {
		/* Network is down. */
		(void)set_led(LED_OFF);
		LOG_INF("Network connectivity lost!");
	}
}

/* Start tracking network availability */
static int prepare_network_tracking(void)
{
	net_mgmt_init_event_callback(&l4_callback, l4_event_handler, EVENT_MASK);
	net_mgmt_add_event_callback(&l4_callback);

	return 0;
}

SYS_INIT(prepare_network_tracking, APPLICATION, 0);

int main(void)
{
	int err;

	LOG_INF("nRF Cloud FOTA Sample, version: %s", CONFIG_NRF_CLOUD_FOTA_SAMPLE_VERSION);

	err = init();
	if (err) {
		LOG_ERR("Initialization failed");
		return 0;
	}

#if defined(CONFIG_NRF_CLOUD_COAP)
	/* nRF Cloud CoAP requires login */
	err = nrf_cloud_coap_init();
	if (err) {
		LOG_ERR("Failed to initialize CoAP client: %d", err);
		return err;
	}
	err = nrf_cloud_coap_connect(NULL);
	if (err) {
		LOG_ERR("Connecting to nRF Cloud failed, error: %d", err);
		return 0;
	}
#endif /* CONFIG_NRF_CLOUD_COAP */

	/* Send the device status which contains HW/FW version info,
	 * details about the network connection, and FOTA service info.
	 * The FOTA service info is required by nRF Cloud to enable FOTA
	 * for the device.
	 */
	send_device_status();

	while (1) {

		/* Query for any pending FOTA jobs. If one is found, download and install
		 * it. This is a blocking operation which can take a long time.
		 * This function is likely to reboot in order to complete the FOTA update.
		 */
		while (true) {
			err = nrf_cloud_fota_poll_process(&fota_ctx);
			if (err == -ENOTRECOVERABLE) {
				sample_reboot(FOTA_REBOOT_SYS_ERROR);
			} else if ((err == -ENOENT) || (err == -EFAULT)) {
				/* A job has finished or failed, check again for another */
				continue;
			}

			break;
		}

		/* Check the configuration in the shadow to determine the FOTA check interval */
		check_config();

		/* Wait for the configured duration or a button press */
#if defined(CONFIG_NRF_CLOUD_REST)
		(void)nrf_cloud_rest_disconnect(&rest_ctx);
#endif /* CONFIG_NRF_CLOUD_REST */

		LOG_INF("Checking for FOTA job in %d minute(s) or when button %d is pressed",
			fota_check_rate, CONFIG_NRFCLOUD_FOTA_BUTTON_EVT_NUM);

		k_event_wait(&button_press_event, BUTTON_PRESSED, true, K_MINUTES(fota_check_rate));
	}
}
```

## src/smp_reset.c
```c
/*
 * Copyright (c) 2024 Nordic Semiconductor ASA
 *
 * SPDX-License-Identifier: LicenseRef-Nordic-5-Clause
 */
#include <zephyr/kernel.h>
#include <zephyr/settings/settings.h>
#include <zephyr/logging/log.h>
#include <zephyr/drivers/gpio.h>
#include <zephyr/device.h>
#include <zephyr/devicetree.h>

LOG_MODULE_REGISTER(nrf_cloud_fota_sample_smp, CONFIG_NRF_CLOUD_FOTA_SAMPLE_LOG_LEVEL);

#define RESET_NODE DT_NODELABEL(nrf52840_reset)
#define HAS_RECOVERY_MODE (DT_NODE_HAS_STATUS(RESET_NODE, okay))

int nrf52840_reset_api(void)
{
	int err;
	const struct gpio_dt_spec reset_pin_spec = GPIO_DT_SPEC_GET(RESET_NODE, gpios);

	if (!device_is_ready(reset_pin_spec.port)) {
		LOG_ERR("Reset device not ready");
		return -EIO;
	}

	/* Configure pin as output and initialize it to inactive state. */
	err = gpio_pin_configure_dt(&reset_pin_spec, GPIO_OUTPUT_INACTIVE);
	if (err) {
		LOG_ERR("Pin configure err: %d", err);
		return err;
	}

	/* Reset the nRF52840 and let it wait until the pin is inactive again
	 * before running to main to ensure that it won't send any data until
	 * the H4 device is setup and ready to receive.
	 */
	err = gpio_pin_set_dt(&reset_pin_spec, 1);
	if (err) {
		LOG_ERR("GPIO Pin set to 1 err: %d", err);
		return err;
	}

	/* Wait for the nRF52840 peripheral to stop sending data.
	 *
	 * It is critical (!) to wait here, so that all bytes
	 * on the lines are received and drained correctly.
	 */
	k_sleep(K_MSEC(10));

	/* We are ready, let the nRF52840 run to main */
	err = gpio_pin_set_dt(&reset_pin_spec, 0);
	if (err) {
		LOG_ERR("GPIO Pin set to 0 err: %d", err);
		return err;
	}

	LOG_DBG("Reset Pin %d", reset_pin_spec.pin);

	return 0;
}
```
