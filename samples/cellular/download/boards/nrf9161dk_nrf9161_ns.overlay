/*
 * Copyright (c) 2023 Nordic Semiconductor ASA
 *
 * SPDX-License-Identifier: LicenseRef-Nordic-5-Clause
 */

/* Disable uart1 in nonsecure since it is used by the TFM secure app. */
&uart1 {
	status = "disabled";
};
