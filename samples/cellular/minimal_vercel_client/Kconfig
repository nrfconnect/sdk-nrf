## samples/cellular/modem_trace_backend/Kconfig.trace_print_stats
```kconfig
#
# Copyright (c) 2022 Nordic Semiconductor
#
# SPDX-License-Identifier: LicenseRef-Nordic-5-Clause
#

if NRF_MODEM_LIB_TRACE

# Adds NRF_MODEM_LIB_TRACE_BACKEND_CUSTOM to the trace backend choice.
choice NRF_MODEM_LIB_TRACE_BACKEND

config NRF_MODEM_LIB_TRACE_BACKEND_CUSTOM
	bool "Count modem traces and print to terminal"
	depends on CPU_LOAD
	depends on FPU
	depends on NEWLIB_LIBC_FLOAT_PRINTF || PICOLIBC_IO_FLOAT
	help
	  Print modem trace data statistics
	  and cpu utilization.

endchoice # NRF_MODEM_LIB_TRACE_BACKEND

if NRF_MODEM_LIB_TRACE_BACKEND_CUSTOM

config CUSTOM_BACKEND_PRINT_PERIOD_MSEC
	int "Statistics print interval (millisec)"
	default 500

endif # NRF_MODEM_LIB_TRACE_BACKEND_CUSTOM

endif # NRF_MODEM_LIB_TRACE
```

## samples/cellular/modem_trace_backend/sample.yaml
```yaml
sample:
  name: Modem trace backend
tests:
  sample.cellular.modem_trace_backend:
    sysbuild: true
    build_only: true
    integration_platforms:
      - nrf9151dk/nrf9151/ns
      - nrf9160dk/nrf9160/ns
      - nrf9161dk/nrf9161/ns
    platform_allow:
      - nrf9151dk/nrf9151/ns
      - nrf9160dk/nrf9160/ns
      - nrf9161dk/nrf9161/ns
    tags: ci_build sysbuild
```

## samples/cellular/modem_trace_flash/Kconfig
```kconfig
#
# Copyright (c) 2022 Nordic Semiconductor
#
# SPDX-License-Identifier: LicenseRef-Nordic-5-Clause
#

menu "Modem trace flash backend sample"

endmenu

module = MODEM_TRACE_FLASH_SAMPLE
module-str = Modem trace flash backend
source "${ZEPHYR_BASE}/subsys/logging/Kconfig.template.log_config"

menu "Zephyr Kernel"
source "Kconfig.zephyr"
endmenu
```

## samples/cellular/modem_trace_flash/boards/nrf9151dk_nrf9151_ns.conf
```kconfig
#
# Copyright (c) 2024 Nordic Semiconductor ASA
#
# SPDX-License-Identifier: LicenseRef-Nordic-5-Clause
#

CONFIG_SPI=y
CONFIG_SPI_NOR=y
CONFIG_SPI_NOR_SFDP_DEVICETREE=y

CONFIG_PM_OVERRIDE_EXTERNAL_DRIVER_CHECK=y

# Reduce flash partition size to reduce erase time and flash usage.
CONFIG_NRF_MODEM_LIB_TRACE_BACKEND_FLASH_PARTITION_SIZE=0x100000
```

## samples/cellular/nrf_cloud_ble_gateway/Kconfig.sysbuild
```kconfig
#
# Copyright (c) 2024 Nordic Semiconductor
#
# SPDX-License-Identifier: LicenseRef-Nordic-5-Clause
#

config WIFI_NRF70
	default y if BOARD_THINGY91X_NRF9151_NS

choice WIFI_NRF70_OPER_MODES
	default WIFI_NRF70_SCAN_ONLY if BOARD_THINGY91X_NRF9151_NS
endchoice

source "${ZEPHYR_BASE}/share/sysbuild/Kconfig"
```

## samples/cellular/nrf_cloud_ble_gateway/boards/apricity_gateway_nrf9160_ns.conf
```kconfig
#
# Copyright (c) 2024 Nordic Semiconductor ASA
#
# SPDX-License-Identifier: LicenseRef-Nordic-5-Clause
#

# Apricity
CONFIG_ENTER_52840_MCUBOOT_VIA_BUTTON=y
```

## samples/cellular/nrf_cloud_ble_gateway/boards/arm/apricity_gateway_nrf9160/Kconfig
```kconfig
# Apricity Gateway nRF9160 board configuration
#
# Copyright (c) 2025 Nordic Semiconductor ASA
#
# SPDX-License-Identifier: LicenseRef-Nordic-5-Clause

module=BOARD
module-dep=LOG
module-str=Log level for board
source "${ZEPHYR_BASE}/subsys/logging/Kconfig.template.log_config"

config BOARD_NRF52840_GPIO_RESET
	bool "Use nRF52840 PCA20035 GPIO reset pin"
	default y
	help
	  Use a GPIO pin to reset the nRF52840 controller and let it wait
	  until all bytes traveling to the H4 device have been received
	  and drained, thus ensuring communication can begin correctly.
```

## samples/cellular/nrf_cloud_ble_gateway/boards/arm/apricity_gateway_nrf9160/Kconfig.board
```kconfig
# Apricity Gateway nRF9160 board configuration
#
# Copyright (c) 2025 Nordic Semiconductor ASA
#
# SPDX-License-Identifier: LicenseRef-Nordic-5-Clause

if SOC_NRF9160_SICA

config BOARD_APRICITY_GATEWAY_NRF9160
	bool "nRF9160 APRICITY GATEWAY"

config BOARD_APRICITY_GATEWAY_NRF9160_NS
	bool "nRF9160 APRICITY GATEWAY non-secure"

endif # SOC_NRF9160_SICA
```

## samples/cellular/nrf_cloud_ble_gateway/src/ble/ui/Kconfig
```kconfig
#
# Copyright (c) 2019 Nordic Semiconductor ASA
#
# SPDX-License-Identifier: LicenseRef-BSD-5-Clause-Nordic
#

config USE_UI_MODULE
	bool "Enable UI module"
	default y
	help
	  Enable the User Interface module for user interaction on
	  development kit hardware.

menu "User Interface"
	visible if USE_UI_MODULE

endmenu

module = UI
module-str = User Interface
source "${ZEPHYR_BASE}/subsys/logging/Kconfig.template.log_config"
```

## samples/cellular/nrf_cloud_ble_gateway/sysbuild/mcuboot/boards/nrf9161dk_nrf9161.conf
```kconfig
#
# Copyright (c) 2023 Nordic Semiconductor ASA
#
# SPDX-License-Identifier: LicenseRef-Nordic-5-Clause
#

# MCUboot config to enable secondary slot on the external flash

CONFIG_SPI=y
CONFIG_SPI_NOR=y
CONFIG_SPI_NOR_SFDP_DEVICETREE=y
CONFIG_SPI_NOR_FLASH_LAYOUT_PAGE_SIZE=4096
CONFIG_SPI_NRFX_RAM_BUFFER_SIZE=32
CONFIG_MULTITHREADING=y

CONFIG_PM_OVERRIDE_EXTERNAL_DRIVER_CHECK=y

CONFIG_FPROTECT=y

# Enabling SPI increases the MCUBoot image size so that it does not fit in the default
# partition size (0xC000). The minimum required size is 0xD000
CONFIG_PM_PARTITION_SIZE_MCUBOOT=0x13E00

# MCUboot requires a large stack size, otherwise an MPU fault will occur
CONFIG_MAIN_STACK_SIZE=16384

# Enable flash operations
CONFIG_FLASH=y

CONFIG_BOOT_MAX_IMG_SECTORS=256

CONFIG_MULTITHREADING=y

CONFIG_LOG=y
CONFIG_LOG_MODE_MINIMAL=y
CONFIG_LOG_DEFAULT_LEVEL=0

# Use minimal C library instead of the Picolib
CONFIG_MINIMAL_LIBC=y
```

## samples/cellular/nrf_cloud_coap_cell_location/Kconfig
```kconfig
#
# Copyright (c) 2025 Nordic Semiconductor ASA
#
# SPDX-License-Identifier: LicenseRef-Nordic-5-Clause
#

menu "nRF Cloud CoAP Cellular Location Sample"

config COAP_CELL_DEFAULT_DOREPLY_VAL
	bool "Default value for the do_reply configuration flag"
	default y

config COAP_CELL_DEFAULT_FALLBACK_VAL
	bool "Default value for the fallback configuration flag"
	default y

config COAP_CELL_DEFAULT_HICONF_VAL
	bool "Default value for the hi_conf configuration flag"

module = NRF_CLOUD_COAP_CELL_LOCATION_SAMPLE
module-str = nRF Cloud CoAP Cellular Location Sample
source "$(ZEPHYR_BASE)/subsys/logging/Kconfig.template.log_config"

endmenu

menu "Zephyr Kernel"
source "Kconfig.zephyr"
endmenu
```

## samples/cellular/nrf_cloud_coap_client/Kconfig
```kconfig
#
# Copyright (c) 2022 Nordic Semiconductor ASA
#
# SPDX-License-Identifier: LicenseRef-Nordic-5-Clause
#

menu "nRF Cloud CoAP client sample"

config NRF_CLOUD_COAP_CLIENT_SAMPLE_VERSION
	string "The sample's version string"
	default "1.0.0"

config COAP_FOTA_JOB_CHECK_RATE_MIN
	int "Rate (minutes) at which this sample will check for FOTA updates"
	default 1

config COAP_FOTA_DL_TIMEOUT_MIN
	int "The time (minutes) allotted for a FOTA download to complete"
	default 15
	help
	  If the FOTA download does not complete in the allotted time,
	  the download will be cancelled and the job status will be
	  set as failed.

config COAP_FOTA_USE_NRF_CLOUD_SETTINGS_AREA
	bool "Use the same settings area as the nRF Cloud FOTA library"
	default y
	help
	  Using the same settings area as the nRF Cloud FOTA library will
	  allow this sample to perform application-FOTA updates to applications
	  built with CONFIG_NRF_CLOUD_FOTA enabled.

config COAP_FOTA_SETTINGS_NAME
	depends on !COAP_FOTA_USE_NRF_CLOUD_SETTINGS_AREA
	string "Settings identifier for the COAP FOTA sample"
	default "coap_fota_sample"
	help
	  The root settings identifier for this application.
	  For application-FOTA, this value should also be found in your target application
	  so that the FOTA status can be properly reported to nRF Cloud.

config COAP_FOTA_SETTINGS_KEY_PENDING_JOB
	depends on !COAP_FOTA_USE_NRF_CLOUD_SETTINGS_AREA
	string "Settings item key for pending FOTA job info"
	default "pending_job"
	help
	  The settings item key where pending FOTA job info will be stored.
	  For application-FOTA, this value should also be found in your target application
	  so that the FOTA status can be properly reported to nRF Cloud.

config COAP_FOTA_USE_THREAD
	bool "Use a thread to process FOTA in the background"
	help
	  If not enabled, call the handle_fota_process() periodically. Otherwise, a
	  thread will process based on COAP_FOTA_JOB_CHECK_RATE_MIN.

config COAP_FOTA_THREAD_STACK_SIZE
	int "CoAP FOTA Thread Stack Size (bytes)"
	default 2048
	help
	  Sets the stack size (in bytes) for the CoAP FOTA thread of the
	  sample.

module = NRF_CLOUD_COAP_CLIENT
module-dep = LOG
module-str = nRF Cloud CoAP Client Sample
source "${ZEPHYR_BASE}/subsys/logging/Kconfig.template.log_config"
endmenu # Application sample

menu "Zephyr Kernel"
source "Kconfig.zephyr"
endmenu
```

## samples/cellular/nrf_cloud_coap_client/sample.yaml
```yaml
sample:
  name: nRF Cloud CoAP client sample
tests:
  samples.nrf9160.nrf_cloud_coap_client:
    build_only: true
    integration_platforms:
      - nrf9160dk_nrf9160_ns
    platform_allow: nrf9160dk_nrf9160_ns nrf9161dk_nrf9161_ns
    extra_args: OVERLAY_CONFIG=overlay-offload-tls.conf
    tags: ci_build
  sample.nrf9160.nrf_cloud_coap_client.nrf7002ek_wifi:
    build_only: true
    integration_platforms:
      - nrf9160dk_nrf9160_ns
    platform_allow: nrf9160dk_nrf9160_ns nrf9161dk_nrf9161_ns
    extra_args: SHIELD=nrf7002ek
                OVERLAY_CONFIG="overlay-nrf7002ek-wifi-scan-only.conf;overlay-offload-tls.conf"
                DTC_OVERLAY_FILE="nrf9160dk_with_nrf7002ek.overlay"
    tags: ci_build
```

## samples/cellular/nrf_cloud_coap_device_message/Kconfig
```kconfig
#
# Copyright (c) 2025 Nordic Semiconductor ASA
#
# SPDX-License-Identifier: LicenseRef-Nordic-5-Clause
#

menu "nRF Cloud CoAP Device Message Sample"

module = NRF_CLOUD_COAP_DEVICE_MESSAGE_SAMPLE
module-str = nRF Cloud CoAP Sample
source "${ZEPHYR_BASE}/subsys/logging/Kconfig.template.log_config"

endmenu

menu "Zephyr Kernel"
source "Kconfig.zephyr"
endmenu
```

## samples/cellular/nrf_cloud_coap_fota/Kconfig
```kconfig
#
# Copyright (c) 2025 Nordic Semiconductor ASA
#
# SPDX-License-Identifier: LicenseRef-Nordic-5-Clause
#

menu "nRF Cloud CoAP FOTA Sample"

config COAP_FOTA_JOB_CHECK_RATE_MIN
	int "Rate (minutes) at which this sample will check for FOTA updates"
	range 1 10080
	default 15

config COAP_FOTA_LTE_LED_NUM
	int "LED number to use for LTE connection status"
	default 0

config COAP_FOTA_BUTTON_EVT_NUM
	int "Button number to use for device interactions"
	default 1

module = NRF_CLOUD_COAP_FOTA_SAMPLE
module-str = nRF Cloud CoAP FOTA Sample
source "${ZEPHYR_BASE}/subsys/logging/Kconfig.template.log_config"

endmenu
menu "Zephyr Kernel"
source "Kconfig.zephyr"
endmenu
```

## samples/cellular/nrf_cloud_coap_fota/sample.yaml
```yaml
sample:
  name: nRF Cloud CoAP FOTA
tests:
  sample.cellular.nrf_cloud_coap_fota:
    sysbuild: true
    build_only: true
    integration_platforms:
      - nrf9151dk/nrf9151/ns
      - nrf9160dk/nrf9160/ns
      - nrf9161dk/nrf9161/ns
      - thingy91x/nrf9151/ns
    platform_allow:
      - nrf9151dk/nrf9151/ns
      - nrf9160dk/nrf9160/ns
      - nrf9161dk/nrf9161/ns
      - thingy91x/nrf9151/ns
    tags:
      - ci_build
      - sysbuild
      - ci_samples_cellular
  sample.cellular.nrf_cloud_coap_fota_delta_modem_update:
    sysbuild: true
    build_only: true
    integration_platforms:
      - nrf9151dk/nrf9151/ns
      - nrf9160dk/nrf9160/ns
      - nrf9161dk/nrf9161/ns
      - thingy91x/nrf9151/ns
    platform_allow:
      - nrf9151dk/nrf9151/ns
      - nrf9160dk/nrf9160/ns
      - nrf9161dk/nrf9161/ns
      - thingy91x/nrf9151/ns
    tags:
      - ci_build
      - sysbuild
      - ci_samples_cellular
    extra_args:
      - EXTRA_CONF_FILE=delta_modem_fota.conf
```

## samples/cellular/nrf_cloud_coap_multi_service/sample.yaml
```yaml
sample:
  name: nRF Cloud CoAP Multi Service Sample
tests:
  sample.nrf9160.nrf_cloud_coap_multi_service:
    build_only: true
    platform_allow: nrf9160dk_nrf9160_ns thingy91_nrf9160_ns
    integration_platforms:
      - nrf9160dk_nrf9160_ns
      - thingy91_nrf9160_ns
    tags: ci_build
```
