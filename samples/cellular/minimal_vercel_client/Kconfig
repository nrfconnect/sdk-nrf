## samples/cellular/modem_shell/sample.yaml
```yaml
sample:
  name: modem_shell Sample
tests:
  sample.cellular.modem_shell:
    sysbuild: true
    build_only: true
    integration_platforms:
      - nrf9151dk/nrf9151/ns
      - nrf9160dk/nrf9160/ns
      - nrf9161dk/nrf9161/ns
    platform_allow:
      - nrf9151dk/nrf9151/ns
      - nrf9160dk/nrf9160/ns
      - nrf9161dk/nrf9161/ns
    tags: ci_build sysbuild ci_samples_cellular
  sample.cellular.modem_shell_debug:
    sysbuild: true
    build_only: true
    integration_platforms:
      - nrf9151dk/nrf9151/ns
      - nrf9160dk/nrf9160/ns
      - nrf9161dk/nrf9161/ns
    platform_allow:
      - nrf9151dk/nrf9151/ns
      - nrf9160dk/nrf9160/ns
      - nrf9161dk/nrf9161/ns
    extra_args: EXTRA_CONF_FILE=overlay-debug.conf
    tags: ci_build sysbuild ci_samples_cellular
  sample.cellular.modem_shell.cloud_mqtt_only:
    sysbuild: true
    build_only: true
    integration_platforms:
      - nrf9151dk/nrf9151/ns
      - nrf9160dk/nrf9160/ns
      - nrf9161dk/nrf9161/ns
    platform_allow:
      - nrf9151dk/nrf9151/ns
      - nrf9160dk/nrf9160/ns
      - nrf9161dk/nrf9161/ns
    extra_configs:
      - CONFIG_LOCATION_SERVICE_NRF_CLOUD_GNSS_POS_SEND=y
    extra_args: EXTRA_CONF_FILE=overlay-cloud_mqtt.conf
    tags: ci_build sysbuild ci_samples_cellular
  sample.cellular.modem_shell.cloud_mqtt_rest:
    sysbuild: true
    build_only: true
    integration_platforms:
      - nrf9151dk/nrf9151/ns
      - nrf9160dk/nrf9160/ns
      - nrf9161dk/nrf9161/ns
    platform_allow:
      - nrf9151dk/nrf9151/ns
      - nrf9160dk/nrf9160/ns
      - nrf9161dk/nrf9161/ns
    extra_configs:
      - CONFIG_MOSH_CLOUD_MQTT=y
      - CONFIG_MOSH_CLOUD_REST=y
    tags: ci_build sysbuild ci_samples_cellular
  sample.cellular.modem_shell.cloud_coap_only:
    sysbuild: true
    build_only: true
    integration_platforms:
      - nrf9151dk/nrf9151/ns
      - nrf9160dk/nrf9160/ns
      - nrf9161dk/nrf9161/ns
    platform_allow:
      - nrf9151dk/nrf9151/ns
      - nrf9160dk/nrf9160/ns
      - nrf9161dk/nrf9161/ns
    extra_configs:
      - CONFIG_LOCATION_SERVICE_NRF_CLOUD_GNSS_POS_SEND=y
    extra_args: EXTRA_CONF_FILE=overlay-cloud_coap.conf
    tags: ci_build sysbuild ci_samples_cellular
  sample.cellular.modem_shell.non_offloading_ip:
    sysbuild: true
    build_only: true
    integration_platforms:
      - nrf9151dk/nrf9151/ns
      - nrf9160dk/nrf9160/ns
      - nrf9161dk/nrf9161/ns
    platform_allow:
      - nrf9151dk/nrf9151/ns
      - nrf9160dk/nrf9160/ns
      - nrf9161dk/nrf9161/ns
    extra_args: EXTRA_CONF_FILE=overlay-non-offloading.conf
    tags: ci_build sysbuild ci_samples_cellular
  sample.cellular.modem_shell.nrf7002ek_wifi:
    sysbuild: true
    build_only: true
    integration_platforms:
      - nrf9151dk/nrf9151/ns
      - nrf9160dk/nrf9160/ns
      - nrf9161dk/nrf9161/ns
    platform_allow:
      - nrf9151dk/nrf9151/ns
      - nrf9160dk/nrf9160/ns
      - nrf9161dk/nrf9161/ns
    extra_args: SHIELD=nrf7002ek_nrf7000 EXTRA_CONF_FILE=overlay-nrf700x-wifi-scan-only.conf
                SB_CONFIG_WIFI_NRF70=y SB_CONFIG_WIFI_NRF70_SCAN_ONLY=y
    tags: ci_build sysbuild ci_samples_cellular
  sample.cellular.modem_shell.nrf7000ek_wifi:
    sysbuild: true
    build_only: true
    integration_platforms:
      - nrf9151dk/nrf9151/ns
      - nrf9160dk/nrf9160/ns
      - nrf9161dk/nrf9161/ns
    platform_allow:
      - nrf9151dk/nrf9151/ns
      - nrf9160dk/nrf9160/ns
      - nrf9161dk/nrf9161/ns
    extra_args: SHIELD=nrf7002ek_nrf7000 EXTRA_CONF_FILE=overlay-nrf700x-wifi-scan-only.conf
                CONFIG_WIFI_NM_WPA_SUPPLICANT=n SB_CONFIG_WIFI_NRF70=y
                SB_CONFIG_WIFI_NRF70_SCAN_ONLY=y
    tags: ci_build sysbuild ci_samples_cellular
  sample.cellular.modem_shell.nrf7002ek_wifi-debug:
    sysbuild: true
    build_only: true
    integration_platforms:
      - nrf9151dk/nrf9151/ns
      - nrf9160dk/nrf9160/ns
      - nrf9161dk/nrf9161/ns
    platform_allow:
      - nrf9151dk/nrf9151/ns
      - nrf9160dk/nrf9160/ns
      - nrf9161dk/nrf9161/ns
    extra_args: SHIELD=nrf7002ek_nrf7000
                EXTRA_CONF_FILE="overlay-nrf700x-wifi-scan-only.conf;overlay-debug.conf"
                SB_CONFIG_WIFI_NRF70=y SB_CONFIG_WIFI_NRF70_SCAN_ONLY=y
    tags: ci_build sysbuild ci_samples_cellular
  sample.cellular.modem_shell.app_fota:
    sysbuild: true
    build_only: true
    integration_platforms:
      - nrf9151dk/nrf9151/ns
      - nrf9160dk/nrf9160/ns
      - nrf9161dk/nrf9161/ns
    platform_allow:
      - nrf9151dk/nrf9151/ns
      - nrf9160dk/nrf9160/ns
      - nrf9161dk/nrf9161/ns
    extra_args: EXTRA_CONF_FILE=overlay-app_fota.conf
                SB_CONFIG_BOOTLOADER_MCUBOOT=y
    tags: ci_build sysbuild ci_samples_cellular
  sample.cellular.modem_shell.modem_fota_full.nrf9160:
    sysbuild: true
    build_only: true
    extra_args: EXTRA_CONF_FILE=overlay-modem_fota_full.conf
                DTC_OVERLAY_FILE="nrf9160dk_ext_flash.overlay"
    integration_platforms:
      - nrf9160dk/nrf9160/ns
    platform_allow: nrf9160dk/nrf9160/ns
    tags: ci_build sysbuild ci_samples_cellular
  sample.cellular.modem_shell.modem_fota_full.nrf91x1:
    sysbuild: true
    build_only: true
    extra_args: EXTRA_CONF_FILE=overlay-modem_fota_full.conf
                DTC_OVERLAY_FILE="nrf9161dk_ext_flash.overlay"
    integration_platforms:
      - nrf9151dk/nrf9151/ns
      - nrf9161dk/nrf9161/ns
    platform_allow:
      - nrf9151dk/nrf9151/ns
      - nrf9161dk/nrf9161/ns
    tags: ci_build sysbuild ci_samples_cellular
  sample.cellular.modem_shell.carrier:
    sysbuild: true
    build_only: true
    extra_args: EXTRA_CONF_FILE=overlay-carrier.conf
    integration_platforms:
      - nrf9151dk/nrf9151/ns
      - nrf9160dk/nrf9160/ns
      - nrf9161dk/nrf9161/ns
    platform_allow:
      - nrf9151dk/nrf9151/ns
      - nrf9160dk/nrf9160/ns
      - nrf9161dk/nrf9161/ns
    tags: ci_build sysbuild ci_samples_cellular
  sample.cellular.modem_shell.lwm2m:
    sysbuild: true
    build_only: true
    extra_configs:
      - CONFIG_MOSH_LWM2M_PSK="000102030405060708090a0b0c0d0e0f"
    extra_args: EXTRA_CONF_FILE=overlay-lwm2m.conf
    integration_platforms:
      - nrf9151dk/nrf9151/ns
      - nrf9160dk/nrf9160/ns
      - nrf9161dk/nrf9161/ns
    platform_allow:
      - nrf9151dk/nrf9151/ns
      - nrf9160dk/nrf9160/ns
      - nrf9161dk/nrf9161/ns
    tags: ci_build sysbuild ci_samples_cellular
  sample.cellular.modem_shell.lwm2m_bootstrap:
    sysbuild: true
    build_only: true
    extra_configs:
      - CONFIG_MOSH_LWM2M_PSK="000102030405060708090a0b0c0d0e0f"
    extra_args: EXTRA_CONF_FILE="overlay-lwm2m.conf;overlay-lwm2m_bootstrap.conf"
    integration_platforms:
      - nrf9151dk/nrf9151/ns
      - nrf9160dk/nrf9160/ns
      - nrf9161dk/nrf9161/ns
    platform_allow:
      - nrf9151dk/nrf9151/ns
      - nrf9160dk/nrf9160/ns
      - nrf9161dk/nrf9161/ns
    tags: ci_build sysbuild ci_samples_cellular
  sample.cellular.modem_shell.lwm2m_pgps:
    sysbuild: true
    build_only: true
    extra_configs:
      - CONFIG_MOSH_LWM2M_PSK="000102030405060708090a0b0c0d0e0f"
    extra_args: EXTRA_CONF_FILE="overlay-lwm2m.conf;overlay-lwm2m_pgps.conf;overlay-pgps.conf"
    integration_platforms:
      - nrf9151dk/nrf9151/ns
      - nrf9160dk/nrf9160/ns
      - nrf9161dk/nrf9161/ns
    platform_allow:
      - nrf9151dk/nrf9151/ns
      - nrf9160dk/nrf9160/ns
      - nrf9161dk/nrf9161/ns
    tags: ci_build sysbuild ci_samples_cellular
  sample.cellular.modem_shell.pgps:
    sysbuild: true
    build_only: true
    extra_args: EXTRA_CONF_FILE=overlay-pgps.conf
    integration_platforms:
      - nrf9151dk/nrf9151/ns
      - nrf9160dk/nrf9160/ns
      - nrf9161dk/nrf9161/ns
    platform_allow:
      - nrf9151dk/nrf9151/ns
      - nrf9160dk/nrf9160/ns
      - nrf9161dk/nrf9161/ns
    tags: ci_build sysbuild ci_samples_cellular
  sample.cellular.modem_shell.location_service_ext:
    sysbuild: true
    build_only: true
    extra_configs:
      - CONFIG_LOCATION_SERVICE_EXTERNAL=y
    extra_args: EXTRA_CONF_FILE=overlay-cloud_mqtt.conf
    integration_platforms:
      - nrf9151dk/nrf9151/ns
      - nrf9160dk/nrf9160/ns
      - nrf9161dk/nrf9161/ns
    platform_allow:
      - nrf9151dk/nrf9151/ns
      - nrf9160dk/nrf9160/ns
      - nrf9161dk/nrf9161/ns
    tags: ci_build sysbuild ci_samples_cellular
  sample.cellular.modem_shell.location_service_ext_pgps_nrf7002ek_wifi:
    sysbuild: true
    build_only: true
    extra_configs:
      - CONFIG_LOCATION_SERVICE_EXTERNAL=y
      - CONFIG_NRF_CLOUD_PGPS_TRANSPORT_NONE=y
    extra_args: SHIELD=nrf7002ek_nrf7000
                EXTRA_CONF_FILE="overlay-cloud_mqtt.conf;overlay-pgps.conf;overlay-nrf700x-wifi-scan-only.conf"
                SB_CONFIG_WIFI_NRF70=y SB_CONFIG_WIFI_NRF70_SCAN_ONLY=y
    integration_platforms:
      - nrf9151dk/nrf9151/ns
      - nrf9160dk/nrf9160/ns
      - nrf9161dk/nrf9161/ns
    platform_allow:
      - nrf9151dk/nrf9151/ns
      - nrf9160dk/nrf9160/ns
      - nrf9161dk/nrf9161/ns
    tags: ci_build sysbuild ci_samples_cellular
  sample.cellular.modem_shell.ppp:
    sysbuild: true
    build_only: true
    extra_args: EXTRA_CONF_FILE=overlay-ppp.conf DTC_OVERLAY_FILE="ppp.overlay"
    integration_platforms:
      - nrf9151dk/nrf9151/ns
      - nrf9160dk/nrf9160/ns
      - nrf9161dk/nrf9161/ns
    platform_allow:
      - nrf9151dk/nrf9151/ns
      - nrf9160dk/nrf9160/ns
      - nrf9161dk/nrf9161/ns
    tags: ci_build sysbuild ci_samples_cellular
  sample.cellular.modem_shell.bt:
    sysbuild: true
    build_only: true
    extra_args: EXTRA_CONF_FILE=overlay-bt.conf DTC_OVERLAY_FILE="bt.overlay"
    integration_platforms:
      - nrf9160dk/nrf9160/ns
    platform_allow: nrf9160dk/nrf9160/ns
    tags: ci_build sysbuild ci_samples_cellular
  sample.cellular.modem_shell.rtt:
    sysbuild: true
    build_only: true
    extra_args: EXTRA_CONF_FILE=overlay-rtt.conf
    integration_platforms:
      - nrf9151dk/nrf9151/ns
      - nrf9160dk/nrf9160/ns
      - nrf9161dk/nrf9161/ns
    platform_allow:
      - nrf9151dk/nrf9151/ns
      - nrf9160dk/nrf9160/ns
      - nrf9161dk/nrf9161/ns
    tags: ci_build sysbuild ci_samples_cellular
  sample.cellular.modem_shell.thingy91:
    sysbuild: true
    build_only: true
    integration_platforms:
      - thingy91/nrf9160/ns
      - thingy91x/nrf9151/ns
    platform_allow:
      - thingy91/nrf9160/ns
      - thingy91x/nrf9151/ns
    tags: ci_build sysbuild ci_samples_cellular
  sample.cellular.modem_shell.thingy91x_wifi:
    sysbuild: true
    build_only: true
    integration_platforms:
      - thingy91x/nrf9151/ns
    platform_allow:
      - thingy91x/nrf9151/ns
    extra_args: EXTRA_CONF_FILE=overlay-nrf700x-wifi-scan-only.conf
                DTC_OVERLAY_FILE=thingy91x_wifi.overlay
                SB_CONFIG_WIFI_NRF70=y SB_CONFIG_WIFI_NRF70_SCAN_ONLY=y
    tags: ci_build sysbuild ci_samples_cellular
  sample.cellular.modem_shell.modem_trace_shell_ext_flash:
    sysbuild: true
    build_only: true
    integration_platforms:
      - nrf9151dk/nrf9151/ns
      - nrf9160dk/nrf9160/ns
      - nrf9161dk/nrf9161/ns
    platform_allow:
      - nrf9151dk/nrf9151/ns
      - nrf9160dk/nrf9160/ns
      - nrf9161dk/nrf9161/ns
    extra_args: modem_shell_SNIPPET="nrf91-modem-trace-ext-flash"
    extra_configs:
      - CONFIG_NRF_MODEM_LIB_SHELL_TRACE=y
    tags: ci_build sysbuild ci_samples_cellular
  sample.cellular.modem_shell.modem_trace_ram:
    sysbuild: true
    build_only: true
    integration_platforms:
      - nrf9151dk/nrf9151/ns
      - nrf9160dk/nrf9160/ns
      - nrf9161dk/nrf9161/ns
    platform_allow:
      - nrf9151dk/nrf9151/ns
      - nrf9160dk/nrf9160/ns
      - nrf9161dk/nrf9161/ns
    extra_args: EXTRA_CONF_FILE="overlay-modem-trace-ram.conf"
    tags: ci_build sysbuild ci_samples_cellular

  # Configurations for different location method combinations
  sample.cellular.modem_shell.location_gnss_wifi_no_cellular:
    sysbuild: true
    build_only: true
    integration_platforms:
      - nrf9151dk/nrf9151/ns
      - nrf9160dk/nrf9160/ns
      - nrf9161dk/nrf9161/ns
    platform_allow:
      - nrf9151dk/nrf9151/ns
      - nrf9160dk/nrf9160/ns
      - nrf9161dk/nrf9161/ns
    extra_configs:
      - CONFIG_LOCATION_METHOD_GNSS=y
      - CONFIG_LOCATION_METHOD_CELLULAR=n
      - CONFIG_LOCATION_METHOD_WIFI=y
    extra_args: SHIELD=nrf7002ek_nrf7000 EXTRA_CONF_FILE=overlay-nrf700x-wifi-scan-only.conf
                SB_CONFIG_WIFI_NRF70=y SB_CONFIG_WIFI_NRF70_SCAN_ONLY=y
    tags: ci_build sysbuild ci_samples_cellular
  sample.cellular.modem_shell.location_wifi_cellular_no_gnss:
    sysbuild: true
    build_only: true
    integration_platforms:
      - nrf9151dk/nrf9151/ns
      - nrf9160dk/nrf9160/ns
      - nrf9161dk/nrf9161/ns
    platform_allow:
      - nrf9151dk/nrf9151/ns
      - nrf9160dk/nrf9160/ns
      - nrf9161dk/nrf9161/ns
    extra_configs:
      - CONFIG_LOCATION_METHOD_GNSS=n
      - CONFIG_LOCATION_METHOD_CELLULAR=y
      - CONFIG_LOCATION_METHOD_WIFI=y
    extra_args: SHIELD=nrf7002ek_nrf7000 EXTRA_CONF_FILE=overlay-nrf700x-wifi-scan-only.conf
                SB_CONFIG_WIFI_NRF70=y SB_CONFIG_WIFI_NRF70_SCAN_ONLY=y
    tags: ci_build sysbuild ci_samples_cellular
  sample.cellular.modem_shell.location_wifi_no_cellular_no_gnss:
    sysbuild: true
    build_only: true
    integration_platforms:
      - nrf9151dk/nrf9151/ns
      - nrf9160dk/nrf9160/ns
      - nrf9161dk/nrf9161/ns
    platform_allow:
      - nrf9151dk/nrf9151/ns
      - nrf9160dk/nrf9160/ns
      - nrf9161dk/nrf9161/ns
    extra_configs:
      - CONFIG_LOCATION_METHOD_GNSS=n
      - CONFIG_LOCATION_METHOD_CELLULAR=n
      - CONFIG_LOCATION_METHOD_WIFI=y
    extra_args: SHIELD=nrf7002ek_nrf7000 EXTRA_CONF_FILE=overlay-nrf700x-wifi-scan-only.conf
                SB_CONFIG_WIFI_NRF70=y SB_CONFIG_WIFI_NRF70_SCAN_ONLY=y
    tags: ci_build sysbuild ci_samples_cellular
  sample.cellular.modem_shell.location_gnss_no_wifi_no_cellular:
    sysbuild: true
    build_only: true
    integration_platforms:
      - nrf9151dk/nrf9151/ns
      - nrf9160dk/nrf9160/ns
      - nrf9161dk/nrf9161/ns
    platform_allow:
      - nrf9151dk/nrf9151/ns
      - nrf9160dk/nrf9160/ns
      - nrf9161dk/nrf9161/ns
    extra_configs:
      - CONFIG_LOCATION_METHOD_GNSS=y
      - CONFIG_LOCATION_METHOD_CELLULAR=n
      - CONFIG_LOCATION_METHOD_WIFI=n
    tags: ci_build sysbuild ci_samples_cellular
  sample.cellular.modem_shell.location_cellular_no_wifi_no_gnss:
    sysbuild: true
    build_only: true
    integration_platforms:
      - nrf9151dk/nrf9151/ns
      - nrf9160dk/nrf9160/ns
      - nrf9161dk/nrf9161/ns
    platform_allow:
      - nrf9151dk/nrf9151/ns
      - nrf9160dk/nrf9160/ns
      - nrf9161dk/nrf9161/ns
    extra_configs:
      - CONFIG_LOCATION_METHOD_GNSS=n
      - CONFIG_LOCATION_METHOD_CELLULAR=y
      - CONFIG_LOCATION_METHOD_WIFI=n
    tags: ci_build sysbuild ci_samples_cellular

  # Configurations with location data details and some location method combinations
  sample.cellular.modem_shell.location_gnss_wifi_cellular_details:
    sysbuild: true
    build_only: true
    integration_platforms:
      - nrf9151dk/nrf9151/ns
      - nrf9160dk/nrf9160/ns
      - nrf9161dk/nrf9161/ns
    platform_allow:
      - nrf9151dk/nrf9151/ns
      - nrf9160dk/nrf9160/ns
      - nrf9161dk/nrf9161/ns
    extra_configs:
      - CONFIG_LOCATION_DATA_DETAILS=y
      - CONFIG_LOCATION_METHOD_GNSS=y
      - CONFIG_LOCATION_METHOD_CELLULAR=y
      - CONFIG_LOCATION_METHOD_WIFI=y
    extra_args: SHIELD=nrf7002ek_nrf7000 EXTRA_CONF_FILE=overlay-nrf700x-wifi-scan-only.conf
                SB_CONFIG_WIFI_NRF70=y SB_CONFIG_WIFI_NRF70_SCAN_ONLY=y
    tags: ci_build sysbuild ci_samples_cellular
  sample.cellular.modem_shell.location_gnss_no_wifi_no_cellular_details:
    sysbuild: true
    build_only: true
    integration_platforms:
      - nrf9151dk/nrf9151/ns
      - nrf9160dk/nrf9160/ns
      - nrf9161dk/nrf9161/ns
    platform_allow:
      - nrf9151dk/nrf9151/ns
      - nrf9160dk/nrf9160/ns
      - nrf9161dk/nrf9161/ns
    extra_configs:
      - CONFIG_LOCATION_DATA_DETAILS=y
      - CONFIG_LOCATION_METHOD_GNSS=y
      - CONFIG_LOCATION_METHOD_CELLULAR=n
      - CONFIG_LOCATION_METHOD_WIFI=n
    tags: ci_build sysbuild ci_samples_cellular
  sample.cellular.modem_shell.location_wifi_cellular_no_gnss_details:
    sysbuild: true
    build_only: true
    integration_platforms:
      - nrf9151dk/nrf9151/ns
      - nrf9160dk/nrf9160/ns
      - nrf9161dk/nrf9161/ns
    platform_allow:
      - nrf9151dk/nrf9151/ns
      - nrf9160dk/nrf9160/ns
      - nrf9161dk/nrf9161/ns
    extra_configs:
      - CONFIG_LOCATION_DATA_DETAILS=y
      - CONFIG_LOCATION_METHOD_GNSS=n
      - CONFIG_LOCATION_METHOD_CELLULAR=y
      - CONFIG_LOCATION_METHOD_WIFI=y
    extra_args: SHIELD=nrf7002ek_nrf7000 EXTRA_CONF_FILE=overlay-nrf700x-wifi-scan-only.conf
                SB_CONFIG_WIFI_NRF70=y SB_CONFIG_WIFI_NRF70_SCAN_ONLY=y
    tags: ci_build sysbuild ci_samples_cellular
  sample.cellular.modem_shell.location_gnss_cellular_no_wifi_details:
    sysbuild: true
    build_only: true
    integration_platforms:
      - nrf9151dk/nrf9151/ns
      - nrf9160dk/nrf9160/ns
      - nrf9161dk/nrf9161/ns
    platform_allow:
      - nrf9151dk/nrf9151/ns
      - nrf9160dk/nrf9160/ns
      - nrf9161dk/nrf9161/ns
    extra_configs:
      - CONFIG_LOCATION_DATA_DETAILS=y
      - CONFIG_LOCATION_METHOD_GNSS=y
      - CONFIG_LOCATION_METHOD_CELLULAR=y
      - CONFIG_LOCATION_METHOD_WIFI=n
    tags: ci_build sysbuild ci_samples_cellular

  # Configurations with modem UART traces to make sure they fit into image.
  # Basic UART trace configuration is tested in sample.cellular.modem_shell.integration_config.
  sample.cellular.modem_shell_modem_uart_trace:
    sysbuild: true
    build_only: true
    extra_args: modem_shell_SNIPPET="nrf91-modem-trace-uart"
    integration_platforms:
      - nrf9151dk/nrf9151/ns
      - nrf9160dk/nrf9160/ns
      - nrf9161dk/nrf9161/ns
    platform_allow:
      - nrf9151dk/nrf9151/ns
      - nrf9160dk/nrf9160/ns
      - nrf9161dk/nrf9161/ns
    tags: ci_build sysbuild ci_samples_cellular
  sample.cellular.modem_shell.non_offloading_ip_modem_uart_trace:
    sysbuild: true
    build_only: true
    extra_args:
      EXTRA_CONF_FILE=overlay-non-offloading.conf
      modem_shell_SNIPPET="nrf91-modem-trace-uart"
    integration_platforms:
      - nrf9151dk/nrf9151/ns
      - nrf9160dk/nrf9160/ns
      - nrf9161dk/nrf9161/ns
    platform_allow:
      - nrf9151dk/nrf9151/ns
      - nrf9160dk/nrf9160/ns
      - nrf9161dk/nrf9161/ns
    tags: ci_build sysbuild ci_samples_cellular
  sample.cellular.modem_shell.thingy91_modem_uart_trace:
    sysbuild: true
    build_only: true
    extra_args: modem_shell_SNIPPET="nrf91-modem-trace-uart"
    integration_platforms:
      - thingy91/nrf9160/ns
      - thingy91x/nrf9151/ns
    platform_allow:
      - thingy91/nrf9160/ns
      - thingy91x/nrf9151/ns
    tags: ci_build sysbuild ci_samples_cellular

  # Configuration which will be used by the CI integration job to verify PRs
  sample.cellular.modem_shell.integration_config:
    sysbuild: true
    build_only: true
    extra_configs:
      - CONFIG_LTE_NETWORK_MODE_LTE_M=y
      - CONFIG_MODEM_ANTENNA_GNSS_EXTERNAL=y
    extra_args: modem_shell_SNIPPET="nrf91-modem-trace-uart"
    integration_platforms:
      - nrf9151dk/nrf9151/ns
    platform_allow:
      - nrf9151dk/nrf9151/ns
    tags: ci_build sysbuild ci_samples_cellular
```
