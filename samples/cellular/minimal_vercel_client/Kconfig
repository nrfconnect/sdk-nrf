## samples/cellular/minimal_vercel_client/Kconfig
```kconfig
# Minimal Vercel Client Configuration

menu "Minimal Vercel Client"

config VERCEL_SERVER_HOSTNAME
	string "Vercel server hostname"
	default "your-app.vercel.app"
	help
	  Hostname of the Vercel server to connect to

config GPS_UPDATE_INTERVAL_SEC
	int "GPS update interval in seconds"
	default 60
	help
	  How often to send GPS updates to the server

config FOTA_CHECK_INTERVAL_MIN
	int "FOTA check interval in minutes"
	default 5
	help
	  How often to check for firmware updates

endmenu

source "Kconfig.zephyr"
```

## samples/cellular/minimal_vercel_client/boards/nrf9151dk_nrf9151_ns.conf
```kconfig
# nRF9151 DK board configuration

# Enable UART for logging
CONFIG_UART_INTERRUPT_DRIVEN=y

# Optimize for nRF9151
CONFIG_FPU=y
```

## samples/cellular/minimal_vercel_client/sample.yaml
```yaml
sample:
  name: Minimal nRF9151 Vercel Client
  description: Minimal firmware with LTE, HTTP, GPS, and FOTA for nRF9151

tests:
  sample.cellular.minimal_vercel_client:
    tags: ci_build
    platform_allow:
      - nrf9151dk_nrf9151_ns
    integration_platforms:
      - nrf9151dk_nrf9151_ns
```

## samples/cellular/modem_shell/Kconfig
```kconfig
#
# Copyright (c) 2020 Nordic Semiconductor ASA
#
# SPDX-License-Identifier: LicenseRef-Nordic-5-Clause
#

source "Kconfig.zephyr"

menu "Nordic Modem Shell config"

config MOSH_IPERF3
	bool "iPerf3"
	default y
	select NRF_IPERF3

config NRF_IPERF3_PROMPTLESS
	bool
	default y

config MOSH_SOCK
	bool "Socket tool"
	default y
	help
	  Socket tool with TCP, UDP, RAW, IPv4, IPv6 and packet socket support.

config MOSH_PING
	bool "ICMP ping"
	default y
	help
	  Ping is a tool for testing the reachability of a host on an IP network.

config MOSH_LINK
	bool "Link control"
	depends on LTE_LINK_CONTROL
	depends on MODEM_INFO
	depends on SETTINGS
	default y
	help
	  Link control changes and queries the state of the LTE connection.

config MOSH_CURL
	bool "cURL"
	default y
	select NRF_CURL

config NRF_CURL_PROMPTLESS
	bool
	default y

config MOSH_GNSS
	bool "GNSS"
	default y
	help
	  GNSS feature for searching the location of the device.

config MOSH_PPP
	bool "PPP"
	help
	  Point-to-Point Protocol for enabling dial-up access to the Internet.

config MOSH_SMS
	bool "SMS"
	default y
	help
	  SMS tool for sending and receiving SMS messages.

config MOSH_LOCATION
	bool "Location"
	default y
	select LOCATION
	select NRF_CLOUD_LOCATION if MOSH_CLOUD_MQTT && (LOCATION_METHOD_CELLULAR || LOCATION_METHOD_WIFI)
	help
	  Tool for location queries via location library.

config MOSH_FOTA
	bool "FOTA"
	default y
	help
	  FOTA for performing software updates over-the-air for both modem and application side.

config MOSH_REST
	bool "REST client"
	default y
	select REST_CLIENT
	help
	  REST client for sending and receiving simple REST requests/responses.

config MOSH_CLOUD_REST
	bool "nRFCloud commands over REST"
	default y
	select NRF_CLOUD_REST
	select MODEM_JWT
	select NRF_CLOUD_AGNSS_FILTERED if NRF_CLOUD_AGNSS && !NRF_CLOUD_MQTT
	select NRF_CLOUD_AGNSS_FILTERED_RUNTIME if NRF_CLOUD_AGNSS && !NRF_CLOUD_MQTT

config MOSH_CLOUD_MQTT
	bool "MQTT connection to nRF Cloud"
	select NRF_CLOUD_MQTT
	help
	  MQTT connection to nRF Cloud.

config MOSH_CLOUD_COAP
	bool "CoAP connection to nRF Cloud"
	select NRF_CLOUD_COAP
	select MODEM_JWT
	help
	  CoAP connection to nRF Cloud.

config MOSH_CLOUD_LWM2M
	bool "Cloud connection using LwM2M"
	help
	  Cloud connection using LwM2M.

config MOSH_AT_CMD_MODE
	bool "Specific AT command mode"
	default y

config MOSH_GPIO_COUNT
	bool "GPIO pin pulse counter"
	default n if BOARD_THINGY91_NRF9160_NS
	default y
	help
	  Tool for counting the number of pulses on a GPIO pin.

config MOSH_PRINT_BUFFER_SIZE
	int "Buffer size used when printing modem shell output"
	default 1024
	help
	  If the printed string exceeds this buffer, an error message is printed first and
	  then the requested string cut into the length of this buffer.

config MOSH_COMMON_WORKQUEUE_STACK_SIZE
	int "Common workqueue stack size"
	default 7168 if MOSH_CLOUD_REST || MOSH_CLOUD_MQTT
	default 6144 if MOSH_STARTUP_CMDS && MOSH_CURL
	default 4096

config MOSH_COMMON_WORKQUEUE_PRIORITY
	int "Common workqueue priority"
	default 5

if MOSH_IPERF3 || MOSH_PING
menu "MoSH iperf3 and ping command selections"

config MOSH_WORKER_THREADS
	bool "Possibility to run iperf3 or ping instances in separate threads"
	default y

config MOSH_STARTUP_CMDS
	bool "Possibility to run stored MoSh commands from settings after bootup"
	default y

config MOSH_NRF91_NON_OFFLOADING_DEV
	bool "Possibility to run iperf3 with Zephyr TCP/IP stack"

endmenu
endif

if MOSH_AT_CMD_MODE
choice
	prompt "Command termination"
	default MOSH_AT_CMD_MODE_CR_LF_TERMINATION
	help
		Sets the command termination ending from the serial terminal
		Levels are:
		-  NULL Termination
		-  CR Termination
		-  LF Termination
		-  CR+LF Termination
	config MOSH_AT_CMD_MODE_NULL_TERMINATION
		bool "NULL Termination"
	config MOSH_AT_CMD_MODE_CR_TERMINATION
		bool "CR Termination"
	config MOSH_AT_CMD_MODE_LF_TERMINATION
		bool "LF Termination"
	config MOSH_AT_CMD_MODE_CR_LF_TERMINATION
		bool "CR+LF Termination"
endchoice
config MOSH_AT_CMD_MODE_TERMINATION
	int
	default 0 if MOSH_AT_CMD_MODE_NULL_TERMINATION
	default 1 if MOSH_AT_CMD_MODE_CR_TERMINATION
	default 2 if MOSH_AT_CMD_MODE_LF_TERMINATION
	default 3 if MOSH_AT_CMD_MODE_CR_LF_TERMINATION
endif

if MOSH_LINK
menu "MoSH link control selections"

config MOSH_LINK_SETT_NORMAL_MODE_AT_CMD_STR_LEN
	int "Link settings AT command length"
	default 127
	help
	  String length for custom AT commands stored into settings to be used
	  when going to normal mode.

endmenu
endif #MOSH_LINK

if MOSH_WORKER_THREADS

config MOSH_WORKER_THREADS_OUTPUT_BUFFER_SIZE
	int "Buffer size for storing output of the background thread commands"
	default 4096

config MOSH_WORKER_THREADS_STACK_SIZE
	int "Worker thread stack size"
	default 4096

endif #MOSH_WORKER_THREADS

if MOSH_CLOUD_LWM2M

config MOSH_LWM2M_PSK
	string "LwM2M pre-shared key for communication"
	help
	  Pre-shared key must be identical to the PSK registered with the device on the LwM2M server.
	  Use the hexadecimal representation.

config MOSH_LWM2M_ENDPOINT_PREFIX
	string "Prefix used in the LwM2M endpoint name"
	default "urn:imei:"
	help
	  Sets the prefix of the endpoint name used when connecting to the LwM2M server.

# Make AVSystem the default LwM2M server.
config LWM2M_CLIENT_UTILS_SERVER
	string "LwM2M server address"
	default "coaps://eu.iot.avsystem.cloud:5684"
	help
	  Kconfig redefinition, please see the help text of the original definition.

endif # MOSH_CLOUD_LWM2M

# For power measurement purposes, activate low power mode for asynchronous UARTs.
if UART_0_ASYNC

config UART_0_NRF_ASYNC_LOW_POWER
	bool "Low power mode"
	default y

endif # UART_0_ASYNC

if UART_1_ASYNC

config UART_1_NRF_ASYNC_LOW_POWER
	bool "Low power mode"
	default y

endif # UART_1_ASYNC

endmenu # Modem Shell
```

## samples/cellular/modem_shell/boards/nrf9251dk_nrf9251_cpuapp.conf
```kconfig
#
# Copyright (c) 2026 Nordic Semiconductor ASA
#
# SPDX-License-Identifier: LicenseRef-Nordic-5-Clause
#

# FOTA not yet supported
CONFIG_MOSH_FOTA=n
CONFIG_FOTA_DOWNLOAD=n

# Use ZMS instead of NVS for storage, because it's better suited for MRAM
CONFIG_ZMS=y
CONFIG_ZMS_LOG_LEVEL_WRN=y
CONFIG_NVS=n

CONFIG_LOCATION_METHOD_WIFI=y

# See comment for CONFIG_HEAP_MEM_POOL_SIZE.
CONFIG_LOCATION_METHOD_WIFI_SCANNING_RESULTS_MAX_CNT=50
CONFIG_LOCATION_WORKQUEUE_STACK_SIZE=8192

# Wi-Fi
CONFIG_WIFI=y
CONFIG_WIFI_NRF92=y

# Wi-Fi shell
CONFIG_NET_L2_WIFI_SHELL=y
# Should be set when CONFIG_NET_L2_WIFI_SHELL is enabled.
# Printing 'wifi scan' command results puts pressure on queues in new locking design in net_mgmt.
# So, use a typical number of networks in a crowded environment as the queue depth.
CONFIG_NET_MGMT_EVENT_QUEUE_SIZE=50

# Networking
CONFIG_NETWORKING=y
CONFIG_NET_NATIVE=y
CONFIG_NET_L2_DUMMY=y
CONFIG_NET_OFFLOAD=y

# Memory configurations
CONFIG_NET_MGMT_EVENT_STACK_SIZE=1024

# Wi-Fi shell sample has 25000 heap size. We need a bit more for location request purposes.
# Heap allocation should be changed when CONFIG_LOCATION_METHOD_WIFI_SCANNING_RESULTS_MAX_CNT
# is changed. In modem shell, it looks like 10 APs requires ~4500 bytes to give some rough numbers.
CONFIG_HEAP_MEM_POOL_SIZE=40000
```

## samples/cellular/modem_shell/boards/thingy91_nrf9160_ns.conf
```kconfig
#
# Copyright (c) 2021 Nordic Semiconductor ASA
#
# SPDX-License-Identifier: LicenseRef-Nordic-5-Clause
#

# Configuration file for Thingy:91.
# This file is merged with prj.conf in the application folder, and options
# set here will take precedence if they are present in both files.

# Disabling some of the features by default to fit MOSH into the flash
CONFIG_MOSH_CURL=n
CONFIG_MOSH_REST=n
CONFIG_MOSH_SMS=n
CONFIG_MOSH_IPERF3=n
CONFIG_MOSH_GNSS=n
CONFIG_MOSH_WORKER_THREADS=n
CONFIG_MOSH_SOCK=n
CONFIG_MOSH_FOTA=n

CONFIG_SHELL_STATS=n
CONFIG_DEVICE_SHELL=n
CONFIG_DEVMEM_SHELL=n
CONFIG_MCUBOOT_SHELL=n

# MCUBOOT
CONFIG_BOOTLOADER_MCUBOOT=y
CONFIG_IMG_MANAGER=y
CONFIG_STREAM_FLASH=y
CONFIG_MCUBOOT_IMG_MANAGER=y
CONFIG_IMG_ERASE_PROGRESSIVELY=y
```

## samples/cellular/modem_shell/boards/thingy91x_nrf9151_ns.conf
```kconfig
#
# Copyright (c) 2024 Nordic Semiconductor ASA
#
# SPDX-License-Identifier: LicenseRef-Nordic-5-Clause
#

# Configuration file for Thingy:91 X.
# This file is merged with prj.conf in the application folder, and options
# set here will take precedence if they are present in both files.

# MCUBOOT
CONFIG_BOOTLOADER_MCUBOOT=y
CONFIG_IMG_MANAGER=y
CONFIG_STREAM_FLASH=y
CONFIG_MCUBOOT_IMG_MANAGER=y
CONFIG_IMG_ERASE_PROGRESSIVELY=y
```
