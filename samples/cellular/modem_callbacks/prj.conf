## sample.yaml
```
sample:
  name: modem callbacks
tests:
  sample.cellular.modem_callbacks:
    sysbuild: true
    build_only: true
    integration_platforms:
      - nrf9151dk/nrf9151/ns
    platform_allow:
      - nrf9151dk/nrf9151/ns
    tags:
      - ci_build
      - sysbuild
      - ci_samples_cellular
```

## prj.conf
```kconfig
#
# Copyright (c) 2022 Nordic Semiconductor ASA
#
# SPDX-License-Identifier: LicenseRef-Nordic-5-Clause
#

# TF-M config
CONFIG_TFM_PROFILE_TYPE_MINIMAL=y

# Samples default
CONFIG_NCS_SAMPLES_DEFAULTS=y

# Network
CONFIG_NETWORKING=y
CONFIG_NET_NATIVE=n
CONFIG_NET_SOCKETS=y
CONFIG_NET_SOCKETS_OFFLOAD=y

# Modem library
CONFIG_NRF_MODEM_LIB=y


# LTE link control
CONFIG_LTE_LINK_CONTROL=y

# Stacks and heaps
CONFIG_HEAP_MEM_POOL_SIZE=1024
CONFIG_MAIN_STACK_SIZE=1536
```

## src/main.c
```c
/*
 * Copyright (c) 2022 Nordic Semiconductor ASA
 *
 * SPDX-License-Identifier: LicenseRef-Nordic-5-Clause
 */

#include <stdio.h>
#include <stdint.h>
#include <zephyr/kernel.h>
#include <modem/nrf_modem_lib.h>
#include <modem/lte_lc.h>

NRF_MODEM_LIB_ON_INIT(init_hook, on_modem_init, NULL);
NRF_MODEM_LIB_ON_SHUTDOWN(shutdown_hook, on_modem_shutdown, NULL);

static void on_modem_init(int ret, void *ctx)
{
	printk("> Initialized with value %d\n", ret);
}

static void on_modem_shutdown(void *ctx)
{
	printk("> Shutting down\n");
}

NRF_MODEM_LIB_ON_CFUN(cfun_monitor, on_cfun, NULL);

static void on_cfun(int mode, void *ctx)
{
	printk("> Functional mode has changed to %d\n", mode);
}

int main(void)
{
	int err;

	printk("Modem callbacks sample started\n");

	printk("Initializing modem library\n");
	err = nrf_modem_lib_init();
	if (err) {
		printk("Modem initialization failed, err %d\n", err);
		return 0;
	}

	printk("Connecting to network\n");
	err = lte_lc_connect();
	if (err) {
		printk("Connecting to network failed, err %d\n", err);
	}

	printk("Shutting down modem library\n");
	err = nrf_modem_lib_shutdown();
	if (err) {
		printk("Shutting down modem failed, err %d\n", err);
		return 0;
	}

	printk("Bye\n");

	return 0;
}
```
