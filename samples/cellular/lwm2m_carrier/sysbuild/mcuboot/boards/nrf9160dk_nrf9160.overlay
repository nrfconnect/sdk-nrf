/*
 * Copyright (c) 2026 Nordic Semiconductor ASA
 *
 * SPDX-License-Identifier: LicenseRef-Nordic-5-Clause
 */

#include "../../../boards/nrf9160dk_nrf9160_ns.overlay"
#include "../../../bootloader.overlay"

/ {
	chosen {
		zephyr,code-partition = &boot_partition;
	};
};
