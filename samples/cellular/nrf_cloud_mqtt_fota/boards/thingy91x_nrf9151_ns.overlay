/*
 * Copyright (c) 2025 Nordic Semiconductor ASA
 *
 * SPDX-License-Identifier: LicenseRef-Nordic-5-Clause
 */

/ {
	aliases {
		ext-flash = &flash_ext;
	};

	chosen {
		nordic,fmfu-storage-partition = &fmfu_storage_partition;
	};
};
