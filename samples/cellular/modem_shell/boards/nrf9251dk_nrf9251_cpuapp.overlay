/*
 * Copyright (c) 2026 Nordic Semiconductor ASA
 *
 * SPDX-License-Identifier: LicenseRef-Nordic-5-Clause
 */

#include <samples/cellular/nrf92_no_bootloader_partitions.dtsi>

&cpuppr_vpr {
	status = "disabled";
	/delete-property/ source-memory;
	/delete-property/ execution-memory;
};

&cpuflpr_vpr {
	status = "disabled";
	/delete-property/ source-memory;
	/delete-property/ execution-memory;
};

&cpuapp_wifi {
	status = "okay";
};

/ {
	/delete-node/ nordic-tz-secure;
	/delete-node/ nordic-tz-nonsecure;
};
