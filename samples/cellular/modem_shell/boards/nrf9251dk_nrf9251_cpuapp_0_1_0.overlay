/*
 * Copyright (c) 2026 Nordic Semiconductor ASA
 *
 * SPDX-License-Identifier: LicenseRef-Nordic-5-Clause
 */

/delete-node/ &cpuapp_boot_partition;
/delete-node/ &cpuapp_slot0_partition;

&mram1x {
	partitions {
		cpuapp_boot_partition: partition@312000 {
			compatible = "zephyr,mapped-partition";
			reg = <0x312000 DT_SIZE_K(64)>;
		};

		cpuapp_slot0_partition: partition@322000 {
			compatible = "zephyr,mapped-partition";
			reg = <0x322000 DT_SIZE_K(888)>;
		};
	};
};
