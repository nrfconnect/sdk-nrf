/*
 * Copyright (c) 2022 Nordic Semiconductor ASA
 *
 * SPDX-License-Identifier: LicenseRef-Nordic-5-Clause
 */

/* Disabled because of conflicts on P0.00 and P0.01 - Arduino pins D0 and D1
 * (iovdd-ctrl-gpios and bucken-gpios in nrf7002ek, respectively). */
&uart1 {
	status = "disabled";
};
