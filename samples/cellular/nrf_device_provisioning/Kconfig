## samples/cellular/nrf_device_provisioning/Kconfig
```kconfig
#
# Copyright (c) 2023 Nordic Semiconductor ASA
#
# SPDX-License-Identifier: LicenseRef-Nordic-5-Clause
#

menu "Zephyr Kernel"
source "Kconfig.zephyr"
endmenu

module = NRF_PROVISIONING_SAMPLE
module-str = nRF Provisioning Sample
source "subsys/logging/Kconfig.template.log_config"
```

## samples/cellular/nrf_provisioning/sample.yaml
```yaml
sample:
  name: nRF Device Provisioning
tests:
  sample.cellular.nrf_provisioning:
    sysbuild: true
    build_only: true
    integration_platforms:
      - nrf9151dk/nrf9151/ns
      - nrf9161dk/nrf9161/ns
    platform_allow:
      - nrf9151dk/nrf9151/ns
      - nrf9160dk/nrf9160/ns
      - nrf9161dk/nrf9161/ns
    tags: sysbuild
```

## samples/cellular/otdoa/Kconfig
```kconfig
#
# Copyright (c) 2020 Nordic Semiconductor ASA
#
# SPDX-License-Identifier: LicenseRef-Nordic-5-Clause
#

menu "OTDOA Sample Application config"

config PERIODIC_EST_INTERVAL
	int "Interval in minutes for periodic OTDOA estimates,  0 to disable."
	default 0

endmenu # OTDOA Sample Application

menu "Zephyr Kernel"
source "Kconfig.zephyr"
endmenu
```

## samples/cellular/otdoa/sample.yaml
```yaml
sample:
  name: otdoa Sample
tests:
  sample.cellular.otdoa:
    sysbuild: true
    build_only: true
    integration_platforms:
      - nrf9151dk/nrf9151/ns
      - nrf9161dk/nrf9161/ns
      - thingy91x/nrf9151/ns
    platform_allow:
      - nrf9151dk/nrf9151/ns
      - nrf9161dk/nrf9161/ns
      - thingy91x/nrf9151/ns
    tags: ci_build sysbuild ci_samples_cellular
```

## samples/cellular/slm_shell/boards/nrf5340dk_nrf5340_cpuapp.conf
```kconfig
#
# Copyright (c) 2023 Nordic Semiconductor ASA
#
# SPDX-License-Identifier: LicenseRef-Nordic-5-Clause
#

# Configuration file for nRF5340DK.
# This file is merged with prj.conf in the application folder, and options
# set here will take precedence if they are present in both files.

CONFIG_NRFX_UARTE=y
CONFIG_UART_2_INTERRUPT_DRIVEN=n
CONFIG_UART_2_ASYNC=y
CONFIG_MODEM_SLM_POWER_PIN=23
CONFIG_MODEM_SLM_INDICATE_PIN=28
```

## samples/cellular/slm_shell/boards/nrf54l15dk_nrf54l15_cpuapp.conf
```kconfig
#
# Copyright (c) 2025 Nordic Semiconductor ASA
#
# SPDX-License-Identifier: LicenseRef-Nordic-5-Clause
#

# Configuration file for nRF54L15DK.
# This file is merged with prj.conf in the application folder, and options
# set here will take precedence if they are present in both files.

CONFIG_NRFX_UARTE21=y
CONFIG_UART_21_INTERRUPT_DRIVEN=n
# CONFIG_UART_21_NRF_HW_ASYNC=y

## P0.04 Button 3 on nRF54L15DK
CONFIG_MODEM_SLM_POWER_PIN=4
## P0.03 UART0_CST when VCOM0 HWFC is disabled in Board Configurator
#CONFIG_MODEM_SLM_INDICATE_PIN=3
```

## samples/cellular/slm_shell/dts/bindings/nordic,dte-dtr.yaml
```yaml
# Copyright (c) 2025 Nordic Semiconductor ASA
# SPDX-License-Identifier: LicenseRef-Nordic-5-Clause

description: |
    DTE side of DTR/RI UART

compatible: "nordic,dte-dtr"

properties:
  dtr-gpios:
    type: phandle-array
    description: Output. Data Terminal Ready pin
    required: true

  ri-gpios:
    type: phandle-array
    description: Input. Ring Indicator pin
    required: true
```

## samples/cellular/slm_shell/sample.yaml
```yaml
sample:
  description: SLM shell sample
  name: slm shell
tests:
  sample.cellular.slm_shell:
    sysbuild: true
    build_only: true
    platform_allow:
      - nrf52840dk/nrf52840
      - nrf5340dk/nrf5340/cpuapp
      - nrf7002dk/nrf5340/cpuapp
      - nrf54l15dk/nrf54l15/cpuapp
    integration_platforms:
      - nrf52840dk/nrf52840
      - nrf5340dk/nrf5340/cpuapp
      - nrf7002dk/nrf5340/cpuapp
      - nrf54l15dk/nrf54l15/cpuapp
    tags:
      - ci_build
      - sysbuild
      - ci_samples_cellular
  sample.cellular.slm_shell.no_indicate_pin:
    sysbuild: true
    build_only: true
    extra_configs:
      - CONFIG_MODEM_SLM_INDICATE_PIN=-1
    platform_allow:
      - nrf52840dk/nrf52840
      - nrf5340dk/nrf5340/cpuapp
      - nrf7002dk/nrf5340/cpuapp
    integration_platforms:
      - nrf5340dk/nrf5340/cpuapp
    tags:
      - ci_build
      - sysbuild
      - ci_samples_cellular
```

## samples/cellular/smp_svr/sample.yaml
```yaml
sample:
  name: smp_svr Sample
tests:
  sample.cellular.smp_svr:
    build_only: true
    integration_platforms:
      - nrf9160dk_nrf52840
    platform_allow: nrf9160dk_nrf52840
    extra_args: EXTRA_DTC_OVERLAY_FILE="nrf9160dk_nrf52840_mcumgr_srv.overlay"
    tags: ci_build
```

## samples/cellular/sms/Kconfig
```kconfig
#
# Copyright (c) 2021 Nordic Semiconductor ASA
#
# SPDX-License-Identifier: LicenseRef-Nordic-5-Clause
#

menu "SMS Sample Settings"

config SMS_SEND_PHONE_NUMBER
	string "Phone number to which the SMS message is sent, including the country code."
	default ""
	help
	  Phone number to which the SMS message is sent, including the country code.
	  If empty, SMS will not be sent at all but the sample waits for received messages.

config SMS_SERVICE_CENTER_NUMBER
	string "Phone number of the SMS service center, including the country code."
	default ""
	help
	  If empty, SMS will not add the service center number into the SMS PDU,
	  and the modem/network will use the default values.

endmenu

menu "Zephyr Kernel"
source "Kconfig.zephyr"
endmenu
```

## samples/cellular/sms/sample.yaml
```yaml
sample:
  name: sms Sample
tests:
  sample.cellular.sms:
    sysbuild: true
    build_only: true
    integration_platforms:
      - nrf9151dk/nrf9151/ns
      - nrf9160dk/nrf9160/ns
      - nrf9161dk/nrf9161/ns
    platform_allow:
      - nrf9151dk/nrf9151/ns
      - nrf9160dk/nrf9160/ns
      - nrf9161dk/nrf9161/ns
    tags: ci_build sysbuild ci_samples_cellular
  sample.cellular.sms.sca:
    sysbuild: true
    build_only: true
    integration_platforms:
      - nrf9151dk/nrf9151/ns
      - nrf9160dk/nrf9160/ns
      - nrf9161dk/nrf9161/ns
    platform_allow:
      - nrf9151dk/nrf9151/ns
      - nrf9160dk/nrf9160/ns
      - nrf9161dk/nrf9161/ns
    extra_configs:
      - CONFIG_GCF_SMS=y
      - CONFIG_SMS_SEND_PHONE_NUMBER=\"123456789\"
      - CONFIG_SMS_SERVICE_CENTER_NUMBER=\"9876543210\"
    tags: ci_build sysbuild ci_samples_cellular
```

## samples/cellular/tls_ciphersuites/Kconfig
```kconfig
#
# Copyright (c) 2022 Nordic Semiconductor ASA
#
# SPDX-License-Identifier: LicenseRef-Nordic-5-Clause
#

menu "TLS CipherSuites sample"

config EXTENDED_CIPHERSUITE_LIST
	bool "Extended ciphersuite list"
	help
	  Extends the ciphersuite list with extra ciphersuites that are
	  only supported by Modem Firmware v1.3.x >= 1 and Modem
	  Firmware v1.2.x >= 7.

endmenu

menu "Zephyr Kernel"
source "Kconfig.zephyr"
endmenu
```

## samples/cellular/tls_ciphersuites/Kconfig.sysbuild
```kconfig
#
# Copyright (c) 2026 Nordic Semiconductor ASA
#
# SPDX-License-Identifier: LicenseRef-Nordic-5-Clause
#

config PARTITION_MANAGER
	default n if !BOARD_THINGY91X && !BOARD_THINGY91

source "share/sysbuild/Kconfig"
```

## samples/cellular/udp/Kconfig
```kconfig
#
# Copyright (c) 2020 Nordic Semiconductor ASA
#
# SPDX-License-Identifier: LicenseRef-Nordic-5-Clause
#

menu "UDP Sample Settings"

config UDP_DATA_UPLOAD_SIZE_BYTES
	int "Number of bytes transmitted to the server"
	default 10

config UDP_DATA_UPLOAD_FREQUENCY_SECONDS
	int "How often data is transmitted to the server"
	default 900

config UDP_SERVER_ADDRESS_STATIC
	string "UDP server IP address"
	default "8.8.8.8"

config UDP_SERVER_PORT
	int "UDP server port number"
	default "2469"

config UDP_PSM_ENABLE
	bool "Enable LTE Power Saving Mode (PSM)"
	default y
	select LTE_PSM_REQ

config UDP_EDRX_ENABLE
	bool "Enable LTE enhanced Discontinuous Reception (eDRX)"
	select LTE_EDRX_REQ

config UDP_RAI_ENABLE
	bool "Enable LTE Release Assistance Indication (RAI)"
	default y
	select LTE_RAI_REQ

if UDP_RAI_ENABLE

choice UDP_RAI_INDICATION
	prompt "RAI indication to set for UDP transmission"
	default UDP_RAI_LAST

config UDP_RAI_NO_DATA
	bool "Indicates that there will be no upcoming data transmission anymore"

config UDP_RAI_LAST
	bool "Indicates that the next transmission will be the last one for some time"

config UDP_RAI_ONGOING
	bool "Indicates that the client expects to use the socket more after the next transmission"

endchoice

endif # UDP_RAI_ENABLE

endmenu

module = UDP
module-str = UDP sample
source "${ZEPHYR_BASE}/subsys/logging/Kconfig.template.log_config"

menu "Zephyr Kernel"
source "Kconfig.zephyr"
endmenu
```

## samples/cellular/udp/sample.yaml
```yaml
sample:
  name: UDP sample
tests:
  sample.cellular.udp:
    build_only: true
    integration_platforms:
      - nrf9151dk/nrf9151/ns
      - nrf9160dk/nrf9160/ns
      - nrf9161dk/nrf9161/ns
      - thingy91_nrf9160_ns
    platform_allow:
      - nrf9151dk/nrf9151/ns
      - nrf9160dk/nrf9160/ns
      - nrf9161dk/nrf9161/ns
      - thingy91_nrf9160_ns
      - thingy91x_nrf9151_ns
    tags: ci_build
```

## samples/common/Kconfig
```kconfig
#
# Copyright (c) 2023 Nordic Semiconductor
#
# SPDX-License-Identifier: LicenseRef-Nordic-5-Clause
#

rsource "mcumgr_bt_ota_dfu/Kconfig"
```

## samples/common/mcumgr_bt_ota_dfu/Kconfig
```kconfig
#
# Copyright (c) 2023 Nordic Semiconductor
#
# SPDX-License-Identifier: LicenseRef-Nordic-5-Clause
#

DT_CHOSEN_EXT_FLASH:= nordic,pm-ext-flash

config NCS_SAMPLE_MCUMGR_BT_OTA_DFU
	bool "MCUmgr OTA DFU over Bluetooth"
	select MCUMGR
	select NET_BUF
	select ZCBOR
	select CRC
	select MCUMGR_TRANSPORT_BT
	imply MCUMGR_TRANSPORT_BT_CONN_PARAM_CONTROL
	imply IMG_MANAGER
	imply STREAM_FLASH
	imply FLASH_MAP
	imply FLASH
	imply MCUMGR_GRP_IMG
	imply MCUMGR_GRP_OS
	imply MCUMGR_GRP_OS_BOOTLOADER_INFO
	imply MCUMGR_TRANSPORT_BT_REASSEMBLY
	imply NORDIC_QSPI_NOR if $(dt_chosen_enabled,$(DT_CHOSEN_EXT_FLASH))
	imply NCS_SAMPLE_MCUMGR_BT_OTA_DFU_SPEEDUP
	depends on BT_PERIPHERAL
	depends on BOOTLOADER_MCUBOOT
	help
	  Enable this option to include MCUmgr in the build which will enable
	  the Bluetooth transport and image management group, which allows
	  for firmware over the air update support of the device.

if NCS_SAMPLE_MCUMGR_BT_OTA_DFU

config NCS_SAMPLE_MCUMGR_BT_OTA_DFU_MCUBOOT_DIRECT_XIP_SUPPORT
	bool
	default y if MCUBOOT_BOOTLOADER_MODE_DIRECT_XIP
	default y if MCUBOOT_BOOTLOADER_MODE_DIRECT_XIP_WITH_REVERT
	imply MCUMGR_GRP_IMG_REJECT_DIRECT_XIP_MISMATCHED_SLOT

config MCUMGR_TRANSPORT_BT_AUTHEN
	default n

config IMG_ERASE_PROGRESSIVELY
	default y

if MCUMGR_TRANSPORT_BT_REASSEMBLY

config MCUMGR_TRANSPORT_NETBUF_SIZE
	default 2475

config MCUMGR_GRP_OS_MCUMGR_PARAMS
	default y

endif # MCUMGR_TRANSPORT_BT_REASSEMBLY

if (SETTINGS_FCB || SETTINGS_NVS)

# Enable support for the storage erase operation only when the storage
# partition is created by the Partition Manager.

config MCUMGR_GRP_ZBASIC
	default y

config MCUMGR_GRP_ZBASIC_STORAGE_ERASE
	default y

endif # (SETTINGS_FCB || SETTINGS_NVS)

if NORDIC_QSPI_NOR

config NORDIC_QSPI_NOR_FLASH_LAYOUT_PAGE_SIZE
	default 4096

config NORDIC_QSPI_NOR_STACK_WRITE_BUFFER_SIZE
	default 16

endif # NORDIC_QSPI_NOR

# Align supported targets with their default MCUboot configuration.

# nRF53 series
if SOC_SERIES_NRF53X

# Thingy53: mcuboot/boot/zephyr/boards/thingy53_nrf5340_cpuapp.conf
if BOARD_THINGY53_NRF5340_CPUAPP || BOARD_THINGY53_NRF5340_CPUAPP_NS

config UPDATEABLE_IMAGE_NUMBER
	default 2

config NRF53_UPGRADE_NETWORK_CORE
	default y

endif # BOARD_THINGY53_NRF5340_CPUAPP || BOARD_THINGY53_NRF5340_CPUAPP_NS

# nRF5340 DK and the rest of the targets from the nRF53 series: mcuboot/boot/zephyr/prj.conf
# Defaults below for the nRF53 series are overridden by the target-specific
# defaults that are defined above (e.g. for the Thingy:53 target).
config NRF53_UPGRADE_NETWORK_CORE
	default n

endif # SOC_SERIES_NRF53X

endif # NCS_SAMPLE_MCUMGR_BT_OTA_DFU

config NCS_SAMPLE_MCUMGR_BT_OTA_DFU_SPEEDUP
	bool "MCUmgr OTA DFU speedup"
	depends on BT_CTLR || (NCS_SAMPLE_HCI_IPC_CHILD_IMAGE || NCS_SAMPLE_MULTIPROTOCOL_RPMSG_CHILD_IMAGE)
	help
	  Enable this option to speed up the OTA DFU transfer over Bluetooth.
	  This option extends the Bluetooth buffers to extend Bluetooth MTU
	  size. The buffer configuration should be the same in the Network Core
	  and Application Core image.

	  This configuration option is automatically applied for the Network
	  Core child image if the NCS_SAMPLE_MCUMGR_BT_OTA_DFU_SPEEDUP option is
	  enabled in the main image.

if NCS_SAMPLE_MCUMGR_BT_OTA_DFU_SPEEDUP

config BT_L2CAP_TX_MTU
	default 498 if BT_HCI_HOST

config BT_BUF_ACL_TX_SIZE
	default 251

config BT_BUF_ACL_RX_SIZE
	default 502

config BT_CTLR_DATA_LENGTH_MAX
	default 251 if BT_CTLR

endif # NCS_SAMPLE_MCUMGR_BT_OTA_DFU_SPEEDUP

config NCS_SAMPLE_MCUMGR_BT_OTA_DFU_VALIDATION
	bool "MCUmgr OTA DFU build time validation"
	default y
	depends on NCS_SAMPLE_MCUMGR_BT_OTA_DFU || NCS_SAMPLE_MCUMGR_BT_OTA_DFU_SPEEDUP
	help
	  Enable this option to validate the MCUmgr OTA DFU configuration at the
	  build time. If the project configuration does not match predefined
	  defaults, the build system issues a warning for each misaligned item.
```

## samples/connectedhomeip/light_bulb/sample.yaml
```yaml
sample:
  name: CHIP Light Bulb
  description: CHIP Light Bulb example
tests:
  connectedhomeip.light_bulb:
    build_only: true
    build_on_all: true
    platform_allow: nrf52840dk_nrf52840 nrf5340dk_nrf5340_cpuapp
    tags: ci_build
```

## samples/connectedhomeip/light_switch/sample.yaml
```yaml
sample:
  name: CHIP Light Switch
  description: CHIP Light Switch example
tests:
  connectedhomeip.light_switch:
    build_only: true
    build_on_all: true
    platform_allow: nrf52840dk_nrf52840 nrf5340dk_nrf5340_cpuapp
    tags: ci_build
```

## samples/connectedhomeip/lock/sample.yaml
```yaml
sample:
  name: CHIP Lock
  description: CHIP Lock example
tests:
  connectedhomeip.lock:
    build_only: true
    build_on_all: true
    platform_allow: nrf52840dk_nrf52840 nrf5340dk_nrf5340_cpuapp
    tags: ci_build
```

## samples/crypto/aes_cbc/sample.yaml
```yaml
sample:
  description: |
    This app provides an example of performing AES encryption and decryption
    using AES CBC mode
  name: AES CBC example
tests:
  sample.aes_cbc:
    tags: introduction psa cc3xx
    platform_allow: >
      nrf5340dk_nrf5340_cpuapp_ns nrf5340dk_nrf5340_cpuapp nrf9161dk_nrf9161_ns
      nrf9161dk_nrf9161 nrf52840dk_nrf52840
    harness: console
    harness_config:
      type: multi_line
      regex:
        - ".*Example finished successfully!.*"
    integration_platforms:
      - nrf5340dk_nrf5340_cpuapp_ns
      - nrf5340dk_nrf5340_cpuapp
      - nrf9161dk_nrf9161_ns
      - nrf9161dk_nrf9161
      - nrf52840dk_nrf52840
```

## samples/crypto/aes_ccm/boards/nrf9151dk_nrf9151.conf
```kconfig
#
# Copyright (c) 2024 Nordic Semiconductor ASA
#
# SPDX-License-Identifier: LicenseRef-Nordic-5-Clause
#
# Using hardware crypto accelerator
CONFIG_PSA_CRYPTO_DRIVER_OBERON=n
CONFIG_PSA_CRYPTO_DRIVER_CC3XX=y
```

## samples/crypto/aes_ctr/Kconfig.sysbuild
```kconfig
#
# Copyright (c) 2026 Nordic Semiconductor
#
# SPDX-License-Identifier: LicenseRef-Nordic-5-Clause
#

config PARTITION_MANAGER
	default n if !((SOC_SERIES_NRF91 || SOC_SERIES_NRF53) && BOARD_IS_NON_SECURE)

source "share/sysbuild/Kconfig"
```

## samples/crypto/aes_ctr/boards/nrf54h20dk_nrf54h20_cpuapp.conf
```kconfig
#
# Copyright (c) 2024 Nordic Semiconductor
#
# SPDX-License-Identifier: LicenseRef-Nordic-5-Clause
#

# Disable Oberon PSA crypto drivers
CONFIG_PSA_CRYPTO_DRIVER_OBERON=n

# Enable PSA crypto from SSF client
CONFIG_NRF_IRONSIDE_SE_PSA_SERVICES=y

# Mbedtls configuration
CONFIG_MBEDTLS_ENABLE_HEAP=y
CONFIG_MBEDTLS_HEAP_SIZE=8192
```
