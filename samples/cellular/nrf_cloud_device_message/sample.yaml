## samples/cellular/nrf_cloud_rest_fota/Kconfig.sysbuild
```kconfig
#
# Copyright (c) 2023 Nordic Semiconductor
#
# SPDX-License-Identifier: LicenseRef-Nordic-5-Clause
#

config PM_EXTERNAL_FLASH_MCUBOOT_SECONDARY
	default y if BOARD_NRF9151DK_NRF9151_NS || BOARD_NRF9161DK_NRF9161_NS
	default y if BOARD_NRF9160DK_NRF9160_NS && "${BOARD_REVISION}" = "0.14.0"

source "${ZEPHYR_BASE}/share/sysbuild/Kconfig"
```

## samples/cellular/nrf_cloud_rest_fota/sample.yaml
```yaml
sample:
  name: nRF Cloud REST FOTA
tests:
  sample.cellular.nrf_cloud_rest_fota:
    sysbuild: true
    build_only: true
    integration_platforms:
      - nrf9151dk/nrf9151/ns
      - nrf9160dk/nrf9160/ns
      - nrf9161dk/nrf9161/ns
    platform_allow:
      - nrf9151dk/nrf9151/ns
      - nrf9160dk/nrf9160/ns
      - nrf9161dk/nrf9161/ns
    tags: ci_build sysbuild
```
