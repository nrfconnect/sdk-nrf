## samples/cellular/nrf_cloud_multi_service/boards/native_sim.conf
```kconfig
#
# Copyright (c) 2025 Nordic Semiconductor ASA
#
# SPDX-License-Identifier: LicenseRef-Nordic-5-Clause
#

CONFIG_DNS_RESOLVER=y
CONFIG_DNS_SERVER_IP_ADDRESSES=y
CONFIG_DNS_SERVER1="8.8.8.8"

CONFIG_NETWORKING=y
CONFIG_NET_UDP=y
CONFIG_NET_TCP=y
CONFIG_NET_IPV6=y
CONFIG_NET_IPV4=y

CONFIG_ENTROPY_GENERATOR=y
CONFIG_TEST_RANDOM_GENERATOR=y
CONFIG_INIT_STACKS=y

CONFIG_NET_LOG=y
CONFIG_LOG=y

CONFIG_NET_STATISTICS=y

CONFIG_NET_PKT_RX_COUNT=32
CONFIG_NET_PKT_TX_COUNT=32
CONFIG_NET_BUF_RX_COUNT=32
CONFIG_NET_BUF_TX_COUNT=32

CONFIG_NET_IF_UNICAST_IPV6_ADDR_COUNT=3
CONFIG_NET_IF_MCAST_IPV6_ADDR_COUNT=4
CONFIG_NET_MAX_CONTEXTS=10

CONFIG_NET_SHELL=y

CONFIG_NET_CONFIG_SETTINGS=y
CONFIG_NET_CONFIG_NEED_IPV6=y
CONFIG_NET_CONFIG_NEED_IPV4=y
CONFIG_NET_CONFIG_MY_IPV6_ADDR="2001:db8::1"
CONFIG_NET_CONFIG_PEER_IPV6_ADDR="2001:db8::2"
CONFIG_NET_CONFIG_MY_IPV4_ADDR="192.0.2.1"
CONFIG_NET_CONFIG_PEER_IPV4_ADDR="192.0.2.2"
CONFIG_NET_CONFIG_MY_IPV4_GW="192.0.2.2"

CONFIG_NET_L2_ETHERNET=y

CONFIG_ETH_NATIVE_TAP=y
CONFIG_ETH_NATIVE_TAP_RANDOM_MAC=y
CONFIG_ETH_NATIVE_TAP_MAC_ADDR="00:00:5e:00:53:2a"


## Disable Modem/LTE/nrf91-specific features
CONFIG_NRF_MODEM_LIB=n
CONFIG_MODEM_INFO=n
CONFIG_MODEM_INFO_ADD_NETWORK=n
CONFIG_AT_HOST_LIBRARY=n
CONFIG_LTE_LINK_CONTROL=n
CONFIG_LTE_PSM_REQ=n

# Networking
CONFIG_NET_SOCKETS_OFFLOAD=n

## Disable cloud features reliant on or specific to nrf91 modem features
CONFIG_NRF_CLOUD_AGNSS=n
CONFIG_NRF_CLOUD_PGPS=n
CONFIG_NRF_CLOUD_PGPS_REQUEST_UPON_INIT=n
CONFIG_LOCATION_METHOD_GNSS=n
CONFIG_LOCATION_METHOD_CELLULAR=n

## Disable FOTA to conserve memory
CONFIG_NRF_CLOUD_FOTA=n
CONFIG_COAP_FOTA=n
CONFIG_BOOTLOADER_MCUBOOT=n
CONFIG_IMG_MANAGER=n
CONFIG_MCUBOOT_IMG_MANAGER=n

CONFIG_TLS_CREDENTIALS=y
CONFIG_TLS_CREDENTIALS_SHELL=y
CONFIG_TLS_CREDENTIALS_SHELL_CRED_BUF_SIZE=3072
CONFIG_TLS_CREDENTIALS_BACKEND_VOLATILE=y
CONFIG_BASE64=y

CONFIG_DATE_TIME_AUTO_UPDATE=n
CONFIG_DATE_TIME_MODEM=n
CONFIG_DATE_TIME_NTP=y
CONFIG_DATE_TIME_LOG_LEVEL_DBG=y

## Disable LED patterns since the WiFi shield is not compatible
CONFIG_LED_INDICATION_DISABLED=y

## Disable LTE conn_mgr bindings
CONFIG_NRF_MODEM_LIB_NET_IF=n

## This had to be disabled for LTE with conn_mgr, but there is no reason to disable for Wi-Fi
CONFIG_DNS_RESOLVER=y
CONFIG_NET_SOCKETS_DNS_TIMEOUT=30000

CONFIG_LOCATION_TRACKING=n
CONFIG_LOCATION=n
CONFIG_DK_LIBRARY=n

# Native network stack
CONFIG_MBEDTLS=y
CONFIG_MBEDTLS_INIT=y
CONFIG_MBEDTLS_BUILTIN=y
CONFIG_MBEDTLS_ENABLE_HEAP=y
CONFIG_MBEDTLS_HEAP_SIZE=120000
CONFIG_MBEDTLS_SSL_MAX_CONTENT_LEN=16384
CONFIG_MBEDTLS_PEM_CERTIFICATE_FORMAT=y
CONFIG_MBEDTLS_KEY_EXCHANGE_RSA_PSK_ENABLED=y
CONFIG_MBEDTLS_KEY_EXCHANGE_ECDHE_PSK_ENABLED=y
CONFIG_MBEDTLS_KEY_EXCHANGE_RSA_ENABLED=y
CONFIG_MBEDTLS_KEY_EXCHANGE_ECDHE_RSA_ENABLED=y
CONFIG_MBEDTLS_KEY_EXCHANGE_ECDHE_ECDSA_ENABLED=y

# NET Sockets
CONFIG_NET_SOCKETS_SOCKOPT_TLS=y

CONFIG_MBEDTLS_ECDH_C=y
CONFIG_MBEDTLS_ECP_C=y
CONFIG_MBEDTLS_ECDSA_C=y
CONFIG_MBEDTLS_ECP_DP_SECP256R1_ENABLED=y

CONFIG_MBEDTLS_X509_CRT_PARSE_C=y
CONFIG_MBEDTLS_SERVER_NAME_INDICATION=y
CONFIG_MBEDTLS_TLS_SESSION_TICKETS=y
CONFIG_MBEDTLS_KEY_EXCHANGE_ECDHE_PSK_ENABLED=y
CONFIG_MBEDTLS_KEY_EXCHANGE_ECDHE_RSA_ENABLED=y
CONFIG_MBEDTLS_KEY_EXCHANGE_ECDHE_ECDSA_ENABLED=y
CONFIG_MBEDTLS_CIPHER_GCM_ENABLED=y
CONFIG_MBEDTLS_ECP_DP_SECP384R1_ENABLED=y
CONFIG_MBEDTLS_ECP_DP_SECP521R1_ENABLED=y
CONFIG_MBEDTLS_ECP_DP_BP256R1_ENABLED=y
CONFIG_MBEDTLS_ECP_DP_BP384R1_ENABLED=y
CONFIG_MBEDTLS_ECP_DP_BP512R1_ENABLED=y
CONFIG_MBEDTLS_ECP_DP_CURVE25519_ENABLED=y

CONFIG_MBEDTLS_SHA1=y
CONFIG_MBEDTLS_SHA256=y
CONFIG_MBEDTLS_SHA384=y
CONFIG_MBEDTLS_SHA512=y

CONFIG_MBEDTLS=y
CONFIG_MBEDTLS_PSA_CRYPTO_C=y
CONFIG_MBEDTLS_PSA_CRYPTO_EXTERNAL_RNG=y
CONFIG_PSA_CRYPTO_ENABLE_ALL=y
CONFIG_BASE64=y
```

## samples/cellular/nrf_cloud_multi_service/boards/nrf9160dk_nrf9160_ns.conf
```kconfig
#
# Copyright (c) 2024 Nordic Semiconductor ASA
#
# SPDX-License-Identifier: LicenseRef-Nordic-5-Clause
#

# 9160DK
#CONFIG_NRF_SW_LPUART=y
#CONFIG_NRF_SW_LPUART_INT_DRIVEN=y

# UART_2/LPUART for use with nrf/samples/bluetooth/hci_lpuart on 52840
#CONFIG_UART_2_ASYNC=y
CONFIG_UART_2_INTERRUPT_DRIVEN=y
#CONFIG_UART_2_NRF_HW_ASYNC=y
#CONFIG_UART_2_NRF_HW_ASYNC_TIMER=2

#CONFIG_NRF_CLOUD_HOST_NAME="mqtt.beta.nrfcloud.com"
#CONFIG_NRF_CLOUD_SEC_TAG=44
```

## samples/cellular/nrf_cloud_multi_service/boards/thingy91x_nrf9151_ns.conf
```kconfig
#
# Copyright (c) 2024 Nordic Semiconductor ASA
#
# SPDX-License-Identifier: LicenseRef-Nordic-5-Clause
#

# Configuration file for Thingy:91 X.
# This file is merged with prj.conf in the application folder, and options
# set here will take precedence if they are present in both files.

# BME680 - Temperature and humidity sensor.
CONFIG_BME680=y

# configs for Wi-Fi
CONFIG_WIFI=y
CONFIG_WIFI_NRF70=y
CONFIG_WIFI_NRF70_SKIP_LOCAL_ADMIN_MAC=y
# Align this with CONFIG_LOCATION_METHOD_WIFI_SCANNING_RESULTS_MAX_CNT
CONFIG_NRF_WIFI_SCAN_MAX_BSS_CNT=10

# Wi-Fi location
CONFIG_LOCATION_TRACKING_WIFI=y
CONFIG_LOCATION_METHOD_WIFI=y
CONFIG_LOCATION_REQUEST_DEFAULT_METHOD_FIRST_GNSS=y
CONFIG_LOCATION_REQUEST_DEFAULT_METHOD_SECOND_WIFI=y
CONFIG_LOCATION_REQUEST_DEFAULT_METHOD_THIRD_CELLULAR=y

# Align this with CONFIG_NRF_WIFI_SCAN_MAX_BSS_CNT
CONFIG_LOCATION_METHOD_WIFI_SCANNING_RESULTS_MAX_CNT=10
CONFIG_LOCATION_WORKQUEUE_STACK_SIZE=8192

# Not for LTE throughput testing
CONFIG_NRF_MODEM_LIB_SHMEM_TX_SIZE=4096
CONFIG_NRF_MODEM_LIB_SHMEM_RX_SIZE=4096

# Scan only using offload API
CONFIG_WIFI_NM_WPA_SUPPLICANT=n

# For nRF9160 the default is socket interface
CONFIG_NET_DEFAULT_IF_ETHERNET=y
CONFIG_MBEDTLS=n
CONFIG_NORDIC_SECURITY_BACKEND=n

# Networking
CONFIG_NET_L2_ETHERNET=y
CONFIG_NET_NATIVE=y
CONFIG_NET_IPV4=y
CONFIG_NET_DHCPV4=y
CONFIG_NET_STATISTICS=y
CONFIG_NET_STATISTICS_WIFI=y
CONFIG_NET_STATISTICS_USER_API=y
CONFIG_NET_CONTEXT_SYNC_RECV=y

# We need 2 to ensure nrf9x_socket gets an IP address regardless of order of net_if array
CONFIG_NET_IF_MAX_IPV4_COUNT=2
CONFIG_NET_IF_MAX_IPV6_COUNT=2

# Memory configurations
CONFIG_NET_BUF_RX_COUNT=8
CONFIG_NET_BUF_TX_COUNT=8
CONFIG_NET_PKT_RX_COUNT=1
CONFIG_NET_PKT_TX_COUNT=1
CONFIG_NET_TX_STACK_SIZE=4096
CONFIG_NET_RX_STACK_SIZE=4096
CONFIG_NET_TC_TX_COUNT=1
CONFIG_NET_MAX_CONTEXTS=5

CONFIG_HEAP_MEM_POOL_SIZE=34000
CONFIG_MAIN_STACK_SIZE=2048
CONFIG_NET_MGMT_EVENT_STACK_SIZE=2048

# Enable external flash
CONFIG_SPI_NOR_SFDP_DEVICETREE=y
CONFIG_PM_OVERRIDE_EXTERNAL_DRIVER_CHECK=y
CONFIG_PM_EXTERNAL_FLASH_MCUBOOT_SECONDARY=y
```

## samples/cellular/nrf_cloud_multi_service/sample.yaml
```yaml
sample:
  name: nRF Cloud Multi Service Sample
tests:
  sample.cellular.nrf_cloud_multi_service.mqtt:
    sysbuild: true
    build_only: true
    platform_allow:
      - nrf9151dk/nrf9151/ns
      - nrf9160dk/nrf9160/ns
      - nrf9161dk/nrf9161/ns
      - thingy91/nrf9160/ns
      - thingy91x/nrf9151/ns
    integration_platforms:
      - nrf9151dk/nrf9151/ns
      - nrf9160dk/nrf9160/ns
      - nrf9161dk/nrf9161/ns
      - thingy91/nrf9160/ns
      - thingy91x/nrf9151/ns
    tags: ci_build sysbuild ci_samples_cellular
  sample.cellular.nrf_cloud_multi_service.mqtt.full:
    sysbuild: true
    build_only: true
    platform_allow: nrf9160dk/nrf9160/ns
    integration_platforms:
      - nrf9160dk/nrf9160/ns
    extra_args: "EXTRA_CONF_FILE=\"overlay_full_modem_fota.conf;\
      overlay_pgps_ext_flash.conf;overlay_mcuboot_ext_flash.conf\""
    tags: ci_build sysbuild ci_samples_cellular
  sample.cellular.nrf_cloud_multi_service.mqtt.min:
    sysbuild: true
    build_only: true
    platform_allow: nrf9160dk/nrf9160/ns
    integration_platforms:
      - nrf9160dk/nrf9160/ns
    extra_args: EXTRA_CONF_FILE="overlay_min_mqtt.conf"
    tags: ci_build sysbuild ci_samples_cellular
  sample.cellular.nrf_cloud_multi_service.coap:
    sysbuild: true
    build_only: true
    platform_allow:
      - nrf9151dk/nrf9151/ns
      - nrf9160dk/nrf9160/ns
      - nrf9161dk/nrf9161/ns
      - thingy91/nrf9160/ns
      - thingy91x/nrf9151/ns
    integration_platforms:
      - nrf9151dk/nrf9151/ns
      - nrf9160dk/nrf9160/ns
      - nrf9161dk/nrf9161/ns
      - thingy91/nrf9160/ns
      - thingy91x/nrf9151/ns
    extra_args: EXTRA_CONF_FILE="overlay_coap.conf"
    tags: ci_build sysbuild ci_samples_cellular
  sample.cellular.nrf_cloud_multi_service.coap.min:
    sysbuild: true
    build_only: true
    platform_allow: nrf9160dk/nrf9160/ns
    integration_platforms:
      - nrf9160dk/nrf9160/ns
    extra_args: EXTRA_CONF_FILE="overlay_coap.conf;overlay_min_coap.conf"
    tags: ci_build sysbuild ci_samples_cellular
  sample.cellular.nrf_cloud_multi_service.coap.trace:
    sysbuild: true
    build_only: true
    platform_allow:
      - nrf9151dk/nrf9151/ns
      - nrf9160dk/nrf9160/ns
      - nrf9161dk/nrf9161/ns
    integration_platforms:
      - nrf9151dk/nrf9151/ns
      - nrf9160dk/nrf9160/ns
      - nrf9161dk/nrf9161/ns
    extra_args: EXTRA_CONF_FILE="overlay_coap.conf;overlay-coap_nrf_provisioning.conf"
      nrf_cloud_multi_service_SNIPPET=nrf91-modem-trace-uart
    tags: ci_build sysbuild ci_samples_cellular
  sample.cellular.nrf7002ek_wifi.scan:
    sysbuild: true
    build_only: true
    integration_platforms:
      - nrf9151dk/nrf9151/ns
      - nrf9160dk/nrf9160/ns
      - nrf9161dk/nrf9161/ns
    platform_allow:
      - nrf9151dk/nrf9151/ns
      - nrf9160dk/nrf9160/ns
      - nrf9161dk/nrf9161/ns
    extra_args: nrf_cloud_multi_service_SHIELD=nrf7002ek_nrf7000
      EXTRA_CONF_FILE="overlay-nrf7002ek-wifi-scan-only.conf"
      SB_CONF_FILE="sysbuild_nrf700x-wifi-scan.conf"
    tags: ci_build sysbuild ci_samples_cellular
  sample.cellular.nrf7002ek_wifi.conn:
    sysbuild: true
    build_only: true
    integration_platforms:
      - nrf5340dk/nrf5340/cpuapp/ns
    platform_allow: nrf5340dk/nrf5340/cpuapp/ns
    extra_args: nrf_cloud_multi_service_SHIELD=nrf7002ek_nrf7000
      EXTRA_CONF_FILE="overlay_nrf700x_wifi_mqtt_no_lte.conf"
      SB_CONF_FILE="sysbuild_nrf700x-wifi-conn.conf"
    tags: ci_build sysbuild ci_samples_cellular
  sample.cellular.nrf7002dk_wifi.conn:
    sysbuild: true
    build_only: true
    integration_platforms:
      - nrf7002dk/nrf5340/cpuapp/ns
    platform_allow: nrf7002dk/nrf5340/cpuapp/ns
    extra_args: EXTRA_CONF_FILE="overlay_nrf700x_wifi_mqtt_no_lte.conf"
      SB_CONF_FILE="sysbuild_nrf700x-wifi-conn.conf"
    tags: ci_build sysbuild ci_samples_cellular
```

## samples/cellular/nrf_cloud_multi_service/sysbuild/mcuboot/boards/nrf9160dk_nrf9160.conf
```kconfig
#
# Copyright (c) 2023 Nordic Semiconductor ASA
#
# SPDX-License-Identifier: LicenseRef-Nordic-5-Clause
#

CONFIG_SPI=y
CONFIG_SPI_NOR=y
CONFIG_SPI_NOR_FLASH_LAYOUT_PAGE_SIZE=4096
CONFIG_SPI_NRFX_RAM_BUFFER_SIZE=32

CONFIG_PM_OVERRIDE_EXTERNAL_DRIVER_CHECK=y

CONFIG_FPROTECT=y

# Enabling SPI increases the MCUBoot image size so that it does not fit in the default
# partition size (0xC000). The minimum required size is 0xD000
CONFIG_PM_PARTITION_SIZE_MCUBOOT=0xD000

# MCUboot requires a large stack size, otherwise an MPU fault will occur
CONFIG_MAIN_STACK_SIZE=16384

# Enable flash operations
CONFIG_FLASH=y

CONFIG_BOOT_MAX_IMG_SECTORS=256

CONFIG_MULTITHREADING=y

CONFIG_LOG=y
CONFIG_LOG_MODE_MINIMAL=y
CONFIG_LOG_DEFAULT_LEVEL=0
```

## samples/cellular/nrf_cloud_rest_cell_location/Kconfig
```kconfig
#
# Copyright (c) 2022 Nordic Semiconductor ASA
#
# SPDX-License-Identifier: LicenseRef-Nordic-5-Clause
#

menu "nRF Cloud REST Cellular Location Sample"

config REST_CELL_DEFAULT_DOREPLY_VAL
	bool "Default value for the do_reply configuration flag"
	default y

config REST_CELL_DEFAULT_FALLBACK_VAL
	bool "Default value for the fallback configuration flag"
	default y

config REST_CELL_DEFAULT_HICONF_VAL
	bool "Default value for the hi_conf configuration flag"

endmenu

menu "Zephyr Kernel"
source "Kconfig.zephyr"
endmenu

module = NRF_CLOUD_REST_CELL_LOCATION_SAMPLE
module-str = nRF Cloud REST Cellular Location Sample
source "$(ZEPHYR_BASE)/subsys/logging/Kconfig.template.log_config"
```

## samples/cellular/nrf_cloud_rest_cell_location/boards/thingy91x_nrf9151_ns.conf
```kconfig
#
# Copyright (c) 2025 Nordic Semiconductor ASA
#
# SPDX-License-Identifier: LicenseRef-Nordic-5-Clause
#

# Configuration file for Thingy:91 X.
# This file is merged with prj.conf in the application folder, and options
# set here will take precedence if they are present in both files.

# Use UUID as client ID
CONFIG_NRF_CLOUD_CLIENT_ID_SRC_INTERNAL_UUID=y
```

## samples/cellular/nrf_cloud_rest_cell_location/sample.yaml
```yaml
sample:
  name: nRF Cloud REST Cellular Positioning
tests:
  sample.cellular.nrf_cloud_rest_cell_pos:
    build_only: true
    integration_platforms:
      - nrf9160dk_nrf9160_ns
    platform_allow: nrf9160dk_nrf9160_ns
    tags: ci_build
```

## samples/cellular/nrf_cloud_rest_device_message/Kconfig
```kconfig
#
# Copyright (c) 2022 Nordic Semiconductor ASA
#
# SPDX-License-Identifier: LicenseRef-Nordic-5-Clause
#

menu "nRF Cloud REST Device Message Sample"

config REST_DEVICE_MESSAGE_SAMPLE_VERSION
	string "The sample's version string"
	default "1.0.0"

config REST_DEVICE_MESSAGE_LTE_LED_NUM
	int "The LED number to use for indicating LTE connection success"
	default 0

config REST_DEVICE_MESSAGE_SEND_LED_NUM
	int "The LED number to use for indicating outgoing REST request"
	default 1

config REST_DEVICE_MESSAGE_KEEP_ALIVE
	bool "Keep connection alive during button handling"
	default y
	help
	  Keep the HTTP connection open after sending the button message so the
	  direct logging message can reuse it. This reduces data and power
	  consumption, but is not compatible with the cloud logging backend.

endmenu

menu "Zephyr Kernel"
source "Kconfig.zephyr"
endmenu

module = NRF_CLOUD_REST_DEVICE_MESSAGE_SAMPLE
module-str = nRF Cloud Rest Sample
source "$(ZEPHYR_BASE)/subsys/logging/Kconfig.template.log_config"
```

## samples/cellular/nrf_cloud_rest_device_message/boards/thingy91x_nrf9151_ns.conf
```kconfig
#
# Copyright (c) 2025 Nordic Semiconductor ASA
#
# SPDX-License-Identifier: LicenseRef-Nordic-5-Clause
#

# Configuration file for Thingy:91 X.
# This file is merged with prj.conf in the application folder, and options
# set here will take precedence if they are present in both files.

# Use UUID as client ID
CONFIG_NRF_CLOUD_CLIENT_ID_SRC_INTERNAL_UUID=y

# RED LED indicates LTE connection success
CONFIG_REST_DEVICE_MESSAGE_LTE_LED_NUM=0
# GREEN LED indicates successful sending of device message
CONFIG_REST_DEVICE_MESSAGE_SEND_LED_NUM=1
```

## samples/cellular/nrf_cloud_rest_device_message/sample.yaml
```yaml
sample:
  name: nRF Cloud REST Device message
tests:
  sample.cellular.nrf_cloud_rest_device_message:
    sysbuild: true
    build_only: true
    integration_platforms:
      - nrf9151dk/nrf9151/ns
      - nrf9160dk/nrf9160/ns
      - nrf9161dk/nrf9161/ns
    platform_allow:
      - nrf9151dk/nrf9151/ns
      - nrf9160dk/nrf9160/ns
      - nrf9161dk/nrf9161/ns
    tags: ci_build sysbuild
```

## samples/cellular/nrf_cloud_rest_fota/Kconfig
```kconfig
#
# Copyright (c) 2021 Nordic Semiconductor ASA
#
# SPDX-License-Identifier: LicenseRef-Nordic-5-Clause
#

menu "nRF Cloud REST FOTA Sample"

config REST_FOTA_SAMPLE_VERSION
	string "The sample's version string"
	default "1.0.0"

config REST_FOTA_JOB_CHECK_RATE_MIN
	int "Rate (minutes) at which this sample will check for FOTA updates"
	range 1 10080
	default 15

config REST_FOTA_LTE_LED_NUM
	int "LED number to use for LTE connection status"
	default 0

config REST_FOTA_BUTTON_EVT_NUM
	int "Button number to use for device interactions"
	default 1

endmenu

menu "Zephyr Kernel"
source "Kconfig.zephyr"
endmenu

module = NRF_CLOUD_REST_FOTA_SAMPLE
module-str = nRF Cloud Rest FOTA Sample
source "$(ZEPHYR_BASE)/subsys/logging/Kconfig.template.log_config"
```
