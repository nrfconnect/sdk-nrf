## CMakeLists.txt
```
#
# Copyright (c) 2021 Nordic Semiconductor
#
# SPDX-License-Identifier: LicenseRef-Nordic-5-Clause
#

cmake_minimum_required(VERSION 3.20.0)

find_package(Zephyr REQUIRED HINTS $ENV{ZEPHYR_BASE})
project(NONE)

# NORDIC SDK APP START
target_sources(app PRIVATE src/main.c)
# NORDIC SDK APP END
```

## Kconfig
```
#
# Copyright (c) 2021 Nordic Semiconductor ASA
#
# SPDX-License-Identifier: LicenseRef-Nordic-5-Clause
#

menu "SMS Sample Settings"

config SMS_SEND_PHONE_NUMBER
	string "Phone number to which the SMS message is sent, including the country code."
	default ""
	help
	  Phone number to which the SMS message is sent, including the country code.
	  If empty, SMS will not be sent at all but the sample waits for received messages.

config SMS_SERVICE_CENTER_NUMBER
	string "Phone number of the SMS service center, including the country code."
	default ""
	help
	  If empty, SMS will not add the service center number into the SMS PDU,
	  and the modem/network will use the default values.

endmenu

menu "Zephyr Kernel"
source "Kconfig.zephyr"
endmenu
```

## sample.yaml
```
sample:
  name: sms Sample
tests:
  sample.cellular.sms:
    sysbuild: true
    build_only: true
    integration_platforms:
      - nrf9151dk/nrf9151/ns
    platform_allow:
      - nrf9151dk/nrf9151/ns
    tags:
      - ci_build
      - sysbuild
      - ci_samples_cellular
  sample.cellular.sms.no_status_report:
    sysbuild: true
    build_only: true
    integration_platforms:
      - nrf9151dk/nrf9151/ns
    platform_allow:
      - nrf9151dk/nrf9151/ns
    extra_configs:
      - CONFIG_SMS_STATUS_REPORT=n
    tags:
      - ci_build
      - sysbuild
      - ci_samples_cellular
```

## prj.conf
```kconfig
#
# Copyright (c) 2021 Nordic Semiconductor ASA
#
# SPDX-License-Identifier: LicenseRef-Nordic-5-Clause
#

# TF-M config
CONFIG_TFM_PROFILE_TYPE_MINIMAL=y

CONFIG_SMS_SEND_PHONE_NUMBER=""

CONFIG_SMS=y
CONFIG_SMS_SUBSCRIBERS_MAX_CNT=2
CONFIG_SMS_LOG_LEVEL_DBG=n
CONFIG_MAIN_STACK_SIZE=1536

# Networking
CONFIG_NETWORKING=y
CONFIG_NET_SOCKETS=y
CONFIG_NET_SOCKETS_OFFLOAD=y
CONFIG_NRF_MODEM_LIB=y

# LTE link control
CONFIG_LTE_LINK_CONTROL=y

# Debugging
CONFIG_LOG=y
CONFIG_ASSERT=y
CONFIG_ASSERT_MODULE_DEFAULT_LEVEL_VERBOSE=y
```

## src/main.c
```c
/*
 * Copyright (c) 2021 Nordic Semiconductor ASA
 *
 * SPDX-License-Identifier: LicenseRef-Nordic-5-Clause
 */

#include <stdio.h>
#include <zephyr/kernel.h>
#include <string.h>
#include <modem/sms.h>
#include <modem/nrf_modem_lib.h>
#include <modem/lte_lc.h>
#include <nrf_modem_at.h>


static void sms_callback(struct sms_data *const data, void *context)
{
	if (data == NULL) {
		printk("%s with NULL data\n", __func__);
		return;
	}

	if (data->type == SMS_TYPE_DELIVER) {
		/* When SMS message is received, print information */
		struct sms_deliver_header *header = &data->header.deliver;

		printk("\nSMS received:\n");
		printk("\tTime:   %02d-%02d-%02d %02d:%02d:%02d\n",
			header->time.year,
			header->time.month,
			header->time.day,
			header->time.hour,
			header->time.minute,
			header->time.second);

		printk("\tText:   '%s'\n", data->payload);
		printk("\tLength: %d\n", data->payload_len);

		if (header->app_port.present) {
			printk("\tApplication port addressing scheme: dest_port=%d, src_port=%d\n",
				header->app_port.dest_port,
				header->app_port.src_port);
		}
		if (header->concatenated.present) {
			printk("\tConcatenated short message: ref_number=%d, msg %d/%d\n",
				header->concatenated.ref_number,
				header->concatenated.seq_number,
				header->concatenated.total_msgs);
		}
	} else if (data->type == SMS_TYPE_STATUS_REPORT) {
		printk("SMS status report received\n");
	} else {
		printk("SMS protocol message with unknown type received\n");
	}
}

int main(void)
{
	int handle = 0;
	int ret = 0;
	char response[16];

	printk("\nSMS sample starting\n");

	ret = nrf_modem_lib_init();
	if (ret) {
		printk("Modem library initialization failed, error: %d\n", ret);
		return 0;
	}

	ret = lte_lc_connect();
	if (ret) {
		printk("Lte_lc failed to initialize and connect, err %d", ret);
		return 0;
	}

	handle = sms_register_listener(sms_callback, NULL);
	if (handle) {
		printk("sms_register_listener returned err: %d\n", handle);
		return 0;
	}

	/* Setting SMS service center number if set into the configuration. */
	if (sizeof(CONFIG_SMS_SERVICE_CENTER_NUMBER) > 1) {
		int err = nrf_modem_at_cmd(
				response, sizeof(response),
				"AT+CSCA=\"%s\",145",
				CONFIG_SMS_SERVICE_CENTER_NUMBER);
		if (err) {
			printk("Setting service center number %s failed, err=%d\n",
			       CONFIG_SMS_SERVICE_CENTER_NUMBER, err);
		} else {
			printk("Setting service center number %s succeeded\n",
			       CONFIG_SMS_SERVICE_CENTER_NUMBER);
		}

	}

	printk("SMS sample is ready for receiving messages\n");

	/* Sending is done to the phone number specified in the configuration,
	 * or if it's left empty, an information text is printed.
	 */
	if (sizeof(CONFIG_SMS_SEND_PHONE_NUMBER) > 1) {
		printk("Sending SMS: number=%s, text=\"SMS sample: testing\"\n",
		       CONFIG_SMS_SEND_PHONE_NUMBER);
		ret = sms_send_text(CONFIG_SMS_SEND_PHONE_NUMBER, "SMS sample: testing");
		if (ret) {
			printk("Sending SMS failed with error: %d\n", ret);
		}
	} else {
		printk("\nSMS sending is skipped but receiving will still work.\n"
		       "If you wish to send SMS, please configure CONFIG_SMS_SEND_PHONE_NUMBER\n");
	}

	/* In our application, we should unregister SMS in some conditions with:
	 *   sms_unregister_listener(handle);
	 * However, this sample will continue to be registered for
	 * received SMS messages and they can be seen in serial port log.
	 */
	return 0;
}
```
