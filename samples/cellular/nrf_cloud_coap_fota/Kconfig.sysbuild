## samples/cellular/nrf_cloud_coap_fota/Kconfig.sysbuild
```kconfig
#
# Copyright (c) 2026 Nordic Semiconductor ASA
#
# SPDX-License-Identifier: LicenseRef-Nordic-5-Clause
#

source "share/sysbuild/Kconfig"

config SECURE_BOOT_APPCORE
	default y if !SOC_SERIES_NRF92
```

## samples/cellular/nrf_cloud_mqtt_cell_location/sample.yaml
```yaml
sample:
  name: nRF Cloud MQTT cellular location
tests:
  sample.cellular.nrf_cloud_mqtt_cell_location:
    sysbuild: true
    build_only: true
    integration_platforms:
      - nrf9151dk/nrf9151/ns
      - nrf9251dk/nrf9251/cpuapp
    platform_allow:
      - nrf9151dk/nrf9151/ns
      - nrf9251dk/nrf9251/cpuapp
      - thingy91x/nrf9151/ns
    tags:
      - ci_build
      - sysbuild
      - ci_samples_cellular
```

## samples/cellular/nrf_cloud_mqtt_device_message/Kconfig
```kconfig
#
# Copyright (c) 2025 Nordic Semiconductor ASA
#
# SPDX-License-Identifier: LicenseRef-Nordic-5-Clause
#

menu "nRF Cloud MQTT Device Message Sample"

module = NRF_CLOUD_MQTT_DEVICE_MESSAGE_SAMPLE
module-str = nRF Cloud MQTT Sample
source "${ZEPHYR_BASE}/subsys/logging/Kconfig.template.log_config"

endmenu

if BUILD_WITH_TFM

choice TFM_PROFILE_TYPE
	default TFM_PROFILE_TYPE_MINIMAL
endchoice

endif # BUILD_WITH_TFM

menu "Zephyr Kernel"
source "Kconfig.zephyr"
endmenu
```

## samples/cellular/nrf_cloud_mqtt_device_message/sample.yaml
```yaml
sample:
  name: nRF Cloud MQTT Device message
tests:
  sample.cellular.nrf_cloud_mqtt_device_message:
    sysbuild: true
    build_only: true
    integration_platforms:
      - nrf9151dk/nrf9151/ns
      - nrf9251dk/nrf9251/cpuapp
    platform_allow:
      - nrf9151dk/nrf9151/ns
      - nrf9251dk/nrf9251/cpuapp
      - thingy91x/nrf9151/ns
    tags:
      - ci_build
      - sysbuild
      - ci_samples_cellular
```

## samples/cellular/nrf_device_provisioning/Kconfig
```kconfig
#
# Copyright (c) 2023 Nordic Semiconductor ASA
#
# SPDX-License-Identifier: LicenseRef-Nordic-5-Clause
#

if BUILD_WITH_TFM

choice TFM_PROFILE_TYPE
	default TFM_PROFILE_TYPE_MINIMAL
endchoice

endif # BUILD_WITH_TFM

menu "Zephyr Kernel"
source "Kconfig.zephyr"
endmenu

module = NRF_PROVISIONING_SAMPLE
module-str = nRF Provisioning Sample
source "subsys/logging/Kconfig.template.log_config"
```

## samples/cellular/nrf_device_provisioning/sample.yaml
```yaml
sample:
  name: nRF Device Provisioning
tests:
  sample.cellular.nrf_device_provisioning:
    sysbuild: true
    build_only: true
    integration_platforms:
      - nrf9151dk/nrf9151/ns
      - nrf9251dk/nrf9251/cpuapp
    platform_allow:
      - nrf9151dk/nrf9151/ns
      - nrf9251dk/nrf9251/cpuapp
      - thingy91x/nrf9151/ns
    tags:
      - sysbuild
      - ci_samples_cellular
```

## samples/cellular/pdn/sample.yaml
```yaml
sample:
  name: pdn sample
tests:
  sample.cellular.pdn:
    sysbuild: true
    build_only: true
    integration_platforms:
      - nrf9151dk/nrf9151/ns
      - nrf9251dk/nrf9251/cpuapp
    platform_allow:
      - nrf9151dk/nrf9151/ns
      - nrf9251dk/nrf9251/cpuapp
    tags:
      - ci_build
      - sysbuild
      - ci_samples_cellular
```

## samples/cellular/sms/sample.yaml
```yaml
sample:
  name: sms Sample
tests:
  sample.cellular.sms:
    sysbuild: true
    build_only: true
    integration_platforms:
      - nrf9151dk/nrf9151/ns
      - nrf9251dk/nrf9251/cpuapp
    platform_allow:
      - nrf9151dk/nrf9151/ns
      - nrf9251dk/nrf9251/cpuapp
    tags:
      - ci_build
      - sysbuild
      - ci_samples_cellular
  sample.cellular.sms.no_status_report:
    sysbuild: true
    build_only: true
    integration_platforms:
      - nrf9151dk/nrf9151/ns
      - nrf9251dk/nrf9251/cpuapp
    platform_allow:
      - nrf9151dk/nrf9151/ns
      - nrf9251dk/nrf9251/cpuapp
    extra_configs:
      - CONFIG_SMS_STATUS_REPORT=n
    tags:
      - ci_build
      - sysbuild
      - ci_samples_cellular
```

## samples/cellular/tls_ciphersuites/Kconfig
```kconfig
#
# Copyright (c) 2022 Nordic Semiconductor ASA
#
# SPDX-License-Identifier: LicenseRef-Nordic-5-Clause
#

menu "TLS CipherSuites sample"

config EXTENDED_CIPHERSUITE_LIST
	bool "Extended ciphersuite list"
	help
	  Extends the ciphersuite list with extra ciphersuites that are
	  only supported by Modem Firmware v1.3.x >= 1 and Modem
	  Firmware v1.2.x >= 7.

endmenu

if BUILD_WITH_TFM

choice TFM_PROFILE_TYPE
	default TFM_PROFILE_TYPE_MINIMAL
endchoice

endif # BUILD_WITH_TFM

menu "Zephyr Kernel"
source "Kconfig.zephyr"
endmenu
```

## samples/cellular/tls_ciphersuites/sample.yaml
```yaml
sample:
  name: TLS Ciphersuites sample
tests:
  sample.cellular.tls_ciphersuites:
    sysbuild: true
    build_only: true
    integration_platforms:
      - nrf9151dk/nrf9151/ns
      - nrf9251dk/nrf9251/cpuapp
    platform_allow:
      - nrf9151dk/nrf9151/ns
      - nrf9251dk/nrf9251/cpuapp
    tags:
      - ci_build
      - sysbuild
      - ci_samples_cellular
```

## samples/cellular/uicc_lwm2m/sample.yaml
```yaml
sample:
  name: UICC LwM2M sample
tests:
  sample.cellular.uicc_lwm2m:
    sysbuild: true
    build_only: true
    platform_allow:
      - nrf9151dk/nrf9151/ns
      - nrf9251dk/nrf9251/cpuapp
      - thingy91x/nrf9151/ns
    integration_platforms:
      - nrf9151dk/nrf9151/ns
      - nrf9251dk/nrf9251/cpuapp
    tags:
      - ci_build
      - sysbuild
      - ci_samples_cellular
```

## samples/debug/ppi_trace/sample.yaml
```yaml
sample:
  description: Sample showing PPI trace
  name: PPI trace sample
tests:
  sample.debug.ppi_trace:
    sysbuild: true
    build_only: true
    integration_platforms:
      - nrf52840dk/nrf52840
      - nrf9151dk/nrf9151
    platform_allow:
      - nrf52dk/nrf52832
      - nrf52840dk/nrf52840
      - nrf9151dk/nrf9151
      - nrf21540dk/nrf52840
    tags:
      - ci_build
      - sysbuild
      - ci_samples_debug
```

## samples/dfu/mcuboot_with_encryption/sysbuild/mcuboot/boards/nrf7120dk_nrf7120_cpuapp_extmem.conf
```kconfig
# Copyright (c) 2026 Nordic Semiconductor ASA
#
# SPDX-License-Identifier: LicenseRef-Nordic-5-Clause

CONFIG_FPROTECT=n
CONFIG_BOOT_WATCHDOG_FEED=n
CONFIG_FLASH_MSPI_NOR_LAYOUT_PAGE_SIZE=4096
```

## samples/dfu/single_slot/sysbuild/mcuboot/boards/nrf7120dk_nrf7120_cpuapp.conf
```kconfig
# Copyright (c) 2026 Nordic Semiconductor ASA
#
# SPDX-License-Identifier: LicenseRef-Nordic-5-Clause

CONFIG_SYS_CLOCK_EXISTS=n
CONFIG_NRF_GRTC_TIMER=n
CONFIG_FLASH=y
CONFIG_SPI_NOR=n
CONFIG_FPROTECT=n
CONFIG_BOOT_WATCHDOG_FEED=n
```

## samples/dfu/single_slot/sysbuild/mcuboot/boards/nrf7120dk_nrf7120e_cpuapp_boot_req.conf
```kconfig
# Copyright (c) 2026 Nordic Semiconductor ASA
#
# SPDX-License-Identifier: LicenseRef-Nordic-5-Clause

CONFIG_SYS_CLOCK_EXISTS=n
CONFIG_NRF_GRTC_TIMER=n
CONFIG_FPROTECT=n
CONFIG_BOOT_WATCHDOG_FEED=n
CONFIG_NRF_BOOT_FIRMWARE_LOADER_BOOT_REQ=y
CONFIG_RETAINED_MEM=y
CONFIG_RETENTION=y
CONFIG_NRF_MCUBOOT_BOOT_REQUEST=y
```
