/*
 * Copyright (c) 2026 Nordic Semiconductor ASA
 *
 * SPDX-License-Identifier: LicenseRef-Nordic-5-Clause
 */

#include "../../../boards/nrf9160dk_nrf9160_ns.overlay"

&sram0_s {
	reg = <0x0 0x40000>;
};

/ {
	chosen {
		zephyr,code-partition = &b0_partition;
	};
};
