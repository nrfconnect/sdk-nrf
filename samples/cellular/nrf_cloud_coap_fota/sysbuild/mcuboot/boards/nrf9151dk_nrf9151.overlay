/*
 * Copyright (c) 2026 Nordic Semiconductor ASA
 *
 * SPDX-License-Identifier: LicenseRef-Nordic-5-Clause
 */

#include "../../../boards/nrf9151dk_nrf9151_ns.overlay"

/ {
	chosen {
		zephyr,code-partition = &boot_partition;
	};
};
