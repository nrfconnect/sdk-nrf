/*
 * Copyright (c) 2026 Nordic Semiconductor ASA
 *
 * SPDX-License-Identifier: LicenseRef-Nordic-5-Clause
 */

/* Provide the net-core slot labels required by the shared sysbuild S0 overlay. */
#include <samples/wifi/nrf5340_cpunet_partitions.dtsi>
