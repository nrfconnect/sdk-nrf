## CMakeLists.txt
```
#
# Copyright (c) 2021 Nordic Semiconductor
#
# SPDX-License-Identifier: LicenseRef-Nordic-5-Clause
#

cmake_minimum_required(VERSION 3.20.0)

find_package(Zephyr REQUIRED HINTS $ENV{ZEPHYR_BASE})
project(fmfu_smp_svr)

# NORDIC SDK APP START
target_sources(app PRIVATE src/main.c)
# NORDIC SDK APP END
```

## sample.yaml
```
sample:
  name: Full modem firmware update using SMP Server sample
  description: Full modem firmware update using SMP Server sample for cellular devices
tests:
  sample.cellular.fmfu_smp_svr:
    sysbuild: true
    build_only: true
    integration_platforms:
      - nrf9151dk/nrf9151/ns
    platform_allow:
      - nrf9151dk/nrf9151/ns
    tags:
      - ci_build
      - sysbuild
      - ci_samples_cellular
```

## sysbuild.conf
```
#
# Copyright (c) 2024 Nordic Semiconductor
#
# SPDX-License-Identifier: LicenseRef-Nordic-5-Clause
#

SB_CONFIG_BOOTLOADER_MCUBOOT=y
```

## prj.conf
```kconfig
#
# Copyright (c) 2021 Nordic Semiconductor ASA
#
# SPDX-License-Identifier: LicenseRef-Nordic-5-Clause
#

# TF-M config
CONFIG_TFM_PROFILE_TYPE_MINIMAL=y

CONFIG_LOG=y
CONFIG_LOG_BACKEND_RTT=y
CONFIG_LOG_BACKEND_UART=n
CONFIG_UART_CONSOLE=n
CONFIG_USE_SEGGER_RTT=y
CONFIG_RTT_CONSOLE=y

# Enable FPU
CONFIG_FPU=y

# Enable mcumgr.
CONFIG_MCUMGR=y
CONFIG_ZCBOR=y
CONFIG_FLASH=y
CONFIG_FLASH_MAP=y
CONFIG_STREAM_FLASH=y
CONFIG_IMG_MANAGER=y
CONFIG_MCUBOOT_BOOTUTIL_LIB=y

# Some command handlers require a large stack.
CONFIG_SYSTEM_WORKQUEUE_STACK_SIZE=4096

# nrf_modem requires a larger main stack than is default
CONFIG_MAIN_STACK_SIZE=2048

# Enable the UART mcumgr transports.
CONFIG_UART_MCUMGR=y
CONFIG_MCUMGR_TRANSPORT_UART=y
CONFIG_BASE64=y
CONFIG_CRC=y
CONFIG_UART_MCUMGR_RX_BUF_SIZE=512
CONFIG_MCUMGR_TRANSPORT_NETBUF_SIZE=512

# Required by the `taskstat` command.
CONFIG_THREAD_MONITOR=y

# Enable statistics and statistic names.
CONFIG_STATS=y
CONFIG_STATS_NAMES=y

# Enable STAT and OS from the core commands
CONFIG_MGMT_FMFU=y
CONFIG_MCUMGR_GRP_OS=y
CONFIG_MCUMGR_GRP_STAT=y
CONFIG_MCUMGR_GRP_IMG=y

CONFIG_NRF_MODEM_LIB=y

# Used for getting the modem version
CONFIG_MODEM_INFO=y

CONFIG_NETWORKING=y
CONFIG_NET_SOCKETS=y
CONFIG_NET_SOCKETS_OFFLOAD=y
CONFIG_HEAP_MEM_POOL_SIZE=8192

# Enable MCUBOOT
CONFIG_BOOTLOADER_MCUBOOT=y
```

## uart.overlay
```dts
&uart0 {
	current-speed = <1000000>;
};
```

## src/main.c
```c
/*
 * Copyright (c) 2021 Nordic Semiconductor ASA
 *
 * SPDX-License-Identifier: LicenseRef-Nordic-5-Clause
 */

#include <zephyr/kernel.h>
#include <mgmt/fmfu_mgmt.h>
#include <mgmt/fmfu_mgmt_stat.h>
#include <modem/modem_info.h>
#include <modem/nrf_modem_lib.h>
#include <zephyr/dfu/mcuboot.h>

int main(void)
{
	int err = nrf_modem_lib_init();

	if (err == 0) {
		char modem_version[MODEM_INFO_MAX_RESPONSE_SIZE];

		err = modem_info_init();
		if (err != 0) {
			printk("Modem info Init error: %d\n\r", err);
		} else {
			modem_info_string_get(MODEM_INFO_FW_VERSION,
					modem_version,
					MODEM_INFO_MAX_RESPONSE_SIZE);
			printk("Starting modem mgmt sample\n\r");
			printk("Modem version: %s\n\r", modem_version);
		}
	}
	/* Shutdown modem to prepare for DFU */
	nrf_modem_lib_shutdown();

	nrf_modem_lib_bootloader_init();
	/* Register SMP Communication stats */
	fmfu_mgmt_stat_init();
	/* Initialize MCUMgr handlers for full modem update */
	err = fmfu_mgmt_init();
	if (err) {
		printk("Error in fmfu init: %d\n\r", err);
	}
	printk("Initialized and ready to receive firmware\n\r");
	if (boot_is_img_confirmed()) {
		printk("Current image confirmed\n\r");
	} else {
		printk("Current image not confirmed yet\n\r");
	}

	return 0;
}
```
