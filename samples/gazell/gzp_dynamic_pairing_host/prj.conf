## CMakeLists.txt
```
#
# Copyright (c) 2021 Nordic Semiconductor ASA
#
# SPDX-License-Identifier: LicenseRef-Nordic-5-Clause
#
cmake_minimum_required(VERSION 3.20)

find_package(Zephyr REQUIRED HINTS $ENV{ZEPHYR_BASE})
project(gzp_dynamic_pairing_host)

# NORDIC SDK APP START
target_sources(app PRIVATE
  src/main.c
)
# NORDIC SDK APP END
```

## sample.yaml
```
sample:
  name: Gazell Dynamic Pairing host sample
tests:
  sample.gazell.gzp_dynamic_pairing.host.build:
    sysbuild: true
    build_only: true
    integration_platforms:
      - nrf52dk/nrf52832
    platform_allow:
      - nrf52dk/nrf52832
      - nrf52833dk/nrf52833
      - nrf52840dk/nrf52840
    tags:
      - ci_build
      - sysbuild
      - ci_samples_gazell
```

## prj.conf
```kconfig
#
# Copyright (c) 2021 Nordic Semiconductor ASA
#
# SPDX-License-Identifier: LicenseRef-Nordic-5-Clause
#
CONFIG_GZLL=y
CONFIG_GAZELL=y
CONFIG_GAZELL_PAIRING=y
CONFIG_GAZELL_PAIRING_HOST=y
CONFIG_GAZELL_PAIRING_SETTINGS=y
CONFIG_GAZELL_PAIRING_CRYPT=y

CONFIG_DK_LIBRARY=y

CONFIG_FLASH=y
CONFIG_FLASH_PAGE_LAYOUT=y
CONFIG_FLASH_MAP=y
CONFIG_NVS=y
CONFIG_SETTINGS=y

CONFIG_CRYPTO=y
CONFIG_CRYPTO_NRF_ECB=y

CONFIG_ENTROPY_GENERATOR=y

CONFIG_LOG=y
CONFIG_LOG_MODE_IMMEDIATE=y
```

## boards/nrf5340dk_nrf5340_cpunet.conf
```kconfig
#
# Copyright (c) 2022 Nordic Semiconductor
#
# SPDX-License-Identifier: LicenseRef-Nordic-5-Clause
#

CONFIG_NCS_SAMPLE_EMPTY_APP_CORE_CHILD_IMAGE=y
```

## src/main.c
```c
/*
 * Copyright (c) 2021 Nordic Semiconductor ASA
 *
 * SPDX-License-Identifier: LicenseRef-Nordic-5-Clause
 */

#include <zephyr/kernel.h>
#include <zephyr/settings/settings.h>
#include <dk_buttons_and_leds.h>
#include <nrf_gzll.h>
#include <gzll_glue.h>
#include <gzp.h>

#include <zephyr/logging/log.h>

LOG_MODULE_REGISTER(app);

/* Pipes 0 and 1 are reserved for GZP pairing and data. See gzp.h. */
#define UNENCRYPTED_DATA_PIPE     2

/* RXPERIOD/2 on LU1 = timeslot period on nRF5x. */
#define NRF_GZLLDE_RXPERIOD_DIV_2 504

static void led_output(uint8_t value)
{
	int err;

	err = dk_set_leds(value & DK_ALL_LEDS_MSK);
	if (err) {
		LOG_ERR("Cannot output LEDs (err: %d)", err);
	}
}

int main(void)
{
	/* Debug helper variables */
	uint32_t length;

	/* Data and acknowledgment payloads */
	uint8_t payload[NRF_GZLL_CONST_MAX_PAYLOAD_LENGTH];

	int err;
	bool result_value;

	settings_subsys_init();

	err = dk_leds_init();
	if (err) {
		LOG_ERR("Cannot initialize LEDs (err: %d)", err);
		return 0;
	}

	/* Initialize Gazell Link Layer glue */
	result_value = gzll_glue_init();
	if (!result_value) {
		LOG_ERR("Cannot initialize GZLL glue code");
		return 0;
	}

	/* Initialize the Gazell Link Layer */
	result_value = nrf_gzll_init(NRF_GZLL_MODE_HOST);
	if (!result_value) {
		LOG_ERR("Cannot initialize GZLL");
		return 0;
	}

	result_value = nrf_gzll_set_timeslot_period(NRF_GZLLDE_RXPERIOD_DIV_2);
	if (!result_value) {
		LOG_ERR("Cannot set GZLL timeslot period");
		return 0;
	}

	/* Initialize the Gazell Pairing Library */
	gzp_init();

	result_value = nrf_gzll_set_rx_pipes_enabled(nrf_gzll_get_rx_pipes_enabled() |
						     (1 << UNENCRYPTED_DATA_PIPE));
	if (!result_value) {
		LOG_ERR("Cannot set GZLL RX pipes");
		return 0;
	}

	gzp_pairing_enable(true);

	result_value = nrf_gzll_enable();
	if (!result_value) {
		LOG_ERR("Cannot enable GZLL");
		return 0;
	}

	LOG_INF("Gazell dynamic pairing example started. Host mode.");

	for (;;) {
		gzp_host_execute();

		/* If a Host ID request received */
		if (gzp_id_req_received()) {
			/* Always grant a request */
			gzp_id_req_grant();
		}

		length = NRF_GZLL_CONST_MAX_PAYLOAD_LENGTH;

		if (nrf_gzll_get_rx_fifo_packet_count(UNENCRYPTED_DATA_PIPE)) {
			if (nrf_gzll_fetch_packet_from_rx_fifo(UNENCRYPTED_DATA_PIPE,
							       payload,
							       &length)) {
				led_output(payload[0]);
			}
		} else if (gzp_crypt_user_data_received()) {
			if (gzp_crypt_user_data_read(payload, (uint8_t *)&length)) {
				led_output(payload[0]);
			}
		}
	}
}
```
