## CMakeLists.txt
```
#
# Copyright (c) 2021 Nordic Semiconductor ASA
#
# SPDX-License-Identifier: LicenseRef-Nordic-5-Clause
#

cmake_minimum_required(VERSION 3.20.0)

find_package(Zephyr REQUIRED HINTS $ENV{ZEPHYR_BASE})

project(random_hw_unique_key)

# NORDIC SDK APP START
target_sources(app PRIVATE src/main.c)
# NORDIC SDK APP END
```

## sample.yaml
```
sample:
  description: Generate and write random keys to the KMU.
  name: Random HW Unique Key
common:
  tags: huk
  platform_allow: >
    nrf5340dk_nrf5340_cpuapp nrf9160dk_nrf9160 nrf52840dk_nrf52840 nrf21540dk_nrf52840
  integration_platforms:
    - nrf5340dk_nrf5340_cpuapp
    - nrf9160dk_nrf9160
    - nrf52840dk_nrf52840
    - nrf21540dk_nrf52840
  harness: console
  harness_config:
    type: multi_line
    regex:
      - "Writing random keys to KMU."
      - "Success!"
tests:
  sample.keys.random_hw_unique_key:
    tags: huk ci_build
  sample.newlib_libc.random_hw_unique_key:
    build_only: true
    extra_args: CONFIG_NEWLIB_LIBC=y
    platform_allow: nrf5340dk_nrf5340_cpuapp nrf52840dk_nrf52840
    integration_platforms:
      - nrf5340dk_nrf5340_cpuapp
      - nrf52840dk_nrf52840
```

## prj.conf
```kconfig
#
# Copyright (c) 2021 Nordic Semiconductor ASA
#
# SPDX-License-Identifier: LicenseRef-Nordic-5-Clause
#

CONFIG_HW_UNIQUE_KEY=y
CONFIG_HW_UNIQUE_KEY_RANDOM=y
CONFIG_MAIN_STACK_SIZE=2048
CONFIG_NORDIC_SECURITY_BACKEND=y
CONFIG_CC3XX_BACKEND=y
CONFIG_PM_SINGLE_IMAGE=y
CONFIG_MPU_ALLOW_FLASH_WRITE=y
CONFIG_RESET_ON_FATAL_ERROR=n
```

## src/main.c
```c
/*
 * Copyright (c) 2021 Nordic Semiconductor ASA.
 *
 * SPDX-License-Identifier: LicenseRef-Nordic-5-Clause
 */

#include <zephyr/kernel.h>
#include <zephyr/sys/printk.h>
#include <string.h>
#include <stdio.h>
#include <hw_unique_key.h>

int main(void)
{
	printk("Writing random keys to KMU.\n\r");
	hw_unique_key_write_random();
	printk("Success!\n\r");

	return 0;
}
```
