## CMakeLists.txt
```
#
# Copyright (c) 2021 Nordic Semiconductor ASA
#
# SPDX-License-Identifier: LicenseRef-Nordic-5-Clause
#

cmake_minimum_required(VERSION 3.20)

find_package(Zephyr REQUIRED HINTS $ENV{ZEPHYR_BASE})

project(random_hw_unique_key)

# NORDIC SDK APP START
target_sources(app PRIVATE src/main.c)
if(CONFIG_BUILD_WITH_TFM)
  target_sources(app PRIVATE src/derive_key_tfm.c)
else ()
  target_sources(app PRIVATE src/derive_key.c)
endif()
# NORDIC SDK APP END
```

## Kconfig.sysbuild
```
#
# Copyright (c) 2025 Nordic Semiconductor ASA
#
# SPDX-License-Identifier: LicenseRef-Nordic-5-Clause
#

config PARTITION_MANAGER
	default n if SOC_SERIES_NRF91 || !BOARD_IS_NON_SECURE

source "share/sysbuild/Kconfig"
```

## sample.yaml
```
sample:
  description: Generate and write random keys to the KMU.
  name: Hardware unique key sample
common:
  tags:
    - huk
    - keys
    - ci_samples_keys
  platform_allow:
    - nrf5340dk/nrf5340/cpuapp
    - nrf5340dk/nrf5340/cpuapp/ns
    - nrf9160dk/nrf9160
    - nrf9160dk/nrf9160/ns
    - nrf9161dk/nrf9161
    - nrf9161dk/nrf9161/ns
    - nrf9151dk/nrf9151
    - nrf9151dk/nrf9151/ns
    - nrf52840dk/nrf52840
    - nrf21540dk/nrf52840
    - nrf54l15dk/nrf54l15/cpuapp
    - nrf54lm20dk/nrf54lm20a/cpuapp
    - nrf54lm20dk/nrf54lm20b/cpuapp
    - nrf54l15dk/nrf54l10/cpuapp
    - nrf54l15dk/nrf54l05/cpuapp
  integration_platforms:
    - nrf5340dk/nrf5340/cpuapp
    - nrf5340dk/nrf5340/cpuapp/ns
    - nrf9160dk/nrf9160
    - nrf9160dk/nrf9160/ns
    - nrf9161dk/nrf9161
    - nrf9161dk/nrf9161/ns
    - nrf9151dk/nrf9151
    - nrf9151dk/nrf9151/ns
    - nrf52840dk/nrf52840
    - nrf21540dk/nrf52840
    - nrf54l15dk/nrf54l15/cpuapp
    - nrf54lm20dk/nrf54lm20a/cpuapp
    - nrf54lm20dk/nrf54lm20b/cpuapp
    - nrf54l15dk/nrf54l10/cpuapp
    - nrf54l15dk/nrf54l05/cpuapp
  harness: console
  harness_config:
    type: multi_line
    regex:
      - ".*Example finished successfully!.*"
tests:
  sample.keys.hw_unique_key:
    sysbuild: true
    tags:
      - huk
      - ci_build
      - sysbuild
      - keys
      - ci_samples_keys
```

## prj.conf
```kconfig
#
# Copyright (c) 2021 Nordic Semiconductor ASA
#
# SPDX-License-Identifier: LicenseRef-Nordic-5-Clause
#

CONFIG_HW_UNIQUE_KEY=y
CONFIG_HW_UNIQUE_KEY_RANDOM=y

CONFIG_LOG=y

CONFIG_MPU_ALLOW_FLASH_WRITE=y
CONFIG_RESET_ON_FATAL_ERROR=n

CONFIG_REBOOT=y

CONFIG_PSA_CRYPTO=y
CONFIG_PSA_WANT_GENERATE_RANDOM=y
CONFIG_PSA_WANT_KEY_TYPE_AES=y
CONFIG_PSA_WANT_ALG_GCM=y
CONFIG_PSA_WANT_ALG_CCM=y
```

## boards/nrf52840dk_nrf52840.conf
```kconfig
#
# Copyright (c) 2021 Nordic Semiconductor ASA
#
# SPDX-License-Identifier: LicenseRef-Nordic-5-Clause
#

CONFIG_REBOOT=y
CONFIG_MBEDTLS_PSA_CRYPTO_C=y
CONFIG_MAIN_STACK_SIZE=4096
CONFIG_MBEDTLS_ENABLE_HEAP=y
```

## boards/nrf5340dk_nrf5340_cpuapp_ns.conf
```kconfig
#
# Copyright (c) 2021 Nordic Semiconductor ASA
#
# SPDX-License-Identifier: LicenseRef-Nordic-5-Clause
#

CONFIG_TFM_PROFILE_TYPE_NOT_SET=y
```

## boards/nrf54l15pdk_nrf54l15_cpuapp.conf
```kconfig
#
# Copyright (c) 2021 Nordic Semiconductor ASA
#
# SPDX-License-Identifier: LicenseRef-Nordic-5-Clause
#

CONFIG_MBEDTLS_PSA_CRYPTO_C=y
CONFIG_MAIN_STACK_SIZE=4096
CONFIG_MBEDTLS_ENABLE_HEAP=y
```

## boards/nrf54l20pdk_nrf54l20_cpuapp.conf
```kconfig
# Copyright (c) 2025 Nordic Semiconductor ASA
#
# SPDX-License-Identifier: LicenseRef-Nordic-5-Clause

CONFIG_MBEDTLS_PSA_CRYPTO_C=y
CONFIG_MAIN_STACK_SIZE=4096
CONFIG_MBEDTLS_ENABLE_HEAP=y
```

## boards/nrf54lv10dk_nrf54lv10a_cpuapp.conf
```kconfig
# Copyright (c) 2026 Nordic Semiconductor ASA
#
# SPDX-License-Identifier: LicenseRef-Nordic-5-Clause

CONFIG_MBEDTLS_PSA_CRYPTO_C=y
CONFIG_MAIN_STACK_SIZE=4096
CONFIG_MBEDTLS_ENABLE_HEAP=y
```

## boards/nrf9160dk_nrf9160.conf
```kconfig
#
# Copyright (c) 2021 Nordic Semiconductor ASA
#
# SPDX-License-Identifier: LicenseRef-Nordic-5-Clause
#

CONFIG_MBEDTLS_PSA_CRYPTO_C=y
CONFIG_MAIN_STACK_SIZE=4096
CONFIG_MBEDTLS_ENABLE_HEAP=y
CONFIG_HW_UNIQUE_KEY=y
CONFIG_HW_UNIQUE_KEY_RANDOM=y
```

## boards/nrf21540dk_nrf52840.overlay
```dts
/delete-node/ &storage_partition;

&flash0 {
	partitions {
		storage_partition: partition@fd000 {
			compatible = "zephyr,mapped-partition";
			label = "storage";
			reg = <0x000fd000 0x00002000>;
		};

		hw_unique_key_partition: partition@ff000 {
			compatible = "zephyr,mapped-partition";
			label = "";
			reg = <0x000ff000 0x00001000>;
		};
	};
};
```

## src/main.c
```c
/*
 * Copyright (c) 2021 Nordic Semiconductor ASA.
 *
 * SPDX-License-Identifier: LicenseRef-Nordic-5-Clause
 */

#include <zephyr/kernel.h>
#include <zephyr/logging/log.h>
#include <string.h>
#include <stdio.h>
#include <psa/crypto.h>
#ifdef CONFIG_BUILD_WITH_TFM
#include <tfm_crypto_defs.h>
#else /* CONFIG_BUILD_WITH_TFM */
#include <hw_unique_key.h>
#ifdef CONFIG_HW_CC3XX
#include <nrf_cc3xx_platform.h>
#endif
#endif /* CONFIG_BUILD_WITH_TFM */
#if !defined(HUK_HAS_KMU)
#include <zephyr/sys/reboot.h>
#endif /* !defined(HUK_HAS_KMU) */

#include "derive_key.h"

#define IV_LEN 12
#define MAC_LEN 16

#ifdef HUK_HAS_CC310
#define ENCRYPT_ALG PSA_ALG_CCM
#else
#define ENCRYPT_ALG PSA_ALG_GCM
#endif

#define APP_SUCCESS		(0)
#define APP_ERROR		(-1)
#define APP_SUCCESS_MESSAGE "Example finished successfully!"
#define APP_ERROR_MESSAGE "Example exited with error!"

#define PRINT_HEX(p_label, p_text, len)\
	({\
		LOG_INF("---- %s (len: %u): ----", p_label, len);\
		LOG_HEXDUMP_INF(p_text, len, "Content:");\
		LOG_INF("---- %s end  ----", p_label);\
	})

LOG_MODULE_REGISTER(app, LOG_LEVEL_DBG);

static psa_key_id_t key_id;

int crypto_init(void)
{
	psa_status_t status;

#if !defined(CONFIG_BUILD_WITH_TFM)
	int result;

#if defined(HUK_HAS_CC310) || defined(HUK_HAS_CC312)
	result = nrf_cc3xx_platform_init();

	if (result != NRF_CC3XX_PLATFORM_SUCCESS) {
		LOG_INF("nrf_cc3xx_platform_init returned error: %d", result);
		return APP_ERROR;
	}
#endif

	if (!hw_unique_key_are_any_written()) {
		LOG_INF("Writing random keys to KMU");
		result = hw_unique_key_write_random();
		if (result != HW_UNIQUE_KEY_SUCCESS) {
			LOG_INF("hw_unique_key_write_random returned error: %d", result);
			return APP_ERROR;
		}
		LOG_INF("Success!");

#if !defined(HUK_HAS_KMU)
		/* Reboot to allow the bootloader to load the key into CryptoCell. */
		sys_reboot(0);
#endif /* !defined(HUK_HAS_KMU) */
	}
#endif /* !defined(CONFIG_BUILD_WITH_TFM) */

	status = psa_crypto_init();
	if (status != PSA_SUCCESS) {
		LOG_INF("psa_crypto_init returned error: %d", status);
		return APP_ERROR;
	}

	return APP_SUCCESS;
}

int crypto_finish(void)
{
	psa_status_t status;

	status = psa_destroy_key(key_id);
	if (status != PSA_SUCCESS) {
		LOG_INF("psa_destroy_key returned error: %d", status);
		return APP_ERROR;
	}

	return APP_SUCCESS;
}

int generate_key(void)
{
	psa_key_attributes_t attributes = PSA_KEY_ATTRIBUTES_INIT;
	uint8_t key_label[] = "HUK derivation sample label";
	psa_status_t status;

	LOG_INF("Deriving key");

	/* Set the key attributes for the storage key */
	psa_set_key_usage_flags(&attributes,
			(PSA_KEY_USAGE_ENCRYPT | PSA_KEY_USAGE_DECRYPT));
	psa_set_key_algorithm(&attributes, ENCRYPT_ALG);
	psa_set_key_type(&attributes, PSA_KEY_TYPE_AES);
	psa_set_key_bits(&attributes, 128);

	status = derive_key(&attributes, key_label, sizeof(key_label) - 1, &key_id);
	if (status != PSA_SUCCESS) {
		LOG_INF("derive_key returned error: %d", status);
		return APP_ERROR;
	}

	return APP_SUCCESS;
}

int encrypt_message(void)
{
	psa_status_t status;
	uint8_t plaintext[] = "Lorem ipsum dolor sit amet. This will be encrypted.";
	uint8_t ciphertext[sizeof(plaintext) + MAC_LEN];
	uint32_t ciphertext_out_len;
	uint8_t iv[IV_LEN];
	uint8_t additional_data[] = "This will be authenticated but not encrypted.";

	LOG_INF("Generating random IV");

	status = psa_generate_random(iv, IV_LEN);
	if (status != PSA_SUCCESS) {
		LOG_INF("psa_generate_random returned error: %d", status);
		return APP_ERROR;
	}

	PRINT_HEX("IV", iv, IV_LEN);

	LOG_INF("Key ID: 0x%x", key_id);
	LOG_INF("Encrypting");
	PRINT_HEX("Plaintext", plaintext, sizeof(plaintext) - 1);

	status = psa_aead_encrypt(key_id, ENCRYPT_ALG, iv, IV_LEN,
				additional_data, sizeof(additional_data) - 1,
				plaintext, sizeof(plaintext) - 1,
				ciphertext, sizeof(ciphertext), &ciphertext_out_len);
	if (status != PSA_SUCCESS) {
		LOG_INF("psa_aead_encrypt returned error: %d", status);
		return APP_ERROR;
	}
	if (ciphertext_out_len != (sizeof(plaintext) - 1 + MAC_LEN)) {
		LOG_INF("ciphertext has wrong length: %d", ciphertext_out_len);
		return APP_ERROR;
	}

	PRINT_HEX("Ciphertext (with authentication tag)", ciphertext, ciphertext_out_len);

	return APP_SUCCESS;
}

int main(void)
{
	int status;

	LOG_INF("Derive a key, then use it to encrypt a message.");

	status = crypto_init();
	if (status != APP_SUCCESS) {
		LOG_INF(APP_ERROR_MESSAGE);
		return APP_ERROR;
	}

	status = generate_key();
	if (status != APP_SUCCESS) {
		LOG_INF(APP_ERROR_MESSAGE);
		return APP_ERROR;
	}

	status = encrypt_message();
	if (status != APP_SUCCESS) {
		LOG_INF(APP_ERROR_MESSAGE);
		return APP_ERROR;
	}

	status = crypto_finish();
	if (status != APP_SUCCESS) {
		LOG_INF(APP_ERROR_MESSAGE);
		return APP_ERROR;
	}

	LOG_INF(APP_SUCCESS_MESSAGE);

	return APP_SUCCESS;
}
```

## src/derive_key.c
```c
/*
 * Copyright (c) 2021 Nordic Semiconductor ASA.
 *
 * SPDX-License-Identifier: LicenseRef-Nordic-5-Clause
 */

#include <zephyr/kernel.h>
#include <zephyr/logging/log.h>
#include <psa/crypto.h>
#include <hw_unique_key.h>

#include "derive_key.h"

#ifdef HUK_HAS_KMU
#define KEYSLOT HUK_KEYSLOT_MKEK
#else
#define KEYSLOT HUK_KEYSLOT_KDR
#endif

#define PRINT_HEX(p_label, p_text, len)\
	({\
		LOG_INF("---- %s (len: %u): ----", p_label, len);\
		LOG_HEXDUMP_INF(p_text, len, "Content:");\
		LOG_INF("---- %s end  ----", p_label);\
	})

LOG_MODULE_DECLARE(app, LOG_LEVEL_DBG);

psa_status_t derive_key(psa_key_attributes_t *attributes, uint8_t *key_label,
			uint32_t label_size, psa_key_id_t *key_id_out)
{
	uint8_t key_out[PSA_BITS_TO_BYTES(128)];
	psa_key_id_t key_id;
	psa_status_t status;
	int err;

	*key_id_out = PSA_KEY_ID_NULL;

	err = hw_unique_key_derive_key(KEYSLOT, NULL, 0,
				       key_label, label_size,
				       key_out, sizeof(key_out));
	if (err != HW_UNIQUE_KEY_SUCCESS) {
		LOG_INF("hw_unique_key_derive_key returned error: %d", err);
		return PSA_ERROR_HARDWARE_FAILURE;
	}

	PRINT_HEX("Key", key_out, sizeof(key_out));

	status = psa_import_key(attributes, key_out, sizeof(key_out), &key_id);
	if (status != PSA_SUCCESS) {
		LOG_INF("psa_import_key returned error: %d", status);
		return status;
	}

	*key_id_out = key_id;
	return PSA_SUCCESS;
}
```

## src/derive_key.h
```c
/*
 * Copyright (c) 2023 Nordic Semiconductor ASA.
 *
 * SPDX-License-Identifier: LicenseRef-Nordic-5-Clause
 */

#ifndef SAMPLES_DERIVE_KEY_H__
#define SAMPLES_DERIVE_KEY_H__

psa_status_t derive_key(psa_key_attributes_t *attributes, uint8_t *key_label,
			uint32_t label_size, psa_key_id_t *key_id_out);

#endif /* SAMPLES_DERIVE_KEY_H*/
```

## src/derive_key_tfm.c
```c
/*
 * Copyright (c) 2021 Nordic Semiconductor ASA.
 *
 * SPDX-License-Identifier: LicenseRef-Nordic-5-Clause
 *
 * Based on "Protected Storage service key management" documentation in "Key derivation" chapter:
 * docs/technical_references/design_docs/ps_key_management.rst
 * in Trusted Firmware-M project.
 */

#include <zephyr/kernel.h>
#include <zephyr/logging/log.h>
#include <psa/crypto.h>
#include <tfm_crypto_defs.h>

#include "derive_key.h"

#if CONFIG_HAS_HW_NRF_CRACEN
/* On platforms with Cracen, the HUK is an AES key, suitable for CMAC KDF. */
#define KDF_ALG	   PSA_ALG_SP800_108_COUNTER_CMAC
#define INPUT_STEP PSA_KEY_DERIVATION_INPUT_LABEL
#else
/* On nrf53 and nRF91 the HUK key is PSA_KEY_TYPE_RAW_DATA, suitable for HKDF. */
#define KDF_ALG PSA_ALG_HKDF(PSA_ALG_SHA_256)
#define INPUT_STEP PSA_KEY_DERIVATION_INPUT_INFO
#endif

LOG_MODULE_DECLARE(app, LOG_LEVEL_DBG);

psa_status_t derive_key(psa_key_attributes_t *attributes, uint8_t *key_label,
			uint32_t key_label_len, psa_key_id_t *key_id_out)
{
	psa_status_t status;
	psa_key_derivation_operation_t op = PSA_KEY_DERIVATION_OPERATION_INIT;
	psa_key_id_t key_id;

	*key_id_out = PSA_KEY_ID_NULL;

	status = psa_key_derivation_setup(&op, KDF_ALG);
	if (status != PSA_SUCCESS) {
		LOG_INF("psa_key_derivation_setup returned error: %d", status);
		return status;
	}

	/* Set up a key derivation operation with HUK  */
	status = psa_key_derivation_input_key(&op, PSA_KEY_DERIVATION_INPUT_SECRET,
					      TFM_BUILTIN_KEY_ID_HUK);
	if (status != PSA_SUCCESS) {
		LOG_INF("psa_key_derivation_input_key returned error: %d", status);
		return status;
	}

	/* Supply the PS key label as an input to the key derivation */
	status = psa_key_derivation_input_bytes(&op, INPUT_STEP, key_label, key_label_len);
	if (status != PSA_SUCCESS) {
		LOG_INF("psa_key_derivation_input_bytes returned error: %d", status);
		return status;
	}

	/* Create the storage key from the key derivation operation */
	status = psa_key_derivation_output_key(attributes, &op, &key_id);
	if (status != PSA_SUCCESS) {
		LOG_INF("psa_key_derivation_output_key returned error: %d", status);
		return status;
	}

	LOG_INF("(Key resides internally in TF-M)");

	/* Finish key derivation operation and free associated resources */
	status = psa_key_derivation_abort(&op);
	if (status != PSA_SUCCESS) {
		LOG_INF("psa_key_derivation_abort returned error: %d", status);
	}

	*key_id_out = key_id;
	return PSA_SUCCESS;
}
```
