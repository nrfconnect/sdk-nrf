## CMakeLists.txt
```
#
# Copyright (c) 2022 Nordic Semiconductor ASA
#
# SPDX-License-Identifier: LicenseRef-Nordic-5-Clause
#
cmake_minimum_required(VERSION 3.20.0)

find_package(Zephyr REQUIRED HINTS $ENV{ZEPHYR_BASE})

project(identity_key_generation)

# NORDIC SDK APP START
target_sources(app PRIVATE src/main.c)
# NORDIC SDK APP END
```

## Kconfig.sysbuild
```
#
# Copyright (c) 2025 Nordic Semiconductor ASA
#
# SPDX-License-Identifier: LicenseRef-Nordic-5-Clause
#

config PARTITION_MANAGER
	default n if !(SOC_SERIES_NRF53 && BOARD_IS_NON_SECURE)

source "share/sysbuild/Kconfig"
```

## sample.yaml
```
sample:
  description: Generate and write identity key.
  name: Identity Key Generate
common:
  tags:
    - keys
    - ci_samples_keys
  platform_allow:
    - nrf5340dk/nrf5340/cpuapp
    - nrf9160dk/nrf9160
    - nrf9161dk/nrf9161
    - nrf9151dk/nrf9151
  integration_platforms:
    - nrf5340dk/nrf5340/cpuapp
    - nrf9160dk/nrf9160
    - nrf9161dk/nrf9161
    - nrf9151dk/nrf9151
  harness: console
  harness_config:
    type: multi_line
    regex:
      - "Writing the identity key to KMU"
      - "Success!"
tests:
  sample.keys.identity_key_generate.random_key:
    sysbuild: true
    tags:
      - keys
      - ci_build
      - sysbuild
      - ci_samples_keys
  # The TFM regression tests rely on a specific key in order to pass.
  # This sample configuration is mainly useful for writing that expected key,
  # which is called a "dummy key".
  sample.keys.identity_key_generate.static_key:
    sysbuild: true
    extra_configs:
      - CONFIG_IDENTITY_KEY_DUMMY=y
    tags:
      - keys
      - ci_build
      - sysbuild
      - ci_samples_keys
```

## prj.conf
```kconfig
#
# Copyright (c) 2022 Nordic Semiconductor ASA
#
# SPDX-License-Identifier: LicenseRef-Nordic-5-Clause
#

CONFIG_MAIN_STACK_SIZE=8192

CONFIG_CONSOLE=y
CONFIG_LOG=y

# The HW_UNIQUE_KEY library is needed for the MKEK
CONFIG_HW_UNIQUE_KEY=y
CONFIG_HW_UNIQUE_KEY_RANDOM=y

CONFIG_IDENTITY_KEY=y
CONFIG_IDENTITY_KEY_RANDOM=y

CONFIG_PSA_CRYPTO=y
CONFIG_PSA_CRYPTO_DRIVER_CC3XX=y
CONFIG_PSA_CRYPTO_DRIVER_OBERON=n
CONFIG_MBEDTLS_ENABLE_HEAP=y
CONFIG_MBEDTLS_HEAP_SIZE=8192

CONFIG_MPU_ALLOW_FLASH_WRITE=y

CONFIG_RESET_ON_FATAL_ERROR=n
```

## src/main.c
```c
/*
 * Copyright (c) 2022 Nordic Semiconductor ASA.
 *
 * SPDX-License-Identifier: LicenseRef-Nordic-5-Clause
 */

#include <zephyr/kernel.h>
#include <zephyr/logging/log.h>
#include <string.h>
#include <stdio.h>
#include <hw_unique_key.h>
#include <identity_key.h>

LOG_MODULE_REGISTER(identity_key_generation, LOG_LEVEL_DBG);

int main(void)
{
	int err;
	LOG_INF("Generating random HUK keys (including MKEK)");
	err = hw_unique_key_write_random();
	if (err != HW_UNIQUE_KEY_SUCCESS) {
		LOG_INF("Failure: Writing random HUK keys failed. Exiting!");
		return 0;
	}

	if (identity_key_is_written()) {
		LOG_INF("Failure: Identity key slot already written. Exiting!");
		return 0;
	}

	LOG_INF("Writing the identity key to KMU");

#ifdef CONFIG_IDENTITY_KEY_DUMMY
	err = identity_key_write_dummy();
#else
	err = identity_key_write_random();
#endif

	if (err != IDENTITY_KEY_SUCCESS) {
		LOG_INF("Failure: Identity key write failed! Exiting!");
		return 0;
	}

	if (!identity_key_is_written()) {
		LOG_INF("Failure: Identity key is not written! Exiting!");
		return 0;
	}

	LOG_INF("Success!");

	return 0;
}
```
