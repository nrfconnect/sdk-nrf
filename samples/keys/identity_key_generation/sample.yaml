## samples/keys/identity_key_generation/sample.yaml
```yaml
sample:
  description: Generate and write identity key.
  name: Identity Key Generate
common:
  tags: keys
  platform_allow:
    - nrf5340dk/nrf5340/cpuapp
    - nrf9160dk/nrf9160
    - nrf9161dk/nrf9161
    - nrf9151dk/nrf9151
  integration_platforms:
    - nrf5340dk/nrf5340/cpuapp
    - nrf9160dk/nrf9160
    - nrf9161dk/nrf9161
    - nrf9151dk/nrf9151
  harness: console
  harness_config:
    type: multi_line
    regex:
      - "Writing the identity key to KMU"
      - "Success!"
tests:
  sample.keys.identity_key_generate.random_key:
    sysbuild: true
    tags: keys ci_build sysbuild

  # The TFM regression tests rely on a specific key in order to pass.
  # This sample configuration is mainly useful for writing that expected key,
  # which is called a "dummy key".
  sample.keys.identity_key_generate.static_key:
    sysbuild: true
    extra_configs:
      - CONFIG_IDENTITY_KEY_DUMMY=y
    tags: keys ci_build sysbuild
```

## samples/keys/identity_key_usage/sample.yaml
```yaml
sample:
  description: Use a previously written identity key from KMU.
  name: Identity Key Usage
common:
  tags: keys
  platform_allow:
    - nrf5340dk/nrf5340/cpuapp
    - nrf9160dk/nrf9160
    - nrf9161dk/nrf9161
    - nrf9151dk/nrf9151
  integration_platforms:
    - nrf5340dk/nrf5340/cpuapp
    - nrf9160dk/nrf9160
    - nrf9161dk/nrf9161
    - nrf9151dk/nrf9151
  harness: console
  harness_config:
    type: multi_line
    regex:
      - "Ciphertext \\(with authentication tag\\):"
tests:
  sample.keys.identity_key_usage:
    sysbuild: true
    tags: keys ci_build sysbuild
    build_only: true
```

## samples/keys/random_hw_unique_key/sample.yaml
```yaml
sample:
  description: Generate and write random keys to the KMU.
  name: Random HW Unique Key
common:
  tags: huk
  platform_allow: >
    nrf5340dk_nrf5340_cpuapp nrf9160dk_nrf9160 nrf52840dk_nrf52840 nrf21540dk_nrf52840
  integration_platforms:
    - nrf5340dk_nrf5340_cpuapp
    - nrf9160dk_nrf9160
    - nrf52840dk_nrf52840
    - nrf21540dk_nrf52840
  harness: console
  harness_config:
    type: multi_line
    regex:
      - "Writing random keys to KMU."
      - "Success!"
tests:
  sample.keys.random_hw_unique_key:
    tags: huk ci_build
  sample.newlib_libc.random_hw_unique_key:
    build_only: true
    extra_args: CONFIG_NEWLIB_LIBC=y
    platform_allow: nrf5340dk_nrf5340_cpuapp nrf52840dk_nrf52840
    integration_platforms:
      - nrf5340dk_nrf5340_cpuapp
      - nrf52840dk_nrf52840
```

## samples/logging/multidomain_backends/Kconfig
```kconfig
#
# Copyright (c) 2026 Nordic Semiconductor
#
# SPDX-License-Identifier: LicenseRef-Nordic-5-Clause
#

mainmenu "Multi-domain backends sample"

source "Kconfig.zephyr"

menu "Sample configuration"

config MULTIDOMAIN_BACKENDS_DICTIONARY_LOGGING
	bool "Enable dictionary output on all enabled log backends"
	default n
	select LOG_DICTIONARY_SUPPORT
	imply LOG_FMT_SECTION
	imply LOG_FMT_SECTION_STRIP if !LOG_ALWAYS_RUNTIME
	help
	  Enables dictionary mode output for UART, BLE, and filesystem backends.
	  This is useful when collecting compact log streams for host-side decoding.

endmenu
```

## samples/logging/multidomain_backends/Kconfig.sysbuild
```kconfig
#
# Copyright (c) 2026 Nordic Semiconductor
#
# SPDX-License-Identifier: LicenseRef-Nordic-5-Clause
#

config PARTITION_MANAGER
	default n

config REMOTE_BOARD
	string
	default "nrf54lm20dk/nrf54lm20a/cpuflpr" if BOARD_NRF54LM20DK_NRF54LM20A_CPUAPP

source "share/sysbuild/Kconfig"
```

## samples/logging/multidomain_backends/sample.yaml
```yaml
sample:
  description: Multi-domain logging sample with UART, BLE, and filesystem backends plus runtime filtering.
  name: Multi-domain logging backends (nRF54LM20)

common:
  sysbuild: true
  tags:
    - logging
    - bluetooth
    - filesystem
    - ipc

tests:
  sample.logging.multidomain_backends.nrf54lm20:
    extra_args:
      - multidomain_backends_SNIPPET=nordic-flpr
    platform_allow:
      - nrf54lm20dk/nrf54lm20a/cpuapp
    integration_platforms:
      - nrf54lm20dk/nrf54lm20a/cpuapp
```

## samples/manufacturing_app/Kconfig
```kconfig
#
# Copyright (c) 2026 Nordic Semiconductor ASA
#
# SPDX-License-Identifier: LicenseRef-Nordic-5-Clause
#

config SAMPLE_MFG_LOG_MACHINE_READABLE
	bool "Machine-readable log output"
	default n
	help
	  When enabled, the manufacturing application emits minimal, line-oriented
	  output suitable for automated test equipment:

	    STEP:<name>        — a step is starting
	    ERR:<message>      — an error condition was detected
	    KV:<key>:<value>   — structured datum (LCS state, IAK public key, ...)
	    DONE:PASS          — manufacturing completed successfully
	    DONE:FAIL          — manufacturing halted with an error

	  MFG_LOG_INF lines (verbose human-readable explanations) are suppressed.

	  When disabled (default), the application emits verbose human-readable
	  output including source file and line numbers for each step.

config SAMPLE_BLOCK_ERASE_ALL
	bool "Block erase-all by programming UICR.ERASEPROTECT during manufacturing"
	default n
	help
	  When enabled, the manufacturing application programs
	  UICR.ERASEPROTECT.PROTECT0 and UICR.ERASEPROTECT.PROTECT1 to
	  0x50FA50FA, permanently blocking the SWD erase-all command on the
	  device.

	  WARNING: This operation is irreversible without authenticated erase-all.
	  Do not enable this option for engineering/development devices.

	  UICR is accessible directly on the privileged cpuapp target via
	  nrfx_rramc_word_write(). See src/erase_protection.c for details.

config SAMPLE_MFG_APP_KEY_KMU_SLOT
	int "KMU slot holding the manufacturing application authentication key"
	default 122
	help
	  KMU slot number that holds the key used to authenticate this
	  manufacturing application. This key is revoked in Step 12 of the
	  manufacturing flow once provisioning is complete.

	  The key must be pre-loaded into this slot before the manufacturing
	  application runs

config SAMPLE_MFG_UROT_KEY_GEN0_KMU_SLOT
	int "KMU slot for UROT public key generation 0 (urot_pubkey_gen0)"
	default 120
	help
	  First physical KMU slot for the UROT generation-0 public key.
	  Ed25519 keys occupy 2 consecutive slots.

config SAMPLE_MFG_UROT_KEY_GEN1_KMU_SLOT
	int "KMU slot for UROT public key generation 1 (urot_pubkey_gen1)"
	default 124
	help
	  First physical KMU slot for the UROT generation-1 public key.
	  Ed25519 keys occupy 2 consecutive slots.

source "Kconfig.zephyr"
```

## samples/manufacturing_app/sample.yaml
```yaml
sample:
  description: >
    Manufacturing application sample for nRF54LV10A.
  name: Manufacturing Application
common:
  tags:
    - keys
    - manufacturing
  platform_allow:
    - nrf54lv10dk/nrf54lv10a/cpuapp
  integration_platforms:
    - nrf54lv10dk/nrf54lv10a/cpuapp
```

## samples/matter/closure/Kconfig
```kconfig
#
# Copyright (c) 2025 Nordic Semiconductor
#
# SPDX-License-Identifier: LicenseRef-Nordic-5-Clause
#
mainmenu "Matter nRF Connect Closure Example Application"

config NCS_SAMPLE_MATTER_PERSISTENT_STORAGE
	default y

# Sample configuration used for Thread networking
if OPENTHREAD

choice OPENTHREAD_NORDIC_LIBRARY_CONFIGURATION
	default OPENTHREAD_NORDIC_LIBRARY_FTD
endchoice

choice OPENTHREAD_DEVICE_TYPE
	default OPENTHREAD_FTD
endchoice

endif # OPENTHREAD

config CHIP_WIFI
	default y if SHIELD_NRF7002EB2
	select DEPRECATED if SOC_SERIES_NRF53X

source "$(ZEPHYR_CONNECTEDHOMEIP_MODULE_DIR)/config/nrfconnect/chip-module/Kconfig.features"
source "$(ZEPHYR_CONNECTEDHOMEIP_MODULE_DIR)/config/nrfconnect/chip-module/Kconfig.defaults"
source "$(ZEPHYR_NRF_MODULE_DIR)/samples/matter/common/src/Kconfig"
source "Kconfig.zephyr"
```

## samples/matter/closure/Kconfig.sysbuild
```kconfig
#
# Copyright (c) 2025 Nordic Semiconductor ASA
#
# SPDX-License-Identifier: LicenseRef-Nordic-5-Clause
#

#### Radio core selection
config NRF_DEFAULT_IPC_RADIO
	default y

# Enable IEEE802.15.4 serialization to network core
# This config automatically pulls in the `overlay-802154.conf` in the ipc_radio image
config NETCORE_IPC_RADIO_IEEE802154
	default y if SOC_SERIES_NRF53X

# Enable Bluetooth serialization to network core
# This config automatically pulls in the `overlay-bt_hci_ipc.conf` in the ipc_radio image
config NETCORE_IPC_RADIO_BT_HCI_IPC
	default y if SOC_SERIES_NRF53X

#### Bootloader
choice BOOTLOADER
	default BOOTLOADER_MCUBOOT
endchoice

if BOOTLOADER_MCUBOOT

#### DFU multi-image support
config DFU_MULTI_IMAGE_PACKAGE_BUILD
	default y

config DFU_MULTI_IMAGE_PACKAGE_APP
	default y

config PM_EXTERNAL_FLASH_MCUBOOT_SECONDARY
	default y

#### DFU network core configuration
if SOC_SERIES_NRF53X

choice MCUBOOT_MODE
	default MCUBOOT_MODE_OVERWRITE_ONLY
endchoice

choice BOOT_SIGNATURE_TYPE
	default BOOT_SIGNATURE_TYPE_RSA
endchoice

config SECURE_BOOT_NETCORE
	default y

config NETCORE_APP_UPDATE
	default y

config DFU_MULTI_IMAGE_PACKAGE_NET
	default y

endif # SOC_SERIES_NRF53X

if BOARD_NRF54L15DK || BOARD_NRF54LM20DK

# Disable checking the external drivers for nRF54L15 and nRF54LM20 DKs.
config PM_OVERRIDE_EXTERNAL_DRIVER_CHECK
	default y

endif # BOARD_NRF54L15DK || BOARD_NRF54LM20DK

endif # BOOTLOADER_MCUBOOT

#### Enable generating factory data
config MATTER_FACTORY_DATA_GENERATE
	default y

source "share/sysbuild/Kconfig"
```

## samples/matter/closure/sample.yaml
```yaml
sample:
  description: Matter Closure sample
  name: Matter Closure
common:
  tags:
    - sysbuild
    - ci_samples_matter
tests:
  sample.matter.closure.debug:
    sysbuild: true
    build_only: true
    integration_platforms:
      - nrf52840dk/nrf52840
      - nrf5340dk/nrf5340/cpuapp
      - nrf54l15dk/nrf54l15/cpuapp
      - nrf54lm20dk/nrf54lm20a/cpuapp
    platform_allow:
      - nrf52840dk/nrf52840
      - nrf5340dk/nrf5340/cpuapp
      - nrf54l15dk/nrf54l15/cpuapp
      - nrf54lm20dk/nrf54lm20a/cpuapp
  sample.matter.closure.release:
    sysbuild: true
    build_only: true
    extra_args:
      - FILE_SUFFIX=release
    integration_platforms:
      - nrf52840dk/nrf52840
      - nrf5340dk/nrf5340/cpuapp
      - nrf54l15dk/nrf54l15/cpuapp
      - nrf54lm20dk/nrf54lm20a/cpuapp
    platform_allow:
      - nrf52840dk/nrf52840
      - nrf5340dk/nrf5340/cpuapp
      - nrf54l15dk/nrf54l15/cpuapp
      - nrf54lm20dk/nrf54lm20a/cpuapp
  sample.matter.closure.nrf7002eb2.debug:
    sysbuild: true
    build_only: true
    extra_args:
      - closure_SHIELD=nrf7002eb2
      - SB_CONFIG_WIFI_NRF70=y
    integration_platforms:
      - nrf54lm20dk/nrf54lm20a/cpuapp
    platform_allow:
      - nrf54lm20dk/nrf54lm20a/cpuapp
  sample.matter.closure.nrf7002eb2.release:
    sysbuild: true
    build_only: true
    extra_args:
      - FILE_SUFFIX=release
      - SB_CONFIG_BOOTLOADER_MCUBOOT=y
      - SB_CONFIG_PARTITION_MANAGER=y
      - closure_SHIELD=nrf7002eb2
      - SB_CONFIG_WIFI_NRF70=y
    integration_platforms:
      - nrf54lm20dk/nrf54lm20a/cpuapp
    platform_allow:
      - nrf54lm20dk/nrf54lm20a/cpuapp
  sample.matter.closure.release.internal:
    sysbuild: true
    build_only: true
    extra_args:
      - FILE_SUFFIX=internal
      - closure_EXTRA_CONF_FILE=prj_release.conf
    integration_platforms:
      - nrf54lm20dk/nrf54lm20a/cpuapp
    platform_allow:
      - nrf54lm20dk/nrf54lm20a/cpuapp
```

## samples/matter/common/src/Kconfig
```kconfig
#
# Copyright (c) 2023 Nordic Semiconductor
#
# SPDX-License-Identifier: LicenseRef-Nordic-5-Clause
#

config NCS_SAMPLE_MATTER_APP_TASK_QUEUE_SIZE
	int "Maximum amount of tasks delegated to be run in the application queue"
	default 10
	help
	  Define the maximum size of the queue dedicated for application tasks that
	  have to be run in the application thread context.

config NCS_SAMPLE_MATTER_APP_TASK_MAX_SIZE
	int "Maximum size of application task in bytes"
	default 16
	help
	  Defines the maximum size of a functor that can be put in the application
	  thread's task queue.

config NCS_SAMPLE_MATTER_CUSTOM_BLUETOOTH_ADVERTISING
	bool "Define the custom behavior of the Bluetooth advertisement in the application code"
	help
	  Disable the default Bluetooth advertising start which is defined in the board.cpp file and
	  allow to use the custom one.

config NCS_SAMPLE_MATTER_OPERATIONAL_KEYS_MIGRATION_TO_ITS
	bool "Enable operational keys migration feature"
	depends on CHIP_CRYPTO_PSA
	help
	  Enables migration of the operational keys stored in the persistent storage to the PSA ITS secure storage.
	  Enable this feature while updating the firmware of in-field devices that run Mbed TLS cryptography backend
	  to the firmware based on PSA Crypto API.

config NCS_SAMPLE_MATTER_FACTORY_RESET_ON_KEY_MIGRATION_FAILURE
	bool "Perform factory reset if the operational key migration failed"
	default y
	depends on NCS_SAMPLE_MATTER_OPERATIONAL_KEYS_MIGRATION_TO_ITS
	help
	  Allow device to perform factory reset if the operational key for Fabric has not been migrated
	  properly to PSA ITS storage.

config NCS_SAMPLE_MATTER_LEDS
	bool "Enable LEDs usage"
	default y
	depends on DK_LIBRARY
	help
	  Enables LEDs module to be used in the application.

config NCS_SAMPLE_MATTER_SETTINGS_SHELL
	bool "Settings shell for Matter purposes"
	default y if CHIP_MEMORY_PROFILING
	depends on SHELL
	depends on NVS || ZMS
	help
	  Allows using matter_settings shell commands.
	  You can use the following commands:
	  peak - to read the maximum settings usage.
	  reset - to reset peak value.
	  get_size - to read the size of specific value.
	  current - to read current settings usage.
	  free - to read free settings space.

config NCS_SAMPLE_MATTER_TEST_EVENT_TRIGGERS
	bool "Test event triggers support"
	default y
	help
	  Enables support for test event triggers for the specific use-cases.

config NCS_SAMPLE_MATTER_TEST_EVENT_TRIGGERS_MAX
	int "Maximum amount of event triggers"
	default 8
	depends on NCS_SAMPLE_MATTER_TEST_EVENT_TRIGGERS
	help
	  Defines the maximum amount of event triggers.

config NCS_SAMPLE_MATTER_TEST_EVENT_TRIGGERS_REGISTER_DEFAULTS
	bool "Register default triggers for Matter sample"
	depends on NCS_SAMPLE_MATTER_TEST_EVENT_TRIGGERS
	default y
	help
	  Automatically register default triggers such as factory reset,
	  device reboot, OTA start query.

config NCS_SAMPLE_MATTER_TEST_EVENT_TRIGGERS_MAX_TRIGGERS_DELEGATES
	int "Maximum amount of the trigger delegates"
	default 2
	depends on NCS_SAMPLE_MATTER_TEST_EVENT_TRIGGERS
	help
	  Defines the maximum number for the TestEventTriggerDelegate implementations
	  to be registered in the nRF test event triggers class.

config NCS_SAMPLE_MATTER_TEST_SHELL
	bool "Test - specific shell commands support for Matter samples"
	depends on CHIP_LIB_SHELL
	help
	  Enables support for test - specific shell commands in Matter samples.

config NCS_SAMPLE_MATTER_PERSISTENT_STORAGE
	bool "Persistent storage support for Matter samples"
	help
	  Matter persistent storage support with the configurable backend.

config NCS_SAMPLE_MATTER_ZAP_FILE_PATH
	string "Path in sample, under which ZAP file is located"
	help
	  Absolute path to location under which ZAP file is located.
	  It shall contain the file name and .zap extension.

config NCS_SAMPLE_MATTER_CERTIFICATION
	bool "Enable patches required for Matter platform certification"
	help
	  It enables including software patches required for the Matter platform certification
	  purposes. Currently it works only with the Matter template sample.

rsource "persistent_storage/Kconfig"
rsource "watchdog/Kconfig"
rsource "diagnostic/Kconfig"
```
