## samples/matter/common/src/bridge/Kconfig
```kconfig
#
# Copyright (c) 2023 Nordic Semiconductor
#
# SPDX-License-Identifier: LicenseRef-Nordic-5-Clause
#

config BRIDGE_MAX_DYNAMIC_ENDPOINTS_NUMBER
	int "Maximum number of dynamic endpoints supported by the Bridge"
	default 16

config BRIDGE_MAX_BRIDGED_DEVICES_NUMBER
	int "Maximum number of physical non-Matter devices supported by the Bridge"
	default 16

config BRIDGE_MAX_BRIDGED_DEVICES_NUMBER_PER_PROVIDER
	int "Maximum number of endpoints paired to the one non-Matter provider device"
	default 2

config BRIDGE_AGGREGATOR_ENDPOINT_ID
	int "Id of an endpoint implementing Aggregator device type functionality"
	default 1

config BRIDGE_MIGRATE_PRE_2_7_0
	bool "Migration of bridged device data stored in old scheme from pre nRF SDK 2.7.0 releases"

config BRIDGE_MIGRATE_VERSION_1
	bool "Migration of bridged device data stored in version 1 of new scheme"
	default y

if BRIDGED_DEVICE_BT

config BRIDGE_BT_RECOVERY_MAX_INTERVAL
	int "Maximum time (in s) between recovery attempts when the BLE connection to the bridged device is lost"
	default 300

config BRIDGE_BT_RECOVERY_SCAN_TIMEOUT_MS
	int "Time (in ms) within which the Bridge will try to re-establish a connection to the lost BT LE device"
	default 2000

config BRIDGE_BT_MAX_SCANNED_DEVICES
	int "Maximum amount of scanned devices"
	default 16

config BRIDGE_BT_SCAN_TIMEOUT_MS
	int "Bluetooth scan timeout in milliseconds"
	default 10000

config BRIDGE_BT_MINIMUM_SECURITY_LEVEL
	int "Minimum Bluetooth security level of bridged devices that will be accepted by the bridge device"
	default 2
	range 2 4
	depends on BT_SMP
	help
	   The minimum Bluetooth security level means that the bridged devices using this or a higher level will be
	   allowed to connect to the bridge. The level cannot be set to a value smaller than 2, as it would mean that
	   the communication with the connected devices will not be encrypted, what is not considered to be secure.

config BRIDGE_BT_SCAN_WINDOW
	int "Time duration of a central actively scanning for devices within scan interval, it is equal BRIDGE_BT_SCAN_WINDOW*0.625 ms"
	default 40  if OPENTHREAD # It is necessary to decrease Bluetooth LE activity to leave some radio time to Thread
	default 48

config BRIDGE_BT_SCAN_INTERVAL
	int "Time between consecutive Bluetooth scan windows, it is equal BRIDGE_BT_SCAN_INTERVAL*0.625 ms"
	default 160 if OPENTHREAD # It is necessary to decrease Bluetooth LE activity to leave some radio time to Thread
	default 96

config BRIDGE_BT_CONNECTION_INTERVAL_MIN
	int "It is the minimum duration of time requested by central after the peripheral device should wake up to communicate, it is equal BRIDGE_BT_CONNECTION_INTERVAL_MIN*1.25 ms"
	range 6 3200
	default 80 if OPENTHREAD # It is necessary to decrease Bluetooth LE activity to leave some radio time to Thread
	default 24

config BRIDGE_BT_CONNECTION_INTERVAL_MAX
	int "It is the maximum duration of time requested by central after the peripheral device should wake up to communicate, it is equal BRIDGE_BT_CONNECTION_INTERVAL_MAX*1.25 ms"
	range 6 3200
	default 80 if OPENTHREAD # It is necessary to decrease Bluetooth LE activity to leave some radio time to Thread
	default 40

config BRIDGE_BT_CONNECTION_TIMEOUT
	int "The time since the last packet was successfully received until the devices consider the connection lost, it is equal BRIDGE_BT_CONNECTION_TIMEOUT cs"
	default 400

config BRIDGE_BT_CONNECTION_LATENCY
	int "It allows the peripheral to skip waking up for a certain number of connection events if it does not have any data to send"
	default 0

config BRIDGE_FORCE_BT_CONNECTION_PARAMS
	bool "Determines whether the Matter bridge forces connection parameters or accepts the Bluetooth LE peripheral device selection"
	default y

endif
```

## samples/matter/common/src/diagnostic/Kconfig
```kconfig
#
# Copyright (c) 2024 Nordic Semiconductor
#
# SPDX-License-Identifier: LicenseRef-Nordic-5-Clause
#

menuconfig NCS_SAMPLE_MATTER_DIAGNOSTIC_LOGS
	bool "Enable diagnostics logs support"
	imply CHIP_ENABLE_BDX_LOG_TRANSFER
	help
	  Provides support for diagnostics logs. Diagnostics logs allow the Matter controller to read end-user,
	  network and crash logs from the Matter device.
	  Diagnostic logs are usable only if the DiagnosticCluster is available and active on the device's root endpoint.
	  Otherwise the compilation error occurs.

if NCS_SAMPLE_MATTER_DIAGNOSTIC_LOGS

config NCS_SAMPLE_MATTER_DIAGNOSTIC_LOGS_MAX_SIMULTANEOUS_SESSIONS
	int "Define maximum simultaneous sessions"
	default 20
	help
	  The maximum simultaneous sessions, which is the capability for sending diagnostic logs
	  to Matter controller using multiple sessions at the same time for different diagnostic
	  intents. When a session finishes, it releases its slot for a new one.

config NCS_SAMPLE_MATTER_DIAGNOSTIC_LOGS_CRASH_LOGS
	bool "Crash logs support"
	select RETAINED_MEM
	select RETENTION
	select RETENTION_MUTEX_FORCE_DISABLE
	select RETAINED_MEM_MUTEX_FORCE_DISABLE
	help
	  Enables support for storing crash logs when the crash occurs.

if NCS_SAMPLE_MATTER_DIAGNOSTIC_LOGS_CRASH_LOGS

config NCS_SAMPLE_MATTER_DIAGNOSTIC_LOGS_REMOVE_CRASH_AFTER_READ
	bool "Remove the last crash data after read"
	help
	  Removes the last crash data after reading it by Matter controller.
	  Disable this option to read the last crash multiple times.

endif # NCS_SAMPLE_MATTER_DIAGNOSTIC_LOGS_CRASH_LOGS

config NCS_SAMPLE_MATTER_DIAGNOSTIC_LOGS_END_USER_LOGS
	bool "End user logs support"
	help
	  Enables support for capturing end user diagnostic logs.

config NCS_SAMPLE_MATTER_DIAGNOSTIC_LOGS_NETWORK_LOGS
	bool "Network logs support"
	help
	  Enables support for capturing network diagnostic logs.

config NCS_SAMPLE_MATTER_DIAGNOSTIC_LOGS_TEST
	bool "Testing module for Diagnostic logs cluster"
	help
	  Enables testing module for diagnostic logs cluster.

config NCS_SAMPLE_MATTER_DIAGNOSTIC_LOGS_REDIRECT
	bool "Redirection of logs to the diagnostic logs module"
	default y if NCS_SAMPLE_MATTER_DIAGNOSTIC_LOGS_END_USER_LOGS || NCS_SAMPLE_MATTER_DIAGNOSTIC_LOGS_NETWORK_LOGS
	depends on LOG_MODE_DEFERRED
	help
	  Enable redirection of the logs formed using logger LOG macro to the Matter diagnostic logs module.
	  This option enables only redirection logs from the "chip" module, as a diagnostic network logs
	  and from the "app" module, as a diagnostic end user logs.

endif # NCS_SAMPLE_MATTER_DIAGNOSTIC_LOGS
```

## samples/matter/common/src/persistent_storage/Kconfig
```kconfig
#
# Copyright (c) 2024 Nordic Semiconductor
#
# SPDX-License-Identifier: LicenseRef-Nordic-5-Clause
#

if NCS_SAMPLE_MATTER_PERSISTENT_STORAGE

config NCS_SAMPLE_MATTER_SETTINGS_STORAGE_BACKEND
	bool "Settings based storage implementation for Matter samples"
	depends on SETTINGS
	default y

config NCS_SAMPLE_MATTER_SECURE_STORAGE_BACKEND
	bool "Secure storage implementation for Matter samples"
	select TRUSTED_STORAGE if (!NRF_IRONSIDE_SE_PSA_SERVICES && !BUILD_WITH_TFM)
	select PSA_PROTECTED_STORAGE if (!NRF_IRONSIDE_SE_PSA_SERVICES && !BUILD_WITH_TFM)
	help
	  Enables the secure persistent storage wrapper API that
	  imitates Zephyr Settings' key-value data format.
	  If building with CMSE enabled (*/ns), the TF-M
	  and Secure Domain PSA Protected Storage implementation
	  is leveraged by default.
	  If building with CMSE disabled (*/cpuapp),
	  the Trusted Storage library must be used.

config NCS_SAMPLE_MATTER_STORAGE_MAX_KEY_LEN
	int "Maximum length (bytes) of the key under which the asset can be stored"
	default 18

if NCS_SAMPLE_MATTER_SECURE_STORAGE_BACKEND

config NCS_SAMPLE_MATTER_SECURE_STORAGE_MAX_ENTRY_NUMBER
	int "Maximum number of entries that can be stored securely"
	default 64

config NCS_SAMPLE_MATTER_SECURE_STORAGE_PSA_KEY_VALUE_OFFSET
	hex "The PSA key offset dedicated for Matter application"
	default 0x40000

config TRUSTED_STORAGE_BACKEND_AEAD_MAX_DATA_SIZE
	default 1410

endif

endif
```

## samples/matter/common/src/watchdog/Kconfig
```kconfig
#
# Copyright (c) 2024 Nordic Semiconductor
#
# SPDX-License-Identifier: LicenseRef-Nordic-5-Clause
#

menuconfig NCS_SAMPLE_MATTER_WATCHDOG
	bool "Watchdog for Matter applications"
	select WATCHDOG

if NCS_SAMPLE_MATTER_WATCHDOG

config NCS_SAMPLE_MATTER_WATCHDOG_DEFAULT
    bool "Use watchdog object dedicated for Main and Matter threads"
    default y
    help
        The default watchdog objects are created in the matter_init.cpp file.
        The watchdog objects are dedicated for Main and Matter threads and are initialized
        using the NCS_SAMPLE_MATTER_WATCHDOG_DEFAULT_FEED_TIME value.

config NCS_SAMPLE_MATTER_WATCHDOG_TIMEOUT
    int "Default maximum window time in milliseconds for receiving the feeding signal"
    default 600000 # 10 minutes
    help
        The default maximum window time defines a time within which the feeding signal must be received
        from all created Watchdog sources to reset the watchdog object's timer.
        If the signals come after elapsing this time, the watchdog timer will not be reset and the
        reboot occur.

config NCS_SAMPLE_MATTER_WATCHDOG_DEFAULT_FEED_TIME
    int "Default interval of feeding time in milliseconds"
    default 300000 # 5 minutes
    help
	  The default interval in milliseconds for calling the feeding callback if it exists.

config NCS_SAMPLE_MATTER_WATCHDOG_EVENT_TRIGGERS
    bool "Enables default event triggers for watchdog purposes"
    default y
    depends on NCS_SAMPLE_MATTER_TEST_EVENT_TRIGGERS
    help
        Enables test event triggers to block Main and Matter stacks for the specific amount of time
        and test Watchdog in this way.

endif # NCS_SAMPLE_MATTER_WATCHDOG
```

## samples/matter/contact_sensor/Kconfig
```kconfig
#
# Copyright (c) 2025 Nordic Semiconductor
#
# SPDX-License-Identifier: LicenseRef-Nordic-5-Clause
#
mainmenu "Matter nRF Connect Contact Sensor Example Application"

choice OPENTHREAD_NORDIC_LIBRARY_CONFIGURATION
	default OPENTHREAD_NORDIC_LIBRARY_MTD
endchoice

choice OPENTHREAD_DEVICE_TYPE
	default OPENTHREAD_MTD
endchoice

config CHIP_ENABLE_ICD_SUPPORT
	default y

config CHIP_ICD_LIT_SUPPORT
	default y

config CHIP_ICD_SIT_SLOW_POLL_LIMIT
	default 5000

config CHIP_ICD_REPORT_ON_ACTIVE_MODE
	default y

# Reduce Thread TX output power to 0 dBm for SED device
config OPENTHREAD_DEFAULT_TX_POWER
	default 0

source "$(ZEPHYR_CONNECTEDHOMEIP_MODULE_DIR)/config/nrfconnect/chip-module/Kconfig.features"
source "$(ZEPHYR_CONNECTEDHOMEIP_MODULE_DIR)/config/nrfconnect/chip-module/Kconfig.defaults"
source "$(ZEPHYR_NRF_MODULE_DIR)/samples/matter/common/src/Kconfig"
source "Kconfig.zephyr"
```

## samples/matter/contact_sensor/boards/nrf54lm20dk_nrf54lm20a_cpuapp_internal.conf
```kconfig
#
# Copyright (c) 2025 Nordic Semiconductor ASA
#
# SPDX-License-Identifier: LicenseRef-Nordic-5-Clause
#

# Disable SPI
CONFIG_CHIP_SPI_NOR=n
```

## samples/matter/contact_sensor/sample.yaml
```yaml
sample:
  description: Matter Contact Sensor example
  name: Matter Contact Sensor
common:
  tags:
    - sysbuild
    - ci_samples_matter
tests:
  sample.matter.contact_sensor.debug:
    sysbuild: true
    build_only: true
    integration_platforms:
      - nrf52840dk/nrf52840
      - nrf5340dk/nrf5340/cpuapp
      - nrf54l15dk/nrf54l15/cpuapp
      - nrf54lm20dk/nrf54lm20a/cpuapp
    platform_allow:
      - nrf52840dk/nrf52840
      - nrf5340dk/nrf5340/cpuapp
      - nrf54l15dk/nrf54l15/cpuapp
      - nrf54lm20dk/nrf54lm20a/cpuapp
  sample.matter.contact_sensor.release:
    sysbuild: true
    build_only: true
    extra_args:
      - FILE_SUFFIX=release
    integration_platforms:
      - nrf54lm20dk/nrf54lm20a/cpuapp
    platform_allow:
      - nrf52840dk/nrf52840
      - nrf5340dk/nrf5340/cpuapp
      - nrf54l15dk/nrf54l15/cpuapp
      - nrf54lm20dk/nrf54lm20a/cpuapp
```

## samples/matter/contact_sensor/sysbuild/mcuboot/boards/nrf5340dk_nrf5340_cpuapp.conf
```kconfig
#
# Copyright (c) 2025 Nordic Semiconductor ASA
#
# SPDX-License-Identifier: LicenseRef-Nordic-5-Clause
#

CONFIG_NORDIC_QSPI_NOR=y
CONFIG_NORDIC_QSPI_NOR_FLASH_LAYOUT_PAGE_SIZE=4096
CONFIG_NORDIC_QSPI_NOR_STACK_WRITE_BUFFER_SIZE=16

CONFIG_MCUBOOT_VERIFY_IMG_ADDRESS=n
CONFIG_NRF53_MULTI_IMAGE_UPDATE=y
CONFIG_FLASH_SIMULATOR_STATS=n
CONFIG_FLASH_SIMULATOR_DOUBLE_WRITES=y
```

## samples/matter/contact_sensor/sysbuild/mcuboot/boards/nrf54lm20dk_nrf54lm20a_cpuapp.conf
```kconfig
#
# Copyright (c) 2025 Nordic Semiconductor ASA
#
# SPDX-License-Identifier: LicenseRef-Nordic-5-Clause
#

CONFIG_HW_STACK_PROTECTION=n
CONFIG_BOOT_WATCHDOG_FEED=n

# nRF54LM20DK uses SPI NOR external flash
CONFIG_GPIO=y
CONFIG_SPI=y
CONFIG_SPI_NOR=y
CONFIG_SPI_NOR_SFDP_DEVICETREE=y
CONFIG_SPI_NOR_FLASH_LAYOUT_PAGE_SIZE=4096

# Increase the maximum number of sectors to 512 to fit the big image size (> 1024 kB).
CONFIG_BOOT_MAX_IMG_SECTORS=512

# Currently, without tickless kernel, the SYSCOUNTER value after the software
# reset is not set properly and due to that the first system interrupt is not called
# in the proper time - the SYSCOUNTER value is set to the value from before
# reset + 1. Hence, the reboot time increases more and more.
# To avoid it enable tickles kernel for mcuboot.
CONFIG_TICKLESS_KERNEL=y
```

## samples/matter/light_bulb/Kconfig
```kconfig
#
# Copyright (c) 2022 Nordic Semiconductor
#
# SPDX-License-Identifier: LicenseRef-Nordic-5-Clause
#
mainmenu "Matter nRF Connect Light Bulb Example Application"

# Sample configuration used for Thread networking
if NET_L2_OPENTHREAD

choice OPENTHREAD_NORDIC_LIBRARY_CONFIGURATION
	default OPENTHREAD_NORDIC_LIBRARY_FTD
endchoice

choice OPENTHREAD_DEVICE_TYPE
	default OPENTHREAD_FTD
endchoice

endif # NET_L2_OPENTHREAD

source "${ZEPHYR_CONNECTEDHOMEIP_MODULE_DIR}/config/nrfconnect/chip-module/Kconfig.features"
source "${ZEPHYR_CONNECTEDHOMEIP_MODULE_DIR}/config/nrfconnect/chip-module/Kconfig.defaults"
source "Kconfig.zephyr"
```
