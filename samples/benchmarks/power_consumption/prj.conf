## CMakeLists.txt
```
#
# Copyright (c) 2026 Nordic Semiconductor ASA
#
# SPDX-License-Identifier: LicenseRef-Nordic-5-Clause
#

cmake_minimum_required(VERSION 3.20.0)
find_package(Zephyr REQUIRED HINTS $ENV{ZEPHYR_BASE})
project(power_consumption)

target_sources(app PRIVATE src/main.c)
```

## Kconfig
```
#
# Copyright (c) 2026 Nordic Semiconductor ASA
#
# SPDX-License-Identifier: LicenseRef-Nordic-5-Clause
#

mainmenu "nRF7120 System ON Idle power consumption benchmark"

config SAMPLE_POWER_CONSUMPTION_IDLE_SECONDS
	int "System ON idle duration in seconds"
	range 1 3600
	default 10
	help
	  Duration of the sleep period (through k_sleep(), on this SoC's default
	  GRTC-backed system timer) before waking up, printing the wake
	  counter, and sleeping again.

choice SAMPLE_POWER_CONSUMPTION_RAM_RETAIN
	prompt "RAM retention level during System ON Idle"
	default SAMPLE_POWER_CONSUMPTION_RAM_RETAIN_FULL
	help
	  Controls the amount of application RAM that remains powered during System ON
	  Idle, using the ram_pwrdn library (see
	  nrf/doc/nrf/libraries/others/ram_pwrdn.rst). Total amount of SRAM on
	  nrf7120dk/nrf7120/cpuapp is 1016 KiB, not 1024 KiB -- keep this in
	  mind when reading the option names below.

config SAMPLE_POWER_CONSUMPTION_RAM_RETAIN_64K
	bool "Retain only the first 64 KiB of application RAM, power down the rest"
	select RAM_POWER_DOWN_LIBRARY
	help
	  Calls power_down_ram() once at boot to power down everything past
	  the first 64 KiB of application RAM (out of 1016 KiB total).

config SAMPLE_POWER_CONSUMPTION_RAM_RETAIN_128K
	bool "Retain only the first 128 KiB of application RAM, power down the rest"
	select RAM_POWER_DOWN_LIBRARY
	help
	  Calls power_down_ram() once at boot to power down everything past
	  the first 128 KiB of application RAM (out of 1016 KiB total).

config SAMPLE_POWER_CONSUMPTION_RAM_RETAIN_256K
	bool "Retain only the first 256 KiB of application RAM, power down the rest"
	select RAM_POWER_DOWN_LIBRARY
	help
	  Calls power_down_ram() once at boot to power down everything past
	  the first 256 KiB of application RAM (out of 1016 KiB total).

config SAMPLE_POWER_CONSUMPTION_RAM_RETAIN_512K
	bool "Retain only the first 512 KiB of application RAM, power down the rest"
	select RAM_POWER_DOWN_LIBRARY
	help
	  Calls power_down_ram() once at boot to power down everything past
	  the first 512 KiB of application RAM (out of 1016 KiB total, so
	  this leaves slightly more than half of RAM powered down, not
	  exactly half).

config SAMPLE_POWER_CONSUMPTION_RAM_RETAIN_FULL
	bool "Retain all RAM (default) -- nothing is powered down"
	help
	  No RAM power-down call is made at all. This is the default: by
	  default, all RAM must stay retained.

config SAMPLE_POWER_CONSUMPTION_RAM_RETAIN_USED_ONLY
	bool "Retain only RAM used by this image (power down the rest)"
	select RAM_POWER_DOWN_LIBRARY
	help
	  Calls power_down_unused_ram() instead of a fixed KiB boundary.
	  Everything from _image_ram_end through the end of application RAM is
	  powered down; runtime heap in that range can bus fault (see ram_pwrdn
	  docs).

endchoice

source "Kconfig.zephyr"
```

## prj.conf
```kconfig
# Serial console is on by default so the reset-button prompt and the
# wake counter are visible out of the box. For the most accurate current
# reading, disable it (see README.rst) -- logging over UART measurably
# raises the current draw.
CONFIG_SERIAL=y
CONFIG_CONSOLE=y
CONFIG_UART_CONSOLE=y

# Required so the console (UART) can actually be suspended around each
# idle window (see main.c) -- without this, the UART peripheral (and
# whatever clock it depends on) stays fully active for the whole "idle"
# window, which dominates the measured current.
CONFIG_PM_DEVICE=y

# Enables the SoC's pm_state_set()/pm_state_exit_post_ops() idle hook
# (soc/nordic/nrf71/soc_power.c), which switches LFXO between Pierce
# and Pixo mode on every idle entry/exit -- required to reliably reach
# the SoC's lowest System ON idle current. The nRF7120 power-state
# devicetree node sets zephyr,pm-device-disabled, so this does not also
# start automatically suspending/resuming the console -- main.c's own
# explicit PM_DEVICE_ACTION_SUSPEND/RESUME calls around each idle window
# are unaffected.
CONFIG_PM=y
```

## lfxo_pixo.overlay
```dts
/*
 * Copyright (c) 2026 Nordic Semiconductor ASA
 *
 * SPDX-License-Identifier: LicenseRef-Nordic-5-Clause
 */

&lfxo {
	mode = "pixo";
};
```

## boards/nrf7120dk_nrf7120_cpuapp.overlay
```dts
/*
 * Copyright (c) 2026 Nordic Semiconductor ASA
 *
 * SPDX-License-Identifier: LicenseRef-Nordic-5-Clause
 */

/*
 * Trim LFXO's internal load capacitance to match the DK's actual
 * crystal (TXC 9HT11-32.768KDZC-T, 9 pF load) plus PCB stray
 * capacitance -- part of the proven combination (with the PIXO trim in
 * main.c and the CONFIG_PM idle hook) needed to reliably reach the
 * SoC's lowest System ON idle current. Left unset, LFXO.CLOAD stays at
 * its hardware reset value (0x0).
 */
&lfxo {
	load-capacitors = "internal";
	load-capacitance-femtofarad = <17000>;
};
```

## boards/nrf7120dk_nrf7120e_cpuapp.overlay
```dts
/*
 * Copyright (c) 2026 Nordic Semiconductor ASA
 *
 * SPDX-License-Identifier: LicenseRef-Nordic-5-Clause
 */

#include "nrf7120dk_nrf7120_cpuapp.overlay"
```

## src/main.c
```c
/*
 * Copyright (c) 2026 Nordic Semiconductor ASA
 *
 * SPDX-License-Identifier: LicenseRef-Nordic-5-Clause
 */

#include <zephyr/device.h>
#include <zephyr/devicetree.h>
#include <zephyr/kernel.h>
#include <zephyr/pm/device.h>
#include <hal/nrf_reset.h>

#if defined(CONFIG_RAM_POWER_DOWN_LIBRARY)
#include <ram_pwrdn.h>
#endif

#define IDLE_TIME K_SECONDS(CONFIG_SAMPLE_POWER_CONSUMPTION_IDLE_SECONDS)

static void configure_ram_retention(void)
{
#if defined(CONFIG_SAMPLE_POWER_CONSUMPTION_RAM_RETAIN_USED_ONLY)
	power_down_unused_ram();
#elif defined(CONFIG_SAMPLE_POWER_CONSUMPTION_RAM_RETAIN_64K) || \
	defined(CONFIG_SAMPLE_POWER_CONSUMPTION_RAM_RETAIN_128K) || \
	defined(CONFIG_SAMPLE_POWER_CONSUMPTION_RAM_RETAIN_256K) || \
	defined(CONFIG_SAMPLE_POWER_CONSUMPTION_RAM_RETAIN_512K)
	uintptr_t ram_start = DT_REG_ADDR(DT_CHOSEN(zephyr_sram));
	uintptr_t ram_end = ram_start + DT_REG_SIZE(DT_CHOSEN(zephyr_sram));

#if defined(CONFIG_SAMPLE_POWER_CONSUMPTION_RAM_RETAIN_64K)
	uintptr_t retained_size = 64U * 1024U;
#elif defined(CONFIG_SAMPLE_POWER_CONSUMPTION_RAM_RETAIN_128K)
	uintptr_t retained_size = 128U * 1024U;
#elif defined(CONFIG_SAMPLE_POWER_CONSUMPTION_RAM_RETAIN_256K)
	uintptr_t retained_size = 256U * 1024U;
#elif defined(CONFIG_SAMPLE_POWER_CONSUMPTION_RAM_RETAIN_512K)
	uintptr_t retained_size = 512U * 1024U;
#endif

	power_down_ram(ram_start + retained_size, ram_end);
#endif
	/* CONFIG_SAMPLE_POWER_CONSUMPTION_RAM_RETAIN_FULL (default): no
	 * power-down call at all -- every byte of application RAM stays retained.
	 */
}

int main(void)
{
	uint32_t resetreas = nrf_reset_resetreas_get(NRF_RESET);

	nrf_reset_resetreas_clear(NRF_RESET, resetreas);

#if defined(CONFIG_SERIAL)
	const struct device *const console = DEVICE_DT_GET(DT_CHOSEN(zephyr_console));
	int err;

	if (!device_is_ready(console)) {
		return 0;
	}

	printk("\nPower consumption demo ready.\n");
#endif

	configure_ram_retention();

#if defined(CONFIG_SERIAL)
	uint32_t wakeups = 0;
#endif

	while (true) {
#if defined(CONFIG_SERIAL)
		/* Suspend the console (UART) before sleeping -- otherwise it
		 * stays fully active (and keeps whatever clock it depends on
		 * requested) for the whole "idle" window, which is the
		 * single biggest cause of elevated idle current in a sample
		 * like this.
		 */
		err = pm_device_action_run(console, PM_DEVICE_ACTION_SUSPEND);
		if (err != 0) {
			printk("Failed to suspend console: %d\n", err);
			return 0;
		}
#endif

		k_sleep(IDLE_TIME);

#if defined(CONFIG_SERIAL)
		err = pm_device_action_run(console, PM_DEVICE_ACTION_RESUME);
		if (err != 0) {
			return 0;
		}

		wakeups++;
		printk("Woken up %u time(s)\n", wakeups);
#endif
	}

	return 0;
}
```
