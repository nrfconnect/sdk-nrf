/*
 * Copyright (c) 2024 Nordic Semiconductor ASA
 *
 * SPDX-License-Identifier: LicenseRef-Nordic-5-Clause
 */

/* Disable the default UART node for the pepper core, as logs are forwarded
 * with STM and the application core UART. This setting also prevents access
 * issues to the same UART instance from two or more different cores.
 */
&uart135 {
	status = "disabled";
};

/delete-node/ &cpuapp_cpuppr_ipc;
/delete-node/ &cpuapp_cpuppr_ipc_shm;
/delete-node/ &cpuppr_cpuapp_ipc_shm;
/delete-node/ &cpuapp_dma_region;
/delete-node/ &cpurad_dma_region;

&cpuppr_code_data {
	reg = <0x2fc00000 DT_SIZE_K(80)>;
};
