/*
 * Copyright (c) 2025 Nordic Semiconductor ASA
 *
 * SPDX-License-Identifier: LicenseRef-Nordic-5-Clause
 */

/* Disable the default UART node for the FLPR core, as logs are forwarded
 * with STM and the application core UART. This setting also prevents access
 * issues to the same UART instance from two or more different cores.
 */
&uart120 {
	status = "disabled";
};

/*
 * Reclaim IPC SHM and the adjacent DMA fast region for FLPR SRAM.
 * Remove the ipc-2-14 node first so it no longer references the labels we delete next.
 */
/delete-node/ &cpuapp_cpuflpr_ipc;
/delete-node/ &cpuapp_cpuflpr_ipc_shm;
/delete-node/ &cpuflpr_cpuapp_ipc_shm;
/delete-node/ &dma_fast_region;

&cpuflpr_code_data {
	reg = <0x2f890000 DT_SIZE_K(64)>;
};
