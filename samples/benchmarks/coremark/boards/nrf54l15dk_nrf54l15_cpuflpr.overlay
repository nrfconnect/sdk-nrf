/*
 * Copyright (c) 2025 Nordic Semiconductor ASA
 *
 * SPDX-License-Identifier: LicenseRef-Nordic-5-Clause
 */

/ {
	aliases {
		button = &button3;
		led = &led3;
	};
};

/* The same set of GPIO and GPIOTE DTS nodes are enabled in the cpuapp and the cpuflpr targets.
 * This is done to allow control over one Button and one LED in each core. The benchmark code is
 * responsible for ensuring that each core exclusively uses the individual GPIO pin and the GPIOTE
 * instance that may be used with the GPIO pin (Button).
 */
