/* SPDX-License-Identifier: LicenseRef-BSD-5-Clause-Nordic */

&uart0 {
	compatible = "nordic,nrf-uarte";
	current-speed = <115200>;
	status = "okay";
    tx-pin = <20>;
    rx-pin = <22>;
    rts-pin = <19>;
    cts-pin = <21>;
};
