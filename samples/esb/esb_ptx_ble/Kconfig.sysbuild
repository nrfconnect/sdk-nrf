## samples/esb/esb_ptx_ble/Kconfig.sysbuild
```kconfig
#
# Copyright (c) 2025 Nordic Semiconductor
#
# SPDX-License-Identifier: LicenseRef-Nordic-5-Clause
#

source "share/sysbuild/Kconfig"

config NRF_DEFAULT_EMPTY
	default y if SOC_SERIES_NRF53X
```

## samples/esb/esb_ptx_ble/boards/nrf54h20dk_nrf54h20_cpurad.conf
```kconfig
#
# Copyright (c) 2025 Nordic Semiconductor ASA
#
# SPDX-License-Identifier: LicenseRef-Nordic-5-Clause
#

# Disable legacy GPPI as it does not support channel allocation
CONFIG_NRFX_GPPI_V1=n
```

## samples/esb/prx/Kconfig
```kconfig
#
# Copyright (c) 2020 Nordic Semiconductor
#
# SPDX-License-Identifier: LicenseRef-BSD-5-Clause-Nordic
#

source "Kconfig.zephyr"

menu "Enhanced ShockBurst: Receiver"

config ESB_PRX_APP_LOG_LEVEL
	int "Log level for the ESB PRX sample"
	default 4

endmenu
```

## samples/esb/prx/boards/nrf54h20pdk_nrf54h20_cpurad_soc1.conf
```kconfig
#
# Copyright (c) 2023 Nordic Semiconductor
#
# SPDX-License-Identifier: LicenseRef-Nordic-5-Clause
#

CONFIG_SERIAL=y
CONFIG_CONSOLE=y
CONFIG_UART_CONSOLE=y

CONFIG_GPIO=y
```

## samples/esb/prx/sample.yaml
```yaml
sample:
  name: ESB prx Sample
tests:
  samples.esb.prx:
    filter: CONFIG_UART_CONSOLE and CONFIG_SERIAL_SUPPORT_INTERRUPT
    tags: samples console
    harness: keyboard
    platform_allow: nrf51dk_nrf51422 nrf52dk_nrf52832 nrf52840dk_nrf52840 nrf52dk_nrf52810
  samples.esb.prx.build:
    build_only: true
    build_on_all: true
    platform_allow: nrf51dk_nrf51422 nrf52dk_nrf52832 nrf52840dk_nrf52840 nrf52dk_nrf52810 nrf5340dk_nrf5340_cpunet
    tags: ci_build
```

## samples/esb/ptx/Kconfig
```kconfig
#
# Copyright (c) 2020 Nordic Semiconductor
#
# SPDX-License-Identifier: LicenseRef-Nordic-5-Clause
#

source "Kconfig.zephyr"

menu "Enhanced ShockBurst: Transmitter"

config ESB_PTX_APP_LOG_LEVEL
	int "Log level for the ESB PTX sample"
	default 4

endmenu
```

## samples/esb/ptx/sample.yaml
```yaml
sample:
  name: ESB ptx Sample
tests:
  sample.esb.ptx:
    filter: CONFIG_UART_CONSOLE and CONFIG_SERIAL_SUPPORT_INTERRUPT
    harness: keyboard
    integration_platforms:
      - nrf52dk_nrf52832
      - nrf52840dk_nrf52840
      - nrf52dk_nrf52810
    platform_allow: nrf52dk_nrf52832 nrf52840dk_nrf52840 nrf52dk_nrf52810
    tags: samples console
  sample.esb.ptx.build:
    build_only: true
    integration_platforms:
      - nrf52dk_nrf52832
      - nrf52833dk_nrf52833
      - nrf52840dk_nrf52840
      - nrf52dk_nrf52810
      - nrf5340dk_nrf5340_cpunet
      - nrf21540dk_nrf52840
    platform_allow: nrf52dk_nrf52832 nrf52833dk_nrf52833 nrf52840dk_nrf52840
      nrf52dk_nrf52810 nrf5340dk_nrf5340_cpunet nrf21540dk_nrf52840
    tags: esb ci_build
  sample.esb.ptx.dynamic_irq:
    build_only: true
    extra_configs:
      - CONFIG_ESB_DYNAMIC_INTERRUPTS=y
      - CONFIG_DYNAMIC_INTERRUPTS=y
      - CONFIG_DYNAMIC_DIRECT_INTERRUPTS=y
    integration_platforms:
      - nrf5340dk_nrf5340_cpunet
      - nrf52840dk_nrf52840
    platform_allow: nrf5340dk_nrf5340_cpunet nrf52840dk_nrf52840
    tags: esb ci_build
  sample.esb.ptx.nrf5340_nrf21540:
    build_only: true
    extra_args: SHIELD=nrf21540ek
    integration_platforms:
      - nrf5340dk_nrf5340_cpunet
    platform_allow: nrf5340dk_nrf5340_cpunet
    tags: esb ci_build
```

## samples/event_manager/sample.yaml
```yaml
sample:
  description: Sample showing Event Manager usage
  name: Event Manager sample
tests:
  samples.event_manager:
    build_only: true
    integration_platforms:
      - nrf52dk_nrf52832
      - nrf52840dk_nrf52840
      - nrf9160dk_nrf9160_ns
    tags: ci_build
```

## samples/event_manager_profiler_tracer/sample.yaml
```yaml
sample:
  description: Sample showing usage of profiling Event Manager events
  name: Event Manager profiler tracer sample
tests:
  samples.event_manager_profiler_tracer:
    build_only: true
    integration_platforms:
      - nrf52dk_nrf52832
      - nrf52840dk_nrf52840
      - nrf9160dk_nrf9160_ns
      - nrf21540dk_nrf52840
    tags: ci_build
```

## samples/event_manager_proxy/Kconfig
```kconfig
#
# Copyright (c) 2022 Nordic Semiconductor ASA
#
# SPDX-License-Identifier: LicenseRef-Nordic-5-Clause
#

menu "Zephyr Kernel"
source "Kconfig.zephyr"
endmenu

menu "Event manager proxy sample application settings"

config APP_EVENT_MANAGER_REMOTE_WAIT_TO
	int "Waiting period for the remote core to finish the initialization"
	range 10 5000
	default 1000
	help
	  The time to wait for second core to report its readiness to transport the events.
	  The time is given in milliseconds.

rsource "common_events/Kconfig"
rsource "modules/Kconfig"
endmenu
```

## samples/event_manager_proxy/boards/nrf5340dk_nrf5340_cpuapp.conf
```kconfig
#
# Copyright (c) 2022 Nordic Semiconductor ASA
#
# SPDX-License-Identifier: LicenseRef-Nordic-5-Clause
#

CONFIG_SOC_NRF53_CPUNET_ENABLE=y
CONFIG_OPENAMP_SLAVE=n
```

## samples/event_manager_proxy/common_events/Kconfig
```kconfig
#
# Copyright (c) 2022 Nordic Semiconductor
#
# SPDX-License-Identifier: LicenseRef-Nordic-5-Clause
#

config APP_ACK_EVENT
	bool "Application ACK event"

config APP_CONFIG_EVENT
	bool "Application config event"

config APP_CONTROL_EVENT
	bool "Application control event"

config APP_MEASUREMENT_EVENT
	bool "Application measurements event"
```

## samples/event_manager_proxy/modules/Kconfig
```kconfig
#
# Copyright (c) 2022 Nordic Semiconductor
#
# SPDX-License-Identifier: LicenseRef-Nordic-5-Clause
#

config APP_MODULE_CONTROLLER_ENABLE
	bool "Enable controller application module"
	select APP_ACK_EVENT
	select APP_CONTROL_EVENT

config APP_MODULE_SENSOR_SIMULATED_ENABLE
	bool "Enable sensor simulated application module"
	select APP_ACK_EVENT
	select APP_CONFIG_EVENT
	select APP_CONTROL_EVENT
	select APP_MEASUREMENT_EVENT

if APP_MODULE_SENSOR_SIMULATED_ENABLE

config APP_MODULE_SENSOR_SIMULATED_INTERVAL
	int "Time interval between simulated sensor values"
	default 500
	help
	  Time in miliseconds between generated sensor value events.
endif

config APP_MODULE_STATS_ENABLE
	bool "Enable statistic application module"
	select APP_CONTROL_EVENT
	select APP_MEASUREMENT_EVENT
```

## samples/event_manager_proxy/remote/Kconfig
```kconfig
#
# Copyright (c) 2022 Nordic Semiconductor ASA
#
# SPDX-License-Identifier: LicenseRef-Nordic-5-Clause
#

menu "Zephyr Kernel"
source "Kconfig.zephyr"
endmenu

menu "Event manager proxy sample application settings"
rsource "../common_events/Kconfig"
rsource "../modules/Kconfig"
endmenu
```

## samples/gazell/gzll_ack_payload/device/sample.yaml
```yaml
sample:
  name: Gazell ACK payload device sample
tests:
  samples.gazell.gzll_ack_payload.device.build:
    build_only: true
    platform_allow: nrf52dk_nrf52832 nrf52833dk_nrf52833 nrf52840dk_nrf52840
    integration_platforms:
      - nrf52dk_nrf52832
      - nrf52833dk_nrf52833
      - nrf52840dk_nrf52840
    tags: ci_build
```

## samples/gazell/gzll_ack_payload_device/Kconfig
```kconfig
#
# Copyright (c) 2021 Nordic Semiconductor
#
# SPDX-License-Identifier: LicenseRef-Nordic-5-Clause
#

menu "Gazell Link Layer sample: Device"

config GZLL_TX_STATISTICS
	bool "Packet transaction statistics"
	default y
	help
	  Turns on transmission statistics gathering.

endmenu

menu "Zephyr Kernel"
source "Kconfig.zephyr"
endmenu
```

## samples/gazell/gzll_ack_payload_device/sample.yaml
```yaml
sample:
  name: Gazell ACK payload device sample
tests:
  sample.gazell.gzll_ack_payload.device.build:
    build_only: true
    integration_platforms:
      - nrf52dk_nrf52832
      - nrf52833dk_nrf52833
      - nrf52840dk_nrf52840
      - nrf52dk_nrf52810
    platform_allow: nrf52dk_nrf52832 nrf52833dk_nrf52833 nrf52840dk_nrf52840 nrf52dk_nrf52810
    tags: ci_build
```

## samples/gazell/gzll_ack_payload_host/sample.yaml
```yaml
sample:
  name: Gazell ACK payload host sample
tests:
  sample.gazell.gzll_ack_payload.host.build:
    sysbuild: true
    build_only: true
    integration_platforms:
      - nrf52dk/nrf52832
      - nrf52833dk/nrf52833
      - nrf52840dk/nrf52840
    platform_allow: nrf52dk/nrf52832 nrf52833dk/nrf52833 nrf52840dk/nrf52840
    tags: ci_build sysbuild
```

## samples/gazell/gzp_dynamic_pairing/host/sample.yaml
```yaml
sample:
  name: Gazell Dynamic Pairing host sample
tests:
  samples.gazell.gzp_dynamic_pairing.host.build:
    build_only: true
    platform_allow: nrf52dk_nrf52832 nrf52833dk_nrf52833 nrf52840dk_nrf52840
    integration_platforms:
      - nrf52dk_nrf52832
      - nrf52833dk_nrf52833
      - nrf52840dk_nrf52840
    tags: ci_build
```

## samples/gazell/gzp_dynamic_pairing_device/sample.yaml
```yaml
sample:
  name: Gazell Dynamic Pairing device sample
tests:
  sample.gazell.gzp_dynamic_pairing.device.build:
    sysbuild: true
    build_only: true
    integration_platforms:
      - nrf52dk/nrf52832
      - nrf52833dk/nrf52833
      - nrf52840dk/nrf52840
    platform_allow: nrf52dk/nrf52832 nrf52833dk/nrf52833 nrf52840dk/nrf52840
    tags: ci_build sysbuild
```

## samples/gazell/gzp_dynamic_pairing_host/boards/nrf5340dk_nrf5340_cpunet.conf
```kconfig
#
# Copyright (c) 2022 Nordic Semiconductor
#
# SPDX-License-Identifier: LicenseRef-Nordic-5-Clause
#

CONFIG_NCS_SAMPLE_EMPTY_APP_CORE_CHILD_IMAGE=y
```

## samples/gazell/gzp_dynamic_pairing_host/sample.yaml
```yaml
sample:
  name: Gazell Dynamic Pairing host sample
tests:
  sample.gazell.gzp_dynamic_pairing.host.build:
    build_only: true
    integration_platforms:
      - nrf52dk_nrf52832
      - nrf52833dk_nrf52833
      - nrf52840dk_nrf52840
      - nrf52dk_nrf52810
    platform_allow: nrf52dk_nrf52832 nrf52833dk_nrf52833 nrf52840dk_nrf52840 nrf52dk_nrf52810
    tags: ci_build
```

## samples/gppi_mutlicore/sample.yaml
```yaml
common:
  sysbuild: true
  tags: ci_build ci_tests_benchmarks_multicore
  harness_config:
    type: multi_line
    ordered: true

tests:
  sample.gppi:
    platform_allow:
      - nrf54h20dk/nrf54h20/cpuapp
    integration_platforms:
      - nrf54h20dk/nrf54h20/cpuapp
    extra_args:
      SB_CONF_FILE=sysbuild/nrf54h20dk_nrf54h20_cpurad.conf
      remote_SB_CONF_FILE=boards/nrf54h20dk_nrf54h20_cpurad.conf
      remote_DTC_OVERLAY_FILE="nrf54h20dk_nrf54h20_cpurad.overlay"
    harness: pytest
```

## samples/hw_id/sample.yaml
```yaml
sample:
  description: Sample showing HW ID library
  name: HW ID sample
tests:
  sample.hw_id.device_id:
    sysbuild: true
    build_only: true
    integration_platforms:
      - nrf5340dk/nrf5340/cpuapp
      - nrf5340dk/nrf5340/cpuapp/ns
      - nrf9160dk/nrf9160
      - nrf9160dk/nrf9160/ns
    platform_allow: >
      nrf5340dk/nrf5340/cpuapp nrf5340dk/nrf5340/cpuapp/ns nrf9160dk/nrf9160 nrf9160dk/nrf9160/ns
    tags: ci_build sysbuild
  sample.hw_id.uuid:
    sysbuild: true
    build_only: true
    integration_platforms:
      - nrf9160dk/nrf9160/ns
    platform_allow: nrf9160dk/nrf9160/ns
    tags: ci_build sysbuild
    extra_args: OVERLAY_CONFIG=overlay-uuid.conf
  sample.hw_id.imei:
    sysbuild: true
    build_only: true
    integration_platforms:
      - nrf9160dk/nrf9160/ns
    platform_allow: nrf9160dk/nrf9160/ns
    tags: ci_build sysbuild
    extra_args: OVERLAY_CONFIG=overlay-imei.conf
  sample.hw_id.ble:
    sysbuild: true
    build_only: true
    integration_platforms:
      - nrf51dk/nrf51822
      - nrf52840dk/nrf52840
      - nrf5340dk/nrf5340/cpuapp
      - nrf5340dk/nrf5340/cpuapp/ns
    platform_allow: >
      nrf51dk/nrf51822 nrf52840dk/nrf52840 nrf5340dk/nrf5340/cpuapp nrf5340dk/nrf5340/cpuapp/ns
    tags: ci_build sysbuild
    extra_args: OVERLAY_CONFIG=overlay-ble-mac.conf
```
