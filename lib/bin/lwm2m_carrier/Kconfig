## lib/gps_sim/Kconfig
```kconfig
# Kconfig - GPS data simulator
#
# Copyright (c) 2018 Nordic Semiconductor
#
# SPDX-License-Identifier: LicenseRef-BSD-5-Clause-Nordic
#

menuconfig GPS_SIM
	bool "GPS simulator"
	help
	  Enable GPS simulator.

if GPS_SIM

config GPS_SIM_DEV_NAME
	string "GPS simulator device name"
	default "GPS_SIM"
	help
		GPS simulator device name.

config GPS_SIM_BASE_LATITUDE
	int "Base latitude for GPS data"
	default 6325280
	help
		Start-point latitude for simulated GPS data,
		from which the generated data will continue.
		Calculated by deg * 100000 + minutes * 1000 N,
		for example 63 deg 25.280' will be 6325280.

config GPS_SIM_BASE_LONGITUDE
	int "Base longitude for GPS data"
	default 1026201
	help
		Start-point longitude for simulated GPS data,
		from which the generated data will continue.
		Calculated by deg * 100000 + minutes * 1000 E,
		for example 10 deg 26.201' will be 1026201.

config GPS_SIM_BASE_TIMESTAMP
	int "Base timestamp for GPS data"
	default 134627
	help
		Timestamp at which the simulator will start counting.
		Format is hour * 10000 + min * 100 + sec, which means that
		13:46:27 becomes 134627.

config GPS_SIM_ELLIPSOID
	bool "Generate ellipsoid GPS path"
	default y
	help
		GPS simulator will create a path that goes in an ellipsoid
		shape.

config GPS_SIM_PSEUDO_RANDOM
	bool "Use pseudo-random values to generate GPS coordinates"
	help
		Enables pseudo-random GPS coordinate creation. Based on uptime
		that's input to a sine function, which causes the otuput
		to not be uniformally distributed, but sinusoidal.

config GPS_SIM_DYNAMIC_VALUES
	bool "GPS simulator dynamically creates data values"
	default y
	select NEWLIB_LIBC
	select NEWLIB_LIBC_FLOAT_PRINTF
	help
		Enables dynamically created simulator otuput as opposed
		to static values.

config GPS_SIM_MAX_STEP
	int "Maximum step size each iteration"
	default 5
	help
		Sets the maximum step size that can be taken in latitude or longitude
		for each simulation iteration. In units of 1/1000 degrees.

config GPS_SIM_TRIGGER
	bool "GPS simulator trigger"
	help
		Enable trigger. When enabled, it will emit 'data ready'
		trigger event time either by button press or at specified
		timer intervals.

if GPS_SIM_TRIGGER

choice
	prompt "Trigger type"
	depends on GPS_SIM_TRIGGER
	default GPS_SIM_TRIGGER_USE_TIMER
	help
		Specify the type of trigger that will be used to emit the
		'data ready' trigger event.

config GPS_SIM_TRIGGER_USE_TIMER
	bool "Use timer for trigger"
	help
		Use timer to trigger 'data ready' event.

config GPS_SIM_TRIGGER_USE_BUTTON
	bool "Use button 2 as trigger"
	help
		Use button 2 to trigger 'data ready' event.

endchoice

if GPS_SIM_TRIGGER && GPS_SIM_TRIGGER_USE_TIMER
	config GPS_SIM_TRIGGER_TIMER_MSEC
		int "Time between triggers, in milliseconds"
		default 1000
		help
			The time interval between each 'data ready' trigger event.
endif

if GPS_SIM_TRIGGER && !GPS_SIM_TRIGGER_USE_TIMER
	config GPS_SIM_TRIGGER_TIMER_MSEC
		int
		default 0
endif

config GPS_SIM_THREAD_PRIORITY
	int "Thread priority"
	depends on GPS_SIM_TRIGGER
	default 10
	help
	  Priority of thread used by the driver to handle interrupts.

config GPS_SIM_THREAD_STACK_SIZE
	int "Trigger thread stack size"
	depends on GPS_SIM_TRIGGER
	default 512
	help
	  Stack size of thread used by the driver to handle interrupts.

endif #GPS_SIM_TRIGGER

endif #GPS_SIM
```

## lib/health_monitor/Kconfig
```kconfig
#
# Copyright (c) 2025 Nordic Semiconductor
#
# SPDX-License-Identifier: LicenseRef-Nordic-5-Clause
#


menuconfig HEALTH_MONITOR
	bool "Health Monitor"
	help
	  Enable Health Monitor, a system that constantly monitors Server state
	  and periodically reports it to the Client.

if HEALTH_MONITOR

config HEALTH_MONITOR_RAPORT_PERIOD
	int "Health Monitor raport period [ms]"
	default 60000
	help
	  Default interval of sending health raport to the client expressed in milliseconds.

config HEALTH_MONITOR_HEALTHCHECK_PERIOD
	int "Health Monitor health check period [ms]"
	default 1000
	help
	  Configures how often health check task should be run.


config HEALTH_MONITOR_SRP_TIMEOUT
	int "SRP registration timeout [s]"
	default 300
	help
	  If SRP registrations are not complete after the given time event is generated.
	  0 for immediate notification, negative to disable.

config HEALTH_MONITOR_SINGLETON_LEADER_TIMEOUT
	int "Singleton Leader timeout [s]"
	default 20
	help
	  If state changes to Leader with no connection to other devices for the given time event is generated.
	  0 for immediate notification, negative to disable.

module = HEALTH_MONITOR
module-str = health_monitor
source "${ZEPHYR_BASE}/subsys/logging/Kconfig.template.log_config"

endif # NRF_PS_SERVER_HEALTH_MONITOR
```

## lib/hw_id/Kconfig
```kconfig
#
# Copyright (c) 2022 Nordic Semiconductor
#
# SPDX-License-Identifier: LicenseRef-Nordic-5-Clause
#

menuconfig HW_ID_LIBRARY
	bool "Hardware ID"
	select HWINFO
	help
	  Provides a unified interface for fetching a unique device ID from hardware.

if HW_ID_LIBRARY

choice HW_ID_LIBRARY_SOURCE
	prompt "HW ID source type"
	default HW_ID_LIBRARY_SOURCE_DEVICE_ID

config HW_ID_LIBRARY_SOURCE_IMEI
	bool "IMEI"
	depends on NRF_MODEM_LIB

config HW_ID_LIBRARY_SOURCE_UUID
	bool "UUID"
	depends on MODEM_JWT
	help
	  This option requires modem firmware v1.3.0 or higher.

config HW_ID_LIBRARY_SOURCE_BLE_MAC
	bool "BLE MAC address"
	depends on BT

config HW_ID_LIBRARY_SOURCE_NET_MAC
	bool "network MAC address"
	depends on NETWORKING

config HW_ID_LIBRARY_SOURCE_DEVICE_ID
	bool "Device ID"
	depends on HWINFO

endchoice # HW_ID_LIBRARY_SOURCE

endif # HW_ID_LIBRARY
```

## lib/hw_unique_key/Kconfig
```kconfig
#
# Copyright (c) 2021 Nordic Semiconductor ASA
#
# SPDX-License-Identifier: LicenseRef-Nordic-5-Clause
#

config HW_UNIQUE_KEY_SRC
	bool
	default y if HW_UNIQUE_KEY || HW_UNIQUE_KEY_LOAD
	depends on !ARM_NONSECURE_FIRMWARE
	help
	  This is true whenever hw_unique_key source files are included in the
	  build.

config HW_UNIQUE_KEY_LOAD
	bool "Load Hardware Unique key on boot"
	depends on HAS_HW_NRF_ACL
	depends on HAS_HW_NRF_CC310
	depends on NRF_CC3XX_PLATFORM
	select FPROTECT
	imply NRFX_NVMC
	help
	  Use this on devices with no KMU. Enable this in the immutable
	  bootloader to load the HUK from the allocated flash area
	  "hw_unique_key_partition" and lock the flash area so no subsequent
	  code can read it.
	  The code allows the app to write a (typically random) key to the flash
	  area on the first clean boot. On subsequent boots, the bootloader
	  will fail if no key is present.

config HW_UNIQUE_KEY_SUPPORTED
	bool
	default y if HAS_HW_NRF_CC3XX

config HW_UNIQUE_KEY
	bool "Hardware Unique Keys (HUK)"
	depends on HW_UNIQUE_KEY_SUPPORTED
	depends on NRF_CC3XX_PLATFORM || BUILD_WITH_TFM
	depends on NRF_SECURITY
	depends on MPU_ALLOW_FLASH_WRITE || BUILD_WITH_TFM
	depends on !BUILD_WITH_TFM || TFM_CRYPTO_BUILTIN_KEYS
	select FPROTECT if HAS_HW_NRF_ACL
	imply NRFX_NVMC if HAS_HW_NRF_ACL
	default y if BUILD_WITH_TFM
	help
	  This option will load the Hardware Unique Key (HUK) in the KDR
	  registers of the CryptoCell peripheral and sets the LCS. It will also
	  lock its flash page so that it's not accesible by the CPU until the
	  next reboot.

if HW_UNIQUE_KEY

config HW_UNIQUE_KEY_RANDOM
	bool "Enable writing random HW Unique Keys"
	depends on MAIN_STACK_SIZE >= 2048 || BUILD_WITH_TFM
	default y if BUILD_WITH_TFM
	help
	  Enable the hw_unique_key_write_random() function which utilizes the
	  NRF_CC3XX_PLATFORM to get random numbers.
	  Disable to save space.
endif

config HW_UNIQUE_KEY_PARTITION_SIZE
	hex
	default 0 if !HAS_HW_NRF_ACL
	default FPROTECT_BLOCK_SIZE
	help
	  Size of the flash page for storing the HUK.
	  Only needed when there is no KMU for storing keys (nRF52840).
```

## lib/identity_key/Kconfig
```kconfig
#
# Copyright (c) 2022 Nordic Semiconductor ASA
#
# SPDX-License-Identifier: LicenseRef-Nordic-5-Clause
#

menuconfig IDENTITY_KEY
	bool "Identity key support"
	depends on NRF_CC3XX_PLATFORM
	depends on NRF_SECURITY
	depends on !TRUSTED_EXECUTION_NONSECURE
	depends on MAIN_STACK_SIZE >= 2048
	depends on ASSERT
	help
	  This option adds support for an identity key stored in the KMU.
	  The key is stored in an encrypted form and is decrypted
	  by the identity key APIs.
	  The identity key is an ECC secp256r1 key pair.

if IDENTITY_KEY

config IDENTITY_KEY_RANDOM
	bool "Enable writing random Identity Keys"
	select PSA_WANT_ALG_ECDSA # Needed to set implicit config PSA_WANT_KEY_TYPE_ECC_KEY_PAIR
	select PSA_WANT_ECC_SECP_R1_256
	help
	  Enable the identity_key_write_random() function.
	  This uses the PSA APIs to generate a random identity key.
	  Disable to save space.

config IDENTITY_KEY_DUMMY
	bool "Write a dummy identity key (not for production)"
	help
	  This option adds support for writing a dummy identity key in an encrypted
	  form in the KMU. This option should only be enabled for debugging and
	  testing purposes.

endif # IDENTITY_KEY
```
