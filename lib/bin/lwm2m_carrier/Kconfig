## lib/contin_array/Kconfig
```kconfig
# Continuous Array creator
#
# Copyright (c) 2022 Nordic Semiconductor
#
# SPDX-License-Identifier: LicenseRef-Nordic-5-Clause
#

config CONTIN_ARRAY
	bool "Continuous array library"
	help
		Enable continuous array library

if CONTIN_ARRAY

module = CONTIN_ARRAY
module-str = Continuous array
source "${ZEPHYR_BASE}/subsys/logging/Kconfig.template.log_config"

endif #CONTIN_ARRAY
```

## lib/cpuconf/Kconfig
```kconfig
#
# Copyright (c) 2025 Nordic Semiconductor ASA
#
# SPDX-License-Identifier: LicenseRef-Nordic-5-Clause
#

config IRONSIDE_SE_CPUCONF
	bool "CPUCONF"
	depends on SOC_NRF54H20_CPUAPP
	select NRF_IRONSIDE_CALL
```

## lib/data_fifo/Kconfig
```kconfig
#
# Copyright (c) 2023 Nordic Semiconductor
#
# SPDX-License-Identifier: LicenseRef-Nordic-5-Clause
#

config DATA_FIFO
	bool "data first-in first-out library"
	help
	  Enable the data first-in first-out library

if DATA_FIFO

module = DATA_FIFO
module-str = Data first-in first-out
source "${ZEPHYR_BASE}/subsys/logging/Kconfig.template.log_config"

endif #DATA_FIFO
```

## lib/date_time/Kconfig
```kconfig
#
# Copyright (c) 2020 Nordic Semiconductor ASA
#
# SPDX-License-Identifier: LicenseRef-Nordic-5-Clause
#

menuconfig DATE_TIME
	bool "Date time library"
	select POSIX_CLOCK

if DATE_TIME

config DATE_TIME_AUTO_UPDATE
	bool "Trigger date-time update when LTE is connected"
	select AT_MONITOR if DATE_TIME_MODEM
	default y if (DATE_TIME_MODEM || DATE_TIME_NTP)
	help
	  Date-time update is triggered automatically when the LTE network becomes available.

config DATE_TIME_UPDATE_INTERVAL_SECONDS
	int "Date time update interval, in seconds"
	default 14400
	help
	  Setting this option to 0 disables sequential date time updates.

config DATE_TIME_TOO_OLD_SECONDS
	int "After which time current date time is considered too old, in seconds"
	default 3600
	help
	  If the library is triggered to perform date time update or a notification provides it
	  outside of the periodic date time updates, it will be applied if previous update was
	  done earlier than given number of seconds ago.
	  This must be smaller than or equal to DATE_TIME_UPDATE_INTERVAL_SECONDS.

config DATE_TIME_MODEM
	bool "Get date time from the nRF9160 onboard modem"
	depends on NRF_MODEM_LIB
	depends on LTE_LINK_CONTROL
	default y

config DATE_TIME_NTP
	bool "Get date time from NTP servers"
	select SNTP
	default y

config DATE_TIME_THREAD_STACK_SIZE
	int "Stack size of the thread maintaining date time"
	default 1280

config DATE_TIME_NTP_QUERY_TIME_SECONDS
	int "Duration in which the library will query for NTP time, in seconds"
	default 5

module=DATE_TIME
module-dep=LOG
module-str=Date time module
source "${ZEPHYR_BASE}/subsys/logging/Kconfig.template.log_config"

endif # DATE_TIME
```

## lib/debugmon/Kconfig
```kconfig
#
# Copyright (c) 2019 Nordic Semiconductor ASA
#
# SPDX-License-Identifier: LicenseRef-Nordic-5-Clause
#

config DEBUG_MONITOR
	bool "SEGGER debug monitor implementation"
```

## lib/dfu_target_uart_host/Kconfig
```kconfig
#
# Copyright (c) 2022 Nordic Semiconductor ASA
#
# SPDX-License-Identifier: LicenseRef-Nordic-5-Clause
#

menu "UART DFU host library"

config DFU_TARGET_UART_HOST
	bool "UART DFU library"
	depends on DFU_TARGET
	depends on DFU_TARGET_MCUBOOT
	depends on SERIAL
	depends on UART_INTERRUPT_DRIVEN
	select RING_BUFFER

if DFU_TARGET_UART_HOST

config DFU_TARGET_UART_HOST_HANDLER_STACK_SIZE
	int "Thread stack size"
	default 512

config DFU_TARGET_UART_HOST_HANDLER_PRIORITY
	int "Thread priority"
	default 4

config DFU_TARGET_UART_HOST_IN_BUFFER_SIZE
	int "Input buffer size"
	default 4096

config DFU_TARGET_UART_HOST_OUT_BUFFER_SIZE
	int "Output buffer size"
	default 128

module=DFU_TARGET_UART_HOST
module-dep=LOG
module-str=Device Firmware Upgrade using UART
source "${ZEPHYR_BASE}/subsys/logging/Kconfig.template.log_config"

endif # DFU_TARGET_UART_HOST

endmenu
```

## lib/dk_buttons_and_leds/Kconfig
```kconfig
#
# Copyright (c) 2018 Nordic Semiconductor
#
# SPDX-License-Identifier: LicenseRef-Nordic-5-Clause
#

menuconfig DK_LIBRARY
	bool "Button and LED Library for Nordic DKs"
	select GPIO

if DK_LIBRARY

config DK_LIBRARY_BUTTON_SCAN_INTERVAL
	int "Scanning interval of buttons in milliseconds"
	default 10

config DK_LIBRARY_DYNAMIC_BUTTON_HANDLERS
	bool "Enable the runtime assignable button handler API"
	default y

module = DK_LIBRARY
module-str = DK library
source "${ZEPHYR_BASE}/subsys/logging/Kconfig.template.log_config"

config DK_LIBRARY_SHELL
	bool "DK_LIBRARY SHELL"
	depends on SHELL
	help
	  DK_LIBRARY shell allows to simulate button press

endif # DK_LIBRARY
```

## lib/dtm_twowire/Kconfig
```kconfig
#
# Copyright (c) 2026 Nordic Semiconductor ASA
#
# SPDX-License-Identifier: LicenseRef-Nordic-5-Clause
#

menuconfig DTM_TWOWIRE_TO_HCI
	bool "DTM 2-wire to HCI conversion library"

if DTM_TWOWIRE_TO_HCI

config DTM_TWOWIRE_TO_HCI_RECEIVER_TEST_VERSION
	int "HCI_LE_Receiver_Test command version"
	range 1 3
	default 3 if BT_CTLR_DTM_HCI_RX_V3
	default 2
	help
		Selects the version of the HCI_LE_Receiver_Test command to generate,
		as specified in the Bluetooth Core Specification 6.2 Vol 4, Part E, 7.8.28.

config DTM_TWOWIRE_TO_HCI_TRANSMITTER_TEST_VERSION
	int "HCI_LE_Transmitter_Test command version"
	range 1 4
	default 4 if BT_CTLR_DTM_HCI_TX_V4
	default 3 if BT_CTLR_DTM_HCI_TX_V3
	default 2
	help
		Selects the version of the HCI_LE_Transmitter_Test command to generate,
		as specified in the Bluetooth Core Specification 6.2 Vol 4, Part E, 7.8.29.

module=DTM_TWOWIRE_TO_HCI
module-dep=LOG
module-str= DTM 2-wire to HCI conversion library
source "$(ZEPHYR_BASE)/subsys/logging/Kconfig.template.log_config"

endif # DTM_TWOWIRE_TO_HCI
```

## lib/edge_impulse/Kconfig
```kconfig
#
# Copyright (c) 2020 Nordic Semiconductor ASA
#
# SPDX-License-Identifier: LicenseRef-Nordic-5-Clause
#

menuconfig EDGE_IMPULSE
	bool "Enable Edge Impulse"
	depends on CPP
	depends on STD_CPP11
	depends on !FP16
	select REQUIRES_FULL_LIBCPP
	imply FPU
	imply CBPRINTF_FP_SUPPORT
	help
	  Enable Edge Impulse library.

if EDGE_IMPULSE

config APP_LINK_WITH_EDGE_IMPULSE
	bool "Link 'app' with Edge Impulse"
	depends on !EI_WRAPPER
	default y
	help
	  Add Edge Impulse header files to the 'app' include path. It may be
	  disabled if the include paths for Edge Impulse are causing aliasing
	  issues for 'app'.

config EDGE_IMPULSE_DOWNLOAD_ALWAYS
	bool "Download Edge Impulse library on each build"
	default y
	help
	  Request the build system to download the Edge Impulse library on each
	  build. This results in the build target to always be considered out
	  of date.
	  If the re-downloaded zip has no code changes, then no re-building of
	  source is performed and only download of zip file will be done.

config EDGE_IMPULSE_URI
	string "Edge Impulse library URI"
	default ''
	help
	  Specify URI used to access archive with Edge Impulse library.
	  The library will be downloaded into build directory. Make sure
	  to specify the HTTP API key header as EI_API_KEY_HEADER variable
	  during build if the HTTP server uses it.
	  You can also specify absolute file path of a local file.

endif # EDGE_IMPULSE

menuconfig EI_WRAPPER
	bool "Enable Edge Impulse wrapper"
	depends on EDGE_IMPULSE
	default y
	help
	  Enable Edge Impulse library wrapper in NCS.

if EI_WRAPPER

config EI_WRAPPER_DATA_BUF_SIZE
	int "Size of input data buffer"
	default 2500
	help
	  The buffer is used to store input data for the Edge Impulse library.
	  Size of the buffer is expressed as number of floats.

config EI_WRAPPER_THREAD_STACK_SIZE
	int "Size of EI wrapper thread stack"
	default 4096
	help
	  Edge Impulse library processes the data in a low-priority thread.
	  The stack size needs to be sufficient for used impulse.

config EI_WRAPPER_THREAD_PRIORITY
	int "Priority of EI wrapper thread"
	default 5
	help
	  It is recommended to use preemptive thread priority to make sure
	  that the thread will not block other operations in system for
	  a long time.

config EI_WRAPPER_PROFILING
	bool "Run Edge Impulse library with profiling logging"
	depends on LOG
	help
	  EI wrapper provides logs with execution time in ms of the classifier
	  with detailed information about time spent in the following stages:
	  sampling, dsp, classification, and anomaly.

config EI_WRAPPER_DEBUG_MODE
	bool "Run Edge Impulse library in debug mode"
	imply NEWLIB_LIBC_FLOAT_PRINTF
	help
	  Enables additional log information from Edge Impulse library.

module=EI_WRAPPER
module-dep=LOG
module-str=Edge Impulse NCS wrapper
source "${ZEPHYR_BASE}/subsys/logging/Kconfig.template.log_config"

endif # EI_WRAPPER
```

## lib/fatal_error/Kconfig
```kconfig
#
# Copyright (c) 2019 Nordic Semiconductor ASA
#
# SPDX-License-Identifier: LicenseRef-Nordic-5-Clause
#

menuconfig RESET_ON_FATAL_ERROR
	bool "Reset on fatal error"
	default y if !DEBUG && !BOARD_NATIVE_POSIX && !QEMU_TARGET && !TEST
	select REBOOT
	help
	  Enable using the fatal error handler defined for Nordic DKs.
	  When it is used, the system restarts after a fatal error.

if RESET_ON_FATAL_ERROR

module = FATAL_ERROR
module-str = Fatal error
source "${ZEPHYR_BASE}/subsys/logging/Kconfig.template.log_config"

endif # RESET_ON_FATAL_ERROR
```

## lib/fem_al/Kconfig
```kconfig
#
# Copyright (c) 2023 Nordic Semiconductor
#
# SPDX-License-Identifier: LicenseRef-Nordic-5-Clause
#

config FEM_AL_LIB
	bool "FEM Abstraction Layer library"
	default n

if FEM_AL_LIB

config FEM
	bool "Front-end module (FEM) support"
	default y
	select MPSL
	select MPSL_FEM_ONLY
	depends on MPSL_FEM_ANY_SUPPORT
	help
	  Controls if front-end module (FEM) is to be configured and enabled.
	  Default type of FEM to use depends on which compatible nodes are in devicetree.

if FEM

# Helper symbol for detecting nRF21540 Front-end module.
config NRF21540_FEM
	bool
	default y
	select MPSL_FEM_NRF21540_RUNTIME_PA_GAIN_CONTROL
	depends on MPSL_FEM_NRF21540_GPIO || MPSL_FEM_NRF21540_GPIO_SPI

config MPSL_FEM_NRF21540_TX_GAIN_DB
	depends on NRF21540_FEM
	default MPSL_FEM_NRF21540_TX_GAIN_DB_POUTA

choice MPSL_FEM_CHOICE
	depends on MPSL_FEM_NRF21540_GPIO_SPI_SUPPORT
	default MPSL_FEM_NRF21540_GPIO_SPI
endchoice

if MPSL_FEM_SIMPLE_GPIO

# The Skyworks front-end module devices specific configuration.
choice SKYWORKS_MODE
	prompt "Skyworks front-end module mode"
	default SKYWORKS_LOW_POWER_MODE

config SKYWORKS_LOW_POWER_MODE
	bool "Low power-mode"
	help
	  Skywork front-end module low-power mode or mode selection is handled by user hardware.

config SKYWORKS_HIGH_POWER_MODE
	bool "High power-mode"
	depends on $(dt_nodelabel_has_prop,nrf_radio_fem,chl-gpios)
	help
	  Skyworks front-end module high-power mode.

config SKYWORKS_BYPASS_MODE
	bool "Bypass mode"
	depends on $(dt_nodelabel_has_prop,nrf_radio_fem,cps-gpios)
	help
	  Skyworks front-end module bypass mode. Bypass path for the integrated LNA.
	  For more details check your device product specification.

endchoice # SKYWORKS_MODE

endif # MPSL_FEM_SIMPLE_GPIO
endif # FEM
endif # FEM_AL_LIB
```

## lib/flash_patch/Kconfig
```kconfig
#
# Copyright (c) 2019 Nordic Semiconductor ASA
#
# SPDX-License-Identifier: LicenseRef-Nordic-5-Clause
#

config DISABLE_FLASH_PATCH
	bool "Disable Cortex-M4 Flash Patch capabilities"
	depends on SOC_NRF52840 || SOC_NRF52833
	depends on REBOOT
	help
	  This disables the Flash Patch and Breakpoint (FPB) unit.
	  The flash patch can be used by malicious code to circumvent secure
	  boot checks. Note that disabling the FPB also disables
	  breakpoints.

config FLASH_PATCH_WARN
	bool
	depends on SOC_NRF52840 || SOC_NRF52833
	depends on !DISABLE_FLASH_PATCH
	depends on IS_SECURE_BOOTLOADER || MCUBOOT
	default y
```

## lib/fprotect/Kconfig
```kconfig
#
# Copyright (c) 2019 Nordic Semiconductor ASA
#
# SPDX-License-Identifier: LicenseRef-Nordic-5-Clause
#

if X86

config NRF_SPU_FLASH_REGION_SIZE
	hex
	default 0x1000
	help
	  Redefinition for the benefit of qemu_x86

config NRF_MPU_FLASH_REGION_SIZE
	hex
	default 0x1000
	help
	  Redefinition for the benefit of qemu_x86

config NRF_BPROT_FLASH_REGION_SIZE
	hex
	default 0x1000
	help
	  Redefinition for the benefit of qemu_x86

config NRF_ACL_FLASH_REGION_SIZE
	hex
	default 0x1000
	help
	  Redefinition for the benefit of qemu_x86

endif

# Workaround for not being able to have commas in macro arguments
DT_ZEPHYR_FLASH := zephyr,flash
DT_CHOSEN_ZEPHYR_FLASH := $(dt_chosen_path,$(DT_ZEPHYR_FLASH))

# This option is used even when FPROTECT is disabled so we add it unconditionally.
config FPROTECT_BLOCK_SIZE
	hex
	default NRF_SPU_FLASH_REGION_SIZE if CPU_HAS_NRF_IDAU
	default NRF_MPU_FLASH_REGION_SIZE if HAS_HW_NRF_MPU
	default NRF_BPROT_FLASH_REGION_SIZE if HAS_HW_NRF_BPROT
	default NRF_ACL_FLASH_REGION_SIZE if HAS_HW_NRF_ACL
	default NRF_RRAM_REGION_SIZE_UNIT if SOC_SERIES_NRF54L && FLASH
	default $(dt_node_int_prop_hex,$(DT_CHOSEN_ZEPHYR_FLASH),erase-block-size)

menuconfig FPROTECT
	bool "FPROTECT"
	depends on SOC_FAMILY_NORDIC_NRF
	depends on !(SOC_SERIES_NRF54L && IS_SECURE_BOOTLOADER)
	depends on !SOC_SERIES_NRF54H
	default y if MCUBOOT && (!SOC_SERIES_NRF54L || (SOC_SERIES_NRF54L && MCUBOOT_MCUBOOT_IMAGE_NUMBER = -1))
	#enabled for nRF54L SoC's when MCUboot is the only one bootloader
	select NRFX_RRAMC if SOC_SERIES_NRF54L
	#allow utilization of both nRF54L SoC's RRAMC regions.
	imply FPROTECT_ALLOW_COMBINED_REGIONS if MCUBOOT && SOC_SERIES_NRF54L && MCUBOOT_MCUBOOT_IMAGE_NUMBER = -1
	help
	  Enable the software library FPROTECT that may or may not be used
	  by other systems to protect flash from writes and possibly also
	  reads. Does not protect against execution.
	  May use the HW peripherals BPROT, ACL, or SPU to achieve this.

if FPROTECT

config FPROTECT_APP
	bool "Lock image partition using FPROTECT"
	help
	  The flash partition which contains the image hex file should never be
	  written to. Set this option to enable a module which will perform
	  a 'fprotect_area' operation during system initialization before
	  the kernel is initialized. This will ensure that the appropriate
	  locking mechanism is configured to not allow write operations to the
	  memory partition which contains the image hex file. Note that this
	  imposes a requirement to the start address and size of the image
	  hex file: they must both be aligned with the locking granularity
	  of the locking mechanism available for the current hardware. See
	  'FPROTECT_BLOCK_SIZE' and set the partition sizes in the system so
	  that this is aligned with the 'app' partition. The start and size
	  of the 'app' partition can be found by either inspecting the file
	  'pm_config.h' in your build directory, or by invoking the
	  'partition_manager_report' target.

config FPROTECT_ALLOW_COMBINED_REGIONS
	bool "Use both RRAMC_regions"
	depends on SOC_SERIES_NRF54L && MCUBOOT
	help
	  Intended for use with NRF54L series devices. Gives total of 62kB
	  lockable memory.

endif # FPROTECT
```

## lib/gcf_sms/Kconfig
```kconfig
# Copyright (c) 2022 Nordic Semiconductor
#
# SPDX-License-Identifier: LicenseRef-Nordic-5-Clause
#

menuconfig GCF_SMS
	bool "Custom SMS commands for GCF certification"
	depends on SOC_SERIES_NRF91X
	select AT_CUSTOM_CMD
	help
	  Add implementations in the application for the following AT commands:
	  AT+CPMS
	  AT+CSMS
	  AT+CSCA
	  AT+CSCS
	  AT+CMGD
	  AT+CMSS
	  AT+CMGW
	  AT+CMGF=0
	  AT+CMMS

if GCF_SMS

module = GCF_SMS
module-str = GCF SMS Lib
source "subsys/logging/Kconfig.template.log_config"

endif # GCF_SMS
```
