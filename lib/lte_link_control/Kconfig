## lib/music_led_sync/Kconfig
```kconfig
# Music Led Synchronization
#
# Copyright (c) 2022 Nordic Semiconductor
#
# SPDX-License-Identifier: LicenseRef-Nordic-5-Clause
#

menu "Music LED Synchronization"

config MUSIC_LED_SYNC
	depends on PWM && CMSIS_DSP_TRANSFORM
	bool "Enable synchronization of RGB LED to music"
	default n

menu "FFT"

choice FFT_SAMPLE_SIZE
	prompt "Select sample size for FFT"
	default FFT_SAMPLE_SIZE_512
	help
		CMSIS FFT supports sample size of 32, 64, 128, 256, 512,
		 1024, 2048, 4096 and 8192.

config FFT_SAMPLE_SIZE_32
	bool "FFT sample size 32"

config FFT_SAMPLE_SIZE_64
	bool "FFT sample size 64"

config FFT_SAMPLE_SIZE_128
	bool "FFT sample size 128"

config FFT_SAMPLE_SIZE_256
	bool "FFT sample size 256"

config FFT_SAMPLE_SIZE_512
	bool "FFT sample size 512"

config FFT_SAMPLE_SIZE_1024
	bool "FFT sample size 1024"

config FFT_SAMPLE_SIZE_2048
	bool "FFT sample size 2048"

config FFT_SAMPLE_SIZE_4096
	bool "FFT sample size 4096"

config FFT_SAMPLE_SIZE_8192
	bool "FFT sample size 8192"
endchoice

config FFT_SAMPLE_SIZE
	int
	default 32 if FFT_SAMPLE_SIZE_32
	default 64 if FFT_SAMPLE_SIZE_64
	default 128 if FFT_SAMPLE_SIZE_128
	default 256 if FFT_SAMPLE_SIZE_256
	default 512 if FFT_SAMPLE_SIZE_512
	default 1024 if FFT_SAMPLE_SIZE_1024
	default 2048 if FFT_SAMPLE_SIZE_2048
	default 4096 if FFT_SAMPLE_SIZE_4096
	default 8192 if FFT_SAMPLE_SIZE_8192
	help
		Sample size for FFT

config FFT_FLAG_INVERSE_TRANSFORM
	int "Flag for transform direction"
	range 0 1
	default 0
	help
		0 for FFT and 1 for IFFT

config FFT_FLAG_BIT_REVERSAL
	int "Flag for bit reversal of output"
	range 0 1
	default 1
	help
		0 to disable and 1 to enable bitreversal

config RGB_RED_FREQ_BIN_RANGE
	int "Freq range for RED RGB LED"
	range 0 256
	default 15

config RGB_GREEN_FREQ_BIN_RANGE
	int "Freq range for GREEN RGB LED"
	range 0 256
	default 150

config RGB_BLUE_FREQ_BIN_RANGE
	int "Freq range for BLUE RGB LED"
	range 0 256
	default 256

endmenu # FFT

config PCM_NUM_BYTES_MONO
	int "Number of bytes for MONO PCM signal"
	range 0 1920
	default 960

config PCM_NUM_BYTES_STEREO
	int "Number of bytes for STEREO PCM signal"
	range 0 3920
	default 1920

config MUSIC_LED_SYNC_STACK_SIZE
	int "Stack size for music color sync module"
	default 3000

config MUSIC_LED_SYNC_THREAD_PRIO
	int "Priority for music color sync thread"
	default 7

config LOG_MUSIC_LED_SYNC_LEVEL
	int "Log level for music_led_sync module"
	default 3

endmenu # Music LED Synchronization
```

## lib/nrf9160_timestamp/Kconfig
```kconfig
#
# Copyright (c) 2020 Nordic Semiconductor ASA
#
# SPDX-License-Identifier: LicenseRef-BSD-5-Clause-Nordic
#

config NRF9160_TIMESTAMP
	bool "nRF9160 timestamp module"
	select AT_CMD
	select SNTP

if NRF9160_TIMESTAMP

config NRF9160_TIMESTAMP_TIME_UPDATE_INTERVAL
	int "Time update interval"
	default 3600

config NRF9160_TIMESTAMP_TIME_FROM_MODEM
	bool "Get time from the nRF9160 onboard modem every update interval"
	default y if BOARD_NRF9160_PCA10090NS || BOARD_NRF9160_PCA20035NS

config NRF9160_TIMESTAMP_NTP_THREAD_SIZE
	int "Stack size of the thread maintaining time from NTP servers"
	default 2048

module=NRF9160_TIMESTAMP
module-dep=LOG
module-str=nRF9160 timestamp module
source "${ZEPHYR_BASE}/subsys/logging/Kconfig.template.log_config"

endif # NRF9160_TIMESTAMP
```

## lib/nrf_802154_callbacks_dispatcher/Kconfig
```kconfig
# Copyright (c) 2026 Nordic Semiconductor
#
# SPDX-License-Identifier: LicenseRef-Nordic-5-Clause
#

config NRF_802154_CALLBACKS_DISPATCHER
	bool "nRF 802.15.4 callbacks dispatcher [EXPERIMENTAL]"
	select EXPERIMENTAL
	help
	  This option enables the nRF 802.15.4 callbacks dispatcher.
	  It is used to dispatch callbacks from the nRF 802.15.4 radio driver
	  to the appropriate client. This feature is useful if your Application
	  needs to use more than one nRF 802.15.4 radio driver client and each
	  client has different callbacks implementations.

config NRF_802154_CALLBACKS_DISPATCHER_INIT_PRIORITY
	int "nRF 802.15.4 callbacks dispatcher init priority"
	default 80
	help
	  This option sets the init priority for the nRF 802.15.4 callbacks dispatcher.
```

## lib/nrf_modem_lib/Kconfig
```kconfig
# Copyright (c) 2018 Nordic Semiconductor
#
# SPDX-License-Identifier: LicenseRef-Nordic-5-Clause
#

# Must be sourced before NRF_MODEM_LIB so it can be used as a dependency
# without creating a circular reference.
rsource "zephyr_modem/Kconfig"

menuconfig NRF_MODEM_LIB
	bool "Modem library"
	depends on (SOC_SERIES_NRF91 && TRUSTED_EXECUTION_NONSECURE) || SOC_NRF9280_CPUAPP \
		|| NRF_MODEM_LIB_ZEPHYR_MODEM
	select NRF_MODEM if !NRF_MODEM_LIB_ZEPHYR_MODEM
	select EXPERIMENTAL if SOC_NRF9280_CPUAPP
	imply NET_SOCKETS_OFFLOAD if !NRF_MODEM_LIB_ZEPHYR_MODEM
	imply NET_IPV4
	imply NET_IPV6
	# The modem must be turned on to achieve low power consumption.
	# But disable it for ZTEST's as some tests have HW
	# resource-conflicts with NRF_MODEM_LIB.
	default y if !ZTEST
	help
	  Use Nordic Modem library.

if NRF_MODEM_LIB

rsource "Kconfig.modemlib"

endif # NRF_MODEM_LIB
```

## lib/nrf_modem_lib/Kconfig.modemlib
```kconfig
# Copyright (c) 2022 Nordic Semiconductor
#
# SPDX-License-Identifier: LicenseRef-Nordic-5-Clause
#

# Redefine this symbol here and give it a non-zero default value
# so that the Zephyr system heap is enabled, the offloading layer
# depends on it
config HEAP_MEM_POOL_SIZE
	int
	default 512

config NRF_MODEM_LIB_SYS_INIT
	bool "Initialize during SYS_INIT"
	default y
	help
	  Initialize the Modem library automatically during the SYS_INIT sequence.
	  Please note that initialization is synchronous and can take up to one
	  minute in case the modem firmware is updated.

menuconfig NRF_MODEM_LIB_TRACE
	bool "Tracing" if !NRF_MODEM_LIB_TRACE_ENABLED
	default y if NRF_MODEM_LIB_TRACE_ENABLED
	help
	  When enabled, a portion of RAM (called Trace region) will be shared with the modem to receive modem's trace data.
	  The size of the Trace region is defined by the NRF_MODEM_LIB_SHMEM_TRACE_SIZE option.
	  Trace data is output on the chosen trace backend.

if NRF_MODEM_LIB_TRACE

# Add trace backends
rsource "trace_backends/Kconfig"

config NRF_MODEM_LIB_TRACE_STACK_SIZE
	int "Modem trace thread stack size"
	default 768 if SIZE_OPTIMIZATIONS
	default 1024

config NRF_MODEM_LIB_TRACE_LEVEL_OVERRIDE
	bool "Override trace level"
	default y

if NRF_MODEM_LIB_TRACE_LEVEL_OVERRIDE

choice NRF_MODEM_LIB_TRACE_LEVEL_CHOICE
	prompt "Trace level"

config NRF_MODEM_LIB_TRACE_LEVEL_FULL
	bool "Full"
config NRF_MODEM_LIB_TRACE_LEVEL_LTE_AND_IP
	bool "IP and LTE"
config NRF_MODEM_LIB_TRACE_LEVEL_IP_ONLY
	bool "IP only"
config NRF_MODEM_LIB_TRACE_LEVEL_COREDUMP_ONLY
	bool "Coredump only"
config NRF_MODEM_LIB_TRACE_LEVEL_OFF
	bool "Off"

endchoice

config NRF_MODEM_LIB_TRACE_LEVEL
	int
	default 0 if NRF_MODEM_LIB_TRACE_LEVEL_OFF
	default 1 if NRF_MODEM_LIB_TRACE_LEVEL_COREDUMP_ONLY
	default 2 if NRF_MODEM_LIB_TRACE_LEVEL_FULL
	default 4 if NRF_MODEM_LIB_TRACE_LEVEL_IP_ONLY
	default 5 if NRF_MODEM_LIB_TRACE_LEVEL_LTE_AND_IP

endif # NRF_MODEM_LIB_TRACE_LEVEL_OVERRIDE

config NRF_MODEM_LIB_TRACE_THREAD_PRIO_OVERRIDE
	bool "Override trace thread priority"

config NRF_MODEM_LIB_TRACE_THREAD_PRIO
	int "Priority of the trace processing thread"
	depends on NRF_MODEM_LIB_TRACE_THREAD_PRIO_OVERRIDE
	default 0

config NRF_MODEM_LIB_TRACE_BACKEND_BITRATE
	bool "Measure trace backend bitrate"

if NRF_MODEM_LIB_TRACE_BACKEND_BITRATE

config NRF_MODEM_LIB_TRACE_BACKEND_BITRATE_PERIOD_MS
	int "Rolling interval where the bitrate is measured (millisec)"
	default 1000

config NRF_MODEM_LIB_TRACE_BACKEND_BITRATE_LOG
	depends on LOG
	bool "Log trace backend bitrate"

if NRF_MODEM_LIB_TRACE_BACKEND_BITRATE_LOG

config NRF_MODEM_LIB_TRACE_BACKEND_BITRATE_LOG_PERIOD_MS
	int "Bitrate log interval (millisec)"
	default 5000

endif # NRF_MODEM_LIB_TRACE_BACKEND_BITRATE_LOG

endif # NRF_MODEM_LIB_TRACE_BACKEND_BITRATE

config NRF_MODEM_LIB_TRACE_BITRATE_LOG
	depends on LOG
	bool "Log trace bitrate"

if NRF_MODEM_LIB_TRACE_BITRATE_LOG

config NRF_MODEM_LIB_TRACE_BITRATE_LOG_PERIOD_MS
	int "Bitrate log interval (millisec)"
	default 1000

endif # NRF_MODEM_LIB_TRACE_BITRATE_LOG

endif # NRF_MODEM_LIB_TRACE

menu "Interrupt priorities"

DT_IPC := $(dt_nodelabel_path,ipc)

config NRF_MODEM_LIB_IPC_IRQ_PRIO_OVERRIDE
	bool "Override IPC IRQ priority"
	help
	  Override the IPC IRQ priority set in device tree

config NRF_MODEM_LIB_IPC_IRQ_PRIO
	int "IPC IRQ priority" if NRF_MODEM_LIB_IPC_IRQ_PRIO_OVERRIDE
	default $(dt_node_array_prop_int,$(DT_IPC),interrupts,1) if !NRF_MODEM_LIB_IPC_IRQ_PRIO_OVERRIDE
endmenu

choice NRF_MODEM_LIB_ON_FAULT
	prompt "Action on modem fault"
	default NRF_MODEM_LIB_ON_FAULT_DO_NOTHING

config NRF_MODEM_LIB_ON_FAULT_DO_NOTHING
	bool "Do nothing"
	help
	  Let the fault handler log the fault and return.

config NRF_MODEM_LIB_ON_FAULT_RESET_MODEM
	bool "Reset modem"
	help
	  Let the fault handler reset the modem.

config NRF_MODEM_LIB_ON_FAULT_APPLICATION_SPECIFIC
	bool "Application defined"
	help
	  Let the application define the fault handler function.

endchoice # NRF_MODEM_LIB_ON_FAULT

comment "Heap and buffers"

config NRF_MODEM_LIB_HEAP_SIZE
	int "Library heap size"
	default 1024
	range 512 4096
	help
	  Size of the library heap.
	  This heap is allocated from the application's RAM region.

config NRF_MODEM_LIB_SHMEM_CTRL_SIZE
	hex
	default NRF_MODEM_SHMEM_CTRL_SIZE
	help
	  Size of the shared memory area used for control structures.
	  This is a constant for a given library build, and is exported
	  by the library via NRF_MODEM_SHMEM_CTRL_SIZE.

config NRF_MODEM_LIB_SHMEM_TX_SIZE
	int "TX region size"
	range 1024 32768
	default 8192
	help
	  Size of the shared memory region owned by the application. This area holds all outgoing data
	  from the application to the modem, e.g. buffers passed to `send()`. Its size affects directly
	  the largest payload that can be sent at once, and the largest AT command that can be sent.

config NRF_MODEM_LIB_SHMEM_RX_SIZE
	int "RX region size"
	range 2488 32768
	default 8192
	help
	  Size of the shared memory region owned by the modem.
	  This area holds all incoming data from the modem, plus the modem's own control structures.

config NRF_MODEM_LIB_SHMEM_TRACE_SIZE_OVERRIDE
	bool "Custom trace region size"
	depends on NRF_MODEM_LIB_TRACE
	help
	  Override the default size of the Trace region (16384 bytes).

config NRF_MODEM_LIB_SHMEM_TRACE_SIZE
	int "Trace region size" if NRF_MODEM_LIB_SHMEM_TRACE_SIZE_OVERRIDE
	default 16384 if NRF_MODEM_LIB_TRACE
	default 0
	help
	  Size of the shared memory region used to receive modem traces.

config NRF_MODEM_LIB_SENDMSG_BUF_SIZE
	int "Size of the sendmsg intermediate buffer"
	default 128
	help
	  Size of an intermediate buffer used by `sendmsg` to repack data and
	  therefore limit the number of `sendto` calls. The buffer is created
	  in a static memory, so it does not impact stack/heap usage. In case
	  the repacked message would not fit into the buffer, `sendmsg` sends
	  each message part separately.

menuconfig NRF_MODEM_LIB_MEM_DIAG
	bool "Memory diagnostic"
	select SYS_HEAP_LISTENER
	select SYS_HEAP_RUNTIME_STATS
	help
	  Keep track of the library and shared memory heap usage.

if (NRF_MODEM_LIB_MEM_DIAG && LOG)

config NRF_MODEM_LIB_MEM_DIAG_ALLOC
	bool "Log all memory allocations"
	help
	   Log all nrf_modem_os_alloc(), nrf_modem_os_free()
	   nrf_modem_os_shm_tx_alloc() and nrf_modem_os_shm_tx_free() calls.

config NRF_MODEM_LIB_MEM_DIAG_DUMP
	bool "Periodically log shared memory and heap statistics"
	help
	  Schedule a periodic system workqueue task to print
	  the library and shared memory heap runtime statistics.

config NRF_MODEM_LIB_MEM_DIAG_DUMP_PERIOD_MS
	depends on NRF_MODEM_LIB_MEM_DIAG_DUMP
	int "Period (millisec)"
	default 20000

endif

comment "Logging"

config NRF_MODEM_LIB_LOG_FW_VERSION_UUID
	depends on LOG
	bool "Log FW version and UUID during initialization"

module = NRF_MODEM_LIB
module-str = Modem library
source "subsys/logging/Kconfig.template.log_config"

comment "Deprecated"

config NRF_MODEM_LIB_TRACE_ENABLED
	bool "Enable proprietary traces (DEPRECATED)"
	help
	  Deprecated, use NRF_MODEM_LIB_TRACE instead.
	  When enabled, a portion of RAM (called Trace region) will be shared with the modem to receive modem's trace data.
	  The size of the Trace region is defined by the NRF_MODEM_LIB_SHMEM_TRACE_SIZE option.
	  Trace data is output on the chosen trace backend.
```

## lib/nrf_modem_lib/lte_connectivity/Kconfig
```kconfig
# Copyright (c) 2023 Nordic Semiconductor
#
# SPDX-License-Identifier: LicenseRef-Nordic-5-Clause
#

menuconfig LTE_CONNECTIVITY
	bool "LTE Connectivity"
	select PDN
	select PDN_ESM_STRERROR
	select LTE_LINK_CONTROL
	depends on NET_SOCKETS_OFFLOAD
	depends on !NET_IPV6_NBR_CACHE
	depends on !NET_IPV6_MLD
	depends on NRF_MODEM_LIB_ON_FAULT_APPLICATION_SPECIFIC
	help
	  Library used to provide connectivity for nRF91 based boards via Zephyr network management.

if LTE_CONNECTIVITY

config LTE_CONNECTIVITY_WORKQUEUE_STACK_SIZE
	int "Workqueue stack size"
	default 1024
	help
	  Stack size of the internal workqueue.

config LTE_CONNECTIVITY_CONNECT_TIMEOUT_SECONDS
	int "Connect timeout in seconds"
	default 0
	help
	  Time period in seconds that the library will try to establish an LTE connection,
	  before timing out. The connect timeout can be updated by calling
	  conn_mgr_if_set_timeout(). Default value is 0 (timeout disabled).
	  When the timeout is disabled, the library relies solely on the modem's internal
	  connection handling to upkeep the connection.

config LTE_CONNECTIVITY_CONNECTION_PERSISTENCE
	bool "Connection persistency"
	default y
	help
	  Persistent connection. If the connection is lost the modem will try to reconnect
	  itself without the need for explicit calls to the network interface.
	  Persistence can be updated run-time by calling conn_mgr_if_set_flag() with
	  CONN_MGR_IF_PERSISTENT as flag parameter.

config LTE_CONNECTIVITY_AUTO_CONNECT
	bool "Auto connect"
	default y
	help
	 If this option is set the Connection Manager will automatically call connect after the
	 network interface has been brought up. This option sets the default value, the option has
	 a corresponding flag that can be set at run time by calling conn_mgr_if_set_flag().

config LTE_CONNECTIVITY_AUTO_DOWN
	bool "Auto down"
	default y
	help
	 If this option is set the Connection Manager will automatically take the network interface
	 down when it stops trying to connect. This option sets the default value, the option has
	 a corresponding flag that can be set at run time by calling conn_mgr_if_set_flag().

endif # LTE_CONNECTIVITY

module = LTE_CONNECTIVITY
module-str = LTE Connectivity
source "subsys/logging/Kconfig.template.log_config"
```
