## lib/nrf_modem_lib/lte_net_if/Kconfig
```kconfig
# Copyright (c) 2023 Nordic Semiconductor
#
# SPDX-License-Identifier: LicenseRef-Nordic-5-Clause
#

menuconfig NRF_MODEM_LIB_NET_IF
	bool "Zephyr networking API support"
	select PDN
	select PDN_ESM_STRERROR
	select LTE_LINK_CONTROL
	depends on NET_SOCKETS_OFFLOAD
	depends on !NET_IPV6_NBR_CACHE
	depends on !NET_IPV6_MLD
	depends on NRF_MODEM_LIB_ON_FAULT_APPLICATION_SPECIFIC
	help
	  Add support for controlling the nRF91 modem using Zephyr networking API.

if NRF_MODEM_LIB_NET_IF

config NRF_MODEM_LIB_NET_IF_AUTO_START
	bool "Network interface auto-start"
	help
	  If this option is enabled, the modem is automatically initialized from the main context
	  at SYS init.
	  Initialization of the modem might take some time, so bear in mind that the main context
	  will be blocked for that duration.
	  If this option is disabled the modem must be manually initialized by bringing
	  the network interface's administrative state up by calling net_if_up().

config NRF_MODEM_LIB_NET_IF_WORKQUEUE_STACK_SIZE
	int "Workqueue stack size"
	default 1024
	help
	  Stack size of the internal workqueue.

config NRF_MODEM_LIB_NET_IF_CONNECT_TIMEOUT_SECONDS
	int "Connect timeout in seconds"
	default 0
	help
	  Time period in seconds that the library will try to establish an LTE connection,
	  before timing out. The connect timeout can be updated by calling
	  conn_mgr_if_set_timeout(). Default value is 0 (timeout disabled).
	  When the timeout is disabled, the library relies solely on the modem's internal
	  connection handling to upkeep the connection.

config NRF_MODEM_LIB_NET_IF_CONNECTION_PERSISTENCE
	bool "Connection persistency"
	default y
	help
	  Persistent connection. If the connection is lost the modem will try to reconnect
	  itself without the need for explicit calls to the network interface.
	  Persistence can be updated run-time by calling conn_mgr_if_set_flag() with
	  CONN_MGR_IF_PERSISTENT as flag parameter.

config NRF_MODEM_LIB_NET_IF_AUTO_CONNECT
	bool "Auto connect"
	help
	 If this option is set the Connection Manager will automatically call connect after the
	 network interface has been brought up. This option sets the default value, the option has
	 a corresponding flag that can be set at run time by calling conn_mgr_if_set_flag().

config NRF_MODEM_LIB_NET_IF_AUTO_DOWN
	bool "Auto down"
	help
	 If this option is set the Connection Manager will automatically take the network interface
	 down when it stops trying to connect. This option sets the default value, the option has
	 a corresponding flag that can be set at run time by calling conn_mgr_if_set_flag().

config NRF_MODEM_LIB_NET_IF_DOWN_DEFAULT_LTE_DISCONNECT
	bool "Disconnect on iface down"
	help
	 If this option is set, the LTE iface will disconnect LTE instead of shutting down the
	 modem when going down. This option sets the default value for the
	 NRF_MODEM_LIB_NET_IF_DOWN connectivity option. The value can still be changed at runtime
	 by calling conn_mgr_if_set_opt().

module = NRF_MODEM_LIB_NET_IF
module-str = Modem network interface
source "subsys/logging/Kconfig.template.log_config"

endif # NRF_MODEM_LIB_NETIF
```

## lib/nrf_modem_lib/lte_net_if/Kconfig.ntn
```kconfig
#
# Copyright (c) 2023 Nordic Semiconductor ASA
#
# SPDX-License-Identifier: LicenseRef-Nordic-5-Clause
#

menuconfig NRF_MODEM_LIB_NET_IF_NTN
	bool "nRF91 LTE network interface for NTN (Non-Terrestrial Network)"
	depends on NRF_MODEM_LIB
	select CONN_MGR_CONNECTIVITY
	help
	  Enable nRF91 LTE network interface for NTN (Non-Terrestrial Network).
	  This provides a separate network interface specifically for NTN connectivity,
	  allowing applications to choose between terrestrial and non-terrestrial networks.
	  
	  This works alongside the regular LTE network interface and provides similar
	  functionality but optimized for satellite communication.

if NRF_MODEM_LIB_NET_IF_NTN

config NRF_MODEM_LIB_NET_IF_NTN_AUTO_START
	bool "Auto-start NTN interface"
	help
	  Automatically start the NTN network interface when the system starts.
	  When enabled, the NTN interface will be brought up automatically during
	  system initialization.

config NRF_MODEM_LIB_NET_IF_NTN_CONNECT_TIMEOUT_SECONDS
	int "NTN LTE connection timeout in seconds"
	range 0 86400
	default 120
	help
	  Time period (in seconds) that the connectivity layer will attempt to establish
	  an NTN LTE connection for, before timing out. If set to 0, no timeout is applied.
	  
	  NTN connections may take longer to establish than terrestrial connections
	  due to the nature of satellite communication, so a longer timeout is recommended.

config NRF_MODEM_LIB_NET_IF_NTN_CONNECTION_PERSISTENCE
	bool "NTN Connection persistence"
	default y
	help
	  When enabled, the NTN connectivity layer will attempt to keep the NTN LTE connection
	  active, even after a connection loss, by automatically re-establishing the connection.
	  
	  This is particularly useful for NTN connections where connectivity may be
	  intermittent due to satellite coverage patterns.

config NRF_MODEM_LIB_NET_IF_NTN_AUTO_CONNECT
	bool "Auto-connect for NTN interface"
	default y
	help
	  Automatically connect the NTN interface when it is brought up.
	  If disabled, the application will need to manually trigger NTN connections.

config NRF_MODEM_LIB_NET_IF_NTN_AUTO_DOWN
	bool "Auto-down for NTN interface"
	default y
	help
	  Automatically bring down the NTN interface when network connectivity is lost.
	  If disabled, the interface will remain up even without network connectivity.

config NRF_MODEM_LIB_NET_IF_NTN_DOWN_DEFAULT_LTE_DISCONNECT
	bool "Disconnect NTN LTE on interface down"
	default y
	help
	  When the NTN network interface is brought down, disconnect from NTN LTE instead
	  of shutting down the modem completely. This allows for faster re-connection
	  and preserves the ability to use other network interfaces.

config NRF_MODEM_LIB_NET_IF_NTN_BANDLOCK_ENABLE
	bool "Enable NTN band lock"
	default n
	help
	  Enable band lock for NTN mode.

if NRF_MODEM_LIB_NET_IF_NTN_BANDLOCK_ENABLE

config NRF_MODEM_LIB_NET_IF_NTN_BANDLOCK
	int "NTN band to lock to"
	default 265
	help
	  Band number to lock NTN mode to.

endif # NRF_MODEM_LIB_NET_IF_NTN_BANDLOCK_ENABLE

config NRF_MODEM_LIB_NET_IF_NTN_CHANNEL_SELECT_ENABLE
	bool "Enable NTN channel select"
	default n
	help
	  Enable channel selection for NTN mode.

if NRF_MODEM_LIB_NET_IF_NTN_CHANNEL_SELECT_ENABLE

config NRF_MODEM_LIB_NET_IF_NTN_CHANNEL_SELECT
	int "NTN channel to select"
	default 1
	help
	  Channel number to select in NTN mode.

endif # NRF_MODEM_LIB_NET_IF_NTN_CHANNEL_SELECT_ENABLE

config NRF_MODEM_LIB_NET_IF_NTN_APN_ENABLE
	bool "Enable NTN APN select"
	default n
	help
	  Enable APN selection for NTN mode.

if NRF_MODEM_LIB_NET_IF_NTN_APN_ENABLE

config NRF_MODEM_LIB_NET_IF_NTN_APN
	string "NTN APN"
	default ""
	help
	  Access Point Name (APN) for NTN connection.
	  Leave empty to use default APN.
endif # NRF_MODEM_LIB_NET_IF_NTN_APN_ENABLE

config NRF_MODEM_LIB_NET_IF_NTN_DISABLE_EPCO
	bool "Disable ePCO"
	default n
	help
	  Disable ePCO.

config NRF_MODEM_LIB_NET_IF_NTN_LOG_SV_DATA_ENABLE
	bool "Enable logging of Satellite Vehicle data"
	default n
	help
	  Enable logging of Satellite Vehicle data.

module = NRF_MODEM_LIB_NET_IF_NTN
module-dep = LOG
module-str = nRF91 NTN LTE network interface
module-help = Enables logging for nRF91 NTN LTE network interface.
source "subsys/logging/Kconfig.template.log_config"

endif # NRF_MODEM_LIB_NET_IF_NTN
```

## lib/nrf_modem_lib/shell/Kconfig
```kconfig
# Copyright (c) 2024 Nordic Semiconductor
#
# SPDX-License-Identifier: LicenseRef-Nordic-5-Clause
#

menu "Shell"

config NRF_MODEM_LIB_SHELL_TRACE
	bool "Modem trace shell commands"

if NRF_MODEM_LIB_SHELL_TRACE

DT_CHOSEN_NORDIC_MODEM_TRACE_UART := nordic,modem-trace-uart
config NRF_MODEM_LIB_SHELL_TRACE_UART
	bool
	default $(dt_chosen_enabled,$(DT_CHOSEN_NORDIC_MODEM_TRACE_UART))

endif # NRF_MODEM_LIB_SHELL_TRACE

endmenu
```

## lib/nrf_modem_lib/trace_backends/flash/Kconfig
```kconfig
#
# Copyright (c) 2022-2023 Nordic Semiconductor
#
# SPDX-License-Identifier: LicenseRef-Nordic-5-Clause
#

# Adds Flash to the trace backend choice.
choice NRF_MODEM_LIB_TRACE_BACKEND

config NRF_MODEM_LIB_TRACE_BACKEND_FLASH
	bool "Stream modem traces to flash"
	depends on FCB
	select FCB_ALLOW_FIXED_ENDMARKER
	depends on FLASH
	depends on FLASH_MAP
	help
	  Use flash trace backend. Note that the backend takes time to erase the flash at
	  initialization. It is therefore recommended to disable CONFIG_NRF_MODEM_LIB_SYS_INIT when
	  enabling the flash trace backend.

endchoice # NRF_MODEM_LIB_TRACE_BACKEND

if NRF_MODEM_LIB_TRACE_BACKEND_FLASH

config NRF_MODEM_LIB_TRACE_BACKEND_FLASH_BUF_SIZE
	int "Flash buffer size"
	default 1024

choice NRF_MODEM_TRACE_FLASH_NOSPACE_POLICY
	prompt "When flash is full"

config NRF_MODEM_TRACE_FLASH_NOSPACE_SIGNAL
	bool "Stop and signal"
	help
	  The application can be notified when the flash is full by implementing the
	  nrf_modem_lib_trace_callback function.

config NRF_MODEM_TRACE_FLASH_NOSPACE_ERASE_OLDEST
	bool "Erase oldest"
	help
	   Allow replacing the oldest trace data with new data.

endchoice # NRF_MODEM_TRACE_FLASH_NOSPACE_POLICY

config NRF_MODEM_LIB_TRACE_FLASH_SECTORS
	int "Number of Flash sectors"
	default 64

config NRF_MODEM_LIB_TRACE_BACKEND_FLASH_PARTITION_SIZE
	hex "External flash space reserved for modem traces"
	range 0 0x800000
	default 0x400000
	help
	  Flash space set aside for modem traces in the external flash.

endif # NRF_MODEM_LIB_TRACE_BACKEND_FLASH
```

## lib/nrf_modem_lib/trace_backends/ram/Kconfig
```kconfig
#
# Copyright (c) 2022-2023 Nordic Semiconductor
#
# SPDX-License-Identifier: LicenseRef-Nordic-5-Clause
#

# Adds Ram to the trace backend choice.
choice NRF_MODEM_LIB_TRACE_BACKEND

config NRF_MODEM_LIB_TRACE_BACKEND_RAM
	bool "Stream modem traces to RAM buffer"
	depends on RING_BUFFER
	help
	  Use RAM trace backend.

endchoice # NRF_MODEM_LIB_TRACE_BACKEND

if NRF_MODEM_LIB_TRACE_BACKEND_RAM

config NRF_MODEM_LIB_TRACE_BACKEND_RAM_LENGTH
	int "RAM buffer size"
	default 32768


endif # NRF_MODEM_LIB_TRACE_BACKEND_RAM
```

## lib/nrf_modem_lib/trace_backends/rtt/Kconfig
```kconfig
#
# Copyright (c) 2022 Nordic Semiconductor
#
# SPDX-License-Identifier: LicenseRef-Nordic-5-Clause
#

# Adds RTT to the trace backend choice.
choice NRF_MODEM_LIB_TRACE_BACKEND

config NRF_MODEM_LIB_TRACE_BACKEND_RTT
	bool "SEGGER RTT"
	depends on USE_SEGGER_RTT

endchoice # NRF_MODEM_LIB_TRACE_BACKEND

if NRF_MODEM_LIB_TRACE_BACKEND_RTT

config NRF_MODEM_LIB_TRACE_BACKEND_RTT_BUF_SIZE
	int "RTT buffer size"
	default 1024

config NRF_MODEM_LIB_TRACE_BACKEND_RTT_SKIP_IF_FIFO_FULL
	bool "Skip modem traces if RTT not connected"
	help
	   To reduce power consumption for applications where RTT backend is not always connected
	   to forward trace data, this allows the backend to skip traces.

endif # NRF_MODEM_LIB_TRACE_BACKEND_RTT
```

## lib/nrf_modem_lib/trace_backends/uart/Kconfig
```kconfig
#
# Copyright (c) 2022 Nordic Semiconductor
#
# SPDX-License-Identifier: LicenseRef-Nordic-5-Clause
#

# Adds UART to the trace backend choice.
choice NRF_MODEM_LIB_TRACE_BACKEND
	default NRF_MODEM_LIB_TRACE_BACKEND_UART if $(dt_chosen_enabled,$(DT_CHOSEN_NORDIC_MODEM_TRACE_UART))

config NRF_MODEM_LIB_TRACE_BACKEND_UART
	bool "UART"
	depends on SERIAL
	depends on UART_ASYNC_API
	select UART_USE_RUNTIME_CONFIGURE

if NRF_MODEM_LIB_TRACE_BACKEND_UART

config NRF_MODEM_LIB_TRACE_BACKEND_UART_CHUNK_SZ
	int "Trace chunk size"
	# This default is the max DMA transfer length
	default 8191
	range 8 8191
	help
	  Trace data is processed in chunks. Every time a whole chunk of trace data is processed, it is freed from the shared memory.
	  By reducing the chunk size, it is possible to free the shared memory more often, albeit by a smaller amount.
	  This, however, can improve the availability of shared memory, thus reducing the chance of losing traces.

choice NRF_MODEM_LIB_TRACE_BACKEND_UART_VERSION
	prompt "UART trace backend version [DEPRECATED]"
	optional

config NRF_MODEM_LIB_TRACE_BACKEND_UART_ZEPHYR
	bool "UART"
	depends on SERIAL
	depends on UART_ASYNC_API
	select UART_USE_RUNTIME_CONFIGURE
	select DEPRECATED
	help
	  Modem tracing with UART require the chosen `nordic,modem-trace-uart` to be set in the Device tree.
	  Deprecated. Use NRF_MODEM_LIB_TRACE_BACKEND_UART directly instead.

endchoice

endif # NRF_MODEM_LIB_TRACE_BACKEND_UART

endchoice # NRF_MODEM_LIB_TRACE_BACKEND
```
