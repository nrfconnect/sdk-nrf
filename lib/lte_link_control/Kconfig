## lib/lte_link_control/modules/Kconfig
```kconfig
#
# Copyright (c) 2024 Nordic Semiconductor ASA
#
# SPDX-License-Identifier: LicenseRef-Nordic-5-Clause
#

config LTE_LC_CONN_EVAL_MODULE
	bool "Connection Parameters Evaluation module"

config LTE_LC_EDRX_MODULE
	bool "Extended Discountinuous Reception (eDRX) module"

config LTE_LC_NEIGHBOR_CELL_MEAS_MODULE
	bool "Neighboring Cell Measurements module"

config LTE_LC_PERIODIC_SEARCH_MODULE
	bool "Periodic Search Configuration module"

config LTE_LC_PSM_MODULE
	bool "Power Saving Mode (PSM) module"

config LTE_LC_RAI_MODULE
	bool "Release Assistance Indication (RAI) module"

config LTE_LC_MODEM_SLEEP_MODULE
	bool "Modem Sleep module"

config LTE_LC_TAU_PRE_WARNING_MODULE
	bool "Tracking Area Update (TAU) module"
```

## lib/lwm2m_carrier/Kconfig
```kconfig
#
# Copyright (c) 2019 Nordic Semiconductor ASA
#
# SPDX-License-Identifier: LicenseRef-BSD-5-Clause-Nordic
#

menuconfig LWM2M_CARRIER
	bool "LwM2M carrier library"
	depends on NEWLIB_LIBC
	depends on BSD_LIBRARY && !BSD_LIBRARY_SYS_INIT
	# Need a source of entropy
	depends on TEST_RANDOM_GENERATOR
	# Flash settings
	depends on FLASH && FLASH_PAGE_LAYOUT
	depends on MPU_ALLOW_FLASH_WRITE
	depends on NVS
	# Heap requirements
	depends on (HEAP_MEM_POOL_SIZE >= 16384)
	# NCS dependencies
	# Networking - Zephyr
	depends on NETWORKING
	depends on NET_SOCKETS
	depends on NET_SOCKETS_OFFLOAD
	# Networking NCS
	depends on LTE_LINK_CONTROL && !LTE_AUTO_INIT_AND_CONNECT
	depends on DOWNLOAD_CLIENT && DOWNLOAD_CLIENT_TLS
	depends on PDN_MANAGEMENT
	# AT libraries
	depends on AT_CMD
	depends on AT_CMD_PARSER
	help
	  A library for cellular connection management.

if LWM2M_CARRIER

config LWM2M_CARRIER_BOOTSTRAP_URI
	string "LwM2M carrier bootstrap URI"
	default ""
	help
	  An URI of the bootstrap server.
	  Leave empty to use the library defaults.

module=LWM2M_CARRIER
module-dep=LOG
module-str=LwM2M carrier library
source "${ZEPHYR_BASE}/subsys/logging/Kconfig.template.log_config"

endif # LWM2M_CARRIER
```

## lib/modem_antenna/Kconfig
```kconfig
#
# Copyright (c) 2022 Nordic Semiconductor ASA
#
# SPDX-License-Identifier: LicenseRef-Nordic-5-Clause
#

menuconfig MODEM_ANTENNA
	bool "Modem antenna configuration"
	depends on NRF_MODEM_LIB
	default y if BOARD_NRF9160DK_NRF9160_NS
	default y if BOARD_NRF9161DK_NRF9161_NS
	default y if BOARD_NRF9151DK_NRF9151_NS
	default y if BOARD_THINGY91_NRF9160_NS

if MODEM_ANTENNA

choice
	default MODEM_ANTENNA_GNSS_ONBOARD
	prompt "Select which antenna to use for GNSS"

config MODEM_ANTENNA_GNSS_ONBOARD
	bool "Use onboard antenna"

config MODEM_ANTENNA_GNSS_EXTERNAL
	bool "Use external antenna"

endchoice

config MODEM_ANTENNA_AT_MAGPIO
	string "AT%XMAGPIO command"
	default "AT\%XMAGPIO=1,0,0,1,1,1574,1577" if BOARD_NRF9160DK_NRF9160_NS
	default "AT\%XMAGPIO=1,1,1,7,1,746,803,2,698,748,2,1710,2200,3,824,894,4,880,960,5,791,849,7,1565,1586" if BOARD_THINGY91_NRF9160_NS
	help
	  Defines the AT%XMAGPIO command to be sent to the modem. Leave
	  empty if this command should not be sent.

config MODEM_ANTENNA_AT_COEX0
	string "AT%XCOEX0 command"
	default "AT\%XCOEX0=1,1,1565,1586" if MODEM_ANTENNA_GNSS_ONBOARD
	default "AT\%XCOEX0" if MODEM_ANTENNA_GNSS_EXTERNAL
	help
	  Defines the AT%XCOEX0 command to be sent to the modem. Leave
	  empty if this command should not be sent.

config MODEM_ANTENNA_AT_MIPIRFFEDEV
	string "AT%XMIPIRFFEDEV command"
	help
	  Defines the AT%XMIPIRFFEDEV command to be sent to the modem. Leave
	  empty if this command should not be sent.

config MODEM_ANTENNA_AT_MIPIRFFECTRL_INIT
	string "AT%XMIPIRFFECTRL command (INIT)"
	help
	  Defines the AT%XMIPIRFFECTRL command to be sent to the modem for INIT phase.
	  Leave empty if this command should not be sent.

config MODEM_ANTENNA_AT_MIPIRFFECTRL_ON
	string "AT%XMIPIRFFECTRL command (ON)"
	help
	  Defines the AT%XMIPIRFFECTRL command to be sent to the modem for ON phase.
	  Leave empty if this command should not be sent.

config MODEM_ANTENNA_AT_MIPIRFFECTRL_OFF
	string "AT%XMIPIRFFECTRL command (OFF)"
	help
	  Defines the AT%XMIPIRFFECTRL command to be sent to the modem for OFF phase.
	  Leave empty if this command should not be sent.

config MODEM_ANTENNA_AT_MIPIRFFECTRL_PWROFF
	string "AT%XMIPIRFFECTRL command (PWROFF)"
	help
	  Defines the AT%XMIPIRFFECTRL command to be sent to the modem for PWROFF phase.
	  Leave empty if this command should not be sent.

module=MODEM_ANTENNA
module-dep=LOG
module-str=Modem antenna
source "${ZEPHYR_BASE}/subsys/logging/Kconfig.template.log_config"

endif # MODEM_ANTENNA
```

## lib/modem_attest_token/Kconfig
```kconfig
#
# Copyright (c) 2021 Nordic Semiconductor
#
# SPDX-License-Identifier: LicenseRef-Nordic-5-Clause
#

menuconfig MODEM_ATTEST_TOKEN
	bool "Modem Attestation Token Library"
	depends on NRF_MODEM_LIB
	help
	  Functionality requires modem firmware version 1.3 or greater.
	  User is responsible for initializing the libraries upon which
	  this library is dependent.

if MODEM_ATTEST_TOKEN

config MODEM_ATTEST_TOKEN_PARSING
	bool "Enable parsing of the attestation token"
	select ZCBOR
	select BASE64
	default y

module=MODEM_ATTEST_TOKEN
module-str=Modem Attestation Token

endif # MODEM_ATTEST_TOKEN
```

## lib/modem_battery/Kconfig
```kconfig
#
# Copyright (c) 2023 Nordic Semiconductor
#
# SPDX-License-Identifier: LicenseRef-Nordic-5-Clause
#

menuconfig MODEM_BATTERY
	bool "nRF9160 modem battery library"
	depends on NRF_MODEM_LIB
	depends on AT_MONITOR

if MODEM_BATTERY

config MODEM_BATTERY_LOW_LEVEL
	int "Modem battery low level voltage threshold (mV)"
	range 3100 3500
	default 3300

choice MODEM_BATTERY_POFWARN
	bool "POFWARN voltage choice"
	default MODEM_BATTERY_POFWARN_3000

config MODEM_BATTERY_POFWARN_3000
	bool "3000 mV"

config MODEM_BATTERY_POFWARN_3100
	bool "3100 mV"

config MODEM_BATTERY_POFWARN_3200
	bool "3200 mV"

config MODEM_BATTERY_POFWARN_3300
	bool "3300 mV"

endchoice

config MODEM_BATTERY_POFWARN_VOLTAGE
	int
	default 30 if MODEM_BATTERY_POFWARN_3000
	default 31 if MODEM_BATTERY_POFWARN_3100
	default 32 if MODEM_BATTERY_POFWARN_3200
	default 33 if MODEM_BATTERY_POFWARN_3300

module = MODEM_BATTERY
module-dep = LOG
module-str = Modem battery library
source "${ZEPHYR_BASE}/subsys/logging/Kconfig.template.log_config"

endif # MODEM_BATTERY
```

## lib/modem_info/Kconfig
```kconfig
#
# Copyright (c) 2019 Nordic Semiconductor
#
# SPDX-License-Identifier: LicenseRef-BSD-5-Clause-Nordic
#

menuconfig MODEM_INFO
	bool "nRF91 modem information library"
	select BSD_LIBRARY
	select AT_CMD_PARSER

if MODEM_INFO

config MODEM_INFO_MAX_AT_PARAMS_RSP
	int "Maximum number of response parameters"
	default 10
	help
	  Set the maximum number of parameters the parser
	  will check for in any given string.

config MODEM_INFO_BUFFER_SIZE
	int "Size of buffer used to read data from the socket"
	default 128
	help
	  Set the size of the buffer that contains the returned
	  string after an AT command. The buffer is processed
	  through the parser.

config MODEM_INFO_ADD_NETWORK
	bool "Read the network information from the modem"
	default y
	help
	  Add the network information to the returned
	  device JSON object.

config MODEM_INFO_ADD_DATE_TIME
	bool "Read the real-time clock value from the modem"
	depends on MODEM_INFO_ADD_NETWORK
	default y
	help
	  Inlcude the real-time clock value read from the modem in the network
	  information. Note, that if no time information is available in the
	  network, the modem info readout might fail.

config MODEM_INFO_ADD_SIM
	bool "Read the SIM card information from the modem"
	default y
	help
	  Add the SIM card information to the returned
	  device JSON object.

config MODEM_INFO_ADD_SIM_ICCID
	bool "Read the SIM card ICCID from the modem"
	default y
	help
	  Add the SIM card ICCID to the returned
	  device JSON object.

config MODEM_INFO_ADD_SIM_IMSI
	bool "Read the SIM card IMSI from the modem"
	default y
	help
	  Add the SIM card IMSI to the returned
	  device JSON object.

config MODEM_INFO_ADD_DEVICE
	bool "Add the device information to the modem informer"
	default y
	help
	  Add the device information to the returned
	  device JSON object.

config MODEM_INFO_ADD_BOARD
	bool "Add board name to JSON string"
	default y
	help
	  Add the name of the board to the returned
	  device JSON object.

endif # MODEM_INFO
```

## lib/modem_jwt/Kconfig
```kconfig
#
# Copyright (c) 2021 Nordic Semiconductor ASA
#
# SPDX-License-Identifier: LicenseRef-Nordic-5-Clause
#

menuconfig MODEM_JWT
	bool "Modem JWT Library"
	select NRF_MODEM_LIB
	select BASE64
	help
	  Functionality requires modem firmware version 1.3 or greater.

if MODEM_JWT

config MODEM_JWT_MAX_LEN
	int "Buffer size to allocate for JWT"
	default 850
	help
	  Minimum JWT response is ~420 bytes.

module=MODEM_JWT
module-str=Modem JWT

endif # MODEM_JWT
```

## lib/modem_key_mgmt/Kconfig
```kconfig
#
# Copyright (c) 2019 Nordic Semiconductor
#
# SPDX-License-Identifier: LicenseRef-Nordic-5-Clause
#

config MODEM_KEY_MGMT
	bool "nRF9160 modem key management library"
	depends on NRF_MODEM_LIB

if MODEM_KEY_MGMT

module = MODEM_KEY_MGMT
module-dep = LOG
module-str = Modem key management
source "${ZEPHYR_BASE}/subsys/logging/Kconfig.template.log_config"

endif # MODEM_KEY_MGMT
```

## lib/modem_slm/Kconfig
```kconfig
#
# Copyright (c) 2023 Nordic Semiconductor
#
# SPDX-License-Identifier: LicenseRef-Nordic-5-Clause
#

menuconfig MODEM_SLM
	bool "Modem SLM Library for host MCU"
	depends on SERIAL
	select UART_ASYNC_API
	select RING_BUFFER
	select UART_USE_RUNTIME_CONFIGURE
	select GPIO_GET_CONFIG
	select PM_DEVICE

if MODEM_SLM

#
# UART buffers
#
config MODEM_SLM_UART_RX_BUF_COUNT
	int "Receive buffers for UART"
	range 2 4
	default 3
	help
	  Number of buffers for receiving (RX) UART traffic.
	  If the buffers are full, UART RX will be disabled until the buffers are processed.

config MODEM_SLM_UART_RX_BUF_SIZE
	int "Receive buffer size for UART"
	range 16 4096
	default 256
	help
	  Amount of received (RX), unprocessed, UART traffic that can be held by a single buffer.

config MODEM_SLM_UART_TX_BUF_SIZE
	int "Send buffer size for UART"
	range 16 4096
	default 256
	help
	  Amount of UART traffic waiting to be sent (TX), which can be held.
	  If the buffers are full, all messages will be sent synchronously.

config MODEM_SLM_AT_CMD_RESP_MAX_SIZE
	int "Maximum size of AT command response from SLM"
	default 2100
	help
	  The maximum size of the AT command response.

config MODEM_SLM_SHELL
	bool "SLM Shell"
	depends on SHELL
	help
	  Adds AT command capability to shell. The shell command is "slm".

choice
	prompt "AT command terminator"
	default MODEM_SLM_CR_LF_TERMINATION
	help
	  Sets the termination ending from the serial terminal
	  Levels are:
	  -  CR Termination
	  -  LF Termination
	  -  CR+LF Termination

config MODEM_SLM_CR_TERMINATION
	bool "CR Termination"

config MODEM_SLM_LF_TERMINATION
	bool "LF Termination"

config MODEM_SLM_CR_LF_TERMINATION
	bool "CR+LF Termination"

endchoice

module = MODEM_SLM
module-str = Modem SLM
source "${ZEPHYR_BASE}/subsys/logging/Kconfig.template.log_config"

endif # MODEM_SLM
```

## lib/multicell_location/Kconfig
```kconfig
#
# Copyright (c) 2021 Nordic Semiconductor ASA
#
# SPDX-License-Identifier: LicenseRef-Nordic-5-Clause
#

menuconfig MULTICELL_LOCATION
	bool "Multicell Location"
	depends on NRF_MODEM_LIB
	depends on LTE_LINK_CONTROL
	select MODEM_KEY_MGMT
	select CJSON_LIB
	help
	  Enables the multicell location library. The library can be used
	  to resolve the device's location based on LTE cell measurements.
	  The library supports multiple location services, which can be
	  configured using Kconfig options.

if MULTICELL_LOCATION

config MULTICELL_LOCATION_SERVICE_NRF_CLOUD
	bool "nRF Cloud location service"
	depends on NRF_CLOUD_REST || NRF_CLOUD_MQTT
	select NRF_CLOUD_REST_AUTOGEN_JWT if NRF_CLOUD_REST
	help
	  Use nRF Cloud location service

config MULTICELL_LOCATION_SERVICE_HERE
	bool "HERE location service"
	help
	  Use HERE location service

if MULTICELL_LOCATION_SERVICE_HERE
config MULTICELL_LOCATION_REST_CLIENT
	bool
	default y
	select REST_CLIENT
	help
	  Use the REST client library with multicell location library. This is
	  separated here from other dependencies to allow disabling of
	  REST client library in tests for mocking purposes.
endif

if MULTICELL_LOCATION_SERVICE_HERE
choice MULTICELL_LOCATION_SERVICE_HERE_VERSION
	prompt "HERE Positioning API version"
	default MULTICELL_LOCATION_HERE_V2
	help
	  Select which HERE API version to use

config MULTICELL_LOCATION_HERE_V1
	bool "HERE API v1"
	help
	  Use HERE location service API v1

config MULTICELL_LOCATION_HERE_V2
	bool "HERE API v2"
	help
	  Use HERE location service API v2

endchoice

choice MULTICELL_LOCATION_HERE_AUTH_METHOD
	prompt "HERE authentication method"
	default MULTICELL_LOCATION_HERE_USE_API_KEY
	help
	  Select authentication method to use when connecting to HERE's server

config MULTICELL_LOCATION_HERE_USE_API_KEY
	bool "Use API key"
	help
	  Use API key for authentication towards HERE location service

config MULTICELL_LOCATION_HERE_USE_APP_CODE_ID
	bool "Use app code and ID"
	help
	  Use app code and ID for authentication towards HERE location service

endchoice

config MULTICELL_LOCATION_HERE_API_KEY
	string "HERE API key"
	depends on MULTICELL_LOCATION_HERE_USE_API_KEY
	help
	  HERE API key, used both for API v1 and v2 when API key authentication
	  method id selected

if MULTICELL_LOCATION_HERE_USE_APP_CODE_ID
config MULTICELL_LOCATION_HERE_APP_CODE
	string "HERE APP code"
	help
	  HERE app code

config MULTICELL_LOCATION_HERE_APP_ID
	string "HERE APP ID"
	help
	  HERE app ID

endif # MULTICELL_LOCATION_HERE_USE_APP_CODE_ID

config MULTICELL_LOCATION_HERE_HTTPS_PORT
	int "HTTPS port number for HERE"
	default 443
	help
	  Port number to use when connecting to HERE location service

config MULTICELL_LOCATION_HERE_HOSTNAME
	string "Server hostname for HERE"
	default "pos.api.here.com" if MULTICELL_LOCATION_HERE_V1 && MULTICELL_LOCATION_HERE_USE_APP_CODE_ID
	default "pos.ls.hereapi.com" if MULTICELL_LOCATION_HERE_V1 && MULTICELL_LOCATION_HERE_USE_API_KEY
	default "positioning.hereapi.com" if MULTICELL_LOCATION_HERE_V2
	help
	  Server hostname to use when connecting to HERE location service

config MULTICELL_LOCATION_HERE_TLS_SEC_TAG
	int "Security tag for HERE TLS certificates"
	default 175
	help
	  Security tag where the required TLS certificates for HERE
	  service will be stored. This sec tag will also be used to provision
	  certificates when multicell_location_provision_certificate() is called.

endif # MULTICELL_LOCATION_SERVICE_HERE

config MULTICELL_LOCATION_MAX_NEIGHBORS
	int "Max number of neighbor cells"
	range 0 17
	default 8
	help
	  Maximum number of neighbor cells to use when creating HTTP request.
	  Increasing the max number will increase the library's RAM usage
	  proportionally.

config MULTICELL_LOCATION_RECV_BUF_SIZE
	int "Receive buffer size"
	default 512
	help
	  Size of the buffer used to store the response from the location
	  service.

module = MULTICELL_LOCATION
module-str = Multicell location
source "${ZEPHYR_BASE}/subsys/logging/Kconfig.template.log_config"

endif # MULTICELL_LOCATION
```

## lib/multithreading_lock/Kconfig
```kconfig
#
# Copyright (c) 2019 Nordic Semiconductor ASA
#
# SPDX-License-Identifier: LicenseRef-Nordic-5-Clause
#

config MULTITHREADING_LOCK
	bool
	help
	  Enable APIs for ensuring threadsafe operation.
```
