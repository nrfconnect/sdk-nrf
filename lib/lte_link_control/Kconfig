## lib/lte_link_control/Kconfig
```kconfig
#
# Copyright (c) 2018 Nordic Semiconductor
#
# SPDX-License-Identifier: LicenseRef-Nordic-5-Clause
#

# Note: the naming of the Kconfig options is inconsistent in this file as a result of gradual
# development. It will be fixed in a future version.

menuconfig LTE_LINK_CONTROL
	bool "LTE link control library"
	select AT_PARSER
	select AT_MONITOR

if LTE_LINK_CONTROL

config HEAP_MEM_POOL_ADD_SIZE_LTE_LINK_CONTROL
	int "Heap required for event handlers"
	default 32
	default 96 if LTE_LC_PDN_MODULE
	help
	  Extra heap size required for allocating event handlers.
	  Default is enough for 4 handlers.

# Modules: these Kconfig options enable specific features of the library.

config LTE_LC_FUNCTIONAL_MODE_MODULE
	bool "Functional mode module"
	default y

config LTE_LC_NETWORK_REGISTRATION_MODULE
	bool "Network registration module"
	depends on LTE_LC_FUNCTIONAL_MODE_MODULE
	default y

config LTE_LC_CONNECTION_STATUS_MODULE
	bool "Connection status module"
	default y

config LTE_LC_MODEM_EVENTS_MODULE
	bool "Modem events module"
	default y

config LTE_LC_SYSTEM_MODE_MODULE
	bool "System mode module"
	default y

config LTE_LC_CONN_EVAL_MODULE
	bool "Connection Parameters Evaluation module"
	depends on LTE_LC_FUNCTIONAL_MODE_MODULE

config LTE_LC_EDRX_MODULE
	bool "Extended Discontinuous Reception (eDRX) module"

config LTE_LC_NEIGHBOR_CELL_MEAS_MODULE
	bool "Neighboring Cell Measurements module"

config LTE_LC_PERIODIC_SEARCH_MODULE
	bool "Periodic Search Configuration module"

config LTE_LC_PSM_MODULE
	bool "Power Saving Mode (PSM) module"

config LTE_LC_RAI_MODULE
	bool "Release Assistance Indication (RAI) module"

config LTE_LC_MODEM_SLEEP_MODULE
	bool "Modem Sleep module"

config LTE_LC_TAU_PRE_WARNING_MODULE
	bool "Tracking Area Update (TAU) module"

config LTE_LC_ENV_EVAL_MODULE
	bool "Environment Evaluation module"
	depends on LTE_LC_FUNCTIONAL_MODE_MODULE

config LTE_LC_PDN_MODULE
	bool "Packet Data Network (PDN) module"

config LTE_LC_CELLULAR_PROFILE_MODULE
	bool "Cellular profile module"

menuconfig LTE_LC_DNS_FALLBACK_MODULE
	bool "DNS Fallback module"
	default y
	help
	  The device might or might not receive a DNS server address by the network during a PDN connection.
	  Even within the same network, the PDN connection establishment method (PCO vs ePCO) might
	  change when the device operates in NB-IoT or LTE Cat-M1, resulting in missing DNS server
	  addresses when one method is used, but not the other.
	  Having a fallback DNS address ensures that the device always has a DNS to fallback to.

if LTE_LC_DNS_FALLBACK_MODULE

config LTE_LC_DNS_FALLBACK_ADDRESS
	string "Fallback DNS address"
	# Zephyr has an option to configure its own DNS servers.
	# Using the DNS_SERVER1 address when the DNS_SERVER_IP_ADDRESSES is enabled
	# lets us re-use the same DNS server as Zephyr's, so that the offloaded and
	# non-offloaded implementations use the same server.
	default DNS_SERVER1 if DNS_SERVER_IP_ADDRESSES
	# Cloudflare DNS
	default "1.1.1.1"

endif # LTE_LC_DNS_FALLBACK_MODULE

# End of modules Kconfig options

config LTE_SHELL
	bool "LTE shell commands"
	default y
	depends on SHELL

config LTE_LOCK_BANDS
	bool "LTE band lock"
	help
	  Enable LTE band lock. Only configured bands are used when this setting is enabled.
	  The allowed bands can be configured using the CONFIG_LTE_LOCK_BAND_MASK and
	  CONFIG_LTE_LOCK_BAND_LIST options. If both are configured, the bands are combined
	  from both options.

if LTE_LOCK_BANDS

config LTE_LOCK_BAND_MASK
	string "LTE band lock mask bit string"
	help
	  Bit string of enabled bands. LSB is band 1. Leading zeroes can be omitted.
	  The maximum length is 88 characters, meaning this can be used with band numbers up to 88.

config LTE_LOCK_BAND_LIST
	string "LTE band list"
	help
	  List of enabled bands. Comma-separated list of band numbers.
	  Can be used with all valid band numbers, including bands over 88.
	  This is only supported by the following modem firmware:
	  - mfw_nrf91x1 v2.0.3 or later
	  - mfw_nrf9151-ntn

endif # LTE_LOCK_BANDS

config LTE_PLMN_SELECTION_OPTIMIZATION
	bool "PLMN selection optimization"
	default y
	help
	  Enable PLMN selection optimization during initial search.
	  This optimization typically makes PLMN selection faster, especially for stationary devices.
	  Refer to the AT%FEACONF command in the AT command manual for more details.

config LTE_LOCK_PLMN
	bool "LTE PLMN lock"
	help
	  Enable PLMN lock for network selection.

if LTE_LOCK_PLMN
config LTE_LOCK_PLMN_STRING
	string "LTE PLMN lock string"
	default "00101"
	help
	  Mobile Country Code (MCC) and Mobile Network Code (MNC) values.
	  Only numeric string format supported.
endif # LTE_LOCK_PLMN

config LTE_UNLOCK_PLMN
	bool "Disable LTE PLMN lock"
	depends on !LTE_LOCK_PLMN
	help
	  Disable PLMN lock for network selection.

if LTE_LC_PSM_MODULE

config LTE_PSM_REQ
	bool "PSM request"
	help
	  Enable request for use of PSM using AT+CPSMS.
	  If this option is set the library will automatically request PSM when
	  the modem is initialized. This will cause the modem to include a PSM request in
	  every subsequent LTE attach request.

choice LTE_PSM_REQ_FORMAT
	prompt "Format for PSM configuration"
	default LTE_PSM_REQ_FORMAT_STRING
	help
	  Select the format in which default parameters for PSM are given.

config LTE_PSM_REQ_FORMAT_STRING
	bool "Use PSM configs given as bit field strings"
	help
	  Use LTE_PSM_REQ_RPTAU and LTE_PSM_REQ_RAT.

config LTE_PSM_REQ_FORMAT_SECONDS
	bool "Use PSM configs given in seconds"
	help
	  Use LTE_PSM_REQ_RPTAU_SECONDS and LTE_PSM_REQ_RAT_SECONDS.

endchoice

config LTE_PSM_REQ_RPTAU
	string "Requested periodic TAU for PSM"
	default "00000011" # 30 minutes
	help
	  Power saving mode setting for requested periodic TAU.
	  See 3GPP 27.007 Ch. 7.38.
	  And 3GPP 24.008 Ch. 10.5.7.4a for data format.

config LTE_PSM_REQ_RAT
	string "Requested active time for PSM"
	default "00100001" # 1 minute
	help
	  Power saving mode setting for requested active time.
	  See 3GPP 27.007 Ch. 7.38.
	  And 3GPP 24.008 Ch. 10.5.7.3 for data format.

config LTE_PSM_REQ_RPTAU_SECONDS
	int "Requested periodic TAU for PSM in seconds"
	default 1800
	help
	  Power saving mode setting for requested periodic TAU in seconds.
	  See lte_lc_psm_param_set_seconds() on limitations although any
	  non-negative value can be given.

config LTE_PSM_REQ_RAT_SECONDS
	int "Requested active time for PSM in seconds"
	default 60
	help
	  Power saving mode setting for requested active time in seconds.
	  See lte_lc_psm_param_set_seconds() on limitations although any
	  non-negative value can be given.

config LTE_PROPRIETARY_PSM_REQ
	bool "Proprietary PSM"
	help
	  Enable use of proprietary PSM using AT%FEACONF. To use this feature, also PSM request
	  must be enabled using CONFIG_LTE_PSM_REQ or lte_lc_psm_req().
	  Refer to the AT command guide for guidance and limitations of this feature.

endif # LTE_LC_PSM_MODULE

if LTE_LC_EDRX_MODULE

config LTE_EDRX_REQ
	bool "eDRX request"
	help
	  Enable request for use of eDRX using AT+CEDRXS.
	  For reference, see 3GPP 27.007 Ch. 7.40.

config LTE_EDRX_REQ_VALUE_LTE_M
	string "Requested eDRX value for LTE-M"
	default "1001"
	help
	  Sets the eDRX value to be requested when LTE-M is used.
	  The format is half a byte in a four-bit format.
	  The eDRX value refers to bit 4 to 1 of octet 3 of the
	  Extended DRX parameters information element.
	  See 3GPP TS 24.008, subclause 10.5.5.32.
	  The value 1001 corresponds to 163.84 seconds.

config LTE_EDRX_REQ_VALUE_NBIOT
	string "Requested eDRX value for NB-IoT"
	default "1001"
	help
	  Sets the eDRX value to be requested when NB-IoT is used.
	  The format is half a byte in a four-bit format.
	  The eDRX value refers to bit 4 to 1 of octet 3 of the
	  Extended DRX parameters information element.
	  See 3GPP TS 24.008, subclause 10.5.5.32.
	  The value 1001 corresponds to 163.84 seconds.

config LTE_EDRX_REQ_VALUE_NTN_NBIOT
	string "Requested eDRX value for NTN NB-IoT"
	default "1001"
	help
	  Sets the eDRX value to be requested when NTN NB-IoT is used.
	  The format is half a byte in a four-bit format.
	  The eDRX value refers to bit 4 to 1 of octet 3 of the
	  Extended DRX parameters information element.
	  See 3GPP TS 24.008, subclause 10.5.5.32.
	  The value 1001 corresponds to 163.84 seconds.

config LTE_PTW_VALUE_LTE_M
	string "Requested PTW value for LTE-M"
	help
	  Sets the Paging Time Window value to be requested when enabling
	  eDRX. The value applies to LTE-M.
	  The format is a string with half a byte in 4-bit format,
	  corresponding to bits 8 to 5 in octet 3 of eDRX information
	  element according to 10.5.5.32 of 3GPP TS 24.008.
	  Requesting a specific PTW configuration should be done with
	  caution. The requested value must be compliant with the eDRX
	  value that is configured, and it is usually best to let the modem
	  use default PTW values.

config LTE_PTW_VALUE_NBIOT
	string "Requested PTW value for NB-IoT"
	help
	  Sets the Paging Time Window value to be requested when enabling
	  eDRX. The value applies to NB-IoT.
	  The format is a string with half a byte in 4-bit format,
	  corresponding to bits 8 to 5 in octet 3 of eDRX information
	  element according to 10.5.5.32 of 3GPP TS 24.008.
	  Requesting a specific PTW configuration should be done with
	  caution. The requested value must be compliant with the eDRX
	  value that is configured, and it is usually best to let the modem
	  use default PTW values.

config LTE_PTW_VALUE_NTN_NBIOT
	string "Requested PTW value for NTN NB-IoT"
	help
	  Sets the Paging Time Window value to be requested when enabling
	  eDRX. The value applies to NTN NB-IoT.
	  The format is a string with half a byte in 4-bit format,
	  corresponding to bits 8 to 5 in octet 3 of eDRX information
	  element according to 10.5.5.32 of 3GPP TS 24.008.
	  Requesting a specific PTW configuration should be done with
	  caution. The requested value must be compliant with the eDRX
	  value that is configured, and it is usually best to let the modem
	  use default PTW values.

endif # LTE_LC_EDRX_MODULE

choice LTE_NETWORK_MODE
	prompt "Select network mode"
	default LTE_NETWORK_MODE_LTE_M_NBIOT_GPS
	help
	  Select the modem system mode.

config LTE_NETWORK_MODE_DEFAULT
	bool "Use default"
	help
	  Use the system mode that is currently set in the modem.

config LTE_NETWORK_MODE_LTE_M
	bool "LTE-M"

config LTE_NETWORK_MODE_LTE_M_GPS
	bool "LTE-M and GPS"

config LTE_NETWORK_MODE_NBIOT
	bool "NB-IoT"

config LTE_NETWORK_MODE_NBIOT_GPS
	bool "NB-IoT and GPS"

config LTE_NETWORK_MODE_LTE_M_NBIOT
	bool "LTE-M and NB-IoT"

config LTE_NETWORK_MODE_LTE_M_NBIOT_GPS
	bool "LTE-M, NB-IoT and GPS"

config LTE_NETWORK_MODE_NTN_NBIOT
	bool "NTN NB-IoT"

endchoice

choice LTE_MODE_PREFERENCE
	prompt "LTE mode preference"
	default LTE_MODE_PREFERENCE_LTE_M_PLMN_PRIO if LTE_NETWORK_MODE_LTE_M_NBIOT || \
		LTE_NETWORK_MODE_LTE_M_NBIOT_GPS
	default LTE_MODE_PREFERENCE_AUTO
	help
	  Selects which LTE mode the modem should use if more than one is
	  available. Note that the LTE preference must match the system modes
	  that are enabled.

config LTE_MODE_PREFERENCE_AUTO
	bool "No preference"
	help
	  No LTE preference, automatically selected by the modem.

config LTE_MODE_PREFERENCE_LTE_M
	bool "LTE-M"
	depends on LTE_NETWORK_MODE_LTE_M_NBIOT || LTE_NETWORK_MODE_LTE_M_NBIOT_GPS
	help
	  LTE-M is preferred over PLMN selection. The modem will prioritize to
	  use LTE-M and switch over to a PLMN where LTE-M is available whenever
	  possible.

config LTE_MODE_PREFERENCE_NBIOT
	bool "NB-IoT"
	depends on LTE_NETWORK_MODE_LTE_M_NBIOT || LTE_NETWORK_MODE_LTE_M_NBIOT_GPS
	help
	  NB-IoT is preferred over PLMN selection. The modem will prioritize to
	  use NB-IoT and switch over to a PLMN where NB-IoT is available
	  whenever possible.

config LTE_MODE_PREFERENCE_LTE_M_PLMN_PRIO
	bool "LTE-M, PLMN prioritized"
	depends on LTE_NETWORK_MODE_LTE_M_NBIOT || LTE_NETWORK_MODE_LTE_M_NBIOT_GPS
	help
	  LTE-M is preferred, but PLMN selection is more important. The modem
	  will prioritize to stay on home network and switch over to NB-IoT
	  if LTE-M is not available.

config LTE_MODE_PREFERENCE_NBIOT_PLMN_PRIO
	bool "NB-IoT, PLMN prioritized"
	depends on LTE_NETWORK_MODE_LTE_M_NBIOT || LTE_NETWORK_MODE_LTE_M_NBIOT_GPS
	help
	  NB-IoT is preferred, but PLMN selection is more important. The modem
	  will prioritize to stay on home network and switch over to LTE-M
	  if NB-IoT is not available.

endchoice

config LTE_MODE_PREFERENCE_VALUE
	int
	default 0 if LTE_MODE_PREFERENCE_AUTO
	default 1 if LTE_MODE_PREFERENCE_LTE_M
	default 2 if LTE_MODE_PREFERENCE_NBIOT
	default 3 if LTE_MODE_PREFERENCE_LTE_M_PLMN_PRIO
	default 4 if LTE_MODE_PREFERENCE_NBIOT_PLMN_PRIO

if LTE_LC_RAI_MODULE

config LTE_RAI_REQ
	bool "Release Assistance Indication (RAI) request"
	help
	  Request use of RAI using AT%RAI. When RAI is enabled, the application needs to use
	  the RAI socket option (SO_RAI) to inform the modem when no more data is expected
	  and the RRC connection can be released.

endif # LTE_LC_RAI_MODULE

config LTE_NETWORK_TIMEOUT
	int "Time period to attempt establishing connection"
	default 600
	help
	  Time period in seconds to attempt establishing an LTE link, before timing out.

if LTE_LC_TAU_PRE_WARNING_MODULE

config LTE_LC_TAU_PRE_WARNING_NOTIFICATIONS
	bool "Get notifications prior to Tracking Area Updates"
	help
	  TAU pre-warning notifications can be used to determine when it is optimal for the
	  application to send user data. If user data is sent prior to the scheduled TAU, the
	  TAU will be sent together with the user data, thus saving power and data transfer.

config LTE_LC_TAU_PRE_WARNING_TIME_MS
	int "TAU pre-warning time"
	range 500 3600000
	default 5000
	help
	  Time in milliseconds before a TAU that a pre-warning is to be received.

config LTE_LC_TAU_PRE_WARNING_THRESHOLD_MS
	int "TAU pre-warning threshold"
	range 10240 3456000000
	default 1200000
	help
	  Minimum value of the given T3412 timer in milliseconds that will trigger TAU
	  pre-warnings.

endif # LTE_LC_TAU_PRE_WARNING_MODULE

if LTE_LC_NEIGHBOR_CELL_MEAS_MODULE

config LTE_NEIGHBOR_CELLS_MAX
	int "Max number of neighbor cells"
	range 1 17
	default 10
	help
	  Maximum number of neighbor cells to allocate space for when
	  performing neighbor cell measurements.
	  Increasing the maximum number of neighbor cells requires
	  more heap space.
	  The modem can deliver information for a maximum of 17 neighbor
	  cells, so there's a trade-off between heap requirements and
	  the risk of not being able to parse all neighbor cell information.

endif # LTE_LC_NEIGHBOR_CELL_MEAS_MODULE

if LTE_LC_MODEM_SLEEP_MODULE

config LTE_LC_MODEM_SLEEP_NOTIFICATIONS
	bool "Modem sleep notifications"
	help
	  If this option is enabled the application will get notifications when the modem
	  enters and exits sleep. The application will also get pre-warning notifications
	  prior to when the modem exits sleep depending on the configured pre-warning time.

config LTE_LC_MODEM_SLEEP_PRE_WARNING_TIME_MS
	int "Modem sleep pre-warning time"
	range 500 3600000
	default 5000
	help
	  Time in milliseconds before modem exits sleep that a pre-warning is to be received.

config LTE_LC_MODEM_SLEEP_NOTIFICATIONS_THRESHOLD_MS
	int "Modem sleep notifications threshold"
	range 10240 3456000000
	default 1200000
	help
	  Minimum value of the duration of the scheduled modem sleep in milliseconds
	  that triggers a notification.

endif # LTE_LC_MODEM_SLEEP_MODULE

config LTE_LC_ENV_EVAL_MAX_PLMN_COUNT
	int "Maximum number of PLMNs to evaluate"
	default 3
	help
	  Maximum number of PLMNs that can be evaluated with lte_lc_env_eval().

config LTE_LC_TRACE
	bool "LTE link control tracing"
	help
	  Enables tracing of LTE link control events. The tracing differs
	  from regular link control events in that they only indicate
	  what has happened and has no associated payload.
	  It is intended to be used for debugging purposes.

config LTE_LC_WORKQUEUE_STACK_SIZE
	int "Stack size for the library work queue"
	default 1280 if LOG_MODE_IMMEDIATE
	default 1024

# PDN (Packet Data Network) Configuration
if LTE_LC_PDN_MODULE

config LTE_LC_PDN_LEGACY_PCO
	bool "Use legacy PCO mode"
	help
	  If selected, PCO will be used instead of ePCO during PDN connection establishment.

config LTE_LC_PDN_ESM_TIMEOUT
	int "ESM timeout (ms)"
	default 1000
	help
	  Timeout for waiting for an ESM notification when activating a PDN, in milliseconds.

config LTE_LC_PDN_DEFAULTS_OVERRIDE
	bool "Override defaults for PDP context 0"
	help
	  The defaults are overridden automatically as soon as the modem has been initialized.

if LTE_LC_PDN_DEFAULTS_OVERRIDE

config LTE_LC_PDN_DEFAULT_APN
	string "Access point name (APN)"
	help
	  The access point name to use for the default PDP context for the first cellular
	  profile (CID 0).

choice
	prompt "Address family"
	default LTE_LC_PDN_DEFAULT_FAM_IPV4V6

config LTE_LC_PDN_DEFAULT_FAM_IPV4
	bool "IPv4"

config LTE_LC_PDN_DEFAULT_FAM_IPV6
	bool "IPv6"

config LTE_LC_PDN_DEFAULT_FAM_IPV4V6
	bool "IPv4v6"

config LTE_LC_PDN_DEFAULT_FAM_NONIP
	bool "Non-IP"

endchoice

config LTE_LC_PDN_DEFAULT_FAM
	int
	default 0 if LTE_LC_PDN_DEFAULT_FAM_IPV4
	default 1 if LTE_LC_PDN_DEFAULT_FAM_IPV6
	default 2 if LTE_LC_PDN_DEFAULT_FAM_IPV4V6
	default 3 if LTE_LC_PDN_DEFAULT_FAM_NONIP

choice
	prompt "Authentication method"
	default LTE_LC_PDN_DEFAULT_AUTH_NONE
	help
	  The authentication method to use for the default PDP context for the first cellular
	  profile (CID 0).

config LTE_LC_PDN_DEFAULT_AUTH_NONE
	bool "None"

config LTE_LC_PDN_DEFAULT_AUTH_PAP
	bool "PAP"

config LTE_LC_PDN_DEFAULT_AUTH_CHAP
	bool "CHAP"

endchoice

config LTE_LC_PDN_DEFAULT_AUTH
	int
	default 0 if LTE_LC_PDN_DEFAULT_AUTH_NONE
	default 1 if LTE_LC_PDN_DEFAULT_AUTH_PAP
	default 2 if LTE_LC_PDN_DEFAULT_AUTH_CHAP

config LTE_LC_PDN_DEFAULT_USERNAME
	string "Username"
	depends on !LTE_LC_PDN_DEFAULT_AUTH_NONE
	help
	  The username to use for authentication for the default PDP context for the first
	  cellular profile (CID 0).

config LTE_LC_PDN_DEFAULT_PASSWORD
	string "Password"
	depends on !LTE_LC_PDN_DEFAULT_AUTH_NONE
	help
	  The password to use for authentication for the default PDP context for the first
	  cellular profile (CID 0).

endif # LTE_LC_PDN_DEFAULTS_OVERRIDE

config LTE_LC_PDN_ESM_STRERROR
	bool "Compile ESM error table"
	help
	  Compile a table with a textual description of ESM error reasons.
	  The description can be retrieved with lte_lc_pdn_esm_strerror().
	  The table and function take about 2 kB of FLASH.

endif # LTE_LC_PDN_MODULE

module = LTE_LINK_CONTROL
module-dep = LOG
module-str = LTE link control library
source "$(ZEPHYR_BASE)/subsys/logging/Kconfig.template.log_config"

endif # LTE_LINK_CONTROL
```
