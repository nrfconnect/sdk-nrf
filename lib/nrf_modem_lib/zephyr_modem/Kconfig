## lib/qos/Kconfig
```kconfig
#
# Copyright (c) 2022 Nordic Semiconductor
#
# SPDX-License-Identifier: LicenseRef-Nordic-5-Clause
#

menuconfig QOS
	bool "QoS library"

if QOS

config QOS_PENDING_MESSAGES_MAX
	int "Maximum amount of pending messages"
	default 10

config QOS_MESSAGE_NOTIFIED_COUNT_MAX
	int "Maximum number of times to notify a message"
	default 3
	help
	  Number of times that a message will be notified before being discarded by the library.

config QOS_MESSAGE_NOTIFY_TIMEOUT_SECONDS
	int "Notify timeout of unACKed messages"
	default	16
	help
	  How often the library will notify unACKed messages flagged with
	  QOS_FLAG_RELIABILITY_ACK_REQUIRED

module = QOS
module-str = QoS
source "subsys/logging/Kconfig.template.log_config"

endif # QOS
```

## lib/ram_pwrdn/Kconfig
```kconfig
#
# Copyright (c) 2020 Nordic Semiconductor
#
# SPDX-License-Identifier: LicenseRef-Nordic-5-Clause
#

menuconfig RAM_POWER_DOWN_LIBRARY
	bool "API for turning off unused RAM segments"
	depends on SOC_NRF52840 || SOC_NRF52833 || SOC_NRF5340_CPUAPP || SOC_SERIES_NRF54L
	# Powering down RAM blocks can only be done from the secure domain
	# for security reasons. If necessary, this limitation could be
	# addressed by a secure service in the future.
	depends on ! BUILD_WITH_TFM
	imply NRF_FORCE_RAM_ON_REBOOT
	help
	  This allows application to call API for disabling unused RAM segments
	  in the System ON mode. Effectively the application looses possibility
	  to use disabled portion of RAM.
	  This is usually not needed, but can improve battery lifetime for
	  applications that spend most of the time in the sleep mode with most
	  peripherals disabled.

if RAM_POWER_DOWN_LIBRARY

module = RAM_POWERDOWN
module-str = RAM power-down library
source "$(ZEPHYR_BASE)/subsys/logging/Kconfig.template.log_config"

endif # RAM_POWER_DOWN_LIBRARY
```

## lib/rram_wear_test/Kconfig
```kconfig
#
# Copyright (c) 2026 Nordic Semiconductor ASA
#
# SPDX-License-Identifier: LicenseRef-Nordic-5-Clause
#

config RRAM_WEAR_TEST
	bool "RRAM wear test library [EXPERIMENTAL]"
	depends on FLASH
	depends on FLASH_MAP
	depends on SOC_FLASH_NRF_RRAM
	select EXPERIMENTAL
	help
	  Library that writes 0x00 / 0xFF patterns over a flash partition (or a forced
	  custom range) and verifies readback. Used by nRF RPC utilities and callable
	  directly from in-tree applications.

module = RRAM_WEAR_TEST
module-str = rram_wear_test
source "subsys/logging/Kconfig.template.log_config"
```

## lib/sample_rate_conv_naive/Kconfig
```kconfig
#
# Copyright (c) 2023 Nordic Semiconductor
#
# SPDX-License-Identifier: LicenseRef-Nordic-5-Clause
#

config SAMPLE_RATE_CONV_NAIVE
	bool "Very basic sample rate conversion library"
	help
	  Enable the simple/naive sample rate conversion library.
	  This uses an extremely basic approach for integer sample rate conversion
	  which prioritizes speed over quality.
	  16k, 24k and 48k are supported.

if SAMPLE_RATE_CONV_NAIVE

module = SAMPLE_RATE_CONV_NAIVE
module-str = Data first-in first-out
source "${ZEPHYR_BASE}/subsys/logging/Kconfig.template.log_config"

endif #SAMPLE_RATE_CONV_NAIVE
```

## lib/sample_rate_converter/Kconfig
```kconfig
#
# Copyright (c) 2023 Nordic Semiconductor
#
# SPDX-License-Identifier: LicenseRef-Nordic-5-Clause
#

menuconfig SAMPLE_RATE_CONVERTER
	bool "Sample Rate conversion library [EXPERIMENTAL]"
	select EXPERIMENTAL
	select CMSIS_DSP
	select CMSIS_DSP_FILTERING
	select TIMING_FUNCTIONS
	select RING_BUFFER
	help
	  Enable the sample rate conversion library. The library uses CMSIS DSP filters to
	  preserve quality during the conversion. Conversion between 16kHz, 24kHz and 48kHz
	  frequencies are supported.

if SAMPLE_RATE_CONVERTER

module = SAMPLE_RATE_CONVERTER
module-str = Sample Rate Converter
source "${ZEPHYR_BASE}/subsys/logging/Kconfig.template.log_config"

config SAMPLE_RATE_CONVERTER_FILTER_TEST
	bool "Include the test filters for the sample rate converter"
	help
	  Includes the test filters for the sample rate converter. These simple filters are
	  intended to be used for unittests only, as they give predictable and easy to understand
	  output.

config SAMPLE_RATE_CONVERTER_FILTER_SIMPLE
	bool "Include the simple sample rate converter filters"
	help
	  Includes the simple filters for the sample rate converter. The simle filters uses a small
	  amount of space and time for the conversion, while also giving some low-pass filter
	  capabilities.

config SAMPLE_RATE_CONVERTER_MAX_FILTER_SIZE
	int
	default 72 if SAMPLE_RATE_CONVERTER_FILTER_SIMPLE
	default 3 if SAMPLE_RATE_CONVERTER_FILTER_TEST
	help
	  The maximum number of filter taps the sample rate converter supports.

config SAMPLE_RATE_CONVERTER_BLOCK_SIZE_MAX
	int "Number of samples per conversion call"
	default 480
	help
	  Number of samples that will be input to the sample rate converter. Number of samples may
	  be lower. Increasing this number will increase the memory usage of the converter.

choice SAMPLE_RATE_CONVERTER_BIT_DEPTH
	prompt "Sample rate converter bit depth"
	default SAMPLE_RATE_CONVERTER_BIT_DEPTH_16
	help
	  Select bit depth for the sample rate converter

config SAMPLE_RATE_CONVERTER_BIT_DEPTH_16
	bool "16 bit sample rate converter"

config SAMPLE_RATE_CONVERTER_BIT_DEPTH_32
	bool "32 bit sample rate converter"
endchoice

endif #SAMPLE_RATE_CONVERTER
```

## lib/sfloat/Kconfig
```kconfig
#
# Copyright (c) 2022 Nordic Semiconductor ASA
#
# SPDX-License-Identifier: LicenseRef-Nordic-5-Clause
#

config SFLOAT
	bool "SFLOAT type"
	select EXPERIMENTAL
	help
	  A library for managing SFLOAT type.
```

## lib/sms/Kconfig
```kconfig
#
# Copyright (c) 2019 Nordic Semiconductor ASA
#
# SPDX-License-Identifier: LicenseRef-Nordic-5-Clause
#

menuconfig SMS
	bool "SMS subscriber"
	select AT_MONITOR
	help
	  A library for managing SMS subscriptions.

if SMS

config SMS_SUBSCRIBERS_MAX_CNT
	int "Maximum number of subscribers"
	default 2
	help
	  Maximum number of subscribers that can register to SMS library.

config SMS_STATUS_REPORT
	bool "SMS status reports"
	default y
	help
	  Request SMS status report by setting TP-SRR bit in SMS header, and
	  setting <ds> field enabled in SMS registration with AT+CNMI.

module=SMS
module-dep=LOG
module-str= SMS library
source "${ZEPHYR_BASE}/subsys/logging/Kconfig.template.log_config"

endif # SMS
```

## lib/st25r3911b/Kconfig
```kconfig
#
# Copyright (c) 2019 Nordic Semiconductor ASA
#
# SPDX-License-Identifier: LicenseRef-BSD-5-Clause-Nordic
#

# Workaround for not being able to have commas in macro arguments
DT_COMPAT_ST_ST25R3911B := st,st25r3911b

menuconfig ST25R3911B_LIB
	bool "NFC ST25R3911B library"
	depends on $(dt_compat_enabled,$(DT_COMPAT_ST_ST25R3911B))
	help
	  Enable the NFC ST25R3911B library.

	  In order to enable this library, the devicetree must have a
	  node with compatible "st,st25r3911b" enabled. This provides
	  devicetree data which is used to configure board-specific
	  code.

if ST25R3911B_LIB

module = ST25R3911B_LIB
module-str = ST25R3911B
source "${ZEPHYR_BASE}/subsys/logging/Kconfig.template.log_config"

endif # ST25R3911B_LIB
```

## lib/supl/Kconfig
```kconfig
#
# Copyright (c) 2019 Nordic Semiconductor ASA
#
# SPDX-License-Identifier: LicenseRef-Nordic-5-Clause
#

config SUPL_CLIENT_LIB
	bool "SUPL Client library"
	depends on NEWLIB_LIBC
	help
	  A library for accessing A-GNSS data using the SUPL protocol.
```

## lib/tone/Kconfig
```kconfig
# Copyright (c) 2023 Nordic Semiconductor
#
# SPDX-License-Identifier: LicenseRef-Nordic-5-Clause
#

menuconfig TONE
	bool "TONE - Sinus creation library"
	default n
	select CMSIS_DSP
	select CMSIS_DSP_FASTMATH
	help
	  Library for creating tones

if TONE

module = TONE
module-str = tone
source "${ZEPHYR_BASE}/subsys/logging/Kconfig.template.log_config"

endif #TONE
```

## lib/uart_cobs/Kconfig
```kconfig
#
# Copyright (c) 2020 Nordic Semiconductor
#
# SPDX-License-Identifier: LicenseRef-BSD-5-Clause-Nordic
#

# UART COBS module configuration

menuconfig UART_COBS
	bool "UART COBS library"
	depends on SERIAL
	depends on UART_ASYNC_API
	help
	  Library for transferring Consistent Overhead Byte Stuffing (COBS)
	  encoded packets using the UART.

if UART_COBS

config UART_COBS_THREAD_PRIO
	int "UART COBS library workqueue thread priority level"
	range 0 NUM_PREEMPT_PRIORITIES
	default 0 if !MULTITHREADING
	default 10
	help
	  Thread priority for the workqueue used by the UART COBS library
	  for processing UART events and dispatching application events.

config UART_COBS_THREAD_STACK_SIZE
	int "UART COBS library workqueue thread stack size"
	default 1024
	help
	  Stack size for the workqueue used by the UART COBS library
	  for processing UART events and dispatching application events.

module=UART_COBS
module-str=UART COBS library
source "${ZEPHYR_BASE}/subsys/logging/Kconfig.template.log_config"

endif # UART_COBS
```

## lib/ui/Kconfig
```kconfig
#
# Copyright (c) 2018 Nordic Semiconductor
#
# SPDX-License-Identifier: LicenseRef-BSD-5-Clause-Nordic
#

menu "User interface library for Nordic DKs"

config UI_OUT_LIBRARY
	bool "User interface output library for Nordic DKs"

if UI_OUT_LIBRARY

comment "User interface output the type of signaling"

config UI_OUT_USER_STATE
	bool "Enable creating user states"
	default n
	help
	  Allows you to create individual user
	  events for the application

config UI_OUT_LOG
	bool "Signalimg events by log"
	default y

config UI_OUT_LEDS
	bool "Signaling events by DK leds"
	select DK_LIBRARY
	default y

menu "Leds intervals"
visible if UI_OUT_LEDS

config UI_OUT_ADV_LED_ON_INTERVAL
	int "Advertising led on interval in milliseconds"
	default 200

config UI_OUT_ADV_LED_OFF_INTERVAL
	int "Advertising led off interval in milliseconds"
	default 1800

config UI_OUT_SCAN_LED_ON_INTERVAL
	int "Scanning led on interval in milliseconds"
	default 1800

config UI_OUT_SCAN_LED_OFF_INTERVAL
	int "Scanning led off interval in milliseconds"
	default 200

config UI_OUT_BONDING_LED_INTERVAL
	int "Bonding led interval in milliseconds"
	default 100

config UI_OUT_ADV_SCAN_LEDS_ON_INTERVAL
	int "Advertising and scanning leds on interval in milliseconds"
	default 500

config UI_OUT_ADV_SCAN_LEDS_OFF_INTERVAL
	int "Advertising and scanning leds off interval in milliseconds"
	default 250

config UI_OUT_ALERT_INTERVAL
	int "Alert led interval"
	default 200
endmenu

menu "Leds"
visible if UI_OUT_LEDS

config UI_OUT_ADV_STARTED_LED
	int "Advertising led number"
	default 1
	range 1 4

config UI_OUT_CONNECTED_LED
	int "Connected led number"
	default 1
	range 1 4

config UI_OUT_BONDING_LED
	int "Bonding led number"
	default 1
	range 1 4

config UI_OUT_SCANNING_LED
	int "Scanning led number"
	default 2
	range 1 4

config UI_OUT_USER_LED1
	int "User led 1 number"
	default 1
	range 1 4

config UI_OUT_USER_LED2
	int "User led 2 number"
	default 2
	range 1 4

config UI_OUT_USER_LED3
	int "User led 3 number"
	default 3
	range 1 4

config UI_OUT_USER_LED4
	int "User led 4 number"
	default 4
	range 1 4

config UI_OUT_ALERT_LED
	int "Alert led number"
	default 2
	range 1 4

endmenu

module = UI_OUT_LIB
module-str = User interface output
source "${ZEPHYR_BASE}/subsys/logging/Kconfig.template.log_config"

endif # UI_OUT_LIBRARY

endmenu
```

## lib/uicc_lwm2m/Kconfig
```kconfig
#
# Copyright (c) 2024 Nordic Semiconductor ASA
#
# SPDX-License-Identifier: LicenseRef-Nordic-5-Clause
#

config UICC_LWM2M
	bool "UICC LwM2M bootstrap support"
	depends on NRF_MODEM_LIB
	help
	  Enable UICC LwM2M bootstrap library
```

## lib/wave_gen/Kconfig
```kconfig
#
# Copyright (c) 2021 Nordic Semiconductor
#
# SPDX-License-Identifier: LicenseRef-Nordic-5-Clause
#

menuconfig WAVE_GEN_LIB
	bool "Enable wave signal generating library"
	select REQUIRES_FULL_LIBC
	help
	  The library can be used to generate a value of a wave signal for given time.
	  Generated signal's type, amplitude, period and offset can be customized.
	  Amplitude of added noise can be specified too.

if WAVE_GEN_LIB

module = WAVE_GEN_LIB
module-str = Wave generating library
source "$(ZEPHYR_BASE)/subsys/logging/Kconfig.template.log_config"

endif # WAVE_GEN_LIB
```
