## lib/nrf_modem_lib/zephyr_modem/Kconfig
```kconfig
# Copyright (c) 2026 Nordic Semiconductor ASA
# SPDX-License-Identifier: LicenseRef-Nordic-5-Clause

config NRF_MODEM_LIB_ZEPHYR_MODEM
	bool "nRF Modem library implemented over Zephyr modem subsystem (CMUX)"
	help
	  Replaces the real nRF Modem library (nrfxlib) with a proxy that
	  routes AT commands over a CMUX session to an nRF91 Series SiP
	  running Serial Modem application.  Intended for non-nRF91 host
	  processors (e.g. nRF54L20).

if NRF_MODEM_LIB_ZEPHYR_MODEM

config NRF_MODEM_LIB_ZEPHYR_MODEM_AT_BUF_SIZE
	int "AT response buffer size"
	default 2048
	help
	  Size of the buffer used to accumulate AT response lines.

config NRF_MODEM_LIB_ZEPHYR_MODEM_UART_BUF_SIZE
	int "UART TX/RX buffer size"
	default 512
	help
	  Size of each of the UART backend send and receive buffers.

config NRF_MODEM_LIB_ZEPHYR_MODEM_STACK_SIZE
	int "AT reader thread stack size"
	default 2048

config NRF_MODEM_LIB_ZEPHYR_MODEM_AT_READER_PRIO
	int "AT reader thread priority"
	default 7
	help
	  Thread priority for the AT response reader. Must be high enough to
	  prevent starvation when other threads issue AT commands frequently
	  (e.g. Memfault LTE metrics). Lower values = higher priority.
	  Default 7 is in the cooperative range below typical application threads.

config NRF_MODEM_LIB_ZEPHYR_MODEM_AT_READER_POLL_MS
	int "AT reader poll interval (ms)"
	default 100
	help
	  Interval at which the AT reader thread polls for data even if no
	  pipe event was received. This handles edge cases where the CMUX
	  pipe event is missed due to race conditions. Lower values improve
	  responsiveness but increase CPU usage slightly.

config NRF_MODEM_LIB_ZEPHYR_MODEM_CMUX_BUF_SIZE
	int "CMUX work buffer size"
	default 1024
	help
	  Size of CMUX receive and transmit work buffers. Should be at least
	  as large as the maximum CMUX frame size (MTU + headers).

config NRF_MODEM_LIB_ZEPHYR_MODEM_DLCI1_RX_BUF_SIZE
	int "DLCI 1 (PPP) receive buffer size"
	default 4096
	help
	  Receive buffer size for the PPP data channel (DLCI 1). Larger buffers
	  reduce the risk of overflow during high throughput periods. This buffer
	  holds received PPP frames until the network stack consumes them.

config NRF_MODEM_LIB_ZEPHYR_MODEM_DLCI2_RX_BUF_SIZE
	int "DLCI 2 (AT) receive buffer size"
	default 2048
	help
	  Receive buffer size for the AT command channel (DLCI 2). Should be
	  large enough to handle verbose AT responses and unsolicited result codes.

config NRF_MODEM_LIB_ZEPHYR_MODEM_RESPONSE_TIMEOUT_MS
	int "AT command response timeout (ms)"
	default 30000

config NRF_MODEM_LIB_ZEPHYR_MODEM_INIT_PRIORITY
	int "SYS_INIT priority"
	default 10

endif # NRF_MODEM_LIB_ZEPHYR_MODEM
```

## lib/ntn/Kconfig
```kconfig
#
# Copyright (c) 2025 Nordic Semiconductor
#
# SPDX-License-Identifier: LicenseRef-Nordic-5-Clause
#

menuconfig NTN
	bool "NTN (Non-Terrestrial Network) library"
	depends on NRF_MODEM_LIB
	select AT_PARSER
	select AT_MONITOR
	imply CBPRINTF_FP_SUPPORT if LOG
	help
	  Library for NTN (Non-Terrestrial Network) helper functionality.

if NTN

config NTN_LOCATION_REQUEST_ADVANCE
	int "Location request advance in seconds"
	default 30
	help
	  Sets how many seconds in advance the NTN_EVT_LOCATION_REQUEST event is sent to
	  request location when modem needs location at a specific time. The value should be long
	  enough so that the application has enough time to update the current location before
	  modem needs it. This should include for example time to start GNSS and get a valid fix.

config NTN_WORKQUEUE_STACK_SIZE
	int "NTN library work queue stack size"
	default 1024
	help
	  Stack size for the NTN library work queue.

config NTN_WORKQUEUE_PRIORITY
	int "NTN library work queue priority"
	default 5
	help
	  Priority for the NTN library work queue.

module = NTN
module-str = NTN library
source "subsys/logging/Kconfig.template.log_config"

endif # NTN
```

## lib/otdoa_al/Kconfig
```kconfig
#
#  Copyright (c) 2025 PHY Wireless, Inc.
#
#  SPDX-License-Identifier: LicenseRef-PHYW
#

menuconfig OTDOA_AL_LIB
	bool "OTDOA library"
	help
		The OTDOA library can be used to do $(PHYWI MARKETING MATERIAL)

if OTDOA_AL_LIB

module = OTDOA_AL_LIB
module-str = OTDOA AL library

config OTDOA_DEFAULT_TIMEOUT_MS
	int "Default timeout to use for OTDOA operations, in milliseconds"
	default 120000

config OTDOA_SHELL_COMMANDS
	bool "PHYWI shell commands for testing OTDOA"
	default n

choice OTDOA_LIB_TYPE
	prompt "Build Type"
	default OTDOA_LIB_TYPE_PROD
	help
		Select the OTDOA library build to link
	config OTDOA_LIB_TYPE_PROD
		bool "Standard production release"
	config OTDOA_LIB_TYPE_DBG
		bool "Debug release with verbose logging"
	config OTDOA_LIB_TYPE_DEV
		bool "Developer release with capture functions"
	endchoice

config OTDOA_LITTLE_FS
	bool "Use an OTDOA-provided LittleFS filesystem"
	default y

config OTDOA_EXTERNAL_STORAGE
	bool "Use external flash filesystem for OTDOA files"
	default y

config OTDOA_CFG_DL_INTERVAL
	int "Interval between uBSA downloads to trigger a config download"
	default 5

config OTDOA_PRS_SAMPLES_BUFFER_COUNT
	int "Number of buffer slabs for PRS samples"
	default 1

config OTDOA_HTTP_BLACKLIST_TIMEOUT
	int "Number of uBSA requests to make before removing an SC ECGI from the DL blacklist"
	default 20

config OTDOA_HTTP_QUEUE_STACK_SIZE
	int "HTTP work queue stack size in bytes"
	default 2048

config OTDOA_HTTP_QUEUE_PRIORITY
	int "HTTP work queue priority"
	default 5

config OTDOA_RS_THREAD_STACK_SIZE
	int "RS work queue stack size in bytes"
	default 4096

config OTDOA_RS_THREAD_PRIORITY
	int "RS work queue priority"
	default 5

config OTDOA_API_TLS_CERT_INSTALL
	bool "Install a TLS certificate through the OTDOA library using otdoa_api_install_tls_cert()"
	default y

config OTDOA_TLS_SEC_TAG
	int "Modem security tag slot to install PhyWi TLS certificate to"
	default 42

config OTDOA_BSA_DL_SERVER_URL
	string "URL to download BSA files from"
	default "api.prod.hellaphy.cloud"

config OTDOA_HTTPS_PORT
	int "Port to use for OTDOA HTTPS operations"
	default 443

config OTDOA_HTTP_PORT
	int "Port to use for OTDOA HTTP operations"
	default 80

config OTDOA_ENABLE_RESULTS_UPLOAD
	bool "Upload of OTDOA results to a server"
	default n

config OTDOA_RESULTS_UPLOAD_PW
	string "Password to use for Phywi API authentication when uploading OTDOA results"
	default ""
	depends on OTDOA_ENABLE_RESULTS_UPLOAD

config OTDOA_UPLOAD_SERVER_URL
	string "URL to upload OTDOA results to"
	default "api.prod.hellaphy.cloud"
	depends on OTDOA_ENABLE_RESULTS_UPLOAD

endif # OTDOA_AL_LIB
```

## lib/pcm_mix/Kconfig
```kconfig
# Copyright (c) 2022 Nordic Semiconductor
#
# SPDX-License-Identifier: LicenseRef-Nordic-5-Clause
#

menuconfig PCM_MIX
	bool "PCM - Pulse Code Modulation mix library"
	help
	  Library for mixing multiple audio streams

if PCM_MIX

module = PCM_MIX
module-str = pcm-mix
source "${ZEPHYR_BASE}/subsys/logging/Kconfig.template.log_config"

endif #PCM_MIX
```

## lib/pcm_stream_channel_modifier/Kconfig
```kconfig
#
# Copyright (c) 2023 Nordic Semiconductor
#
# SPDX-License-Identifier: LicenseRef-Nordic-5-Clause
#

menuconfig PSCM
	bool "PSCM - PCM Stream Channel Modifier Library"
	help
	  Library for manipulating pulse coded modulation (PCM) streams

if PSCM

module = PSCM
module-str = PCM Stream Channel Modifier
source "${ZEPHYR_BASE}/subsys/logging/Kconfig.template.log_config"

endif #PSCM
```

## lib/pdn/Kconfig
```kconfig
#
# Copyright (c) 2021 Nordic Semiconductor ASA
#
# SPDX-License-Identifier: LicenseRef-Nordic-5-Clause
#

menuconfig PDN
	bool "Packet Domain Network library"
	depends on NRF_MODEM_LIB && AT_MONITOR
	# library uses heap
	depends on HEAP_MEM_POOL_SIZE > 0

if PDN

config PDN_LEGACY_PCO
	bool "Use legacy PCO mode"
	help
	  If selected, PCO will be used instead of ePCO during PDN connection establishment.

config PDN_ESM_TIMEOUT
	int "ESM timeout (ms)"
	default 1000
	help
	  Timeout for waiting for an ESM notification when activating a PDN, in milliseconds.

config PDN_INIT_PRIORITY
	int "Initialization priority"
	default APPLICATION_INIT_PRIORITY

config PDN_DEFAULTS_OVERRIDE
	bool "Override defaults for PDP context 0"
	help
	  The defaults are overridden automatically as soon as the modem has been initialized.

if PDN_DEFAULTS_OVERRIDE

config PDN_DEFAULT_APN
	string "Access point name (APN)"

choice
	prompt "Family"
	default PDN_DEFAULT_FAM_IPV4V6

config PDN_DEFAULT_FAM_IPV4
	bool "IPV4"
config PDN_DEFAULT_FAM_IPV6
	bool "IPV6"
config PDN_DEFAULT_FAM_IPV4V6
	bool "IPV4V6"
config PDN_DEFAULT_FAM_NONIP
	bool "Non-IP"

endchoice

config PDN_DEFAULT_FAM
	int
	default 0 if PDN_DEFAULT_FAM_IPV4
	default 1 if PDN_DEFAULT_FAM_IPV6
	default 2 if PDN_DEFAULT_FAM_IPV4V6
	default 3 if PDN_DEFAULT_FAM_NONIP

choice
	prompt "Authentication method"
	default PDN_DEFAULT_AUTH_NONE

config PDN_DEFAULT_AUTH_NONE
	bool "None"
config PDN_DEFAULT_AUTH_PAP
	bool "PAP"
config PDN_DEFAULT_AUTH_CHAP
	bool "CHAP"
endchoice

config PDN_DEFAULT_AUTH
	int
	default 0 if PDN_DEFAULT_AUTH_NONE
	default 1 if PDN_DEFAULT_AUTH_PAP
	default 2 if PDN_DEFAULT_AUTH_CHAP

config PDN_DEFAULT_USERNAME
	string "Username"
	depends on !PDN_DEFAULT_AUTH_NONE

config PDN_DEFAULT_PASSWORD
	string "Password"
	depends on !PDN_DEFAULT_AUTH_NONE

endif # PDN_DEFAULTS_OVERRIDE

config PDN_ESM_STRERROR
	bool "Compile ESM error table"
	help
	  Compile a table with a textual description of ESM error reasons.
	  The description can be retrieved with pdn_esm_strerror().
	  The table and function take about 2 KB of FLASH.

module=PDN
module-dep=LOG
module-str=PDN library
source "${ZEPHYR_BASE}/subsys/logging/Kconfig.template.log_config"

endif # PDN
```

## lib/pdn_management/Kconfig
```kconfig
#
# Copyright (c) 2019 Nordic Semiconductor
#
# SPDX-License-Identifier: LicenseRef-Nordic-5-Clause
#

config PDN_MANAGEMENT
	bool "PDN Management for nRF9160"
	depends on NRF_MODEM_LIB
```

## lib/pelion/Kconfig
```kconfig
#
# Copyright (c) 2021 Nordic Semiconductor ASA
#
# SPDX-License-Identifier: LicenseRef-Nordic-5-Clause
#

# The purpose of this file is to override and extend settings related to
# building Pelion cloud client library.

if PELION_SOURCES

config OPENTHREAD_SECURITY_INTERNAL
	bool
	default y if PELION_NRF_SECURITY

config MBEDTLS_PROMPTLESS
	bool
	default y if !CUSTOM_PELION_SECURITY

config NORDIC_SECURITY_PROMPTLESS
	bool
	default y if !CUSTOM_PELION_SECURITY

menu "Pelion Device Management Client Library"

config MBEDTLS_SSL_MAX_CONTENT_LEN
	int
	default 4096

choice
	prompt "Pelion Security"

config CUSTOM_PELION_SECURITY
	bool "Custom"
	help
	  Custom security settings. Choosing this setting will allow for user
	  specific control of all security related settings.

config PELION_NRF_SECURITY
	bool "nRF Security"
	select OPENTHREAD_NRF_SECURITY if NET_L2_OPENTHREAD
	select MBEDTLS_TLS_LIBRARY
	select MBEDTLS_X509_LIBRARY
	select MBEDTLS_CIPHER_MODE_CBC
	select MBEDTLS_CIPHER_MODE_CTR
	select MBEDTLS_CIPHER_PADDING_PKCS7
	select MBEDTLS_ECP_DP_SECP256R1_ENABLED
	select MBEDTLS_PKCS1_V15
	select MBEDTLS_PKCS1_V21
	select MBEDTLS_AES_C
	select MBEDTLS_CCM_C
	select MBEDTLS_CMAC_C
	select MBEDTLS_CTR_DRBG_C
	select MBEDTLS_ECDH_C
	select MBEDTLS_ECDSA_C
	select MBEDTLS_ECP_C
	select MBEDTLS_HMAC_DRBG_C
	select MBEDTLS_PK_WRITE_C
	select MBEDTLS_SHA256_C
	select MBEDTLS_SSL_RENEGOTIATION
	select MBEDTLS_SSL_ALPN
	select MBEDTLS_SSL_DTLS_CLIENT_PORT_REUSE
	select MBEDTLS_SSL_DTLS_BADMAC_LIMIT
	select MBEDTLS_SSL_SESSION_TICKETS
	select MBEDTLS_SSL_SERVER_NAME_INDICATION
	select MBEDTLS_SSL_CACHE_C
	select MBEDTLS_SSL_TICKET_C
	select MBEDTLS_X509_CHECK_KEY_USAGE
	select MBEDTLS_X509_CHECK_EXTENDED_KEY_USAGE
	select MBEDTLS_X509_CRL_PARSE_C
	select MBEDTLS_X509_CSR_PARSE_C
	select MBEDTLS_X509_CREATE_C
	select MBEDTLS_X509_CSR_WRITE_C
	select NORDIC_SECURITY_BACKEND
	select NRF_SECURITY_ADVANCED
	select NRF_SECURITY_RNG
	select OBERON_BACKEND if !CC3XX_BACKEND
	help
	  Default mbedtls configuration for Pelion.

endchoice

config PELION_MBEDTLS_LIB_NAME
	string
	default "mbedtls_common mbedcrypto_shared mbedcrypto_cc3xx mbedcrypto_oberon mbedcrypto_vanilla" if CC3XX_BACKEND && OBERON_BACKEND && MBEDTLS_VANILLA_BACKEND
	default "mbedtls_common mbedcrypto_shared mbedcrypto_cc3xx mbedcrypto_oberon" if CC3XX_BACKEND && OBERON_BACKEND
	default "mbedtls_common mbedcrypto_shared mbedcrypto_cc3xx mbedcrypto_vanilla" if CC3XX_BACKEND && MBEDTLS_VANILLA_BACKEND
	default "mbedtls_common mbedcrypto_shared mbedcrypto_oberon mbedcrypto_vanilla" if OBERON_BACKEND && MBEDTLS_VANILLA_BACKEND
	default "mbedtls_common mbedcrypto_shared mbedcrypto_vanilla" if MBEDTLS_VANILLA_BACKEND
	default "mbedtls_common mbedcrypto_shared mbedcrypto_cc3xx" if CC3XX_BACKEND
	default "mbedtls_common mbedcrypto_shared mbedcrypto_oberon" if OBERON_BACKEND
	default "mbedtls_common" if PELION_NRF_SECURITY
	help
	  This option allows to specify one or more mbedtls library files to be
	  linked with Pelion. Separate multiple values with space " ".

endmenu

endif
```

## lib/ppi_seq/Kconfig
```kconfig
#
# Copyright (c) 2026 Nordic Semiconductor ASA
#
# SPDX-License-Identifier: LicenseRef-Nordic-5-Clause
#

config PPI_SEQ
	bool "PPI Sequencer"
	select NRFX_TIMER
	imply NRFX_GPPI
	help
	  PPI Sequencer is a module for periodically triggering hardware tasks
	  (like SPI transfer) using PPI and timing source (GRTC, TIMER or RTC).

config PPI_SEQ_MAX_PPI_HANDLES
	int "Maximum number of PPI handles"
	default 8
	help
	  Should not be touched unless RAM optimization is needed. For simpler use
	  cases not all handles are used but each slot is just 4 bytes.
config PPI_SEQ_I2C_SPI
	bool "PPI Sequencer for I2C/SPI"
	depends on $(dt_compat_enabled,$(DT_COMPAT_NORDIC_PPI_SEQ_I2C)) || \
		   $(dt_compat_enabled,$(DT_COMPAT_NORDIC_PPI_SEQ_SPI))
	default y
	select NRFX_SPIM if $(dt_compat_enabled,$(DT_COMPAT_NORDIC_PPI_SEQ_SPI))
	select NRFX_TWIM if $(dt_compat_enabled,$(DT_COMPAT_NORDIC_PPI_SEQ_I2C))
	select PPI_SEQ
	select PINCTRL
```

## lib/ppr_prl/Kconfig
```kconfig
#
#Copyright(c) 2025 Nordic Semiconductor ASA
#
#SPDX - License - Identifier : LicenseRef - Nordic - 5 - Clause
#

menuconfig PPR_PRL
	bool "PPR power request logger library"
	help
	  This library provides communication with the PPR power request logger.


if PPR_PRL

config PPR_PRL_AUTO_START
	bool "Auto start PPR PRL"
	default y
	help
	  If selected, the PPR power logger will be started automatically
	  when the application starts. Otherwise, the application must
	  call ppr_prl_start() to start the logger.

if PPR_PRL_AUTO_START

config PPR_PRL_AUTO_START_CONFIG_VTIM_CNTTOP
	int "VTIM_CNTTOP value"
	default 16000
	help
	  The value of the VTIM_CNTTOP register for the PPR power request logger sampling timer.
	  The TIMER runs at 16 MHz and the value is the number of clock cycles to count before taking a sample.

config PPR_PRL_AUTO_START_CONFIG_MAX_SAMPLES
	int "Number of samples the power logger should collect"
	default 1024
	help
	  The number of samples the power logger should collect before stopping.

endif # PPR_PRL_AUTO_START

endif # PPR_PRL
```

## lib/process_certs/Kconfig
```kconfig
#
# Copyright (c) 2025 Nordic Semiconductor
#
# SPDX-License-Identifier: LicenseRef-Nordic-5-Clause
#
config PROCESS_CERT_BLOBS
	bool "Process enterprise certicates"
	depends on WIFI_NM_WPA_SUPPLICANT_CRYPTO_ENTERPRISE 
	
```
