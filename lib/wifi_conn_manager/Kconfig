## modules/tfm/zephyr/Kconfig
```kconfig
#
# Copyright (c) 2021 Nordic Semiconductor ASA
#
# SPDX-License-Identifier: LicenseRef-Nordic-5-Clause
#

config TFM_BOARD
	string
	default "${ZEPHYR_NRF_MODULE_DIR}/modules/tfm/tfm/boards/nrf9160" if SOC_NRF9160_SICA
	default "${ZEPHYR_NRF_MODULE_DIR}/modules/tfm/tfm/boards/nrf5340_cpuapp" if SOC_NRF5340_CPUAPP_QKAA
	depends on TRUSTED_EXECUTION_NONSECURE
	help
	  Redefinition of TFM_BOARD to use out-of-tree boards. These depend on
	  ${TFM_BOARD_BASE_DIR} being set to the TFM board dir inside sdk-nrf.

# Copied from secure_fw/partitions/platform/Kconfig, appended the TFM prefix
menu "Platform partition component configs"
	depends on TFM_PARTITION_PLATFORM

config TFM_PLATFORM_SERVICE_INPUT_BUFFER_SIZE
	int "Size of input buffer"
	default 64

config TFM_PLATFORM_SERVICE_OUTPUT_BUFFER_SIZE
	int "Size of output buffer"
	default 64

config TFM_PLATFORM_SP_STACK_SIZE
	hex "Stack size"
	default 0x500

config TFM_PLATFORM_NV_COUNTER_MODULE_DISABLED
	bool "Disable Non-volatile counter module"
	default y if TFM_PROFILE_TYPE_MINIMAL

endmenu

# Copied from secure_fw/partitions/crypto/Kconfig, appended the TFM prefix
menu "Crypto component configs"
	depends on TFM_PARTITION_CRYPTO

config TFM_CRYPTO_SINGLE_PART_FUNCS_DISABLED
	bool "Only enable multi-part operations"
	default n
	help
	  Only enable multi-part operations in Hash, MAC, AEAD and symmetric
	  ciphers, to optimize memory footprint in resource-constrained devices
endmenu

# Copied from secure_fw/partitions/initial_attestation/Kconfig, appended the TFM prefix
menu "Attestation component configs"
	depends on TFM_PARTITION_INITIAL_ATTESTATION

config TFM_ATTEST_INCLUDE_OPTIONAL_CLAIMS
	bool "Include optional claims in initial attestation token"
	default y

config TFM_ATTEST_INCLUDE_COSE_KEY_ID
	bool "Include COSE key-id in initial attestation token"
	default n

# Only the PSA_IOT_1 profile is supported
config TFM_ATTEST_TOKEN_PROFILE_PSA_IOT_1_ENABLED
	bool
	default y
	help
	  Set the PSA_IOT_1 initial attestation token profile

config TFM_ATTEST_STACK_SIZE
	hex "Attestation service stack size"
	default 0x700
endmenu

# Copied from secure_fw/partitions/internal_trusted_storage/Kconfig, appended the TFM prefix
menu "ITS component configs"
	depends on TFM_PARTITION_INTERNAL_TRUSTED_STORAGE

config TFM_ITS_CREATE_FLASH_LAYOUT
	bool "Create flash FS"
	default y
	help
	  Create flash FS if it doesn't exist for Internal Trusted Storage
	  partition

config TFM_ITS_RAM_FS
	bool "Enable emulated RAM FS"
	default n
	help
	  Enable emulated RAM FS for platforms that don't have flash for
	  Internal Trusted Storage partition

config TFM_ITS_VALIDATE_METADATA_FROM_FLASH
	bool "Validate filesystem metadata"
	default y
	help
	  Validate filesystem metadata every time it is read from flash

config TFM_ITS_MAX_ASSET_SIZE_OVERRIDE
	default y

config TFM_ITS_MAX_ASSET_SIZE
	default 512

config TFM_ITS_NUM_ASSETS
	default 10

config TFM_ITS_BUF_SIZE
	int "Size of the ITS internal data transfer buffer"
	default TFM_ITS_MAX_ASSET_SIZE
	help
	  Size of the ITS internal data transfer buffer (defaults to
	  TFM_ITS_MAX_ASSET_SIZE if not set)

config TFM_ITS_STACK_SIZE
	hex "Stack size"
	default 0x720
endmenu

# Copied from secure_fw/partitions/protected_storage/Kconfig, appended the TFM prefix
menu "PS component configs"
	depends on TFM_PARTITION_PROTECTED_STORAGE

config TFM_PS_CREATE_FLASH_LAYOUT
	bool "Create flash FS"
	default y
	help
	  Create flash FS if it doesn't exist for Protected Storage partition

config TFM_PS_RAM_FS
	bool "Enable emulated RAM FS"
	default n
	help
	  Enable emulated RAM FS for platforms that don't have flash for
	  Protected Storage partition

config TFM_PS_ROLLBACK_PROTECTION
	bool "Enable rollback protection"
	default y
	help
	  Enable rollback protection for Protected Storage partition

config TFM_PS_VALIDATE_METADATA_FROM_FLASH
	bool "Validate filesystem metadata"
	default y
	help
	  Validate filesystem metadata every time it is read from flash

config TFM_PS_MAX_ASSET_SIZE
	int "Maximum stored asset size"
	default 2048
	help
	  The maximum asset size to be stored in the Protected Storage area

config TFM_PS_NUM_ASSETS
	int "Maximum stored assets number"
	default 10
	help
	  The maximum number of assets to be stored in the Protected Storage
	  area

config TFM_PS_STACK_SIZE
	hex "Stack size"
	default 0x700
endmenu

# Copied from secure_fw/spm/Kconfig, removed CONFIG prefix
menu "TF-M SPM component configs"

config TFM_CONN_HANDLE_MAX_NUM
	int "Maximal number of handling secure services"
	default 8
	help
	  The maximal number of secure services that are connected or requested at
	  the same time

config TFM_DOORBELL_API
	bool "Enable the doorbell APIs"
	depends on TFM_IPC
	default n
endmenu
```
