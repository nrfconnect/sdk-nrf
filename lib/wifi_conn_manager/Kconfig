## modules/memfault-firmware-sdk/Kconfig
```kconfig
#
# Copyright (c) 2021 Nordic Semiconductor ASA
#
# SPDX-License-Identifier: LicenseRef-Nordic-5-Clause
#

if MEMFAULT

config MEMFAULT_NCS_PROJECT_KEY
	string "Memfault API key"
	help
	  Memfault project key

choice
	prompt "Choose built-in Memfault Device Info or custom implementation"
	default MEMFAULT_NCS_DEVICE_INFO_BUILTIN

config MEMFAULT_NCS_DEVICE_INFO_BUILTIN
	bool "Built-in Memfault Device Info implementation"
	help
	  Use built-in Memfault Device Info implementation

config MEMFAULT_NCS_DEVICE_INFO_CUSTOM
	bool "Custom user-defined Memfault Device Info implementation"
	help
	  Use custom user-defined Memfault Device Info implementation.
	  'memfault_platform_get_device_info()' will need to be defined in the
	  application.

endchoice

if MEMFAULT_NCS_DEVICE_INFO_BUILTIN

choice
	prompt "Memfault device ID generation method"
	default MEMFAULT_NCS_DEVICE_ID_HW_ID

config MEMFAULT_NCS_DEVICE_ID_IMEI
	bool "Use IMEI as Memfault device ID [DEPRECATED]"
	select DEPRECATED
	depends on NRF_MODEM_LIB
	help
	  Use the device's IMEI as Memfault device ID. Deprecated, use
	  MEMFAULT_NCS_DEVICE_ID_HW_ID and HW_ID_LIBRARY_SOURCE_IMEI instead.

config MEMFAULT_NCS_DEVICE_ID_NET_MAC
	bool "Use network interface MAC address as device ID [DEPRECATED]"
	select DEPRECATED
	depends on NETWORKING
	help
	  Use the device's network interface MAC address as Memfault device ID.
	  Deprecated, use MEMFAULT_NCS_DEVICE_ID_HW_ID and
	  HW_ID_LIBRARY_SOURCE_NET_MAC instead.

config MEMFAULT_NCS_DEVICE_ID_HW_ID
	bool "Use hw_id for Memfault Device ID"
	select HW_ID_LIBRARY
	help
	  Helper symbol to use hw_id API for Memfault Device ID if a corresponding option is selected.

config MEMFAULT_NCS_DEVICE_ID_STATIC
	bool "Set Memfault device ID in Kconfig"
	help
	  Set the Memfault device ID with CONFIG_MEMFAULT_NCS_DEVICE_ID

config MEMFAULT_NCS_DEVICE_ID_RUNTIME
	bool "Set device ID runtime"
	help
	  Set the Memfault device ID runtime using memfault_ncs_device_id_set()

endchoice

config MEMFAULT_NCS_DEVICE_ID
	string "Memfault device ID"
	depends on MEMFAULT_NCS_DEVICE_ID_STATIC
	help
	  Memfault device ID

config MEMFAULT_NCS_DEVICE_ID_MAX_LEN
	int "Memfault device ID max length"
	depends on MEMFAULT_NCS_DEVICE_ID_RUNTIME
	default 30
	help
	  Maximum length for the device ID when CONFIG_MEMFAULT_NCS_DEVICE_ID_RUNTIME
	  is selected as method for device ID generation

config MEMFAULT_NCS_HW_VERSION
	string "Hardware version"
	default BOARD
	help
	  Device hardware version

config MEMFAULT_NCS_FW_TYPE
	string "Firmware type"
	default "app"
	help
	  Firmware type (Memfault Software Type) running on the board

choice MEMFAULT_FW_VERSION
	prompt "Firmware version generation method"
	default MEMFAULT_NCS_FW_VERSION_AUTO
	help
	  Method to use to generate firmware version

config MEMFAULT_NCS_FW_VERSION_STATIC
	bool "Static firmware version"
	help
	  Use statically configured firmware version, as opposed to a
	  dynamically generated one

config MEMFAULT_NCS_FW_VERSION_AUTO
	bool "Dynamic firmware version"
	help
	  Use dyanimically generated firmware version. The version is
	  re-generated on every compiler run
endchoice

config MEMFAULT_NCS_FW_VERSION_PREFIX
	string "Firmware version prefix"
	depends on MEMFAULT_NCS_FW_VERSION_AUTO
	default "0.0.1+"
	help
	  Prefix to use in front of automatically generated build version string.
	  If the build version string is "a1b2c3d", the full firmware version
	  will become "<prefix>a1b2c3d".

config MEMFAULT_NCS_FW_VERSION
	string "Static firmware version to use"
	depends on MEMFAULT_NCS_FW_VERSION_STATIC
	default "$(APP_VERSION_TWEAK_STRING)" if "$(VERSION_MAJOR)" != ""
	help
	 When using a statically configured firmware version, this value
	 will be reported to Memfault

endif  # MEMFAULT_NCS_DEVICE_INFO_BUILTIN

config MEMFAULT_NCS_INIT_PRIORITY
	int "Memfault initialization priority"
	default 90

config MEMFAULT_NCS_PROVISION_CERTIFICATES
	bool "Provision certificates on initalization"
	default y if MEMFAULT_ROOT_CERT_STORAGE_NRF9160_MODEM
	help
	  Provision required TLS root certificates for connecting to Memfault's
	  endpoints. If this option is disabled, the user is responsible for
	  calling the appropriate Memfault APIs for provisioning the
	  certificates before attempting to connect to Memfault servers.

config MEMFAULT_NCS_STACK_METRICS
	bool "Collect stack metrics"
	select THREAD_ANALYZER
	select THREAD_NAME
	default y
	help
	  Collect metrics for unused stack space for selected stacks.
	  Currently the connection_poll_thread, BT RX, and BT TX threads are supported.

config MEMFAULT_NCS_LTE_METRICS
	bool "Collect LTE metrics"
	select LTE_LC_TRACE
	depends on LTE_LINK_CONTROL
	depends on LTE_LC_EDRX_MODULE
	depends on LTE_LC_PSM_MODULE
	depends on MODEM_INFO
	help
	  Capture LTE metrics while the application is running. Supported
	  metrics are time to connect and number of connection establishments.

config MEMFAULT_NCS_BT_METRICS
	bool "Collect BT metrics"
	depends on BT
	help
	  Collect metrics related to the Bluetooth stack in background while application is running.

config MEMFAULT_NCS_LOCATION_METRICS
	bool "Collect location metrics"
	depends on LOCATION
	depends on LOCATION_DATA_DETAILS
	default y
	help
	  Collect metrics related to location fixes while the application is running.

config MEMFAULT_NCS_USE_DEFAULT_METRICS
	bool
	select MEMFAULT_METRICS_EXTRA_DEFS_FILE
	default y if (MEMFAULT_NCS_STACK_METRICS || MEMFAULT_NCS_LTE_METRICS || MEMFAULT_NCS_BT_METRICS || MEMFAULT_NCS_LOCATION_METRICS)

config MEMFAULT_NCS_IMPLEMENT_METRICS_COLLECTION
	bool "Implement metrics collection"
	depends on MEMFAULT_NCS_USE_DEFAULT_METRICS
	default y
	help
	  Implement the Memfault 'memfault_metrics_heartbeat_collect_data()' function
	  for the selected metrics. Disable this to override the implementation.

menuconfig MEMFAULT_NCS_POST_COREDUMP_ON_NETWORK_CONNECTED
	bool "Post coredump on network connected"
	depends on LTE_LC_PDN_MODULE
	depends on LTE_LINK_CONTROL
	depends on SOC_SERIES_NRF91
	select SMF
	select SMF_ANCESTOR_SUPPORT
	select SMF_INITIAL_TRANSITION
	help
	  Post coredump to Memfault when the device is connected to LTE network.
	  This option is only supported for nRF91 targets.

if MEMFAULT_NCS_POST_COREDUMP_ON_NETWORK_CONNECTED

config MEMFAULT_NCS_POST_MODEM_TRACE_ON_COREDUMP
	bool "Post modem trace on coredump"
	select MEMFAULT_CDR_ENABLE
	depends on NRF_MODEM_LIB_TRACE
	depends on NRF_MODEM_LIB_TRACE_BACKEND_FLASH || NRF_MODEM_LIB_TRACE_BACKEND_RAM
	help
	  Capture modem traces continuously to flash or RAM (no init RAM), and post the traces
	  together with the coredump to Memfault in the event of a crash.

config MEMFAULT_NCS_POST_COREDUMP_AFTER_INITIAL_DELAY
	bool "Post coredump after initial delay"
	default y
	help
	  Delay coredump posting to Memfault to avoid conflicts with the application's
	  TLS connection setup that occurs typically LTE network is obtained.
	  The delay duration is defined by CONFIG_MEMFAULT_NCS_POST_COREDUMP_RETRY_INTERVAL_SECONDS.

config MEMFAULT_NCS_POST_COREDUMP_RETRIES_MAX
	int "Max number of coredump post retries"
	default 3
	default 4 if MEMFAULT_NCS_POST_COREDUMP_AFTER_INITIAL_WAIT
	help
	  Maximum number of retries to post a coredump to Memfault.

config MEMFAULT_NCS_POST_COREDUMP_RETRY_INTERVAL_SECONDS
	int "Retry interval in seconds"
	default 30
	help
	  Interval in seconds between coredump post retries.

config MEMFAULT_NCS_POST_COREDUMP_THREAD_STACK_SIZE
	int "Post coredump thread size"
	default 512

config MEMFAULT_NCS_POST_INITIAL_HEARTBEAT_ON_NETWORK_CONNECTED
	bool "Post initial heartbeat on network connected without coredump"
	default y
	help
	  When enabled, if no coredump is available on network connection, trigger
	  an initial heartbeat and post data to Memfault. This is useful for sending
	  initial metrics to Memfault after boot without having to wait for the first automatic upload
	  set by CONFIG_MEMFAULT_HTTP_PERIODIC_UPLOAD_INTERVAL_SECONDS.
	  Note that when a coredump is found, heartbeat data is always sent along with
	  the coredump regardless of this setting.

endif # MEMFAULT_NCS_POST_COREDUMP_ON_NETWORK_CONNECTED

config MEMFAULT_NCS_ETB_CAPTURE
	bool "Enable ETB trace capture"
	depends on ETB_TRACE
	select MEMFAULT_PLATFORM_EXTRA_CONFIG_FILE
	help
	  Enable storing of the content in the Embedded Trace Buffer (ETB) on crash.
	  This will include the content of the ETB buffer into the coredump as the global variable
	  `etb_buf`.

config MEMFAULT_NCS_INTERNAL_FLASH_BACKED_COREDUMP
	bool "Save coredump to internal flash instead of RAM"
	select MEMFAULT_COREDUMP_STORAGE_CUSTOM
	depends on PARTITION_MANAGER_ENABLED
	depends on FLASH
	help
	  Use internal flash to store coredump data

if MEMFAULT_NCS_INTERNAL_FLASH_BACKED_COREDUMP

config MEMFAULT_NCS_FLASH_REGION_SIZE
	hex
	default $(dt_node_int_prop_hex,$(DT_CHOSEN_ZEPHYR_FLASH),erase-block-size)

partition=MEMFAULT_STORAGE
partition-size=0x10000
source "$(ZEPHYR_NRF_MODULE_DIR)/subsys/partition_manager/Kconfig.template.partition_config"

endif # MEMFAULT_NCS_INTERNAL_FLASH_BACKED_COREDUMP

# We want to encourage the use of a dedicated workqueue to upload data periodically,
# as sending data from the system workqueue is known to be problematic in
# LTE networks. Therefore we override the default value for
# MEMFAULT_HTTP_PERIODIC_UPLOAD_CONTEXT and set it to
# MEMFAULT_HTTP_PERIODIC_UPLOAD_USE_DEDICATED_WORKQUEUE.
choice MEMFAULT_HTTP_PERIODIC_UPLOAD_CONTEXT
	depends on MEMFAULT_HTTP_PERIODIC_UPLOAD
	default MEMFAULT_HTTP_PERIODIC_UPLOAD_USE_DEDICATED_WORKQUEUE
endchoice

module = MEMFAULT_NCS
module-dep = LOG
module-str = Memfault NCS module
source "$(ZEPHYR_BASE)/subsys/logging/Kconfig.template.log_config"

endif # MEMFAULT
```

## modules/openthread/Kconfig.nrf5
```kconfig
# Copyright (c) 2025 Nordic Semiconductor ASA
# SPDX-License-Identifier: LicenseRef-Nordic-5-Clause

if !NET_L2_OPENTHREAD

config NRF5_SELECTIVE_TXCHANNEL
	bool "Support for selective TX channel setting"
	help
	  Enable support for selectively setting TX channel for every timed transmission request.

config NRF5_CARRIER_FUNCTIONS
	bool "Support for carrier functions"
	default y if OPENTHREAD_DIAG
	help
	  Enable support for functions such as modulated carrier and continuous carrier.

config NRF5_VENDOR_OUI_ENABLE
	bool "Support setting Vendor Organizationally Unique Identifier"
	help
	  This option enables setting custom vendor
	  OUI using NRF5_VENDOR_OUI . After enabling,
	  user is obliged to set NRF5_VENDOR_OUI value,
	  as this option has no default value.

if NRF5_VENDOR_OUI_ENABLE

config NRF5_VENDOR_OUI
	int "Vendor Organizationally Unique Identifier"
	help
	  Custom vendor OUI, which makes 24 most-significant
	  bits of MAC address

endif # NRF5_VENDOR_OUI_ENABLE

config NRF5_UICR_EUI64_ENABLE
	bool "Support usage of EUI64 value stored in UICR registers"
	depends on !NRF5_VENDOR_OUI_ENABLE
	depends on SOC_SERIES_NRF52 || SOC_SERIES_NRF53 || SOC_SERIES_NRF54L
	help
	  This option enables setting custom vendor EUI64 value
	  stored in User information configuration registers (UICR).
	  Notice that this disables the default setting of EUI64
	  value from Factory information configuration registers
	  (FICR).

if NRF5_UICR_EUI64_ENABLE

config NRF5_UICR_EUI64_REG
	int "UICR base register for the EUI64 value"
	range 0 30 if SOC_SERIES_NRF52
	range 0 190 if SOC_SERIES_NRF53
	range 0 318 if SOC_SERIES_NRF54L
	default 0
	help
	  Base of the two consecutive registers from the UICR customer
	  section in which custom EUI64 is stored.

endif # NRF5_UICR_EUI64_ENABLE

config NRF5_LOG_RX_FAILURES
	bool "Frame reception failures logging"
	help
	  There are few cases where the frame reception failure can happen because of
	  internal cause. These cases are reported forward by general code error.

	  This options enables logging the reason of frame reception failure.
	  It can be helpful for the network traffic analyze but it generates also
	  a lot of log records in a stress environment.

config NRF5_DELAY_TRX_ACC
	int "Clock accuracy for delayed operations"
	default CLOCK_CONTROL_NRF_ACCURACY if BOARD_NRF52840DONGLE_NRF52840
	default 20 # Value agreed after research as the best for power consumption and system reliability.
	help
	  Accuracy of the clock used for scheduling radio delayed operations (delayed transmission
	  or delayed reception), in ppm.

endif # !NET_L2_OPENTHREAD
```

## modules/tfm/Kconfig
```kconfig
#
# Copyright (c) 2021 Nordic Semiconductor ASA
#
# SPDX-License-Identifier: LicenseRef-Nordic-5-Clause
#

config TFM_BOARD
	string
	default "${ZEPHYR_NRF_MODULE_DIR}/modules/tfm/boards/nrf9160" if SOC_NRF9160_SICA
	default "${ZEPHYR_NRF_MODULE_DIR}/modules/tfm/boards/nrf5340_cpuapp" if SOC_NRF5340_CPUAPP_QKAA
	depends on TRUSTED_EXECUTION_NONSECURE
	help
	  Redefintition of TFM_BOARD to use out-of-tree boards. These depend on
	  ${TFM_BOARD_BASE_DIR} being set to the TFM board dir inside sdk-nrf.

config TFM_ITS_ENCRYPTION
	bool "Enable flash encryption for ITS"
	help
	  This enables a flash driver for ITS specifically that encrypts the
	  flash contents with AES-XTS.
```
