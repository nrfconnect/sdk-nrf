## lib/wifi_conn_manager/Kconfig
```kconfig
#
# Copyright (c) 2018 Nordic Semiconductor
#
# SPDX-License-Identifier: LicenseRef-Nordic-5-Clause
#

menuconfig WIFI_CONN_MGR
	bool "nRF700x Wi-Fi Connection Manager"

if WIFI_CONN_MGR

config WIFI_CONN_MGR_SUPPORTED_CREDS
	int "Number of supported network credentials"
	default 5
	help
		How many different network credentials
		the library supports

config WIFI_CONN_MGR_PSA_UID
	int "UID number where wifi credentials are stored in PSA Protected Storage"
	default 9
	help
		This UID shall be unique and not be used by other parts of the app.

module = WIFI_CONN_MGR
module-dep = LOG
module-str = WiFi Connection Manager library
source "${ZEPHYR_BASE}/subsys/logging/Kconfig.template.log_config"

endif # WIFI_CONN_MGR
```

## modules/Kconfig
```kconfig
#
# Copyright (c) 2021 Nordic Semiconductor ASA
#
# SPDX-License-Identifier: LicenseRef-Nordic-5-Clause
#

configdefault BOOT_BANNER
	default n if NCS_BOOT_BANNER

osource "$(NCS_MEMFAULT_FIRMWARE_SDK_KCONFIG)"
rsource "wfa-qt/Kconfig"
rsource "nrfxlib/nrf_802154_callbacks_dispatcher/Kconfig"
```

## modules/Kconfig.mcuboot
```kconfig
config SIGN_IMAGES
	bool "Sign images for MCUBoot"
	default y
	depends on MCUBOOT_BUILD_STRATEGY_FROM_SOURCE \
		   || BOOT_SIGNATURE_KEY_FILE != ""
	help
	  Sign images for MCUBoot as integrated part of the build stages using
	  the private key.

config BOOT_SIGNATURE_KEY_FILE
	string "MCUBoot PEM key file"
	depends on !MCUBOOT_BUILD_STRATEGY_FROM_SOURCE
	help
	  Absolute path to PEM key file containing the private key corresponding
	  to the public key included in MCUBoot. This will be used to sign the
	  image so that it can be verified by MCUBoot. Since MCUBoot is not
	  built from source, it is not possible for the build system to deduce
	  what key was used when compiling it. Hence, it is required that the
	  key is passed to the build system through this option.

config INIT_ARCH_HW_AT_BOOT
	default n if SPM
	default y
	help
	  The image will be booted directly by an unknown image which might not
	  leave the system in a clean state, so it is necessary to perform
	  architecture specific hardware initialization.

DT_COMPAT_NORDIC_QSPI_NOR := nordic,qspi-nor
config NORDIC_QSPI_NOR
	default y if $(dt_compat_on_bus,$(DT_COMPAT_NORDIC_QSPI_NOR),qspi) && PM_EXTERNAL_FLASH_MCUBOOT_SECONDARY && !SPI_NOR

DT_ZEPHYR_FLASH := zephyr,flash
DT_CHOSEN_ZEPHYR_FLASH := $(dt_chosen_path,$(DT_ZEPHYR_FLASH))
config NORDIC_QSPI_NOR_FLASH_LAYOUT_PAGE_SIZE
	default $(dt_node_int_prop_int,$(DT_CHOSEN_ZEPHYR_FLASH),erase-block-size)
	help
	  Set the flash layout page size equal to the erase block size of the
	  chosen Zephyr flash devicetree node to ensure that swapping can be
	  performed.

config BOOT_IMAGE_ACCESS_HOOKS_FILE
	string
	default "${ZEPHYR_NRF_MODULE_DIR}/modules/mcuboot/hooks/nrf53_hooks.c"
	depends on BOOT_IMAGE_ACCESS_HOOKS

config BOOT_IMAGE_ACCESS_HOOKS
	bool
	default y if UPDATEABLE_IMAGE_NUMBER > 1 && SOC_NRF5340_CPUAPP && PM_EXTERNAL_FLASH_MCUBOOT_SECONDARY
	depends on MCUBOOT

config BOOT_UPGRADE_ONLY
	bool
	# Only here to satisfy compliance check

DT_COMPAT_SIM_FLASH:= zephyr,sim-flash
DT_SIM_FLASH_PATH := $(dt_nodelabel_path,flash_sim0)

config NRF53_MULTI_IMAGE_UPDATE
	bool "Support updating app core and net core in a single operation"
	default y
	depends on UPDATEABLE_IMAGE_NUMBER > 1
	depends on SOC_NRF5340_CPUAPP
	depends on BOOT_IMAGE_ACCESS_HOOKS
	depends on FLASH_SIMULATOR
	depends on FLASH_SIMULATOR_DOUBLE_WRITES
	depends on !FLASH_SIMULATOR_STATS
	depends on PM_EXTERNAL_FLASH_MCUBOOT_SECONDARY
	depends on BOOT_UPGRADE_ONLY
	depends on $(dt_compat_enabled,$(DT_COMPAT_SIM_FLASH))

config NRF53_RAM_FLASH_SIZE
	hex
	depends on NRF53_MULTI_IMAGE_UPDATE
	default $(dt_node_reg_size_hex,$(DT_SIM_FLASH_PATH))
	help
	  When performing a multi image update on the nRF53 the net core data
	  is read from external flash, and buffered in  RAM. This option is used
	  to define forward the size of this RAM region to the partition manager
	  configuration.
```

## modules/cddl-gen/Kconfig
```kconfig
#
# Copyright (c) 2021 Nordic Semiconductor ASA
#
# SPDX-License-Identifier: LicenseRef-BSD-5-Clause-Nordic
#

config CDDL_GEN
	bool "Support code generated by cddl-gen module"
```

## modules/cjson/Kconfig
```kconfig
#
# Copyright (c) 2018 Nordic Semiconductor
#
# SPDX-License-Identifier: LicenseRef-Nordic-5-Clause
#

config CJSON_LIB
	bool "cJSON library"
	# Since minimal libc lacks sscanf and strtod we need to use newlibc
	# Allow external libc to allow native posix to be used for unit test
	# The cJSON library is using snprintf with floats. We therefore need to
	# enable NEWLIB_LIBC_FLOAT_PRINTF to ensure that these are handled correctly.
	depends on (NEWLIB_LIBC && NEWLIB_LIBC_FLOAT_PRINTF) || EXTERNAL_LIBC || PICOLIBC
```

## modules/coremark/Kconfig
```kconfig
#
# Copyright (c) 2024 Nordic Semiconductor
#
# SPDX-License-Identifier: LicenseRef-Nordic-5-Clause
#

menuconfig COREMARK
	bool "CoreMark benchmark"
	imply CBPRINTF_FP_SUPPORT

if COREMARK

config COREMARK_ITERATIONS
	int "Number of iterations to run"
	range 10 10000
	default 2000
	help
	  Specify the number of iterations to run the benchmark.
	  CoreMark should execute for at least 10 seconds to have valid results.
	  The minimum number of iterations depends on the platform and its configuration.

config COREMARK_THREADS_NUMBER
	int "Number of threads for the parallel benchmark execution"
	default 1
	range 1 1 if COREMARK_MEMORY_METHOD_STATIC
	help
	  Specify the number of threads to use for the CoreMark execution.
	  1 - means the execution only from the main thread.
	  Each thread will execute the CoreMark algorithm COREMARK_ITERATIONS number of times in parallel.

config COREMARK_THREADS_PRIORITY
	int "CoreMark thread priority"
	default 0
	depends on COREMARK_THREADS_NUMBER > 1
	help
	  Specify the piority of threads to use for the CoreMark execution.

config COREMARK_THREADS_TIMEOUT_MS
	int
	default 60000
	depends on COREMARK_THREADS_NUMBER > 1
	help
	  Timeout after which thread k_join operaton will timeout and signalize error.

choice COREMARK_RUN_TYPE
	prompt "Coremark run type"
	default COREMARK_RUN_TYPE_PERFORMANCE
	help
	   Specify the purpose of the CoreMark execution. The required memory size may vary
	   depending on the type.

config COREMARK_RUN_TYPE_PERFORMANCE
	bool "Performance run"
	help
	  Predefined CoreMark run type which sets CoreMark data to 2000 bytes.

config COREMARK_RUN_TYPE_PROFILE
	bool "Profile run"
	help
	  Predefined CoreMark run type which sets CoreMark data to 1000 bytes.

config COREMARK_RUN_TYPE_VALIDATION
	bool "Validation run"
	help
	  Predefined CoreMark run type which sets CoreMark data to 500 bytes.

endchoice # COREMARK_RUN_TYPE

config COREMARK_DATA_SIZE
	int "Total size for the data algorithms will operate on"
	default 500 if COREMARK_RUN_TYPE_VALIDATION
	default 1200 if COREMARK_RUN_TYPE_PROFILE
	default 2000 if COREMARK_RUN_TYPE_PERFORMANCE
	range 100 2000
	help
	  Specify the size for the data algorithms. You can choose different values
	  for it. For registering your results, you need to
	  run CoreMark with default values for PROFILE and PERFORMANCE run types.

choice COREMARK_MEMORY_METHOD
	prompt "Memory Method"
	default COREMARK_MEMORY_METHOD_STACK
	help
	  This option defines the method to get a block of memory.

config COREMARK_MEMORY_METHOD_STACK
	bool "Stack"
	help
	  The main thread stack is used for this memory method. Make sure that there
	  is enough memory allocated with the MAIN_STACK_SIZE option. The size depends
	  on the size of the data that CoreMark operates on and a number of threads. It should
	  be higher than:
	    COREMARK_DATA_SIZE * COREMARK_THREADS_NUMBER + main thread context.

config COREMARK_MEMORY_METHOD_STATIC
	bool "Static"
	help
	   Data is allocated in the RAM as a regular static variable.
	   In this case, you do not need to be aware of the main thread stack size or heap memory pool size.

config COREMARK_MEMORY_METHOD_MALLOC
	bool "Malloc"
	help
	  To use this option, you need to set up the system heap size using the
	  HEAP_MEM_POOL_SIZE option. The size depends on the number of parallel
	  contexts executed and COREMARK_RUN_TYPE. It should be higher than
	  COREMARK_DATA_SIZE * COREMARK_THREADS_NUMBER.

endchoice # COREMARK_MEMORY_METHOD

endif # COREMARK
```

## modules/hal_nordic/nrfx/Kconfig
```kconfig
# Copyright (c) 2016 Nordic Semiconductor ASA
# SPDX-License-Identifier: Apache-2.0

config HAS_NRFX
	bool

menu "nrfx drivers"
	depends on HAS_NRFX

rsource "Kconfig.logging"

config NRFX_MRAMC
	bool "MRAMC driver"
	depends on $(dt_has_compat,$(DT_COMPAT_NORDIC_MRAM))

endmenu # "nrfx drivers"
```

## modules/hal_nordic/nrfx/Kconfig.logging
```kconfig
# Copyright (c) 2023 Nordic Semiconductor ASA
# SPDX-License-Identifier: Apache-2.0

menu "nrfx drivers logging"
	depends on LOG

config NRFX_MRAMC_LOG
    bool "MRAMC driver logging"
    depends on NRFX_MRAMC

endmenu # "nrfx drivers logging"
```
