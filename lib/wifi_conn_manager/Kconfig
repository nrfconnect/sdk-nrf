## modules/hostap/Kconfig
```kconfig
# Nordic WiFi driver for nRF52840 and nRF5340
#
# Copyright (c) 2022 Nordic Semiconductor
#
# SPDX-License-Identifier: LicenseRef-Nordic-5-Clause
#

menuconfig WIFI_NM_WPA_SUPPLICANT
	bool "WPA supplicant support"
	# Need full POSIX from libc, Zephyr's POSIX support is only partial
	select POSIX_CLOCK
	select POSIX_SIGNAL
	select POSIX_API
	select NET_SOCKETS
	select NET_SOCKETS_PACKET
	select NET_SOCKETPAIR
	select NET_L2_WIFI_MGMT
	select WIFI_NM
	select EXPERIMENTAL if !SOC_SERIES_NRF53X && !SOC_SERIES_NRF91X
	select COMMON_LIBC_MALLOC
	help
	  WPA supplicant implements 802.1X related functions.

if WIFI_NM_WPA_SUPPLICANT

config COMMON_LIBC_MALLOC_ARENA_SIZE
	default 40000 if WPA_SUPP_AP
	# 8192 for MbedTLS heap
	default 21808 if MBEDTLS_ENABLE_HEAP
	# 30K is mandatory, but might need more for long duration use cases
	default 30000

# Hidden as these are mandatory for WFA certification
config WPA_SUPP_WMM_AC
	bool
	default y

config WPA_SUPP_MBO
	bool
	default y

# Memory optimizations
config WPA_SUPP_ADVANCED_FEATURES
	bool "Enable advanced features"
	default y

if WPA_SUPP_ADVANCED_FEATURES

config WPA_SUPP_ROBUST_AV
	bool "Robust Audio Video streaming support"
	default y

config WPA_SUPP_WNM
	bool "Wireless Network Management support"
	default y

config WPA_SUPP_RRM
	bool "Radio Resource Management support"
	default y
endif

config WPA_SUPP_MGD_IFACES_PREFIXES
	string "WPA supplicant managed interfaces prefixes"
	default "wlan,esp,nordic_wlan"

config WPA_SUPP_THREAD_STACK_SIZE
	int "Stack size for wpa_supplicant thread"
	default 5200

config WPA_SUPP_WQ_STACK_SIZE
	int "Stack size for wpa_supplicant workqueue"
	default 4400

config WPA_SUPP_WQ_PRIORITY
	int "Priority for wpa_supplicant workqueue"
	default 7

config WPA_SUPP_CRYPTO_WEP
	bool "WEP (Legacy crypto) support"

choice WPA_SUPP_CRYPTO_BACKEND
	prompt "WPA supplicant crypto implementation"
	default WPA_SUPP_CRYPTO_PSA if BUILD_WITH_TFM
	default WPA_SUPP_CRYPTO_LEGACY if !BUILD_WITH_TFM
	help
	  Select the crypto implementation to use for WPA supplicant.

# To easily manage the crypto dependencies we separate the crypto
# implementations into two Kconfig options. One for the legacy crypto
# and one for the PSA crypto.
config WPA_SUPP_CRYPTO_PSA
	bool "PSA Crypto support for WiFi"
	select MBEDTLS
	select NRF_SECURITY
	select PSA_WANT_GENERATE_RANDOM
	# Legacy crypto, still needed
	select MBEDTLS_SHA1_C
	select MBEDTLS_LEGACY_CRYPTO_C
	select MBEDTLS_CMAC_C
	select MBEDTLS_GCM_C
	select MBEDTLS_TLS_LIBRARY
	select MBEDTLS_PK_C
	select MBEDTLS_PK_WRITE_C
	select MBEDTLS_X509_LIBRARY
	select MBEDTLS_X509_CRT_PARSE_C
	select MBEDTLS_CIPHER_C
	select MBEDTLS_CIPHER_MODE_CTR
	select MBEDTLS_CIPHER_MODE_CBC
	select MBEDTLS_SSL_TLS_C
	select MBEDTLS_ECP_C
	select MBEDTLS_CTR_DRBG_C
	select MBEDTLS_KEY_EXCHANGE_ALL_ENABLED
	select MBEDTLS_MD_C
	select MBEDTLS_CIPHER_PADDING_PKCS7
	select MBEDTLS_PKCS5_C

config WPA_SUPP_CRYPTO_LEGACY
	bool "Legacy Crypto support for WiFi using nRF security"
	select MBEDTLS
	select NRF_SECURITY
	select MBEDTLS_CIPHER_MODE_CBC
	select MBEDTLS_CIPHER_MODE_CTR
	select MBEDTLS_LEGACY_CRYPTO_C
	select MBEDTLS_SHA1_C
	select MBEDTLS_ECP_C
	select MBEDTLS_CTR_DRBG_C
	select MBEDTLS_PK_C
	select MBEDTLS_PKCS5_C
	select MBEDTLS_CIPHER_PADDING_PKCS7
	select MBEDTLS_PK_WRITE_C
	select MBEDTLS_KEY_EXCHANGE_ALL_ENABLED

config WPA_SUPP_CRYPTO_LEGACY_MBEDTLS
	bool "Legacy Crypto support for WiFi using vanilla MbedTLS"
	select MBEDTLS
	select MBEDTLS_CIPHER_MODE_CTR_ENABLED
	select MBEDTLS_CIPHER_MODE_CBC_ENABLED
	select MBEDTLS_ECP_C
	select MBEDTLS_ECP_ALL_ENABLED
	select MBEDTLS_MAC_CMAC_ENABLED
	select MBEDTLS_PKCS5_C
	select MBEDTLS_PK_WRITE_C
	select MBEDTLS_ECDH_C
	select MBEDTLS_ECDSA_C
	select MBEDTLS_ECJPAKE_C
	select MBEDTLS_KEY_EXCHANGE_ECDHE_PSK_ENABLED
	select MBEDTLS_KEY_EXCHANGE_ECDHE_RSA_ENABLED
	select MBEDTLS_KEY_EXCHANGE_ECJPAKE_ENABLED
	select MBEDTLS_KEY_EXCHANGE_ALL_ENABLED

config WPA_SUPP_CRYPTO_NONE
	bool "No Crypto support for WiFi"

endchoice

# To fix MAC_MD5 Kconfig warning
config NET_TCP_ISN_RFC6528
	default n if !WPA_SUPP_CRYPTO_NONE

config WPA_SUPP_CRYPTO_ENTERPRISE
	bool "Enterprise Crypto support for WiFi"
	depends on !WPA_SUPP_CRYPTO_NONE

config WPA_SUPP_WPA3
	bool "WPA3 support"
	depends on !WPA_SUPP_CRYPTO_NONE
	default y

config WPA_SUPP_AP
	bool "AP mode support"

config WPA_SUPP_WPS
	bool "WPS support"
	depends on !WPA_SUPP_CRYPTO_NONE

config WPA_SUPP_P2P
	bool "P2P mode support"
	select WPA_SUPP_AP
	select WPA_SUPP_WPS

config WPA_SUPP_EAPOL
	bool "Enable EAPoL supplicant"

config WPA_CLI
	bool "CLI support for wpa_supplicant"
	default n

config NET_SOCKETPAIR_BUFFER_SIZE
	default 4096

config POSIX_MAX_FDS
	# l2_packet - 1
	# ctrl_iface - 2 * socketpairs = 4(local and global)
	# z_wpa_event_sock - 1 socketpair = 2
	# Remaining left for the applications running in default configuration
	default 16 if !POSIX_API

config BSS_MAX_IDLE_TIME
	int "BSS max idle timeout in seconds"
	range 0 64000
	default 300
	help
	  BSS max idle timeout is the period for which AP may keep a client
	  in associated state while there is no traffic from that particular
	  client. Set 0 to disable inclusion of BSS max idle time tag in
	  association request. If a non-zero value is set, STA can suggest a
	  timeout by including BSS max idle period in the association request.
	  AP may choose to consider or ignore the STA's preferred value.
	  Ref: Sec 11.21.13 of IEEE Std 802.11™-2020

# Control interface is stack heavy (buffers + snprintfs)
# Making calls to RPU from net_mgmt callbacks (status - RSSI)
config NET_MGMT_EVENT_STACK_SIZE
	default 4400

config NET_SOCKETS_POLL_MAX
	default 6

module = WIFI_NM_WPA_SUPPLICANT
module-str = WPA supplicant
source "subsys/logging/Kconfig.template.log_config"

config WPA_SUPP_DEBUG_LEVEL
	int "Min compiled-in debug message level for WPA supplicant"
	default 0 if WPA_SUPP_LOG_LEVEL_DBG # MSG_EXCESSIVE
	default 3 if WPA_SUPP_LOG_LEVEL_INF # MSG_INFO
	default 4 if WPA_SUPP_LOG_LEVEL_WRN # MSG_WARNING
	default 5 if WPA_SUPP_LOG_LEVEL_ERR # MSG_ERROR
	default 6
	help
	  Minimum priority level of a debug message emitted by WPA supplicant that
	  is compiled-in the firmware. See wpa_debug.h file of the supplicant for
	  available levels and functions for emitting the messages. Note that
	  runtime filtering can also be configured in addition to the compile-time
	  filtering.

# Debug logs need more buffer space
config LOG_BUFFER_SIZE
	default 4096 if WPA_SUPP_LOG_LEVEL_DBG
	default 2048

# Without this logs are logs independent of buffer size
if WPA_SUPP_LOG_LEVEL_DBG
	choice LOG_MODE
		default LOG_MODE_IMMEDIATE
	endchoice
endif

config WPA_SUPP_NO_DEBUG
	bool "Disable printing of debug messages, saves code size significantly"

choice WPA_SUPP_NW_SEL
	prompt "WPA supplicant Network selection criterion"
	default WPA_SUPP_NW_SEL_THROUGHPUT
	help
		Select the network selection method for the supplicant.

config WPA_SUPP_NW_SEL_THROUGHPUT
	bool "Throughput based network selection"
	help
	  Select the network based on throughput.

config WPA_SUPP_NW_SEL_RELIABILITY
	bool "Reliability based network selection"
	help
	  Select the network based on reliability.
endchoice

endif # WIFI_NM_WPA_SUPPLICANT
```

## modules/mbedtls/Kconfig
```kconfig
#
# Copyright (c) 2021 Nordic Semiconductor ASA
#
# SPDX-License-Identifier: LicenseRef-Nordic-5-Clause
#

# Increase the heap size of mbedtls when building with TF-M.
config MBEDTLS_HEAP_SIZE
	default 8320 if BUILD_WITH_TFM

if !(NRF_SECURITY || NORDIC_SECURITY_BACKEND)

# Here we can do whatever we want before sourcing.
source "$(ZEPHYR_BASE)/modules/mbedtls/Kconfig"

endif
```

## modules/mcuboot/Kconfig
```kconfig
menu "MCUboot"

if BOOTLOADER_MCUBOOT

menuconfig MCUBOOT_HARDWARE_DOWNGRADE_PREVENTION
	bool "Downgrade prevention using hardware security counters"
	depends on SOC_NRF5340_CPUAPP || SOC_SERIES_NRF91 || SOC_SERIES_NRF54L || SOC_SERIES_NRF54H
	help
	  This option can be enabled by the application and will ensure
	  that the MCUBOOT_HW_DOWNGRADE_PREVENTION Kconfig option is
	  enabled in the MCUboot image.

if MCUBOOT_HARDWARE_DOWNGRADE_PREVENTION

config MCUBOOT_HW_DOWNGRADE_PREVENTION_COUNTER_SLOTS
	int "Number of available hardware counter slots"
	default 240
	range 2 288 if SOC_SERIES_NRF54L
	range 2 300
	depends on !SOC_SERIES_NRF54H
	help
	  When MCUBOOT_HW_DOWNGRADE_PREVENTION is enabled, MCUboot will use
	  one hardware counter for each updatable image (UPDATEABLE_IMAGE_NUMBER).
	  This configuration specifies how many counter slots will be allocated
	  for each hardware counter. The hardware counters are stored in OTP storage.
	  The rationale for the default number (240): Assume one update a month for
	  10 years, then double that value just in case. This default fits
	  comfortably within the OTP region of UICR.

config MCUBOOT_HW_DOWNGRADE_PREVENTION_COUNTER_VALUE
	int "Security counter value"
	default 1
	range 1 65535 if !SOC_SERIES_NRF54H
	range 1 4294967295 if SOC_SERIES_NRF54H
	help
	  The security counter value for this image.
	  This is the value that will be passed to the --security-counter
	  parameter of imgtool.py

endif # MCUBOOT_HARDWARE_DOWNGRADE_PREVENTION

# HACK: NCS temphack to keep our imgtool integration working now that
# there is no CONFIG_DT_* CMake namespace anymore. Use Zephyr
# kconfigfunctions to thread the flash write block size through
# Kconfig so it can be accessed from CMake. Needs a better solution.
DT_ZEPHYR_FLASH := zephyr,flash
DT_CHOSEN_ZEPHYR_FLASH := $(dt_chosen_path,$(DT_ZEPHYR_FLASH))
config MCUBOOT_FLASH_WRITE_BLOCK_SIZE
	int
	default $(dt_node_int_prop_int,$(DT_CHOSEN_ZEPHYR_FLASH),write-block-size)

endif # BOOTLOADER_MCUBOOT

config DT_FLASH_WRITE_BLOCK_SIZE
	int
	default $(dt_node_int_prop_int,$(DT_CHOSEN_ZEPHYR_FLASH),write-block-size)

config MCUBOOT_USB_SUPPORT
	bool
	default y if "$(dt_nodelabel_enabled,zephyr_udc0)"

config USE_NRF53_MULTI_IMAGE_WITHOUT_UPGRADE_ONLY
	bool "Allow nRF53 multi-image update support [dangerous]"
	help
	  Enabling this option allows you to use NRF53_MULTI_IMAGE update
	  without having BOOT_UPGRADE_ONLY enabled, allowing you to use
	  different swapping methods. This will however give you the potential
	  of bricking the network core upon reverts.

config MCUBOOT_USE_ALL_AVAILABLE_RAM
	bool "Allow MCUBoot to use all available RAM"
	depends on ARM_TRUSTZONE_M
	default y if BOARD_THINGY53_NRF5340_CPUAPP_NS || BOARD_THINGY53_NRF5340_CPUAPP
	help
	  By default MCUBoot uses only the secure RAM partition.

endmenu

DT_CHOSEN_BOOTLOADER_REQUEST := nrf,bootloader-request
DT_CHOSEN_BOOTLOADER_REQUEST_BACKUP := nrf,bootloader-request-backup

config NRF_MCUBOOT_BOOT_REQUEST
	bool "MCUboot bootloader requests"
	imply MCUMGR_GRP_IMG_NRF
	depends on $(dt_chosen_enabled,$(DT_CHOSEN_BOOTLOADER_REQUEST))
	help
	  Handle bootloader requests.

if NRF_MCUBOOT_BOOT_REQUEST

choice NRF_MCUBOOT_BOOT_REQUEST_IMPL
	prompt "Shared memory backend"
	default NRF_MCUBOOT_BOOT_REQUEST_IMPL_RETENTION if RETENTION

config NRF_MCUBOOT_BOOT_REQUEST_IMPL_RETENTION
	bool "Retention"
	depends on RETENTION
	depends on $(dt_chosen_has_compat,$(DT_CHOSEN_BOOTLOADER_REQUEST),$(DT_COMPAT_ZEPHYR_RETENTION))
	help
	  Use zephyr,bootloader-request chosen node compatible with the
	  zephyr,retention driver as the memory area to store and read from the
	  bootloader requests.
	  The built-in prefix property should be used to indicate the request
	  structure version to ensure compatibility between the bootloader and
	  the application.

config NRF_MCUBOOT_BOOT_REQUEST_IMPL_FLASH
	bool "NVM partition"
	depends on FLASH
	depends on CRC
	depends on !PARTITION_MANAGER_ENABLED # Partition manager uses an incompatible flash_map.h
	help
	  Use zephyr,bootloader-request chosen node compatible with the
	  flash driver as the memory area to store and read from the bootloader
	  requests.

endchoice

config NRF_MCUBOOT_BOOT_REQUEST_PREFERENCE_KEEP
	bool "Keep boot preference value across reboots"
	depends on $(dt_chosen_enabled,$(DT_CHOSEN_BOOTLOADER_REQUEST_BACKUP))
	default y
	help
	  Use zephyr,bootloader-request-backup chosen node compatible with the
	  zephyr,retention driver as the memory area to store a copy of
	  bootloader requests.
	  If this optional node is defined, the module will keep a copy of data
	  inside a backup region, allowing to preserve the preferred slot
	  selection across device resets.

config NCS_MCUBOOT_BOOT_REQUEST_TEST_SETS_BOOT_PREFERENCE
	bool "Set boot preference if a slot is marked for test"
	help
	  This option allows to verify boot preference requests through issuing
	  the image test.
	  Using this option is not recommended in production systems, because
	  it will boot any newly transferred image, even if it has a lower
	  version than the current one.
	  The rollback protection (using security counters) will still be
	  effective.

endif # NRF_MCUBOOT_BOOT_REQUEST
```
