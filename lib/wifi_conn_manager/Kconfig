## modules/wfa-qt/Kconfig
```kconfig
#
# Copyright (c) 2023 Nordic Semiconductor
#
# SPDX-License-Identifier: LicenseRef-Nordic-5-Clause
#

module = WFA_QT
module-str = Log level for WFA Quick Track
module-help = Sets log level for WFA Quick Track
source "subsys/logging/Kconfig.template.log_config"

config WFA_QT_CONTROL_APP
	# Need full POSIX from libc, Zephyr's POSIX support is only partial
	select POSIX_API
	select PTHREAD_IPC
	select POSIX_SIGNAL
	bool "WFA Quicktrack control app"

config WFA_QT_THREAD_STACK_SIZE
	int "WFA QT thread stack size"
	default 4096
	help
	  Set the stack size for WFA QT thread.

config WFA_QT_REBOOT_TIMEOUT_MS
	int "Timeout for reboot (in milliseconds)"
	default 1000
	help
	  Set the timeout value (in milliseconds) for reboot operation.

config WFA_QT_DEFAULT_INTERFACE
	string "Default Wi-Fi interface"
	default "nordic_wlan0"
	help
	  Set the default Wi-Fi interface.

config WPAS_READY_TIMEOUT_MS
	int "WPA supplicant ready timeout (ms)"
	default 10000
	help
	  Set the timeout for WPA supplicant to be ready.
```

## modules/zcbor/Kconfig
```kconfig
#
# Copyright (c) 2021 Nordic Semiconductor ASA
#
# SPDX-License-Identifier: LicenseRef-Nordic-5-Clause
#

config ZCBOR
	bool "Support code generated by zcbor module"

if ZCBOR

config ZCBOR_CANONICAL
	bool "zcbor encoding should produce 'canonical' CBOR."
	help
	  Enabling this will prevent zcbor from creating lists and maps with
	  indefinite-length arrays (it will still decode them properly).

config ZCBOR_STOP_ON_ERROR
	bool "Enable the `stop_on_error` functionality."
	help
	  This makes all functions abort their execution if called when an error
	  has already happened.

config ZCBOR_VERBOSE
	bool "Make zcbor code print messages."

config ZCBOR_ASSERT
	bool
	default y if ASSERT

config ZCBOR_BIG_ENDIAN
	bool
	default y if BIG_ENDIAN

endif # ZCBOR
```
