## modules/trusted-firmware-m/Kconfig.peripheral_secure
```kconfig
#
# Copyright (c) 2022 Nordic Semiconductor ASA
#
# SPDX-License-Identifier: LicenseRef-Nordic-5-Clause
#

if BUILD_WITH_TFM

menu "Peripheral Secure mapping"

peripheral=FPU
peripheral_depends=CPU_HAS_FPU
rsource "Kconfig.template.peripheral_secure"

peripheral=DCNF
peripheral_depends=$(dt_has_compat,$(DT_COMPAT_NORDIC_NRF_DCNF))
rsource "Kconfig.template.peripheral_secure"

peripheral=OSCILLATORS
peripheral_depends=$(dt_has_compat,$(DT_COMPAT_NORDIC_NRF_OSCILLATORS))
rsource "Kconfig.template.peripheral_secure"

peripheral=REGULATORS
peripheral_depends=$(dt_has_compat,$(DT_COMPAT_NORDIC_NRF_REGULATORS))
rsource "Kconfig.template.peripheral_secure"

peripheral=CLOCK
peripheral_depends=$(dt_has_compat,$(DT_COMPAT_NORDIC_NRF_CLOCK))
rsource "Kconfig.template.peripheral_secure"

peripheral=POWER
peripheral_depends=$(dt_has_compat,$(DT_COMPAT_NORDIC_NRF_POWER))
rsource "Kconfig.template.peripheral_secure"

peripheral=RESET
peripheral_depends=$(dt_has_compat,$(DT_COMPAT_NORDIC_NRF_RESET))
rsource "Kconfig.template.peripheral_secure"

peripheral=CTRLAP
peripheral_depends=$(dt_has_compat,$(DT_COMPAT_NORDIC_NRF_CTRLAPPERI))
rsource "Kconfig.template.peripheral_secure"

peripheral=SPIM0
peripheral_depends=$(dt_nodelabel_has_compat,spi0,$(DT_COMPAT_NORDIC_NRF_SPIM))
rsource "Kconfig.template.peripheral_secure"

peripheral=SPIS0
peripheral_depends=$(dt_nodelabel_has_compat,spi0,$(DT_COMPAT_NORDIC_NRF_SPIS))
rsource "Kconfig.template.peripheral_secure"

peripheral=TWIM0
peripheral_depends=$(dt_nodelabel_has_compat,i2c0,$(DT_COMPAT_NORDIC_NRF_TWIM))
rsource "Kconfig.template.peripheral_secure"

peripheral=TWIS0
peripheral_depends=$(dt_nodelabel_has_compat,i2c0,$(DT_COMPAT_NORDIC_NRF_TWIS))
rsource "Kconfig.template.peripheral_secure"

peripheral=UARTE0
peripheral_depends=$(dt_nodelabel_has_compat,uart0,$(DT_COMPAT_NORDIC_NRF_UARTE))
rsource "Kconfig.template.peripheral_secure"

peripheral=SPIM1
peripheral_depends=$(dt_nodelabel_has_compat,spi1,$(DT_COMPAT_NORDIC_NRF_SPIM))
rsource "Kconfig.template.peripheral_secure"

peripheral=SPIS1
peripheral_depends=$(dt_nodelabel_has_compat,spi1,$(DT_COMPAT_NORDIC_NRF_SPIS))
rsource "Kconfig.template.peripheral_secure"

peripheral=TWIM1
peripheral_depends=$(dt_nodelabel_has_compat,i2c1,$(DT_COMPAT_NORDIC_NRF_TWIM))
rsource "Kconfig.template.peripheral_secure"

peripheral=TWIS1
peripheral_depends=$(dt_nodelabel_has_compat,i2c1,$(DT_COMPAT_NORDIC_NRF_TWIS))
rsource "Kconfig.template.peripheral_secure"

peripheral=UARTE1
peripheral_depends=$(dt_nodelabel_has_compat,uart1,$(DT_COMPAT_NORDIC_NRF_UARTE))
rsource "Kconfig.template.peripheral_secure"

peripheral=SPIM4
peripheral_depends=$(dt_nodelabel_has_compat,spi4,$(DT_COMPAT_NORDIC_NRF_SPIM))
rsource "Kconfig.template.peripheral_secure"

peripheral=SPIM2
peripheral_depends=$(dt_nodelabel_has_compat,spi2,$(DT_COMPAT_NORDIC_NRF_SPIM))
rsource "Kconfig.template.peripheral_secure"

peripheral=SPIS2
peripheral_depends=$(dt_nodelabel_has_compat,spi2,$(DT_COMPAT_NORDIC_NRF_SPIS))
rsource "Kconfig.template.peripheral_secure"

peripheral=TWIM2
peripheral_depends=$(dt_nodelabel_has_compat,i2c2,$(DT_COMPAT_NORDIC_NRF_TWIM))
rsource "Kconfig.template.peripheral_secure"

peripheral=TWIS2
peripheral_depends=$(dt_nodelabel_has_compat,i2c2,$(DT_COMPAT_NORDIC_NRF_TWIS))
rsource "Kconfig.template.peripheral_secure"

peripheral=UARTE2
peripheral_depends=$(dt_nodelabel_has_compat,uart2,$(DT_COMPAT_NORDIC_NRF_UARTE))
rsource "Kconfig.template.peripheral_secure"

peripheral=SPIM3
peripheral_depends=$(dt_nodelabel_has_compat,spi3,$(DT_COMPAT_NORDIC_NRF_SPIM))
rsource "Kconfig.template.peripheral_secure"

peripheral=SPIS3
peripheral_depends=$(dt_nodelabel_has_compat,spi3,$(DT_COMPAT_NORDIC_NRF_SPIS))
rsource "Kconfig.template.peripheral_secure"

peripheral=TWIM3
peripheral_depends=$(dt_nodelabel_has_compat,i2c3,$(DT_COMPAT_NORDIC_NRF_TWIM))
rsource "Kconfig.template.peripheral_secure"

peripheral=TWIS3
peripheral_depends=$(dt_nodelabel_has_compat,i2c3,$(DT_COMPAT_NORDIC_NRF_TWIS))
rsource "Kconfig.template.peripheral_secure"

peripheral=UARTE3
peripheral_depends=$(dt_nodelabel_has_compat,uart3,$(DT_COMPAT_NORDIC_NRF_UARTE))
rsource "Kconfig.template.peripheral_secure"

peripheral=SAADC
peripheral_depends=$(dt_has_compat,$(DT_COMPAT_NORDIC_NRF_SAADC))
rsource "Kconfig.template.peripheral_secure"

peripheral=TIMER0
peripheral_depends=$(dt_nodelabel_has_compat,timer0,$(DT_COMPAT_NORDIC_NRF_TIMER))
rsource "Kconfig.template.peripheral_secure"

peripheral=TIMER1
peripheral_depends=$(dt_nodelabel_has_compat,timer1,$(DT_COMPAT_NORDIC_NRF_TIMER))
rsource "Kconfig.template.peripheral_secure"

peripheral=TIMER2
peripheral_depends=$(dt_nodelabel_has_compat,timer2,$(DT_COMPAT_NORDIC_NRF_TIMER))
rsource "Kconfig.template.peripheral_secure"

peripheral=RTC0
peripheral_depends=$(dt_nodelabel_has_compat,rtc0,$(DT_COMPAT_NORDIC_NRF_RTC))
rsource "Kconfig.template.peripheral_secure"

peripheral=RTC1
peripheral_depends=$(dt_nodelabel_has_compat,rtc1,$(DT_COMPAT_NORDIC_NRF_RTC))
rsource "Kconfig.template.peripheral_secure"

config NRF_DPPI_SECURE
	bool "DPPI configured as secure peripheral"
	depends on $(dt_has_compat,$(DT_COMPAT_NORDIC_NRF_DPPIC))
	help
	  DPPI is implemented with user-selectable security mapping.
	  If it has been configured as a secure peripheral then only the secure
	  processing environment is able to access the peripheral

peripheral=WDT0
peripheral_depends=$(dt_nodelabel_has_compat,wdt0,$(DT_COMPAT_NORDIC_NRF_WDT))
rsource "Kconfig.template.peripheral_secure"

peripheral=WDT1
peripheral_depends=$(dt_nodelabel_has_compat,wdt1,$(DT_COMPAT_NORDIC_NRF_WDT))
rsource "Kconfig.template.peripheral_secure"

peripheral=COMP
peripheral_depends=$(dt_has_compat,$(DT_COMPAT_NORDIC_NRF_COMP))
rsource "Kconfig.template.peripheral_secure"

peripheral=LPCOMP
peripheral_depends=$(dt_has_compat,$(DT_COMPAT_NORDIC_NRF_LPCOMP))
rsource "Kconfig.template.peripheral_secure"

peripheral=EGU0
peripheral_depends=$(dt_nodelabel_has_compat,egu0,$(DT_COMPAT_NORDIC_NRF_EGU))
rsource "Kconfig.template.peripheral_secure"

peripheral=EGU1
peripheral_depends=$(dt_nodelabel_has_compat,egu1,$(DT_COMPAT_NORDIC_NRF_EGU))
rsource "Kconfig.template.peripheral_secure"

peripheral=EGU2
peripheral_depends=$(dt_nodelabel_has_compat,egu2,$(DT_COMPAT_NORDIC_NRF_EGU))
rsource "Kconfig.template.peripheral_secure"

peripheral=EGU3
peripheral_depends=$(dt_nodelabel_has_compat,egu3,$(DT_COMPAT_NORDIC_NRF_EGU))
rsource "Kconfig.template.peripheral_secure"

peripheral=EGU4
peripheral_depends=$(dt_nodelabel_has_compat,egu4,$(DT_COMPAT_NORDIC_NRF_EGU))
rsource "Kconfig.template.peripheral_secure"

peripheral=EGU5
peripheral_depends=$(dt_nodelabel_has_compat,egu5,$(DT_COMPAT_NORDIC_NRF_EGU))
rsource "Kconfig.template.peripheral_secure"

peripheral=PWM0
peripheral_depends=$(dt_nodelabel_has_compat,pwm0,$(DT_COMPAT_NORDIC_NRF_PWM))
rsource "Kconfig.template.peripheral_secure"

peripheral=PWM1
peripheral_depends=$(dt_nodelabel_has_compat,pwm1,$(DT_COMPAT_NORDIC_NRF_PWM))
rsource "Kconfig.template.peripheral_secure"

peripheral=PWM2
peripheral_depends=$(dt_nodelabel_has_compat,pwm2,$(DT_COMPAT_NORDIC_NRF_PWM))
rsource "Kconfig.template.peripheral_secure"

peripheral=PWM3
peripheral_depends=$(dt_nodelabel_has_compat,pwm3,$(DT_COMPAT_NORDIC_NRF_PWM))
rsource "Kconfig.template.peripheral_secure"

peripheral=PDM
peripheral_depends=$(dt_has_compat,$(DT_COMPAT_NORDIC_NRF_PDM))
rsource "Kconfig.template.peripheral_secure"

peripheral=I2S
peripheral_depends=$(dt_has_compat,$(DT_COMPAT_NORDIC_NRF_I2S))
rsource "Kconfig.template.peripheral_secure"

peripheral=IPC
peripheral_depends=$(dt_has_compat,$(DT_COMPAT_NORDIC_NRF_IPC))
rsource "Kconfig.template.peripheral_secure"

peripheral=QSPI
peripheral_depends=$(dt_has_compat,$(DT_COMPAT_NORDIC_NRF_QSPI))
rsource "Kconfig.template.peripheral_secure"

peripheral=NFCT
peripheral_depends=$(dt_has_compat,$(DT_COMPAT_NORDIC_NRF_NFCT))
rsource "Kconfig.template.peripheral_secure"

peripheral=MUTEX
peripheral_depends=$(dt_has_compat,$(DT_COMPAT_NORDIC_NRF_MUTEX))
rsource "Kconfig.template.peripheral_secure"

peripheral=QDEC0
peripheral_depends=$(dt_nodelabel_has_compat,qdec0,$(DT_COMPAT_NORDIC_NRF_QDEC))
rsource "Kconfig.template.peripheral_secure"

peripheral=QDEC1
peripheral_depends=$(dt_nodelabel_has_compat,qdec1,$(DT_COMPAT_NORDIC_NRF_QDEC))
rsource "Kconfig.template.peripheral_secure"

peripheral=USBD
peripheral_depends=$(dt_has_compat,$(DT_COMPAT_NORDIC_NRF_USBD))
rsource "Kconfig.template.peripheral_secure"

peripheral=USBREG
peripheral_depends=$(dt_has_compat,$(DT_COMPAT_NORDIC_NRF_USBREG))
rsource "Kconfig.template.peripheral_secure"

peripheral=NVMC
peripheral_depends=y
rsource "Kconfig.template.peripheral_secure"

peripheral=GPIO0
peripheral_depends=$(dt_nodelabel_has_compat,gpio0,$(DT_COMPAT_NORDIC_NRF_GPIO))
rsource "Kconfig.template.peripheral_secure"

peripheral=GPIO1
peripheral_depends=$(dt_nodelabel_has_compat,gpio1,$(DT_COMPAT_NORDIC_NRF_GPIO))
rsource "Kconfig.template.peripheral_secure"

peripheral=VMC
peripheral_depends=$(dt_has_compat,$(DT_COMPAT_NORDIC_NRF_VMC))
rsource "Kconfig.template.peripheral_secure"

config NRF_GPIOTE0_SECURE
	bool "GPIOTE configured as secure peripheral"
	depends on HAS_HW_NRF_GPIOTE
	help
	  GPIOTE0 is implemented with secure only security.
	  This option only enables it to be used in the secure image.

config NRF_GPIO0_PIN_MASK_SECURE
	hex "Set GPIO0 PERM mask for Secure"
	default 0x00000000
	depends on HAS_HW_NRF_GPIO0 && !NRF_GPIO0_SECURE
	help
	  GPIO is implemented with split security. If it has been configured as
	  non-secure it can be accessed by both secure and non-secure accesses.
	  A bitmask can be set to configure a subset of the GPIO pins as secure
	  to prevent non-secure from accessing these pin. Secure accesses can be
	  made to GPIO pins configured as non-secure.

config NRF_GPIO1_PIN_MASK_SECURE
	hex "Set GPIO1 PERM mask for Secure"
	default 0x00000000
	depends on HAS_HW_NRF_GPIO1 && !NRF_GPIO1_SECURE
	help
	  GPIO is implemented with split security. If it has been configured as
	  non-secure it can be accessed by both secure and non-secure accesses.
	  A bitmask can be set to configure a subset of the GPIO pins as secure
	  to prevent non-secure from accessing these pin. Secure accesses can be
	  made to GPIO pins configured as non-secure.

config NRF_DPPI_CHANNEL_MASK_SECURE
	hex "Set DPPI PERM mask for Secure"
	default 0x00000000
	depends on HAS_HW_NRF_DPPIC && !NRF_DPPI_SECURE
	help
	  DPPI is implemented with split securety. If it has been configured as
	  non-secure it can be accessed by both secure and non-secure accesses.
	  A bitmask can be set to configure a subset of the DPPI channels as
	  secure to prevent non-secure from accessing these channels. Secure
	  accesses can be made to the DPPI pins configured as non-secure.

endmenu # Peripheral Secure mapping

endif # BUILD_WITH_TFM
```

## modules/trusted-firmware-m/Kconfig.template.peripheral_secure
```kconfig
#
# Copyright (c) 2022 Nordic Semiconductor ASA
#
# SPDX-License-Identifier: LicenseRef-Nordic-5-Clause
#

config NRF_$(peripheral)_SECURE
	bool "$(peripheral) configured as secure peripheral"
	depends on $(peripheral_depends)
	help
	  $(peripheral) is implemented with user-selectable security mapping.
	  If it has been configured as a secure peripheral then only the secure
	  processing environment is able to access the peripheral
```

## modules/trusted-firmware-m/Kconfig.tfm.crypto_modules
```kconfig
#
# Copyright (c) 2026 Nordic Semiconductor ASA
#
# SPDX-License-Identifier: LicenseRef-Nordic-5-Clause
#

if TFM_PARTITION_CRYPTO && (PSA_CRYPTO_DRIVER_OBERON || PSA_CRYPTO_DRIVER_CRACEN)

config TFM_CRYPTO_PAKE_MODULE_ENABLED
	bool "PAKE crypto module"
	default y
	depends on PSA_HAS_PAKE_SUPPORT
	help
	  Enable the PAKE crypto module within the crypto partition.

config TFM_CRYPTO_KEY_WRAPPING_MODULE_ENABLED
	bool "Key wrapping crypto module"
	default y
	depends on PSA_HAS_KEY_WRAP_SUPPORT
	help
	  Enable the key wrapping module within the crypto partition.

endif # TFM_PARTITION_CRYPTO && (PSA_CRYPTO_DRIVER_OBERON || PSA_CRYPTO_DRIVER_CRACEN)

source "$(ZEPHYR_BASE)/modules/trusted-firmware-m/Kconfig.tfm.crypto_modules"
```

## modules/trusted-firmware-m/Kconfig.tfm.defconfig
```kconfig
#
# Copyright (c) 2023 Nordic Semiconductor ASA
#
# SPDX-License-Identifier: LicenseRef-Nordic-5-Clause
#

config TFM_BOARD
	string
	# Redefinition of TFM_BOARD to use out-of-tree boards.
	default "${ZEPHYR_NRF_MODULE_DIR}/modules/trusted-firmware-m/tfm_boards/nrf9160" if SOC_NRF9160
	default "${ZEPHYR_NRF_MODULE_DIR}/modules/trusted-firmware-m/tfm_boards/nrf9120" if SOC_NRF9120
	default "${ZEPHYR_NRF_MODULE_DIR}/modules/trusted-firmware-m/tfm_boards/nrf5340_cpuapp" if SOC_NRF5340_CPUAPP
	default "${ZEPHYR_NRF_MODULE_DIR}/modules/trusted-firmware-m/tfm_boards/nrf54l15_cpuapp" if SOC_SERIES_NRF54LX
	depends on TRUSTED_EXECUTION_NONSECURE

if BUILD_WITH_TFM

config TFM_BL2
	bool
	default n

config TFM_DUMMY_PROVISIONING
	bool
	default n

config TFM_REGRESSION_NS
	bool
	select NRF_TIMER0_SECURE if !SOC_SERIES_NRF54LX
	select NRF_TIMER00_SECURE if SOC_SERIES_NRF54LX

config TFM_LOG_LEVEL_SILENCE
	# Overrule zephyr disable TF-M secure output if the uart1 node has not
	# assigned GPIO pins using pinctrl.
	default n
	depends on $(dt_nodelabel_has_prop,uart0,pinctrl-names)  || \
		   $(dt_nodelabel_has_prop,uart1,pinctrl-names)  || \
		   $(dt_nodelabel_has_prop,uart00,pinctrl-names) || \
		   $(dt_nodelabel_has_prop,uart20,pinctrl-names) || \
		   $(dt_nodelabel_has_prop,uart21,pinctrl-names) || \
		   $(dt_nodelabel_has_prop,uart22,pinctrl-names) || \
		   $(dt_nodelabel_has_prop,uart30,pinctrl-names)

choice TFM_PROFILE_TYPE
	default TFM_PROFILE_TYPE_NOT_SET if SOC_SERIES_NRF54LX
	default TFM_PROFILE_TYPE_MINIMAL
endchoice

choice TFM_MODEL
	default TFM_SFN if TFM_PROFILE_TYPE_MINIMAL
endchoice

config TFM_QCBOR_PATH
	string
	default "$(ZEPHYR_TRUSTED_FIRMWARE_M_MODULE_DIR)/../qcbor"

config TFM_PARTITION_INITIAL_ATTESTATION
	bool
	# We select "implementation ID" because it is a mandatory claim
	# in the IAT.
	# The initial attestation partition requires ECDSA algorithm with
	# SHA-256 and uses the Identity Key stored in the KMU.
	# The identity key is a secp256r1 key pair.
	# The ECDSA algorithm and the cc3xx boot seed requires RNG.
	select PSA_WANT_ALG_SHA_256
	select PSA_WANT_KEY_TYPE_ECC_KEY_PAIR_GENERATE
	select PSA_WANT_KEY_TYPE_ECC_KEY_PAIR_EXPORT
	select PSA_WANT_ALG_ECDSA
	select PSA_WANT_ECC_SECP_R1_256
	select SECURE_BOOT_STORAGE

config TFM_PARTITION_PROTECTED_STORAGE
	bool
	# The encryption policy relies on a secret hardware unique key (HUK) per device.
	# The protected storage partition require HKDF with HMAC and SHA-256 to
	# derive the storage key and an AEAD encryption algorithm for storage
	# encryption.
	select HW_UNIQUE_KEY if HW_UNIQUE_KEY_SUPPORTED
	select PSA_WANT_ALG_HKDF
	select PSA_WANT_ALG_HMAC
	select PSA_WANT_ALG_SHA_256
	select PSA_WANT_KEY_TYPE_AES
	select PSA_WANT_ALG_CCM if SOC_SERIES_NRF91X
	select PSA_WANT_ALG_GCM if SOC_NRF5340_CPUAPP
	select PSA_WANT_ALG_GCM if SOC_SERIES_NRF54LX

config TFM_ITS_ENCRYPTED
	bool
	select PSA_WANT_ALG_CHACHA20_POLY1305 if SOC_SERIES_NRF54LX

config BOOTLOADER_MCUBOOT
	bool
	imply TFM_HW_INIT_RESET_ON_BOOT
	imply TFM_HW_INIT_NRF_PERIPHERALS

endif # BUILD_WITH_TFM
```
