## CMakeLists.txt
```
#
# Copyright (c) 2024 Nordic Semiconductor
#
# SPDX-License-Identifier: LicenseRef-Nordic-5-Clause
#
cmake_minimum_required(VERSION 3.20.0)

find_package(Zephyr REQUIRED HINTS $ENV{ZEPHYR_BASE})
project(nrf_auraconfig)

add_subdirectory(${ZEPHYR_BASE}/tests/bsim/babblekit babblekit)
target_link_libraries(app PRIVATE babblekit)

# Include application events and configuration headers
zephyr_library_include_directories(app PRIVATE
    ${ZEPHYR_NRF_MODULE_DIR}/samples/bluetooth/nrf_auraconfig/include
    ${ZEPHYR_NRF_MODULE_DIR}/applications/nrf_audio/include
    ${ZEPHYR_NRF_MODULE_DIR}/applications/nrf_audio/src/bluetooth
    ${ZEPHYR_NRF_MODULE_DIR}/applications/nrf_audio/src/modules
    ${ZEPHYR_NRF_MODULE_DIR}/applications/nrf_audio/src/utils/macros
)

add_subdirectory(${ZEPHYR_NRF_MODULE_DIR}/applications/nrf_audio/src/bluetooth bluetooth_build)

target_sources_ifdef(CONFIG_NRF_AUDIO_SD_CARD_MODULE app PRIVATE ${ZEPHYR_NRF_MODULE_DIR}/applications/nrf_audio/src/modules/sd_card.c)
target_sources_ifdef(CONFIG_NRF_AUDIO_SD_CARD_LC3_FILE app PRIVATE ${ZEPHYR_NRF_MODULE_DIR}/applications/nrf_audio/src/modules/lc3_file.c)
target_sources_ifdef(CONFIG_NRF_AUDIO_SD_CARD_LC3_STREAMER app PRIVATE ${ZEPHYR_NRF_MODULE_DIR}/applications/nrf_audio/src/modules/lc3_streamer.c)

target_sources(app PRIVATE ${ZEPHYR_NRF_MODULE_DIR}/samples/bluetooth/nrf_auraconfig/src/nrf_auraconfig.c)

target_sources(app PRIVATE src/led_mock.c)
target_sources(app PRIVATE src/audio_time_mock.c)
target_sources(app PRIVATE src/main.c)

zephyr_include_directories(
  ${BSIM_COMPONENTS_PATH}/libUtilv1/src/
  ${BSIM_COMPONENTS_PATH}/libPhyComv1/src/
  )
```

## Kconfig
```
#
# Copyright (c) 2024 Nordic Semiconductor ASA
#
# SPDX-License-Identifier: LicenseRef-Nordic-5-Clause
#

rsource "$(ZEPHYR_NRF_MODULE_DIR)/applications/nrf_audio/src/audio/Kconfig"
rsource "$(ZEPHYR_NRF_MODULE_DIR)/applications/nrf_audio/src/bluetooth/Kconfig"
rsource "$(ZEPHYR_NRF_MODULE_DIR)/applications/nrf_audio/src/modules/Kconfig"
rsource "$(ZEPHYR_NRF_MODULE_DIR)/applications/nrf_audio/src/utils/Kconfig"

#----------------------------------------------------------------------------#

config NRF_AUDIO_TRANSPORT_BIS
	bool "Use BIS (Broadcast Isochronous Stream)"

config NRF_AURACONFIG
	bool "nRF Auraconfig [EXPERIMENTAL]"
	depends on NRF_AUDIO_TRANSPORT_BIS
	select EXPERIMENTAL
	default y

menu "Logging"

module = NRF_AUDIO_MAIN
module-str = main
source "subsys/logging/Kconfig.template.log_config"

module = NAC_TEST
module-str = nac_test
source "subsys/logging/Kconfig.template.log_config"

endmenu # Log levels

source "Kconfig.zephyr"
```

## Kconfig.sysbuild
```
#
# Copyright (c) 2024 Nordic Semiconductor
#
# SPDX-License-Identifier: LicenseRef-Nordic-5-Clause
#

source "share/sysbuild/Kconfig"

config NRF_DEFAULT_IPC_RADIO
	bool
	default y

config NATIVE_SIMULATOR_PRIMARY_MCU_INDEX
	int
	# Pipe test arguments to go to the application core.
	default 0 if $(BOARD_TARGET_STRING) = "NRF5340BSIM_NRF5340_CPUAPP"
```

## prj.conf
```kconfig
#
# Copyright (c) 2024 Nordic Semiconductor ASA
#
# SPDX-License-Identifier: LicenseRef-Nordic-5-Clause
#


# General
CONFIG_REBOOT=y
CONFIG_DEBUG=y
CONFIG_ASSERT=y
CONFIG_STACK_USAGE=y
CONFIG_THREAD_RUNTIME_STATS=y
CONFIG_MAIN_THREAD_PRIORITY=10
CONFIG_STACK_SENTINEL=y
CONFIG_INIT_STACKS=y
CONFIG_MAIN_STACK_SIZE=12000
CONFIG_THREAD_NAME=y
CONFIG_SYSTEM_WORKQUEUE_STACK_SIZE=1200
CONFIG_SW_CODEC_LC3_T2_SOFTWARE=n


# Uart driver
CONFIG_SERIAL=y

# Logging
CONFIG_LOG=y
CONFIG_LOG_TAG_MAX_LEN=2
CONFIG_LOG_TAG_DEFAULT="--"

CONFIG_LOG_BUFFER_SIZE=4096
CONFIG_USE_SEGGER_RTT=n
CONFIG_LOG_BACKEND_RTT=n

CONFIG_SOC_NRF53_CPUNET_ENABLE=y

CONFIG_ZBUS=y
CONFIG_ZBUS_RUNTIME_OBSERVERS=y
CONFIG_ZBUS_MSG_SUBSCRIBER=y
CONFIG_ZBUS_MSG_SUBSCRIBER_NET_BUF_POOL_SIZE=20

CONFIG_REGULATOR=y
CONFIG_CONTIN_ARRAY=y
CONFIG_DATA_FIFO=y

# Enable NRFX_CLOCK for ACLK control
CONFIG_NRFX_CLOCK=y
CONFIG_NRF_AUDIO_SYNC_TIMER_USES_RTC=y

# Audio codec LC3 related defines
# FPU_SHARING enables preservation of the hardware floating point registers
# across context switches to allow multiple threads to perform concurrent
# floating point operations.
CONFIG_FPU=y

# Enable SDHC interface
CONFIG_DISK_DRIVERS=y
CONFIG_DISK_DRIVER_SDMMC=y

# Allocate buffer on RAM for transferring chunck of data
# from Flash to SPI
CONFIG_SPI_NRFX_RAM_BUFFER_SIZE=8

# File system
CONFIG_FILE_SYSTEM=y
CONFIG_FAT_FILESYSTEM_ELM=y
CONFIG_FS_FATFS_LFN=y
CONFIG_FS_FATFS_LFN_MODE_STACK=y

# exFAT enabled to support longer file names and higher transfer speed
CONFIG_FS_FATFS_EXFAT=y
# Set the maximum file name length to 255
CONFIG_FS_FATFS_MAX_LFN=255

# Enable SPI interface
CONFIG_SPI=y

# Enable ADC for board version readback
CONFIG_ADC=y

CONFIG_WATCHDOG=y
CONFIG_TASK_WDT=y

# Console related defines
CONFIG_UART_CONSOLE=n
CONFIG_CONSOLE=n

# Shell related defines
CONFIG_SHELL=y
CONFIG_KERNEL_SHELL=y
CONFIG_SHELL_BACKEND_DUMMY=y
CONFIG_SHELL_BACKEND_SERIAL=n
CONFIG_SHELL_VT100_COMMANDS=y
CONFIG_SHELL_VT100_COLORS=y
CONFIG_SHELL_STACK_SIZE=8096
CONFIG_SHELL_CMD_BUFF_SIZE=128
## Reduce shell memory usage
CONFIG_SHELL_WILDCARD=n
CONFIG_SHELL_HELP_ON_WRONG_ARGUMENT_COUNT=n
CONFIG_SHELL_STATS=n
CONFIG_SHELL_CMDS=n
CONFIG_SHELL_HISTORY=y

# Turn off default shell commands
CONFIG_I2C_SHELL=n
CONFIG_HWINFO_SHELL=n
CONFIG_CLOCK_CONTROL_NRF_SHELL=n
CONFIG_FLASH_SHELL=n
CONFIG_DEVICE_SHELL=n

# Suppress LOG_ERR messages from sd_check_card_type. Because SPI_SDHC has no card presence method,
# assume card is in slot. Thus error message is always shown if card is not inserted
CONFIG_SD_LOG_LEVEL_OFF=y

# Suppress LOG_INF messages from hci_core
CONFIG_BT_HCI_CORE_LOG_LEVEL_WRN=y

## ISO related configs
CONFIG_BT=y
CONFIG_BT_DEVICE_NAME_DYNAMIC=y
CONFIG_BT_CAP_INITIATOR=y

CONFIG_BT_ISO_BROADCASTER=y
CONFIG_BT_ISO_MAX_BIG=2
CONFIG_BT_ISO_MAX_CHAN=8

# The following should be twice that of BT_ISO_MAX_CHAN
CONFIG_BT_ISO_TX_BUF_COUNT=16

CONFIG_BT_BAP_BROADCAST_SOURCE=y
CONFIG_BT_BAP_BROADCAST_SRC_COUNT=2
CONFIG_BT_EXT_ADV_MAX_ADV_SET=2
CONFIG_BT_BAP_BROADCAST_SRC_SUBGROUP_COUNT=4
CONFIG_BT_BAP_BROADCAST_SRC_STREAM_COUNT=8

# Broadcasting Device - 0x0885
CONFIG_BT_DEVICE_APPEARANCE=2181

CONFIG_NRF_AUDIO_TRANSPORT_BIS=y
CONFIG_NRF_AUDIO_BROADCAST_CONFIGURABLE=y
CONFIG_NRF_AUDIO_BROADCAST_ZBUS_EVT_STREAM_SENT=y

CONFIG_NRF_AUDIO_MSG_SUB_THREAD_PRIO=3

CONFIG_NRF_AUDIO_SW_CODEC_NONE=y
CONFIG_FPU_SHARING=n
CONFIG_NEWLIB_LIBC=n

CONFIG_POSIX_API=y

CONFIG_NRF_AUDIO_SD_CARD_MODULE=y
CONFIG_NRF_AUDIO_SD_CARD_LC3_FILE=y
CONFIG_NRF_AUDIO_SD_CARD_LC3_STREAMER=y

CONFIG_NRF_AUDIO_SD_CARD_LC3_STREAMER_STACK_SIZE=8000

CONFIG_NRF_AUDIO_MODULE_SD_CARD_LOG_LEVEL_WRN=y
CONFIG_NRF_AUDIO_BT_TX_LOG_LEVEL_ERR=y

CONFIG_ENTROPY_GENERATOR=y

CONFIG_NRF_AUDIO_SOURCE_I2S=y
```

## app.overlay
```dts
/*
 * Copyright (c) 2025 Nordic Semiconductor ASA
 *
 * SPDX-License-Identifier: LicenseRef-Nordic-5-Clause
 */

/ {
	ramdisk0 {
		compatible = "zephyr,ram-disk";
		disk-name = "RAM";
		sector-size = <512>;
		sector-count = <80>;
	};
};
```

## src/main.c
```c
/*
 * Copyright (c) 2024 Nordic Semiconductor ASA
 *
 * SPDX-License-Identifier: LicenseRef-Nordic-5-Clause
 */

#include "nrf_auraconfig.h"

#include <babblekit/testcase.h>
#include <zephyr/shell/shell_backend.h>
#include <bstests.h>
#include <bs_tracing.h>
#include <bs_types.h>

#include <zephyr/logging/log.h>
#include <zephyr/logging/log_backend.h>
LOG_MODULE_REGISTER(nac_test, CONFIG_NAC_TEST_LOG_LEVEL);

static uint32_t log_err_count;
static uint32_t log_dropped;

static void log_backend_test_parser_process(const struct log_backend *const backend,
					    union log_msg_generic *msg_generic)
{
	ARG_UNUSED(backend);

	if (log_msg_get_level(&msg_generic->log) == LOG_LEVEL_ERR) {
		log_err_count++;
	}
}

static void log_backend_test_parser_dropped(const struct log_backend *const backend, uint32_t cnt)
{
	ARG_UNUSED(backend);
	log_dropped += cnt;
}

static const struct log_backend_api log_backend_test_parser_api = {
	.process = log_backend_test_parser_process,
	.dropped = log_backend_test_parser_dropped,
};

LOG_BACKEND_DEFINE(log_backend_test_parser, log_backend_test_parser_api, true);

extern enum bst_result_t bst_result;

#define MAX_ARGS	200
#define MAX_ARG_LEN	50
#define ARG_COMMAND	"nac"
#define MAX_COMMAND_LEN 60

static int argc_copy;
static char argv_copy[MAX_ARGS][MAX_ARG_LEN];

/* This code is executed by the test framework and not Zephyr */
static void test_args(int argc, char *argv[])
{
	argc_copy = argc;

	for (int i = 0; i < argc; i++) {
		if (i > MAX_ARGS) {
			TEST_FAIL("ENOMEM, MAX_ARG");
		}
		if (strlen(argv[i]) > MAX_ARG_LEN) {
			TEST_FAIL("ENOMEM, MAX_ARG_LEN");
		}

		memcpy(argv_copy[i], argv[i], strlen(argv[i]) + 1);
	}
}

static int modules_configure(void)
{
	int ret;
	char cmd_str[MAX_COMMAND_LEN] = {'\0'};

	if (argc_copy == 0) {
		LOG_ERR("No arguments provided");
		return -EINVAL;
	}

	if (strcmp(argv_copy[0], ARG_COMMAND) != 0) {
		LOG_ERR("First argument must be '%s'", ARG_COMMAND);
		return -EINVAL;
	}

	strcat(cmd_str, argv_copy[0]);

	/* Parse argv_copy, divide by keyword ARG_COMMAND and send commands to shell */
	for (int i = 1; i < argc_copy; i++) {
		if (strcmp(argv_copy[i], ARG_COMMAND) == 0) {
			/* Send command and reset argc */
			ret = shell_execute_cmd(NULL, cmd_str);
			if (ret) {
				LOG_ERR("Failed to send command %s, err: %d", cmd_str, ret);
				return ret;
			}
			memset(cmd_str, '\0', sizeof(cmd_str));

			strcat(cmd_str, argv_copy[i]);
		} else {
			if (strlen(cmd_str) + strlen(argv_copy[i]) > MAX_COMMAND_LEN) {
				LOG_ERR("Command too long");
				return -EINVAL;
			}

			strcat(cmd_str, " ");
			strcat(cmd_str, argv_copy[i]);
		}
	}

	/* Send last command */
	ret = shell_execute_cmd(NULL, cmd_str);
	if (ret) {
		LOG_ERR("Failed to send command %s", cmd_str);
		return ret;
	}

	return 0;
}

void test_main(void)
{
	int err;

	int backends = shell_backend_count_get();

	if (backends != 1) {
		TEST_FAIL("Only one shell backend accepted. Found: %d", backends);
	}

	nrf_auraconfig_main();

	err = modules_configure();
	if (err) {
		TEST_FAIL("Configure failed (err %d)", err);
	}
}

static void test_delete(void)
{
	if (log_err_count != 0) {
		TEST_FAIL("%u <err> prints detected in nac test", log_err_count);
		return;
	}

	if (log_dropped != 0) {
		/* Dropped messages are not a problem in itself, but shows that
		 * the logging system is being overloaded.
		 * Does not catch overload in other logging backends.
		 */
		TEST_FAIL("%u log messages dropped in nac test", log_dropped);
		return;
	}

	if (bst_result == In_progress) {
		/* The nRF_Auraconfig sample won't stop by itself, so running == passing */
		TEST_PASS();
	} else {
		TEST_FAIL("Test aborted");
	}
}

static const struct bst_test_instance test_vector[] = {
	{
		.test_args_f = test_args,
		.test_id = "nac",
		.test_main_f = test_main,
		.test_delete_f = test_delete,
	},
	BSTEST_END_MARKER,
};

struct bst_test_list *test_nrf_auraconfig_install(struct bst_test_list *tests)
{
	return bst_add_tests(tests, test_vector);
}

bst_test_install_t test_installers[] = {test_nrf_auraconfig_install, NULL};

int main(void)
{
	bst_main();
	return 0;
}
```

## src/audio_sync_timer_mock.c
```c
/*
 * Copyright (c) 2024 Nordic Semiconductor ASA
 *
 * SPDX-License-Identifier: LicenseRef-Nordic-5-Clause
 */

#include "audio_sync_timer.h"

uint32_t audio_sync_timer_capture(void)
{
	return 0;
}

uint32_t audio_sync_timer_capture_get(void)
{
	return 0;
}
```

## src/audio_time_mock.c
```c
/*
 * Copyright (c) 2024 Nordic Semiconductor ASA
 *
 * SPDX-License-Identifier: LicenseRef-Nordic-5-Clause
 */

#include "audio_time.h"

uint32_t audio_time_us_get(void)
{
	return 0;
}
```

## src/led_mock.c
```c
/*
 * Copyright (c) 2025 Nordic Semiconductor ASA
 *
 * SPDX-License-Identifier: LicenseRef-Nordic-5-Clause
 */

#include "led.h"
#include "led_assignments.h"


int led_on(uint8_t led, ...)
{
	return 0;
}

int led_off(uint8_t led)
{
	return 0;
}

int led_blink(uint8_t led, ...)
{
	return 0;
}

int led_init(void)
{
	return 0;
}
```
