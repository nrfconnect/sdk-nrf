## tests/drivers/audio/pdm_loopback/Kconfig
```kconfig
#
# Copyright (c) 2024 Nordic Semiconductor ASA
#
# SPDX-License-Identifier: LicenseRef-Nordic-5-Clause
#

source "Kconfig.zephyr"

config TEST_PDM_SAMPLING_RATE
	int "PDM sample rate in Hz"
	default 10000
	help
	  The test will use it to define frequency of PDM sampling and
	  calculate the size of the buffer.

config TEST_PDM_EXPECTED_FREQUENCY
	int "Expected PDM_CLK frequency in Hz"
	default 1000000
	help
	  The test will use it to confirm that the captured PDM_CLK
	  frequency in correct.

config TEST_PDM_SAMPLING_TIME
	int "PDM sampling time for one block in ms"
	default 100
	help
	  The test will use it to calculate the size of data block and
	  determine the period of capturing timer.

config TEST_USE_DMM
	bool "Use of DMM pre-allocation"
	help
	  The test will use it to determine whether to prealocate DMM
	  buffer or use regular mem slab and allocate dmm buffer inside
	  PDM driver.
```

## tests/drivers/audio/pdm_loopback/testcase.yaml
```yaml
common:
  tags:
    - drivers
    - ci_tests_drivers_audio
  harness: ztest
  harness_config:
    fixture: gpio_loopback
  timeout: 20

tests:
  drivers.audio.pdm_loopback.nrf54l.1000khz:
    platform_allow:
      - nrf54l15dk/nrf54l15/cpuapp
      - nrf54l15dk/nrf54l15/cpuapp/ns
      - nrf54lm20dk/nrf54lm20a/cpuapp
    integration_platforms:
      - nrf54lm20dk/nrf54lm20a/cpuapp
    extra_args: CONFIG_NRFX_TIMER=y
  drivers.audio.pdm_loopback.nrf54lm20.1000khz:
    platform_allow:
      - nrf54lm20dk/nrf54lm20a/cpuapp
    extra_args:
      - CONFIG_NRFX_TIMER=y
      - CONFIG_TEST_PDM_SAMPLING_RATE=20000
  drivers.audio.pdm_loopback.nrf54l.1280khz:
    platform_allow:
      - nrf54l15dk/nrf54l15/cpuapp
      - nrf54l15dk/nrf54l15/cpuapp/ns
      - nrf54lm20dk/nrf54lm20a/cpuapp
    integration_platforms:
      - nrf54lm20dk/nrf54lm20a/cpuapp
    extra_args:
      - CONFIG_NRFX_TIMER=y
      - CONFIG_TEST_PDM_SAMPLING_RATE=16000
      - CONFIG_TEST_PDM_EXPECTED_FREQUENCY=1280000
  drivers.audio.pdm_loopback.nrf54l.1600khz:
    platform_allow:
      - nrf54l15dk/nrf54l15/cpuapp
      - nrf54l15dk/nrf54l15/cpuapp/ns
      - nrf54lm20dk/nrf54lm20a/cpuapp
    integration_platforms:
      - nrf54lm20dk/nrf54lm20a/cpuapp
    extra_args:
      - CONFIG_NRFX_TIMER=y
      - CONFIG_TEST_PDM_SAMPLING_RATE=32000
      - CONFIG_TEST_PDM_EXPECTED_FREQUENCY=1600000
  drivers.audio.pdm_loopback.nrf54lm20.aclk.1000khz:
    platform_allow:
      - nrf54lm20dk/nrf54lm20a/cpuapp
    extra_args:
      - CONFIG_NRFX_TIMER=y
      - CONFIG_TEST_PDM_SAMPLING_RATE=20000
      - EXTRA_DTC_OVERLAY_FILE="boards/nrf54l_aclk.overlay"
  drivers.audio.pdm_loopback.nrf54lm20.aclk.1280khz:
    platform_allow:
      - nrf54lm20dk/nrf54lm20a/cpuapp
    extra_args:
      - CONFIG_NRFX_TIMER=y
      - CONFIG_TEST_PDM_SAMPLING_RATE=16000
      - CONFIG_TEST_PDM_EXPECTED_FREQUENCY=1280000
      - EXTRA_DTC_OVERLAY_FILE="boards/nrf54l_aclk.overlay"
  drivers.audio.pdm_loopback.nrf54lm20.aclk.1600khz:
    platform_allow:
      - nrf54lm20dk/nrf54lm20a/cpuapp
    extra_args:
      - CONFIG_NRFX_TIMER=y
      - CONFIG_TEST_PDM_SAMPLING_RATE=32000
      - CONFIG_TEST_PDM_EXPECTED_FREQUENCY=1600000
      - EXTRA_DTC_OVERLAY_FILE="boards/nrf54l_aclk.overlay"
  drivers.audio.pdm_loopback.nrf54h20.1000khz:
    platform_allow:
      - nrf54h20dk/nrf54h20/cpuapp
    extra_args:
      - CONFIG_NRFX_TIMER=y
      - CONFIG_TEST_PDM_SAMPLING_TIME=10
      - CONFIG_TEST_USE_DMM=y
  drivers.audio.pdm_loopback.nrf54h20.1600khz:
    platform_allow:
      - nrf54h20dk/nrf54h20/cpuapp
    extra_args:
      - CONFIG_NRFX_TIMER=y
      - CONFIG_TEST_PDM_SAMPLING_RATE=16000
      - CONFIG_TEST_PDM_EXPECTED_FREQUENCY=1600000
      - CONFIG_TEST_PDM_SAMPLING_TIME=10
      - CONFIG_TEST_USE_DMM=y
  drivers.audio.pdm_loopback.nrf54h20.audiopll.44k1hz:
    platform_allow:
      - nrf54h20dk/nrf54h20/cpuapp
    extra_args:
      - CONFIG_NRFX_TIMER=y
      - CONFIG_TEST_PDM_SAMPLING_RATE=44100
      - CONFIG_TEST_PDM_EXPECTED_FREQUENCY=1411200
      - CONFIG_TEST_PDM_SAMPLING_TIME=10
      - CONFIG_CLOCK_CONTROL=y
      - CONFIG_TEST_USE_DMM=y
      - DTC_OVERLAY_FILE="boards/nrf54h20dk_nrf54h20_cpuapp_audiopll_44k1.overlay"
  drivers.audio.pdm_loopback.nrf54h20.audiopll.48khz:
    platform_allow:
      - nrf54h20dk/nrf54h20/cpuapp
    extra_args:
      - CONFIG_NRFX_TIMER=y
      - CONFIG_TEST_PDM_SAMPLING_RATE=48000
      - CONFIG_TEST_PDM_EXPECTED_FREQUENCY=1536000
      - CONFIG_TEST_PDM_SAMPLING_TIME=10
      - CONFIG_CLOCK_CONTROL=y
      - CONFIG_TEST_USE_DMM=y
      - DTC_OVERLAY_FILE="boards/nrf54h20dk_nrf54h20_cpuapp_audiopll_48k.overlay"
  drivers.audio.pdm_loopback.nrf54h20.no_dmm:
    platform_allow:
      - nrf54h20dk/nrf54h20/cpuapp
    extra_args:
      - CONFIG_NRFX_TIMER=y
      - CONFIG_TEST_PDM_SAMPLING_TIME=10
  drivers.audio.pdm_loopback.nrf7120.1280khz:
    platform_allow:
      - nrf7120dk/nrf7120/cpuapp
    extra_args:
      - CONFIG_NRFX_TIMER=y
      - CONFIG_TEST_PDM_SAMPLING_RATE=16000
      - CONFIG_TEST_PDM_EXPECTED_FREQUENCY=1280000
  drivers.audio.pdm_loopback.nrf7120.auxpll.44k1hz:
    platform_allow:
      - nrf7120dk/nrf7120/cpuapp
    extra_args:
      - CONFIG_NRFX_TIMER=y
      - CONFIG_TEST_PDM_SAMPLING_RATE=44100
      - CONFIG_TEST_PDM_EXPECTED_FREQUENCY=1411200
      - CONFIG_CLOCK_CONTROL=y
      - DTC_OVERLAY_FILE="boards/nrf7120dk_nrf7120_cpuapp_audio_auxpll_44k1hz.overlay"
  drivers.audio.pdm_loopback.nrf7120.auxpll.48khz:
    platform_allow:
      - nrf7120dk/nrf7120/cpuapp
    extra_args:
      - CONFIG_NRFX_TIMER=y
      - CONFIG_TEST_PDM_SAMPLING_RATE=48000
      - CONFIG_TEST_PDM_EXPECTED_FREQUENCY=1536000
      - CONFIG_CLOCK_CONTROL=y
      - DTC_OVERLAY_FILE="boards/nrf7120dk_nrf7120_cpuapp_audio_auxpll_48khz.overlay"
```

## tests/drivers/audio/pdm_prescaler/Kconfig
```kconfig
#
# Copyright (c) 2025 Nordic Semiconductor ASA
#
# SPDX-License-Identifier: LicenseRef-Nordic-5-Clause
#

source "Kconfig.zephyr"

config TEST_PDM_SAMPLING_RATE
	int "PDM sample rate in Hz"
	default 10000
	help
	  The test will use it to define frequency of PDM sampling and
	  calculate the size of the buffer.

config TEST_PDM_EXPECTED_FREQUENCY
	int "Expected PDM_CLK frequency in Hz"
	default 1000000
	help
	  The test will use it to confirm that the captured PDM_CLK
	  frequency in correct.

config TEST_PDM_SAMPLING_TIME
	int "PDM sampling time for one block in ms"
	default 100
	help
	  The test will use it to calculate the size of data block and
	  determine the period of capturing timer.
```

## tests/drivers/audio/pdm_prescaler/testcase.yaml
```yaml
common:
  tags:
    - drivers
    - ci_tests_drivers_audio
  harness: ztest
  harness_config:
    fixture: gpio_loopback
  timeout: 20
  platform_exclude:
    - nrf54h20dk/nrf54h20/cpuapp
    # On nrf54H20 there is no PRESCALER register

tests:
  drivers.audio.pdm_prescaler.nrf54l.1000khz:
    platform_allow:
      - nrf54l15dk/nrf54l15/cpuapp
      - nrf54l15dk/nrf54l15/cpuapp/ns
      - nrf54lm20dk/nrf54lm20a/cpuapp
    integration_platforms:
      - nrf54lm20dk/nrf54lm20a/cpuapp
  drivers.audio.pdm_prescaler.nrf54lm20.1000khz:
    platform_allow:
      - nrf54lm20dk/nrf54lm20a/cpuapp
    extra_args:
      - CONFIG_TEST_PDM_SAMPLING_RATE=20000
  drivers.audio.pdm_prescaler.nrf54l.1280khz:
    platform_allow:
      - nrf54l15dk/nrf54l15/cpuapp
      - nrf54l15dk/nrf54l15/cpuapp/ns
      - nrf54lm20dk/nrf54lm20a/cpuapp
    integration_platforms:
      - nrf54lm20dk/nrf54lm20a/cpuapp
    extra_args:
      - CONFIG_TEST_PDM_SAMPLING_RATE=16000
      - CONFIG_TEST_PDM_EXPECTED_FREQUENCY=1280000
  drivers.audio.pdm_prescaler.nrf54l.1600khz:
    platform_allow:
      - nrf54l15dk/nrf54l15/cpuapp
      - nrf54l15dk/nrf54l15/cpuapp/ns
      - nrf54lm20dk/nrf54lm20a/cpuapp
    integration_platforms:
      - nrf54lm20dk/nrf54lm20a/cpuapp
    extra_args:
      - CONFIG_TEST_PDM_SAMPLING_RATE=32000
      - CONFIG_TEST_PDM_EXPECTED_FREQUENCY=1600000
  drivers.audio.pdm_prescaler.nrf54lm20.aclk.1000khz:
    platform_allow:
      - nrf54lm20dk/nrf54lm20a/cpuapp
    extra_args:
      - CONFIG_TEST_PDM_SAMPLING_RATE=20000
      - EXTRA_DTC_OVERLAY_FILE="nrf54l_aclk.overlay"
  drivers.audio.pdm_prescaler.nrf54lm20.aclk.1280khz:
    platform_allow:
      - nrf54lm20dk/nrf54lm20a/cpuapp
    extra_args:
      - CONFIG_TEST_PDM_SAMPLING_RATE=16000
      - CONFIG_TEST_PDM_EXPECTED_FREQUENCY=1280000
      - EXTRA_DTC_OVERLAY_FILE="nrf54l_aclk.overlay"
  drivers.audio.pdm_prescaler.nrf54lm20.aclk.1600khz:
    platform_allow:
      - nrf54lm20dk/nrf54lm20a/cpuapp
    extra_args:
      - CONFIG_TEST_PDM_SAMPLING_RATE=32000
      - CONFIG_TEST_PDM_EXPECTED_FREQUENCY=1600000
      - EXTRA_DTC_OVERLAY_FILE="nrf54l_aclk.overlay"
```
