## tests/bluetooth/bsim/nrf_auraconfig/Kconfig
```kconfig
#
# Copyright (c) 2024 Nordic Semiconductor ASA
#
# SPDX-License-Identifier: LicenseRef-Nordic-5-Clause
#

rsource "$(ZEPHYR_NRF_MODULE_DIR)/applications/nrf5340_audio/src/audio/Kconfig"
rsource "$(ZEPHYR_NRF_MODULE_DIR)/applications/nrf5340_audio/src/bluetooth/Kconfig"
rsource "$(ZEPHYR_NRF_MODULE_DIR)/applications/nrf5340_audio/src/modules/Kconfig"
rsource "$(ZEPHYR_NRF_MODULE_DIR)/applications/nrf5340_audio/src/utils/Kconfig"

#----------------------------------------------------------------------------#

config TRANSPORT_BIS
	bool "Use BIS (Broadcast Isochronous Stream)"

config NRF_AURACONFIG
	bool "nRF Auraconfig"
	depends on TRANSPORT_BIS
	select EXPERIMENTAL
	default y

menu "Logging"

module = MAIN
module-str = main
source "subsys/logging/Kconfig.template.log_config"

module = NAC_TEST
module-str = nac_test
source "subsys/logging/Kconfig.template.log_config"

endmenu # Log levels

source "Kconfig.zephyr"
```

## tests/bluetooth/bsim/nrf_auraconfig/Kconfig.sysbuild
```kconfig
#
# Copyright (c) 2024 Nordic Semiconductor
#
# SPDX-License-Identifier: LicenseRef-Nordic-5-Clause
#

source "share/sysbuild/Kconfig"

config NRF_DEFAULT_IPC_RADIO
	bool
	default y

config NATIVE_SIMULATOR_PRIMARY_MCU_INDEX
	int
	# Pipe test arguments to go to the application core.
	default 0 if $(BOARD_TARGET_STRING) = "NRF5340BSIM_NRF5340_CPUAPP"
```

## tests/bluetooth/bsim/nrf_auraconfig/tester/Kconfig
```kconfig
#
# Copyright (c) 2024 Nordic Semiconductor
#
# SPDX-License-Identifier: LicenseRef-Nordic-5-Clause
#

menu "Logging"

module = MAIN
module-str = main
source "subsys/logging/Kconfig.template.log_config"

module = NAC_TESTER
module-str = nac_tester
source "subsys/logging/Kconfig.template.log_config"

endmenu # Log levels

source "Kconfig.zephyr"
```

## tests/bluetooth/host/shell/Kconfig.sysbuild
```kconfig
#
# Copyright (c) 2026 Nordic Semiconductor ASA
#
# SPDX-License-Identifier: LicenseRef-Nordic-5-Clause
#

config NRF_DEFAULT_IPC_RADIO
	default y

config NETCORE_IPC_RADIO_BT_HCI_IPC
	default y

source "share/sysbuild/Kconfig"
```

## tests/bluetooth/host/shell/testcase.yaml
```yaml
common:
  # Default platform_allow & integration_platforms for the tests below, which a few override
  platform_allow:
    - native_sim
  integration_platforms:
    - native_sim
tests:
  bluetooth.shell.main:
    extra_configs:
      - CONFIG_UART_NATIVE_PTY_0_ON_STDINOUT=y
    platform_allow:
      - qemu_x86
      - native_sim
      - native_sim/native/64
      - nrf52840dk/nrf52840
    integration_platforms:
      - qemu_x86
    platform_exclude: nrf52dk/nrf52810
    tags: bluetooth
    harness: keyboard
    min_flash: 145
  bluetooth.shell.power_control_request:
    extra_configs:
      - CONFIG_BT_TRANSMIT_POWER_CONTROL=y
      - CONFIG_BT_LL_SW_SPLIT=n
    build_only: true
  bluetooth.shell.path_loss_monitoring:
    extra_configs:
      - CONFIG_BT_PATH_LOSS_MONITORING=y
      - CONFIG_BT_LL_SW_SPLIT=n
    build_only: true
  bluetooth.shell.subrating:
    extra_configs:
      - CONFIG_BT_SUBRATING=y
      - CONFIG_BT_LL_SW_SPLIT=n
    build_only: true
  bluetooth.shell.extended_feature_set:
    extra_configs:
      - CONFIG_BT_LE_MAX_LOCAL_SUPPORTED_FEATURE_PAGE=10
      - CONFIG_BT_LE_EXTENDED_FEAT_SET=y
      - CONFIG_BT_LL_SW_SPLIT=n
    build_only: true
  bluetooth.shell.frame_space_update:
    extra_configs:
      - CONFIG_BT_FRAME_SPACE_UPDATE=y
      - CONFIG_BT_LE_EXTENDED_FEAT_SET=y
      - CONFIG_BT_LL_SW_SPLIT=n
    build_only: true
  bluetooth.shell.shorter_connection_intervals:
    extra_configs:
      - CONFIG_BT_SHORTER_CONNECTION_INTERVALS=y
      - CONFIG_BT_LE_EXTENDED_FEAT_SET=y
      - CONFIG_BT_SUBRATING=y
      - CONFIG_BT_LL_SW_SPLIT=n
    build_only: true
  bluetooth.shell.channel_sounding:
    extra_configs:
      - CONFIG_BT_CHANNEL_SOUNDING=y
      - CONFIG_BT_CHANNEL_SOUNDING_TEST=y
      - CONFIG_BT_LL_SW_SPLIT=n
    build_only: true
  bluetooth.shell.no_privacy:
    build_only: true
    extra_args: CONFIG_BT_PRIVACY=n
    tags: bluetooth
  bluetooth.shell.log_defaults:
    build_only: true
    extra_args: CONF_FILE="log.conf"
    tags: bluetooth
  bluetooth.native_shell:
    build_only: true
    extra_args:
      - EXTRA_CONF_FILE=snippets/xterm-native-shell/xterm-native-shell.conf
      - EXTRA_DTC_OVERLAY_FILE=snippets/xterm-native-shell/xterm-native-shell.overlay
    platform_allow:
      - nrf52_bsim
    integration_platforms:
      - nrf52_bsim
```

## tests/bluetooth/iso/Kconfig
```kconfig
config PRINT_CONN_INTERVAL
	int "Print pr X connection interval"
	default 100
	help
	  For each set interval, a summary will be printed and a LED toggled.

config BIS_ISO_CHAN_COUNT_MAX
	int "Max number of ISO channels"
	default 2
	help
	  It is not necessary to use all channels. Increasing will use more ROM.

config ISO_TEST_LOG_LEVEL
	int "Default log level for ISO test module"
	default 3

config ACL_TEST_LOG_LEVEL
	int "Default log level for ACL test module"
	default 3

source "Kconfig.zephyr"
```

## tests/bluetooth/iso/bsim/Kconfig
```kconfig
config PRINT_ISO_INTERVAL
	int "Print every X ISO interval"
	default 200
	help
	  For each set interval, a summary will be printed and a LED toggled.

config PRINT_CONN_INTERVAL
	int "Print every X connection interval"
	default 20


config BIS_ISO_CHAN_COUNT_MAX
	int "Max number of ISO channels"
	default 2
	help
	  It is not necessary to use all channels. Increasing will use more ROM.

config ISO_TEST_LOG_LEVEL
	int "Default log level for ISO test module"
	default 3

config ACL_TEST_LOG_LEVEL
	int "Default log level for ACL test module"
	default 3

source "Kconfig.zephyr"
```

## tests/bluetooth/iso/testcase.yaml
```yaml
tests:
  bluetooth.bis_and_acl:
    sysbuild: true
    build_only: true
    platform_allow: nrf5340dk/nrf5340/cpuapp nrf5340_audio_dk/nrf5340/cpuapp
    integration_platforms:
      - nrf5340dk/nrf5340/cpuapp
      - nrf5340_audio_dk/nrf5340/cpuapp
    tags: bis_and_acl sysbuild
    timeout: 20
```

## tests/bluetooth/tester/testcase.yaml
```yaml
tests:
  bluetooth.general.tester.build:
    sysbuild: true
    build_only: true
    platform_allow:
      - nrf52840dk/nrf52840
      - nrf54l15dk/nrf54l15/cpuapp
    tags:
      - bluetooth
      - ci_build
      - sysbuild
    integration_platforms:
      - nrf52840dk/nrf52840
      - nrf54l15dk/nrf54l15/cpuapp
```

## tests/bsim/bluetooth/ll/conn/testcase.yaml
```yaml
common:
  build_only: true
  tags:
    - bluetooth
  harness: bsim
  sysbuild: true

tests:
  bluetooth.ll.conn.split:
    platform_allow:
      - nrf52_bsim/native
      - nrf5340bsim/nrf5340/cpunet
      - nrf5340bsim/nrf5340/cpuapp
      - nrf54l15bsim/nrf54l15/cpuapp
    harness_config:
      bsim_exe_name: tests_bsim_bluetooth_ll_conn_prj_split_conf
    extra_args:
      CONF_FILE=prj_split.conf

  bluetooth.ll.conn.split.1ms:
    platform_allow:
      - nrf52_bsim/native
      - nrf5340bsim/nrf5340/cpunet
    harness_config:
      bsim_exe_name: tests_bsim_bluetooth_ll_conn_prj_split_1ms_conf
    extra_args:
      CONF_FILE=prj_split_1ms.conf

  bluetooth.ll.conn.split.tx_defer:
    platform_allow:
      - nrf52_bsim/native
      - nrf5340bsim/nrf5340/cpunet
    harness_config:
      bsim_exe_name: tests_bsim_bluetooth_ll_conn_prj_split_tx_defer_conf
    extra_args:
      CONF_FILE=prj_split_tx_defer.conf

  bluetooth.ll.conn.split.privacy:
    platform_allow:
      - nrf52_bsim/native
      - nrf5340bsim/nrf5340/cpunet
      - nrf5340bsim/nrf5340/cpuapp
      - nrf54l15bsim/nrf54l15/cpuapp
    harness_config:
      bsim_exe_name: tests_bsim_bluetooth_ll_conn_prj_split_privacy_conf
    extra_args:
      CONF_FILE=prj_split_privacy.conf

  bluetooth.ll.conn.split.low_lat:
    platform_allow:
      - nrf52_bsim/native
      - nrf5340bsim/nrf5340/cpunet
    harness_config:
      bsim_exe_name: tests_bsim_bluetooth_ll_conn_prj_split_low_lat_conf
    extra_args:
      CONF_FILE=prj_split_low_lat.conf

  bluetooth.ll.conn.split.single_timer:
    platform_allow:
      - nrf52_bsim/native
      - nrf5340bsim/nrf5340/cpunet
    harness_config:
      bsim_exe_name: tests_bsim_bluetooth_ll_conn_prj_split_single_timer_conf
    extra_args:
      CONF_FILE=prj_split_single_timer.conf
```

## tests/bsim/bluetooth/ll/multiple_id/testcase.yaml
```yaml
common:
  build_only: true
  tags:
    - bluetooth
  harness: bsim
  sysbuild: true

tests:
  bluetooth.ll.multiple_id:
    platform_allow:
      - nrf52_bsim/native
      - nrf5340bsim/nrf5340/cpunet
      - nrf5340bsim/nrf5340/cpuapp
      - nrf54l15bsim/nrf54l15/cpuapp
    harness_config:
      bsim_exe_name: tests_bsim_bluetooth_ll_multiple_id_prj_conf
```

## tests/bsim/bluetooth/ll/throughput/testcase.yaml
```yaml
common:
  build_only: true
  tags:
    - bluetooth
  harness: bsim
  sysbuild: true

tests:
  bluetooth.ll.throughput:
    platform_allow:
      - nrf52_bsim/native
      - nrf5340bsim/nrf5340/cpunet
      - nrf5340bsim/nrf5340/cpuapp
      - nrf54l15bsim/nrf54l15/cpuapp
    harness_config:
      bsim_exe_name: tests_bsim_bluetooth_ll_throughput_prj_conf
  bluetooth.ll.throughput.no_phy_update:
    platform_allow:
      - nrf52_bsim/native
      - nrf5340bsim/nrf5340/cpunet
      - nrf5340bsim/nrf5340/cpuapp
      - nrf54l15bsim/nrf54l15/cpuapp
    extra_args:
      - EXTRA_CONF_FILE=overlay-no_phy_update.conf
    harness_config:
      bsim_exe_name: tests_bsim_bluetooth_ll_throughput_prj_conf_overlay-no_phy_update_conf
```

## tests/crypto/Kconfig
```kconfig
config REDUCED_TEST_SUITE
	bool "Reduced test suite"
	default n
	help
		If False, all test vectors in all test_vector_* files are used as a test basis.
		If True, only the test vectors in test_vectors.c are used.

config CRYPTO_TEST_LONG_RUNNING_VECTORS
	bool "Test slow vectors"
	default y
	help
	  Some test vectors are much slower than others.
	  If True these will be tested.
	  Do a search of CRYPTO_TEST_LONG_RUNNING_VECTORS amongst the
	  test_vectors_* files to see which vectors are affected.

config CRYPTO_TEST_LARGE_VECTORS
	bool "Test large vectors"
	default y
	help
	  Some test vectors are very large.
	  This might be inappropriate for devices with
	  limited resources.
	  If True large test vectors will be compiled and executed.
	  Also, some test suites have a very large amount of similar but small
	  test vectors, this amount will be somewhat reduced when False.

config CRYPTO_TEST_HASH
	bool "Test hash (SHA, hmac, hkdf)"
	default y
	help
	  Hash support is always enabled.
	  In order to save space on smaller devices,
	  allow skipping these tests by setting this to False,
	  which means the tests are neither executed nor compiled in.


source "Kconfig.zephyr"
```

## tests/crypto/testcase.yaml
```yaml
tests:
  crypto.cc3xx:
    sysbuild: true
    extra_args: OVERLAY_CONFIG=overlay-cc3xx.conf
    platform_allow:
      - nrf52840dk/nrf52840
      - nrf5340dk/nrf5340/cpuapp
      - nrf9151dk/nrf9151
      - nrf9160dk/nrf9160
      - nrf9161dk/nrf9161
    integration_platforms:
      - nrf52840dk/nrf52840
      - nrf5340dk/nrf5340/cpuapp
      - nrf9151dk/nrf9151
      - nrf9160dk/nrf9160
      - nrf9161dk/nrf9161
    tags: crypto ci_build legacy cc3xx_legacy sysbuild
    harness_config:
      type: multi_line
      regex:
        - ".*PROJECT EXECUTION SUCCESSFUL.*"
    timeout: 200
  crypto.oberon:
    sysbuild: true
    extra_args: OVERLAY_CONFIG=overlay-oberon.conf
    platform_allow:
      - nrf52840dk/nrf52840
      - nrf5340dk/nrf5340/cpuapp
      - nrf9151dk/nrf9151
      - nrf9160dk/nrf9160
      - nrf9161dk/nrf9161
    integration_platforms:
      - nrf52840dk/nrf52840
      - nrf5340dk/nrf5340/cpuapp
      - nrf9151dk/nrf9151
      - nrf9160dk/nrf9160
      - nrf9161dk/nrf9161
    tags: crypto ci_build legacy oberon_legacy sysbuild
    harness_config:
      type: multi_line
      regex:
        - ".*PROJECT EXECUTION SUCCESSFUL.*"
    timeout: 200
```

## tests/drivers/adc/adc_latency/testcase.yaml
```yaml
common:
  tags:
    - drivers
    - adc
    - ci_tests_zephyr_drivers_adc
  harness: ztest
  harness_config:
    fixture: gpio_loopback
  platform_allow:
    - nrf54h20dk/nrf54h20/cpuapp
    - nrf54l15dk/nrf54l15/cpuapp
    - nrf5340dk/nrf5340/cpuapp
    - nrf52840dk/nrf52840
  integration_platforms:
    - nrf54h20dk/nrf54h20/cpuapp

tests:
  drivers.adc.adc_latency: {}
```

## tests/drivers/adc/adc_scan/testcase.yaml
```yaml
common:
  tags:
    - drivers
    - adc
    - ci_tests_zephyr_drivers_adc
  harness: ztest
  platform_allow:
    - nrf54l15dk/nrf54l15/cpuapp
    - nrf54lm20dk/nrf54lm20a/cpuapp
  integration_platforms:
    - nrf54l15dk/nrf54l15/cpuapp

tests:
  drivers.adc.adc_scan_with_timer: {}
```

## tests/drivers/audio/dmic_dump_buffer/Kconfig
```kconfig
#
# Copyright (c) 2025 Nordic Semiconductor ASA
#
# SPDX-License-Identifier: LicenseRef-Nordic-5-Clause
#

source "Kconfig.zephyr"

config TEST_USE_DMM
	bool "Use of DMM pre-allocation"
	help
	  The test will use it to determine whether to prealocate DMM
	  buffer or use regular mem slab and allocate dmm buffer inside
	  PDM driver.

config TEST_STEREO_CONFIGURATION
	bool "Select mono / stereo operation"
	help
	  When set to 'y' PDM driver will be configured in stereo mode.
	  In such case, import RAW audio data using following configuration:
	  Signed 16-bit PCM; little-endian; stereo; 16000Hz.
```

## tests/drivers/audio/dmic_dump_buffer/testcase.yaml
```yaml
common:
  build_only: true
  tags:
    - drivers
    - dmic
    - ci_tests_drivers_audio
  harness: console
  harness_config:
    fixture: physical_microphone

tests:
  drivers.audio.dmic_dump_buffer:
    filter: dt_nodelabel_enabled("dmic_dev")
    platform_allow:
      - nrf52840dk/nrf52840
      - nrf5340dk/nrf5340/cpuapp
      - nrf54h20dk/nrf54h20/cpuapp
      - nrf54l15dk/nrf54l15/cpuapp
    integration_platforms:
      - nrf54h20dk/nrf54h20/cpuapp
  drivers.audio.dmic_dump_buffer.stereo:
    filter: dt_nodelabel_enabled("dmic_dev")
    extra_args:
      - CONFIG_TEST_STEREO_CONFIGURATION=y
    platform_allow:
      - nrf52840dk/nrf52840
      - nrf5340dk/nrf5340/cpuapp
      - nrf54h20dk/nrf54h20/cpuapp
      - nrf54l15dk/nrf54l15/cpuapp
    integration_platforms:
      - nrf54h20dk/nrf54h20/cpuapp
  drivers.audio.dmic_dump_buffer.dmm:
    filter: dt_nodelabel_enabled("dmic_dev")
    platform_allow:
      - nrf54h20dk/nrf54h20/cpuapp
    extra_args:
      - CONFIG_TEST_USE_DMM=y
  drivers.audio.dmic_dump_buffer.dmm.stereo:
    filter: dt_nodelabel_enabled("dmic_dev")
    platform_allow:
      - nrf54h20dk/nrf54h20/cpuapp
    extra_args:
      - CONFIG_TEST_USE_DMM=y
      - CONFIG_TEST_STEREO_CONFIGURATION=y
```

## tests/drivers/audio/pdm_instances/testcase.yaml
```yaml
common:
  tags:
    - drivers
    - ci_tests_drivers_audio
  harness: ztest
  harness_config:
    fixture: gpio_loopback

tests:
  drivers.audio.pdm_instances:
    platform_allow:
      - nrf54h20dk/nrf54h20/cpuapp
      - nrf54l15dk/nrf54l15/cpuapp
      - nrf54lm20dk/nrf54lm20a/cpuapp
      - nrf7120pdk/nrf7120/cpuapp
    integration_platforms:
      - nrf54h20dk/nrf54h20/cpuapp
```
