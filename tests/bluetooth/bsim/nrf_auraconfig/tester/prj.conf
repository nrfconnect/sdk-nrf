## CMakeLists.txt
```
#
# Copyright (c) 2024 Nordic Semiconductor
#
# SPDX-License-Identifier: LicenseRef-Nordic-5-Clause
#
cmake_minimum_required(VERSION 3.20.0)

find_package(Zephyr REQUIRED HINTS $ENV{ZEPHYR_BASE})
project(nrf_auraconfig_test)

add_subdirectory(${ZEPHYR_BASE}/tests/bsim/babblekit babblekit)
target_link_libraries(app PRIVATE babblekit)

target_sources(app PRIVATE
  src/nrf_auraconfig_test.c
  src/main.c
)

zephyr_library_include_directories(app PRIVATE
    ${ZEPHYR_NRF_MODULE_DIR}/tests/bluetooth/bsim/nrf_auraconfig/tester/include)

zephyr_include_directories(
  ${BSIM_COMPONENTS_PATH}/libUtilv1/src/
  ${BSIM_COMPONENTS_PATH}/libPhyComv1/src/
  )
```

## Kconfig
```
#
# Copyright (c) 2024 Nordic Semiconductor
#
# SPDX-License-Identifier: LicenseRef-Nordic-5-Clause
#

menu "Logging"

module = NRF_AUDIO_MAIN
module-str = main
source "subsys/logging/Kconfig.template.log_config"

module = NAC_TESTER
module-str = nac_tester
source "subsys/logging/Kconfig.template.log_config"

endmenu # Log levels

source "Kconfig.zephyr"
```

## Kconfig.sysbuild
```
#
# Copyright (c) 2024 Nordic Semiconductor
#
# SPDX-License-Identifier: LicenseRef-Nordic-5-Clause
#

source "${ZEPHYR_BASE}/share/sysbuild/Kconfig"

config NET_CORE_BOARD
	string
	default "nrf5340bsim/nrf5340/cpunet" if $(BOARD_TARGET_STRING) = "NRF5340BSIM_NRF5340_CPUAPP"


config NATIVE_SIMULATOR_PRIMARY_MCU_INDEX
	int
	# Pipe test arguments to go to the application core.
	default 0 if $(BOARD_TARGET_STRING) = "NRF5340BSIM_NRF5340_CPUAPP"
```

## prj.conf
```kconfig
CONFIG_BT=y
CONFIG_LOG=y
CONFIG_LOG_MODE_IMMEDIATE=y

CONFIG_ENTROPY_GENERATOR=y
CONFIG_BT_GATT_DYNAMIC_DB=y

CONFIG_UTF8=y
CONFIG_BT_AUDIO=y
CONFIG_BT_PBP=y
CONFIG_BT_SMP=y
CONFIG_BT_PAC_SNK=y
CONFIG_BT_OBSERVER=y
CONFIG_BT_PERIPHERAL=y
CONFIG_BT_ISO_PERIPHERAL=y
CONFIG_BT_BAP_BROADCAST_SINK=y
CONFIG_BT_BAP_SCAN_DELEGATOR=y
CONFIG_BT_ISO_SYNC_RECEIVER=y
CONFIG_BT_ISO_MAX_CHAN=4

# Allocate 2 RX buffers per channel
CONFIG_BT_ISO_RX_BUF_COUNT=8
CONFIG_BT_BAP_BROADCAST_SNK_SUBGROUP_COUNT=3
CONFIG_BT_BAP_BROADCAST_SNK_STREAM_COUNT=4
CONFIG_BT_BAP_BASS_MAX_SUBGROUPS=3
CONFIG_BT_AUDIO_CODEC_CFG_MAX_METADATA_SIZE=80
CONFIG_BT_BUF_ACL_RX_SIZE=255
CONFIG_BT_BUF_ACL_TX_SIZE=251

CONFIG_BT_DEVICE_NAME="Broadcast Audio Sink"

# Shell related defines
CONFIG_SHELL=y
CONFIG_SHELL_BACKEND_DUMMY=y
CONFIG_SHELL_VT100_COMMANDS=y
CONFIG_SHELL_VT100_COLORS=y
CONFIG_SHELL_STACK_SIZE=4096
CONFIG_SHELL_CMD_BUFF_SIZE=128
## Reduce shell memory usage
CONFIG_SHELL_WILDCARD=n
CONFIG_SHELL_HELP_ON_WRONG_ARGUMENT_COUNT=n
CONFIG_SHELL_STATS=n
CONFIG_SHELL_CMDS=n
CONFIG_SHELL_HISTORY=y

# Turn off default shell commands
CONFIG_I2C_SHELL=n
CONFIG_HWINFO_SHELL=n
CONFIG_CLOCK_CONTROL_NRF_SHELL=n
CONFIG_FLASH_SHELL=n
CONFIG_DEVICE_SHELL=n
```

## src/main.c
```c
/*
 * Copyright (c) 2024 Nordic Semiconductor ASA
 *
 * SPDX-License-Identifier: LicenseRef-Nordic-5-Clause
 */

#include "nac_test.h"

#include <babblekit/testcase.h>
#include <zephyr/shell/shell_backend.h>
#include <bstests.h>
#include <bs_tracing.h>
#include <bs_types.h>

#include <zephyr/logging/log.h>
LOG_MODULE_REGISTER(nac_tester, CONFIG_NAC_TESTER_LOG_LEVEL);

extern enum bst_result_t bst_result;

#define MAX_ARGS	200
#define MAX_ARG_LEN	50
#define ARG_COMMAND	"nac_test"
#define MAX_COMMAND_LEN 60

static int argc_copy;
static char argv_copy[MAX_ARGS][MAX_ARG_LEN];

/* This code is executed by the test framework and not Zephyr */
static void test_args(int argc, char *argv[])
{
	argc_copy = argc;

	for (int i = 0; i < argc; i++) {
		if (i > MAX_ARGS) {
			TEST_FAIL("ENOMEM, MAX_ARG");
		}
		if (strlen(argv[i]) > MAX_ARG_LEN) {
			TEST_FAIL("ENOMEM, MAX_ARG_LEN");
		}
		memcpy(argv_copy[i], argv[i], strlen(argv[i]) + 1);
	}
}

static int modules_configure(void)
{
	int ret;
	char cmd_str[MAX_COMMAND_LEN] = {'\0'};

	if (argc_copy == 0) {
		LOG_ERR("No arguments provided");
		return -EINVAL;
	}

	if (strcmp(argv_copy[0], ARG_COMMAND) != 0) {
		LOG_ERR("First argument must be '%s'", ARG_COMMAND);
		return -EINVAL;
	}

	strcat(cmd_str, argv_copy[0]);
	strcat(cmd_str, " ");

	/* Parse argv_copy, divide by keyword ARG_COMMAND and send commands to shell */
	for (int i = 1; i < argc_copy; i++) {
		if (strcmp(argv_copy[i], ARG_COMMAND) == 0) {
			/* Send command and reset argc */
			ret = shell_execute_cmd(NULL, cmd_str);
			if (ret) {
				LOG_ERR("Failed to send command %s, err: %d", cmd_str, ret);
				return ret;
			}
			memset(cmd_str, '\0', sizeof(cmd_str));

			strcat(cmd_str, argv_copy[i]);
			strcat(cmd_str, " ");
		} else {
			if (strlen(cmd_str) + strlen(argv_copy[i]) > MAX_COMMAND_LEN) {
				LOG_ERR("Command too long");
				return -EINVAL;
			}

			strcat(cmd_str, argv_copy[i]);
			strcat(cmd_str, " ");
		}
	}

	/* Send last command */
	ret = shell_execute_cmd(NULL, cmd_str);
	if (ret) {
		LOG_ERR("Failed to send command %s", cmd_str);
		return ret;
	}

	return 0;
}

void test_main(void)
{
	int err;

	int backends = shell_backend_count_get();

	if (backends != 1) {
		TEST_FAIL("Only one shell backend accepted. Found: %d", backends);
	}

	err = nac_test_main();
	if (err) {
		TEST_FAIL("nac_test_main failed (err %d)", err);
	}

	err = modules_configure();
	if (err) {
		TEST_FAIL("Configure failed (err %d)", err);
	}

	nac_test_loop();
}

static const struct bst_test_instance test_vector[] = {
	{
		.test_args_f = test_args,
		.test_id = "nac_test",
		.test_main_f = test_main,
	},
	BSTEST_END_MARKER,
};

struct bst_test_list *test_nrf_auraconfig_install(struct bst_test_list *tests)
{
	return bst_add_tests(tests, test_vector);
}

bst_test_install_t test_installers[] = {test_nrf_auraconfig_install, NULL};

int main(void)
{
	bst_main();
	return 0;
}
```

## include/nac_test.h
```c
/*
 * Copyright (c) 2024 Nordic Semiconductor ASA
 *
 * SPDX-License-Identifier: LicenseRef-Nordic-5-Clause
 */

#ifndef _NAC_TEST_
#define _NAC_TEST_

/**
 * @defgroup auraconfig_tester nRF Auraconfig tester
 * @brief nRF Auraconfig tester
 *
 * @{
 */

#include <zephyr/bluetooth/audio/cap.h>

#define ADV_NAME_MAX (28)

struct nac_test_values_subgroup {
	uint32_t sampling_rate_hz;
	uint32_t frame_duration_us;
	uint8_t octets_per_frame;
	char language[4]; /* Allow space for '\0' */
	bool immediate_rend_flag;
	enum bt_audio_context context;
	char program_info[255];
	uint8_t num_bis;
	enum bt_audio_location locations[CONFIG_BT_BAP_BROADCAST_SNK_STREAM_COUNT];
};

struct nac_test_values_big {
	char adv_name[ADV_NAME_MAX + 1];
	char broadcast_name[ADV_NAME_MAX + 1];
	uint32_t broadcast_id;
	uint8_t phy;
	uint32_t pd_us;
	bool encryption;
	uint8_t broadcast_code[BT_ISO_BROADCAST_CODE_SIZE + 1];
	uint8_t num_subgroups;
	bool high_quality;
	bool std_quality;
	struct nac_test_values_subgroup *subgroups;
};

void nac_test_loop(void);

int nac_test_main(void);

/** @} */

#endif /* _NAC_TEST_ */
```
