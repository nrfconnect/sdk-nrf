## CMakeLists.txt
```
#
# Copyright (c) 2023 Nordic Semiconductor ASA
#
# SPDX-License-Identifier: LicenseRef-Nordic-5-Clause
#

cmake_minimum_required(VERSION 3.20.0)

find_package(Zephyr REQUIRED HINTS $ENV{ZEPHYR_BASE})
project(broadcaster_and_central)

target_sources(app PRIVATE
    src/main.c
    modules/iso_broadcast_src.c
    modules/iso_broadcast_sink.c
    modules/central.c
    modules/peripheral.c)
zephyr_include_directories(modules)
```

## Kconfig
```
config PRINT_ISO_INTERVAL
	int "Print pr X ISO interval"
	default 200
	help
	  For each set interval, a summary will be printed and a LED toggled.

config PRINT_CONN_INTERVAL
	int "Print pr X conn interval"
	default 20


config BIS_ISO_CHAN_COUNT_MAX
	int "Max number of ISO channels"
	default 2
	help
	  It is not necessary to use all channels. Increasing will use more ROM.

config ISO_TEST_LOG_LEVEL
	int "Default log level for ISO test module"
	default 3

config ACL_TEST_LOG_LEVEL
	int "Default log level for ACL test module"
	default 3

source "Kconfig.zephyr"
```

## Kconfig.sysbuild
```
#
# Copyright (c) 2024 Nordic Semiconductor
#
# SPDX-License-Identifier: LicenseRef-Nordic-5-Clause
#

config PARTITION_MANAGER
	default n

config NRF_DEFAULT_IPC_RADIO
	default y

source "share/sysbuild/Kconfig"
```

## prj.conf
```kconfig
CONFIG_BT=y
CONFIG_BT_ISO_BROADCASTER=y
CONFIG_BT_DEVICE_NAME="ISO broadcast and ACL"
CONFIG_BT_CENTRAL=y
CONFIG_BT_PERIPHERAL=y
CONFIG_BT_OBSERVER=y
CONFIG_BT_ISO_SYNC_RECEIVER=y
CONFIG_BT_SMP=y

CONFIG_BT_ISO_MAX_CHAN=2
CONFIG_BT_ISO_TX_BUF_COUNT=2
CONFIG_BT_ISO_TX_MTU=251

CONFIG_BT_EXT_ADV=y
CONFIG_BT_PER_ADV_SYNC=y

CONFIG_BT_GAP_AUTO_UPDATE_CONN_PARAMS=n
CONFIG_BT_AUTO_PHY_PERIPHERAL_NONE=y
CONFIG_BT_GATT_AUTO_UPDATE_MTU=y
CONFIG_BT_MAX_CONN=2

CONFIG_BT_NUS=y
CONFIG_BT_NUS_CLIENT=y
CONFIG_BT_GATT_DM=y
CONFIG_BT_GATT_CLIENT=y
CONFIG_BT_BUF_EVT_RX_COUNT=11
CONFIG_BT_BUF_ACL_TX_COUNT=10
CONFIG_BT_ATT_PREPARE_COUNT=2
CONFIG_BT_L2CAP_TX_BUF_COUNT=10
CONFIG_BT_L2CAP_TX_MTU=498
CONFIG_BT_BUF_ACL_TX_SIZE=502
CONFIG_BT_BUF_ACL_RX_SIZE=502
CONFIG_BT_L2CAP_DYNAMIC_CHANNEL=y

CONFIG_MAIN_STACK_SIZE=4096

CONFIG_LOG=y
CONFIG_LOG_BUFFER_SIZE=4096
CONFIG_LOG_BACKEND_UART=y
CONFIG_SHELL_LOG_BACKEND=y

CONFIG_SHELL=y
CONFIG_KERNEL_SHELL=y
CONFIG_USE_SEGGER_RTT=y

CONFIG_SHELL_RTT_INIT_LOG_LEVEL_INF=y
CONFIG_SHELL_BACKEND_RTT=y
CONFIG_SHELL_BACKEND_SERIAL=n
CONFIG_SHELL_VT100_COMMANDS=y
CONFIG_SHELL_VT100_COLORS=y
CONFIG_SHELL_STACK_SIZE=2048
CONFIG_SHELL_CMD_BUFF_SIZE=128
CONFIG_SHELL_TAB=y
CONFIG_SHELL_TAB_AUTOCOMPLETION=y

# Getopt
CONFIG_MINIMAL_LIBC=n
CONFIG_NEWLIB_LIBC=y
# Need to disable devmem shell since it enforces Zephyr's internal version of getopt
CONFIG_DEVMEM_SHELL=n
CONFIG_POSIX_C_LIB_EXT=y
CONFIG_GETOPT_LONG=y
CONFIG_SHELL_GETOPT=y

# This example requires more workqueue stack
CONFIG_SYSTEM_WORKQUEUE_STACK_SIZE=2048
CONFIG_NRFX_CLOCK=y
CONFIG_BT_USE_DEBUG_KEYS=y
```

## src/main.c
```c
/*
 * Copyright (c) 2023 Nordic Semiconductor ASA
 *
 * SPDX-License-Identifier: LicenseRef-Nordic-5-Clause
 */
#include <zephyr/bluetooth/bluetooth.h>
#include "iso_broadcast_src.h"
#include "iso_broadcast_sink.h"
#include <zephyr/drivers/clock_control/nrf_clock_control.h>

#include <zephyr/logging/log.h>
LOG_MODULE_REGISTER(main, CONFIG_ISO_TEST_LOG_LEVEL);

static const uint32_t hfclk_requested_frequency = MHZ(128);

static int hfclock_config_and_start(void)
{
	/* Use this to turn on 128 MHz clock for cpu_app */
	clock_control_set_rate(DEVICE_DT_GET_ONE(nordic_nrf_clock_hfclk), NULL,
			       &hfclk_requested_frequency);

	nrf_clock_hfclk_t clk_src;

	nrfx_clock_hfclk_start();
	while (!nrfx_clock_hfclk_running_check(&clk_src)) {
	}

	return 0;
}


int main(void)
{
	int err;

	LOG_INF("Starting ISO tester");

	hfclock_config_and_start();

	err = bt_enable(NULL);
	if (err) {
		LOG_ERR("Bluetooth init failed (err %d)", err);
	}

	err = iso_broadcast_src_init();
	if (err) {
		LOG_ERR("iso_broadcast_src_init failed (err %d)", err);
	}

	err = iso_broadcast_sink_init();
	if (err) {
		LOG_ERR("iso_broadcaster_sink_init failed (err %d)", err);
	}

	return 0;
}
```
