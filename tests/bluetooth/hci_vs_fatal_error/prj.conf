## CMakeLists.txt
```
#
# Copyright (c) 2026 Nordic Semiconductor ASA
#
# SPDX-License-Identifier: LicenseRef-Nordic-5-Clause
#

cmake_minimum_required(VERSION 3.20.0)

find_package(Zephyr REQUIRED HINTS $ENV{ZEPHYR_BASE})
project(hci_vs_fatal_error)

target_include_directories(app PRIVATE
  ${ZEPHYR_NRF_MODULE_DIR}/applications/ipc_radio/src
)

target_sources(app PRIVATE src/main.c)
```

## sysbuild.conf
```
#
# Copyright (c) 2026 Nordic Semiconductor ASA
#
# SPDX-License-Identifier: LicenseRef-Nordic-5-Clause
#

SB_CONFIG_NETCORE_IPC_RADIO=y
SB_CONFIG_NETCORE_IPC_RADIO_BT_HCI_IPC=y
```

## prj.conf
```kconfig
#
# Copyright (c) 2026 Nordic Semiconductor ASA
#
# SPDX-License-Identifier: LicenseRef-Nordic-5-Clause
#

CONFIG_ZTEST=y

CONFIG_LOG=y
CONFIG_LOG_MODE_IMMEDIATE=y

CONFIG_BT=y
CONFIG_BT_HCI_RAW=y
CONFIG_BT_BUF_EVT_RX_COUNT=16

CONFIG_MAIN_STACK_SIZE=2048
CONFIG_ZTEST_STACK_SIZE=2048
```

## sysbuild_hci_ipc.conf
```kconfig
#
# Copyright (c) 2026 Nordic Semiconductor ASA
#
# SPDX-License-Identifier: LicenseRef-Nordic-5-Clause
#

# Build the hci_ipc sample as the network core image instead of the ipc_radio application. The
# controller it runs is selected by the bt-ll-sw-split snippet applied in sysbuild.cmake.
SB_CONFIG_NETCORE_HCI_IPC=y
```

## boards/nrf5340dk_nrf5340_cpuapp.overlay
```dts
/*
 * Copyright (c) 2026 Nordic Semiconductor ASA
 *
 * SPDX-License-Identifier: LicenseRef-Nordic-5-Clause
 */

#include "../dts/nrf5340_ipc_fatal.overlay"
```

## dts/nrf5340_ipc_fatal.dtsi
```dts
/*
 * Copyright (c) 2026 Nordic Semiconductor ASA
 *
 * SPDX-License-Identifier: LicenseRef-Nordic-5-Clause
 */

/* Memory for the fatal error report channel, carved off the end of the region the two cores
 * already share so that the HCI transport keeps the layout it had. Both cores include this file,
 * which is what keeps them agreeing on the addresses.
 *
 * The channel only ever holds one report, so a single region and a single direction is enough.
 */

&sram0_shared {
	reg = <0x70000 0xfc00>;
};

&sram0 {
	sram_ipc_fatal: sram@7fc00 {
		reg = <0x7fc00 0x400>;
	};
};
```

## dts/nrf5340_ipc_fatal.overlay
```dts
/*
 * Copyright (c) 2026 Nordic Semiconductor ASA
 *
 * SPDX-License-Identifier: LicenseRef-Nordic-5-Clause
 */

/* The fatal error report channel, as seen by both cores. The controller writes a report and
 * signals the mailbox; the host reads it. There is no reverse direction and no handshake, so the
 * two cores need nothing more than the same region and the same mailbox channel, and both get
 * that by including this file.
 *
 * Channel 2 is free: the IPC instance carrying HCI uses channels 0 and 1.
 */

#include "nrf5340_ipc_fatal.dtsi"

/ {
	bt_hci_fatal_report: bt_hci_fatal_report {
		compatible = "zephyr,bt-hci-fatal-report";
		memory-region = <&sram_ipc_fatal>;
		mboxes = <&mbox 2>;
		mbox-names = "report";
		status = "okay";
	};
};
```

## src/main.c
```c
/*
 * Copyright (c) 2026 Nordic Semiconductor ASA
 *
 * SPDX-License-Identifier: LicenseRef-Nordic-5-Clause
 */

/* Test of the Vendor Specific fatal error reporting of the ipc_radio application.
 *
 * The test runs on the application core and drives the network core, running the ipc_radio
 * application with the fault injection hook enabled, over the HCI IPC transport. For every
 * combination of an execution context (thread, interrupt, zero-latency interrupt) and a fault
 * type (kernel panic, controller assert), the test:
 *
 *  - injects the fault with a Vendor Specific HCI command,
 *  - waits for the Vendor Specific fatal error HCI event and validates its content,
 *  - waits for the network core to reset and to accept HCI commands again.
 */

#include <string.h>

#include <zephyr/fatal.h>
#include <zephyr/kernel.h>
#include <zephyr/net_buf.h>
#include <zephyr/sys/byteorder.h>
#include <zephyr/ztest.h>

#include <zephyr/bluetooth/bluetooth.h>
#include <zephyr/bluetooth/buf.h>
#include <zephyr/bluetooth/hci.h>
#include <zephyr/bluetooth/hci_raw.h>
#include <zephyr/bluetooth/hci_vs.h>

#include <zephyr/logging/log.h>

#include "fatal_error_test_hook.h"

LOG_MODULE_REGISTER(hci_vs_fatal_error, LOG_LEVEL_INF);

/* Time in milliseconds given to the network core to report the fatal error. */
#define FATAL_ERROR_TIMEOUT_MS 5000
/* Time in milliseconds given to the network core to reset and bind the IPC endpoint again. */
#define CTLR_ALIVE_TIMEOUT_MS  10000
/* Interval in milliseconds between two HCI Reset commands used to probe the network core. */
#define CTLR_PROBE_INTERVAL_MS 250

static K_FIFO_DEFINE(rx_queue);

static void cmd_send(uint16_t opcode, const void *param, uint8_t param_len)
{
	struct bt_hci_cmd_hdr hdr;
	struct net_buf *buf;
	int err;

	hdr.opcode = sys_cpu_to_le16(opcode);
	hdr.param_len = param_len;

	buf = bt_buf_get_tx(BT_BUF_CMD, K_SECONDS(1), &hdr, sizeof(hdr));
	zassert_not_null(buf, "Failed to allocate a command buffer.");

	if (param_len > 0U) {
		net_buf_add_mem(buf, param, param_len);
	}

	err = bt_send(buf);
	zassert_ok(err, "Failed to send the HCI command %#06x: %d.", opcode, err);
}

/* Get the next event of the given type, or NULL when the timeout expires. */
static struct net_buf *evt_get(uint8_t evt_code, int64_t timeout_ms)
{
	const int64_t end = k_uptime_get() + timeout_ms;

	while (true) {
		struct bt_hci_evt_hdr *hdr;
		struct net_buf *buf;
		int64_t remaining;

		remaining = end - k_uptime_get();
		if (remaining <= 0) {
			return NULL;
		}

		buf = k_fifo_get(&rx_queue, K_MSEC(remaining));
		if (buf == NULL) {
			return NULL;
		}

		/* The buffer is H:4 encoded, so the packet type indicator comes first. */
		if (buf->len < sizeof(uint8_t) || net_buf_pull_u8(buf) != BT_HCI_H4_EVT) {
			net_buf_unref(buf);
			continue;
		}

		if (buf->len < sizeof(*hdr)) {
			net_buf_unref(buf);
			continue;
		}

		hdr = (void *)buf->data;
		if (hdr->evt == evt_code) {
			net_buf_pull(buf, sizeof(*hdr));
			return buf;
		}

		net_buf_unref(buf);
	}
}

/* Wait for the Command Complete event with the NOP opcode that the network core sends once it
 * has booted and bound the IPC endpoint. Anything that arrives before it is discarded.
 */
static bool ctlr_booted_wait(int64_t timeout_ms)
{
	const int64_t end = k_uptime_get() + timeout_ms;

	while (true) {
		struct bt_hci_evt_cmd_complete *cc;
		struct net_buf *buf;
		int64_t remaining;

		remaining = end - k_uptime_get();
		if (remaining <= 0) {
			return false;
		}

		buf = evt_get(BT_HCI_EVT_CMD_COMPLETE, remaining);
		if (buf == NULL) {
			return false;
		}

		cc = (void *)buf->data;
		if (buf->len >= sizeof(*cc) && sys_le16_to_cpu(cc->opcode) == BT_OP_NOP) {
			net_buf_unref(buf);
			return true;
		}

		net_buf_unref(buf);
	}
}

/* Probe the network core with HCI Reset commands until it answers. */
static bool ctlr_alive_wait(int64_t timeout_ms)
{
	const int64_t end = k_uptime_get() + timeout_ms;

	while (k_uptime_get() < end) {
		struct bt_hci_evt_cmd_complete *cc;
		struct net_buf *buf;

		cmd_send(BT_HCI_OP_RESET, NULL, 0U);

		buf = evt_get(BT_HCI_EVT_CMD_COMPLETE, CTLR_PROBE_INTERVAL_MS);
		if (buf == NULL) {
			continue;
		}

		cc = (void *)buf->data;
		if (buf->len >= sizeof(*cc) && sys_le16_to_cpu(cc->opcode) == BT_HCI_OP_RESET) {
			net_buf_unref(buf);
			return true;
		}

		net_buf_unref(buf);
	}

	return false;
}

static void fault_inject(uint8_t context, uint8_t fault)
{
	const struct bt_hci_vs_fatal_error_test_inject cmd = {
		.context = context,
		.fault = fault,
	};

	cmd_send(BT_HCI_OP_VS_FATAL_ERROR_TEST_INJECT, &cmd, sizeof(cmd));
}

static void stack_frame_validate(struct net_buf *buf)
{
	const struct bt_hci_vs_fatal_error_stack_frame *sf;
	const struct bt_hci_vs_fatal_error_cpu_data_cortex_m *cpu_data;

	zassert_true(buf->len >= (sizeof(*sf) + sizeof(*cpu_data)),
		     "Stack frame event is too short: %u.", buf->len);

	sf = (const void *)buf->data;
	zassert_equal(sf->cpu_type, BT_HCI_EVT_VS_ERROR_CPU_TYPE_CORTEX_M,
		      "Unexpected CPU type: %u.", sf->cpu_type);
	zassert_equal(sys_le32_to_cpu(sf->reason), K_ERR_KERNEL_PANIC,
		      "Unexpected fatal error reason: %u.", sys_le32_to_cpu(sf->reason));

	cpu_data = (const void *)sf->cpu_data;
	zassert_not_equal(sys_le32_to_cpu(cpu_data->pc), 0U, "Program counter is not reported.");
	zassert_not_equal(sys_le32_to_cpu(cpu_data->lr), 0U, "Link register is not reported.");
}

static void ctrl_assert_validate(struct net_buf *buf)
{
	const char *file = (const char *)buf->data;
	size_t file_len;
	uint32_t line;

	zassert_true(buf->len > sizeof(line), "Controller assert event is too short: %u.",
		     buf->len);

	file_len = strnlen(file, buf->len);
	zassert_true(file_len > 0U, "File name is not reported.");
	zassert_true(file_len < buf->len, "File name is not null terminated.");

	line = sys_get_le32(&buf->data[file_len + 1U]);
	zassert_not_equal(line, 0U, "Line number is not reported.");

	LOG_INF("Controller assert reported in %s at %u.", file, line);
}

static void fatal_error_test(uint8_t context, uint8_t fault)
{
	uint8_t data_type = (fault == BT_HCI_VS_FATAL_ERROR_TEST_FAULT_ASSERT)
				    ? BT_HCI_EVT_VS_ERROR_DATA_TYPE_CTRL_ASSERT
				    : BT_HCI_EVT_VS_ERROR_DATA_TYPE_STACK_FRAME;
	struct bt_hci_evt_vs *vs;
	struct net_buf *buf;

	fault_inject(context, fault);

	buf = evt_get(BT_HCI_EVT_VENDOR, FATAL_ERROR_TIMEOUT_MS);
	zassert_not_null(buf, "Fatal error event was not reported.");

	vs = (void *)buf->data;
	zassert_equal(vs->subevent, data_type, "Unexpected fatal error data type: %u.",
		      vs->subevent);
	net_buf_pull(buf, sizeof(*vs));

	if (data_type == BT_HCI_EVT_VS_ERROR_DATA_TYPE_STACK_FRAME) {
		stack_frame_validate(buf);
	} else {
		ctrl_assert_validate(buf);
	}

	net_buf_unref(buf);

	/* The network core resets itself after the report. That it comes back, which also
	 * validates the fatal_error_reset() path, is checked by the set-up of the next test
	 * case, which waits for the ready announcement of the network core. Consuming that
	 * announcement here would leave the set-up waiting for one that never comes.
	 */
}

ZTEST(hci_vs_fatal_error, test_thread_panic)
{
	fatal_error_test(BT_HCI_VS_FATAL_ERROR_TEST_CONTEXT_THREAD,
			 BT_HCI_VS_FATAL_ERROR_TEST_FAULT_PANIC);
}

ZTEST(hci_vs_fatal_error, test_thread_assert)
{
	fatal_error_test(BT_HCI_VS_FATAL_ERROR_TEST_CONTEXT_THREAD,
			 BT_HCI_VS_FATAL_ERROR_TEST_FAULT_ASSERT);
}

ZTEST(hci_vs_fatal_error, test_isr_panic)
{
	fatal_error_test(BT_HCI_VS_FATAL_ERROR_TEST_CONTEXT_ISR,
			 BT_HCI_VS_FATAL_ERROR_TEST_FAULT_PANIC);
}

ZTEST(hci_vs_fatal_error, test_isr_assert)
{
	fatal_error_test(BT_HCI_VS_FATAL_ERROR_TEST_CONTEXT_ISR,
			 BT_HCI_VS_FATAL_ERROR_TEST_FAULT_ASSERT);
}

ZTEST(hci_vs_fatal_error, test_zli_panic)
{
	fatal_error_test(BT_HCI_VS_FATAL_ERROR_TEST_CONTEXT_ZLI,
			 BT_HCI_VS_FATAL_ERROR_TEST_FAULT_PANIC);
}

ZTEST(hci_vs_fatal_error, test_zli_assert)
{
	fatal_error_test(BT_HCI_VS_FATAL_ERROR_TEST_CONTEXT_ZLI,
			 BT_HCI_VS_FATAL_ERROR_TEST_FAULT_ASSERT);
}

static void test_before(void *fixture)
{
	int err;

	ARG_UNUSED(fixture);

	/* Bring the transport up per test case, so that the endpoint is registered again on this
	 * side in step with the network core that has just booted or reset. The call returns
	 * once the endpoint is bound, so the network core is up by the time it succeeds.
	 */
	err = bt_enable_raw(&rx_queue);
	zassert_ok(err, "Failed to enable the raw HCI transport: %d.", err);

	/* Binding the endpoint only means that the IPC transport is up. The network core
	 * announces that its controller is ready with a Command Complete for the NOP opcode,
	 * so wait for that before sending anything to it.
	 */
	zassert_true(ctlr_booted_wait(CTLR_ALIVE_TIMEOUT_MS),
		     "The network core did not announce that it is ready.");

	zassert_true(ctlr_alive_wait(CTLR_ALIVE_TIMEOUT_MS),
		     "The network core does not accept HCI commands.");
}

static void test_after(void *fixture)
{
	int err;

	ARG_UNUSED(fixture);

	err = bt_disable_raw();
	zassert_ok(err, "Failed to disable the raw HCI transport: %d.", err);

	/* The transport is down, so nothing can be queued any more. Return the events that the
	 * test case left behind to the pool.
	 */
	while (true) {
		struct net_buf *buf = k_fifo_get(&rx_queue, K_NO_WAIT);

		if (buf == NULL) {
			break;
		}

		net_buf_unref(buf);
	}
}

ZTEST_SUITE(hci_vs_fatal_error, NULL, NULL, test_before, test_after, NULL);
```

## src/fatal_error_test_hook.c
```c
/*
 * Copyright (c) 2026 Nordic Semiconductor ASA
 *
 * SPDX-License-Identifier: LicenseRef-Nordic-5-Clause
 */

/* Test-only fault injection hook.
 *
 * The hook implements a Vendor Specific HCI command that raises a fatal error in the requested
 * execution context. It is used by the tests validating that the Vendor Specific fatal error
 * event reaches the host from a thread, an interrupt and a zero-latency interrupt context.
 *
 * It is compiled into whichever network core image the test builds, either the ipc_radio
 * application or the hci_ipc sample, and only when that image enables its own fault injection
 * hook Kconfig option. That must never be the case in a production image.
 */

#include <zephyr/kernel.h>
#include <zephyr/irq.h>
#include <zephyr/irq_offload.h>
#include <zephyr/net_buf.h>
#include <zephyr/sys/byteorder.h>
#include <zephyr/sys/util.h>

#include <zephyr/bluetooth/hci.h>

#include <zephyr/logging/log.h>

#include <cmsis_core.h>

#include "fatal_error_test_hook.h"

LOG_MODULE_REGISTER(fatal_error_test_hook, CONFIG_LOG_DEFAULT_LEVEL);

/* Length of the H:4 packet type indicator that prefixes the payload of an HCI buffer. */
#define H4_TYPE_LEN 1U

/* Each network core image names the fault injection hook options after itself, so resolve the
 * zero-latency interrupt line once here and let the rest of the file work with it.
 */
#if defined(CONFIG_IPC_RADIO_FATAL_ERROR_TEST_HOOK_ZLI)
#define HOOK_ZLI_IRQN CONFIG_IPC_RADIO_FATAL_ERROR_TEST_HOOK_ZLI_IRQN
#elif defined(CONFIG_HCI_IPC_FATAL_ERROR_TEST_HOOK_ZLI)
#define HOOK_ZLI_IRQN CONFIG_HCI_IPC_FATAL_ERROR_TEST_HOOK_ZLI_IRQN
#endif

static void fault_raise(uint8_t fault);

static uint8_t pending_fault;

#if defined(HOOK_ZLI_IRQN)
/* A zero-latency interrupt bypasses the kernel, so it has to be registered as a direct ISR. */
ISR_DIRECT_DECLARE(zli_isr)
{
	fault_raise(pending_fault);

	return 0;
}

static void zli_trigger(void)
{
	IRQ_DIRECT_CONNECT(HOOK_ZLI_IRQN, 0, zli_isr, IRQ_ZERO_LATENCY);
	irq_enable(HOOK_ZLI_IRQN);

	NVIC_SetPendingIRQ(HOOK_ZLI_IRQN);

	/* The zero-latency interrupt is not masked by irq_lock() and preempts this context
	 * immediately, hence this point is never reached.
	 */
	for (;;) {
	}
}
#endif /* HOOK_ZLI_IRQN */

static void isr_offload(const void *arg)
{
	ARG_UNUSED(arg);

	fault_raise(pending_fault);
}

static void fault_raise(uint8_t fault)
{
	switch (fault) {
	case BT_HCI_VS_FATAL_ERROR_TEST_FAULT_ASSERT:
		extern void bt_ctlr_assert_handle(char *file, uint32_t line);

		bt_ctlr_assert_handle(__FILE__, __LINE__);
		break;

	case BT_HCI_VS_FATAL_ERROR_TEST_FAULT_PANIC:
	default:
		k_panic();
		break;
	}
}

bool fatal_error_test_hook_cmd(struct net_buf *buf)
{
	const struct bt_hci_vs_fatal_error_test_inject *cmd;
	const struct bt_hci_cmd_hdr *hdr;

	if (buf->len < (H4_TYPE_LEN + sizeof(*hdr))) {
		return false;
	}

	if (buf->data[0] != BT_HCI_H4_CMD) {
		return false;
	}

	hdr = (const void *)&buf->data[H4_TYPE_LEN];
	if (sys_le16_to_cpu(hdr->opcode) != BT_HCI_OP_VS_FATAL_ERROR_TEST_INJECT) {
		return false;
	}

	/* From here on the command is ours. It never reaches the controller, which does not
	 * know this opcode, so every path below has to return true.
	 */
	if (hdr->param_len < sizeof(*cmd)) {
		LOG_ERR("Fault injection command is %u bytes, expected at least %u.",
			hdr->param_len, (uint8_t)sizeof(*cmd));
		return true;
	}

	cmd = (const void *)&buf->data[H4_TYPE_LEN + sizeof(*hdr)];

	LOG_WRN("Injecting a fatal error, context %u fault %u.", cmd->context, cmd->fault);

	pending_fault = cmd->fault;

	switch (cmd->context) {
	case BT_HCI_VS_FATAL_ERROR_TEST_CONTEXT_ISR:
		irq_offload(isr_offload, NULL);
		break;

#if defined(HOOK_ZLI_IRQN)
	case BT_HCI_VS_FATAL_ERROR_TEST_CONTEXT_ZLI:
		zli_trigger();
		break;
#endif /* HOOK_ZLI_IRQN */

	case BT_HCI_VS_FATAL_ERROR_TEST_CONTEXT_THREAD:
		fault_raise(cmd->fault);
		break;

	default:
		LOG_ERR("Unsupported fault injection context %u.", cmd->context);
		break;
	}

	return true;
}
```

## src/fatal_error_test_hook.h
```c
/*
 * Copyright (c) 2026 Nordic Semiconductor ASA
 *
 * SPDX-License-Identifier: LicenseRef-Nordic-5-Clause
 */

/* Test-only fault injection interface of the ipc_radio Bluetooth HCI serialization.
 *
 * The Vendor Specific HCI command defined here is only implemented when the
 * CONFIG_IPC_RADIO_FATAL_ERROR_TEST_HOOK Kconfig option is enabled. It is shared with the
 * test application running on the application core.
 */

#ifndef IPC_RADIO_FATAL_ERROR_TEST_H_
#define IPC_RADIO_FATAL_ERROR_TEST_H_

#include <stdbool.h>

#include <zephyr/bluetooth/hci.h>
#include <zephyr/net_buf.h>

#ifdef __cplusplus
extern "C" {
#endif

/** Vendor Specific HCI command injecting a fatal error. */
#define BT_HCI_OP_VS_FATAL_ERROR_TEST_INJECT BT_OP(BT_OGF_VS, 0x03ffu)

/** Raise the fatal error from the HCI command handling thread. */
#define BT_HCI_VS_FATAL_ERROR_TEST_CONTEXT_THREAD 0x00u
/** Raise the fatal error from an interrupt context. */
#define BT_HCI_VS_FATAL_ERROR_TEST_CONTEXT_ISR    0x01u
/** Raise the fatal error from a zero-latency interrupt context. */
#define BT_HCI_VS_FATAL_ERROR_TEST_CONTEXT_ZLI    0x02u

/** Raise the fatal error with k_panic(), reported as a stack frame. */
#define BT_HCI_VS_FATAL_ERROR_TEST_FAULT_PANIC  0x00u
/** Raise the fatal error with bt_ctlr_assert_handle(), reported as a controller assert. */
#define BT_HCI_VS_FATAL_ERROR_TEST_FAULT_ASSERT 0x01u

struct bt_hci_vs_fatal_error_test_inject {
	uint8_t context;
	uint8_t fault;
} __packed;

/** Consume the fault injection command on its way to the controller.
 *
 * Called by the ipc_radio HCI serialization for every H:4 encoded buffer the host sends,
 * from the thread that would otherwise pass the buffer to the controller.
 *
 * @param buf Buffer the host sent.
 *
 * @retval true  The buffer holds the fault injection command and must not be forwarded to the
 *               controller. The call only returns if the command was malformed, otherwise the
 *               requested fatal error is raised before it can return.
 * @retval false The buffer holds an unrelated packet.
 */
bool fatal_error_test_hook_cmd(struct net_buf *buf);

#ifdef __cplusplus
}
#endif

#endif /* IPC_RADIO_FATAL_ERROR_TEST_H_ */
```
