## CMakeLists.txt
```
# SPDX-License-Identifier: Apache-2.0

cmake_minimum_required(VERSION 3.20.0)

LIST(APPEND QEMU_EXTRA_FLAGS -serial unix:/tmp/bt-stack-tester)

find_package(Zephyr REQUIRED HINTS $ENV{ZEPHYR_BASE})
project(tester)

zephyr_library_include_directories(${ZEPHYR_BASE}/samples/bluetooth)
zephyr_library_include_directories(${ZEPHYR_BASE}/subsys/bluetooth/mesh)
zephyr_library_include_directories(${ZEPHYR_NRF_MODULE_DIR}/subsys/bluetooth/mesh)
target_sources(app PRIVATE
  src/main.c
  src/bttester.c
  src/gap.c
)

if(CONFIG_BT_MESH)
  target_sources(app PRIVATE src/mesh.c)
  target_sources(app PRIVATE src/mmdl.c)
  target_sources(app PRIVATE src/model_handler.c)
endif()
```

## prj.conf
```kconfig
# CONFIG_TEST enforces minimal logging, which we don't want
CONFIG_TEST=n

# Enable the option below to measure stack usage
#CONFIG_INIT_STACKS=y
CONFIG_THREAD_NAME=y
CONFIG_HW_STACK_PROTECTION=y
CONFIG_SYSTEM_WORKQUEUE_STACK_SIZE=3072
CONFIG_MAIN_STACK_SIZE=2560
CONFIG_BT_RX_STACK_SIZE=3072

# Log configs
CONFIG_LOG=y
CONFIG_LOG_BUFFER_SIZE=4096
CONFIG_LOG_BACKEND_RTT=y
CONFIG_LOG_BACKEND_RTT_MODE_DROP=y
CONFIG_LOG_BACKEND_SHOW_COLOR=n
CONFIG_LOG_PROCESS_THREAD_STACK_SIZE=1024
CONFIG_LOG_DEFAULT_LEVEL=1

CONFIG_RTT_CONSOLE=y
CONFIG_USE_SEGGER_RTT=y
CONFIG_SEGGER_RTT_BUFFER_SIZE_UP=4096
CONFIG_UART_INTERRUPT_DRIVEN=y
CONFIG_UART_CONSOLE=n
CONFIG_UART_PIPE=y

# Setting
CONFIG_SETTINGS=y
CONFIG_FLASH=y
CONFIG_FLASH_MAP=y

# General Bluetooth Controller and Host Configs
CONFIG_BT=y
CONFIG_BT_CENTRAL=y
CONFIG_BT_PERIPHERAL=y
CONFIG_BT_PRIVACY=n
CONFIG_BT_SMP=y
CONFIG_BT_SMP_ENFORCE_MITM=n
CONFIG_BT_SIGNING=y
CONFIG_BT_BONDABLE=y
CONFIG_BT_ATT_PREPARE_COUNT=4
CONFIG_BT_GATT_CLIENT=y
CONFIG_BT_L2CAP_DYNAMIC_CHANNEL=y
CONFIG_BT_DEVICE_NAME="Tester"
CONFIG_BT_DEVICE_NAME_MAX=32
CONFIG_BT_DEVICE_NAME_DYNAMIC=y
CONFIG_BT_DEVICE_NAME_GATT_WRITABLE=y
CONFIG_BT_TESTING=y

# Mesh Protocol Configs
CONFIG_BT_MESH=y
CONFIG_BT_MESH_RELAY=y
CONFIG_BT_EXT_ADV=y
CONFIG_BT_MESH_PB_ADV=y
CONFIG_BT_MESH_PB_GATT=y
CONFIG_BT_MESH_LOW_POWER=y
CONFIG_BT_MESH_LPN_AUTO=n
CONFIG_BT_MESH_GATT_PROXY=y
CONFIG_BT_MESH_LABEL_COUNT=2
CONFIG_BT_MESH_SUBNET_COUNT=2
CONFIG_BT_MESH_MODEL_GROUP_COUNT=2
CONFIG_BT_MESH_APP_KEY_COUNT=4
CONFIG_BT_MESH_IV_UPDATE_TEST=y
CONFIG_BT_MESH_CFG_CLI=y
CONFIG_BT_MESH_HEALTH_CLI=y
CONFIG_BT_MESH_FRIEND=y
CONFIG_BT_MESH_FRIEND_QUEUE_SIZE=32
CONFIG_BT_MESH_RX_SEG_MAX=13
CONFIG_BT_MESH_TX_SEG_MSG_COUNT=2
CONFIG_BT_MESH_LPN_POLL_TIMEOUT=100
CONFIG_BT_MESH_TX_SEG_MAX=24
CONFIG_BT_MESH_MODEL_EXTENSIONS=y
CONFIG_BT_MESH_COMP_PAGE_1=y
CONFIG_BT_MESH_MODEL_EXTENSION_LIST_SIZE=100

# Mesh Model Configs
CONFIG_BT_MESH_PLVL_SRV=y
CONFIG_BT_MESH_BATTERY_SRV=y
CONFIG_BT_MESH_LOC_SRV=y
CONFIG_BT_MESH_PROP_SRV=y
CONFIG_BT_MESH_SENSOR_SRV=y
CONFIG_BT_MESH_TIME_SRV=y
CONFIG_BT_MESH_LIGHTNESS_SRV=y
CONFIG_BT_MESH_LIGHT_CTRL_SRV=y
CONFIG_BT_MESH_SCENE_SRV=y
CONFIG_BT_MESH_LIGHT_CTL_SRV=y
CONFIG_BT_MESH_ONOFF_CLI=y
CONFIG_BT_MESH_LVL_CLI=y
CONFIG_BT_MESH_DTT_CLI=y
CONFIG_BT_MESH_PONOFF_CLI=y
CONFIG_BT_MESH_PLVL_CLI=y
CONFIG_BT_MESH_BATTERY_CLI=y
CONFIG_BT_MESH_LOC_CLI=y
CONFIG_BT_MESH_PROP_CLI=y
CONFIG_BT_MESH_SENSOR_CLI=y
CONFIG_BT_MESH_TIME_CLI=y
CONFIG_BT_MESH_LIGHTNESS_CLI=y
CONFIG_BT_MESH_LIGHT_CTRL_CLI=y
CONFIG_BT_MESH_SCENE_CLI=y
CONFIG_BT_MESH_LIGHT_CTL_CLI=y
CONFIG_BT_MESH_LIGHT_TEMP_SRV=y
CONFIG_BT_MESH_LIGHT_XYL_CLI=y
CONFIG_BT_MESH_LIGHT_XYL_SRV=y
CONFIG_BT_MESH_LIGHT_HSL_CLI=y
CONFIG_BT_MESH_LIGHT_HSL_SRV=y
CONFIG_BT_MESH_SCHEDULER_CLI=y
CONFIG_BT_MESH_SCHEDULER_SRV=y
CONFIG_BT_MESH_SCENES_MAX=10

CONFIG_BT_MESH_LIGHT_CTRL_SRV_TIME_FADE_ON=0
CONFIG_BT_MESH_LIGHT_CTRL_SRV_TIME_FADE_PROLONG=0
CONFIG_BT_MESH_LIGHT_CTRL_SRV_TIME_FADE_STANDBY_AUTO=0
CONFIG_BT_MESH_LIGHT_CTRL_SRV_TIME_FADE_STANDBY_MANUAL=0
CONFIG_BT_MESH_LIGHT_CTRL_SRV_TIME_PROLONG=0
```

## src/main.c
```c
/* main.c - Application main entry point */

/*
 * Copyright (c) 2015-2016 Intel Corporation
 *
 * SPDX-License-Identifier: Apache-2.0
 */

#include <zephyr/kernel.h>
#include <zephyr/types.h>
#include <zephyr/toolchain.h>

#include <zephyr/logging/log.h>
#define LOG_MODULE_NAME bttester_main
LOG_MODULE_REGISTER(LOG_MODULE_NAME);

#include "bttester.h"

int main(void)
{
	tester_init();

	return 0;
}
```

## src/mesh.c
```c
/* mesh.c - Bluetooth Mesh Tester */

/*
 * Copyright (c) 2017 Intel Corporation
 *
 * SPDX-License-Identifier: LicenseRef-Nordic-5-Clause
 */

#include <zephyr/bluetooth/bluetooth.h>

#include <assert.h>
#include <errno.h>
#include <string.h>
#include <zephyr/bluetooth/mesh.h>
#include <zephyr/bluetooth/mesh/access.h>
#include <zephyr/bluetooth/mesh/cfg.h>
#include <zephyr/settings/settings.h>
#include <zephyr/sys/byteorder.h>
#include <app_keys.h>
#include "access.h"

#define LOG_LEVEL CONFIG_BT_MESH_LOG_LEVEL
#include "zephyr/logging/log.h"
LOG_MODULE_REGISTER(bttester_mesh);
#include "mesh/testing.h"
#include "model_handler.h"
#include "bttester.h"

#define CONTROLLER_INDEX 0

/* Address of the Node that bound AppKeys to our models (PTS). It is the
 * destination for Client model messages. It is stored in settings because
 * without reprovisioning PTS does not bind AppKeys again after a reboot.
 */
#define TESTER_PTS_ADDR_KEY "bttester/pts_addr"

/* Test state clean-up for the no-reprovisioning mode.
 *
 * Deleted before the "settings_load()", keys relative to "bt/mesh":
 * - s/<id>/{data,pub,sub,subv}, v/<id>/{data,pub,sub,subv}: model state,
 *   publications and subscriptions;
 * - Va/<idx>: label UUIDs, referenced by pub and subv;
 * - Cfg: Configuration Server state (Default TTL, relay, ...);
 * - HBPub: Heartbeat publication.
 * Kept: Net, NetKey, AppKey, IV, Seq, RPL, AppKey bindings, thus can
 * continue without provisioning.
 *
 * Only at the start of a Test Case: Auto-PTS registers the MMDL service
 * (BTP_SERVICE_ID_MMDL) only in the Test Case pre-run.
 * After an IUT reset inside a Test Case (autopts/wid/mmdl.py iut_reset():
 * WID 630, 631, 661, 663) GAP and MESH are registered again, and MESH_INIT,
 * MESH_CONFIG_PROVISIONING and MESH_START are sent again, but not the MMDL
 * service registration. So the states stored before the reset are loaded,
 * as the Test Case expects.
 *
 * Done in MESH_START before settings_load(), so the mesh stack loads the
 * models with their default states.
 */
#define TEST_STATE_KEYS_MAX 64
#define TEST_STATE_KEY_LEN  48

/* Health server data */
extern uint8_t cur_faults[CUR_FAULTS_MAX];
extern uint8_t reg_faults[CUR_FAULTS_MAX * 2];
extern struct bt_mesh_model vnd_models[1];

/* Provision node data */
static uint8_t net_key[16];
static uint16_t net_key_idx;
static uint8_t flags;
static uint32_t iv_index;
static uint16_t addr;
static uint8_t dev_key[16];
static uint8_t input_size;

/* Configured provisioning data */
static uint8_t dev_uuid[16];
static uint8_t static_auth[16];

struct net_ctx net = {
	.local = BT_MESH_ADDR_UNASSIGNED,
	.dst = BT_MESH_ADDR_UNASSIGNED,
};

struct test_state_keys {
	size_t cnt;
	bool is_overflow;
	bool is_name_err;
	char names[TEST_STATE_KEYS_MAX][TEST_STATE_KEY_LEN];
};

static struct test_state_keys state_keys;

/* Set by the MMDL service registration, used by the next MESH_START.
 * RAM only: an IUT reset clears it.
 */
static bool has_test_state_clear_req;

uint16_t tester_pts_addr = BT_MESH_ADDR_UNASSIGNED;

static bool tester_mesh_is_key_field(const char *field, const char *name)
{
	const size_t len = strlen(name);

	return !strncmp(field, name, len) &&
	       (field[len] == '\0' || field[len] == '/');
}

static bool tester_mesh_is_test_state_key(const char *key)
{
	const char *field;

	/* Top-level keys: Configuration Server state, Heartbeat, publication and
	 * label UUIDs.
	 */
	if (!strcmp(key, "Cfg") || !strcmp(key, "HBPub") || !strncmp(key, "Va/", 3)) {
		return true;
	}

	/* Model keys: "s/<id>/<field>[/...]" (SIG) or "v/<id>/<field>[/...]"
	 * (vendor).
	 */
	if ((key[0] != 's' && key[0] != 'v') || key[1] != '/') {
		return false;
	}

	/* Skip "<id>/" to get to the field name. */
	field = strchr(key + 2, '/');
	if (!field) {
		return false;
	}
	++field;

	/* Check if this specific entry is one of the Model state, publication and
	 * subscription entries.
	 */
	return tester_mesh_is_key_field(field, "data") ||
	       tester_mesh_is_key_field(field, "pub") ||
	       tester_mesh_is_key_field(field, "sub") ||
	       tester_mesh_is_key_field(field, "subv");
}

static void tester_mesh_set_pts_addr(uint16_t pts_addr)
{
	if (tester_pts_addr == pts_addr) {
		return;
	}

	tester_pts_addr = pts_addr;

	if (IS_ENABLED(CONFIG_BT_SETTINGS)) {
		if (pts_addr == BT_MESH_ADDR_UNASSIGNED) {
			(void)settings_delete(TESTER_PTS_ADDR_KEY);
		} else {
			(void)settings_save_one(TESTER_PTS_ADDR_KEY, &tester_pts_addr,
						sizeof(tester_pts_addr));
		}
	}
}

static void tester_mesh_clear_net_ctx(void)
{
	net.local = BT_MESH_ADDR_UNASSIGNED;
	net.dst = BT_MESH_ADDR_UNASSIGNED;
	net.net_idx = 0;
}

static int tester_mesh_collect_test_state_key(const char *key, size_t len,
					      settings_read_cb read_cb,
					      void *args, void *param)
{
	struct test_state_keys *keys = param;
	int n;

	ARG_UNUSED(len);
	ARG_UNUSED(read_cb);
	ARG_UNUSED(args);

	if (!key || !tester_mesh_is_test_state_key(key)) {
		return 0;
	}

	if (keys->cnt >= TEST_STATE_KEYS_MAX) {
		keys->is_overflow = true;
		return 0;
	}

	n = snprintk(keys->names[keys->cnt], TEST_STATE_KEY_LEN, "bt/mesh/%s",
		     key);
	if (n < 0 || n >= TEST_STATE_KEY_LEN) {
		keys->is_name_err = true;
		return 0;
	}

	++keys->cnt;

	return 0;
}

static int tester_mesh_clear_test_state(void)
{
	int err;

	/* Remove after each walk: deleting inside the load callback is not safe.
	 * Walk on and on until all keys are deleted (the overflow flag is cleared).
	 */
	do {
		state_keys.cnt = 0U;
		state_keys.is_overflow = false;
		state_keys.is_name_err = false;

		err = settings_load_subtree_direct("bt/mesh", tester_mesh_collect_test_state_key,
						   &state_keys);
		if (err) {
			LOG_ERR("Failed to read bt/mesh: err %d", err);
			return err;
		}

		if (state_keys.is_name_err) {
			return -ENAMETOOLONG;
		}

		for (size_t i = 0; i < state_keys.cnt; i++) {
			LOG_DBG("Deleting %s...", state_keys.names[i]);

			err = settings_delete(state_keys.names[i]);
			if (err) {
				LOG_ERR("Failed to delete %s: err %d", state_keys.names[i], err);
				return err;
			}
		}
	} while (state_keys.is_overflow);

	return 0;
}

static int tester_mesh_load_settings(const char *name, size_t len,
				     settings_read_cb read_cb, void *cb_arg)
{
	const char *next;
	ssize_t rc;

	if (!settings_name_steq(name, "pts_addr", &next) || next) {
		return -ENOENT;
	}

	if (len != sizeof(tester_pts_addr)) {
		return -EINVAL;
	}

	rc = read_cb(cb_arg, &tester_pts_addr, sizeof(tester_pts_addr));

	return (rc < 0) ? (int)rc : 0;
}

static bool tester_mesh_restore_net_ctx(void)
{
	uint16_t net_idxs[CONFIG_BT_MESH_SUBNET_COUNT];
	uint16_t primary = bt_mesh_primary_addr();
	ssize_t net_cnt;

	if (primary == BT_MESH_ADDR_UNASSIGNED) {
		LOG_ERR("No primary address, cannot proceed.");
		return false;
	}

	/* Model messages use the subnet of their AppKey instead. */
	net_cnt = bt_mesh_subnets_get(net_idxs, ARRAY_SIZE(net_idxs), 0);
	if (net_cnt <= 0) {
		LOG_ERR("No known subnets, cannot proceed.");
		return false;
	}

	/* Select the default subnet for the network context: the lowest NetKey
	 * index, the choice will not depend on the order how subnets were added.
	 * Client models use the subnet of their AppKey.
	 */
	net.net_idx = net_idxs[0];
	for (ssize_t i = 1; i < net_cnt; i++) {
		if (net_idxs[i] < net.net_idx) {
			net.net_idx = net_idxs[i];
		}
	}

	net.local = primary;

	return true;
}

SETTINGS_STATIC_HANDLER_DEFINE(bttester, "bttester", NULL, tester_mesh_load_settings,
			       NULL, NULL);

static void supported_commands(uint8_t *data, uint16_t len)
{
	struct net_buf_simple *buf = NET_BUF_SIMPLE(BTP_DATA_MAX_SIZE);

	net_buf_simple_init(buf, 0);

	/* 1st octet */
	net_buf_simple_add_u8(buf, 0);
	tester_set_bit(buf->data, MESH_READ_SUPPORTED_COMMANDS);
	tester_set_bit(buf->data, MESH_CONFIG_PROVISIONING);
	tester_set_bit(buf->data, MESH_INIT);
	tester_set_bit(buf->data, MESH_RESET);
	tester_set_bit(buf->data, MESH_START);

	tester_send(BTP_SERVICE_ID_MESH, MESH_READ_SUPPORTED_COMMANDS,
		    CONTROLLER_INDEX, buf->data, buf->len);
}

static void link_open(bt_mesh_prov_bearer_t bearer)
{
	struct mesh_prov_link_open_ev ev;

	LOG_DBG("bearer 0x%02x", bearer);

	switch (bearer) {
	case BT_MESH_PROV_ADV:
		ev.bearer = MESH_PROV_BEARER_PB_ADV;
		break;
	case BT_MESH_PROV_GATT:
		ev.bearer = MESH_PROV_BEARER_PB_GATT;
		break;
	default:
		LOG_ERR("Invalid bearer");

		return;
	}

	tester_send(BTP_SERVICE_ID_MESH, MESH_EV_PROV_LINK_OPEN,
		    CONTROLLER_INDEX, (uint8_t *) &ev, sizeof(ev));
}

static void link_close(bt_mesh_prov_bearer_t bearer)
{
	struct mesh_prov_link_closed_ev ev;

	LOG_DBG("bearer 0x%02x", bearer);

	switch (bearer) {
	case BT_MESH_PROV_ADV:
		ev.bearer = MESH_PROV_BEARER_PB_ADV;
		break;
	case BT_MESH_PROV_GATT:
		ev.bearer = MESH_PROV_BEARER_PB_GATT;
		break;
	default:
		LOG_ERR("Invalid bearer");

		return;
	}

	tester_send(BTP_SERVICE_ID_MESH, MESH_EV_PROV_LINK_CLOSED,
		    CONTROLLER_INDEX, (uint8_t *) &ev, sizeof(ev));
}

static int output_numeric(bt_mesh_output_action_t action, uint8_t *numeric, size_t size)
{
	struct mesh_out_number_action_ev ev;
	uint32_t number;

	if (size > sizeof(number)) {
		LOG_ERR("Unsupported size %zu", size);
		return -EINVAL;
	}

	number = sys_get_le32(numeric);

	LOG_DBG("action 0x%04x number 0x%08x", action, number);

	ev.action = sys_cpu_to_le16(action);
	ev.number = sys_cpu_to_le32(number);

	tester_send(BTP_SERVICE_ID_MESH, MESH_EV_OUT_NUMBER_ACTION,
		    CONTROLLER_INDEX, (uint8_t *) &ev, sizeof(ev));

	return 0;
}

static int output_string(const char *str)
{
	struct mesh_out_string_action_ev *ev;
	struct net_buf_simple *buf = NET_BUF_SIMPLE(BTP_DATA_MAX_SIZE);

	LOG_DBG("str %s", str);

	net_buf_simple_init(buf, 0);

	ev = net_buf_simple_add(buf, sizeof(*ev));
	ev->string_len = strlen(str);

	net_buf_simple_add_mem(buf, str, ev->string_len);

	tester_send(BTP_SERVICE_ID_MESH, MESH_EV_OUT_STRING_ACTION,
		    CONTROLLER_INDEX, buf->data, buf->len);

	return 0;
}

static int input(bt_mesh_input_action_t action, uint8_t size)
{
	struct mesh_in_action_ev ev;

	LOG_DBG("action 0x%04x number 0x%02x", action, size);

	input_size = size;

	ev.action = sys_cpu_to_le16(action);
	ev.size = size;

	tester_send(BTP_SERVICE_ID_MESH, MESH_EV_IN_ACTION, CONTROLLER_INDEX,
		    (uint8_t *) &ev, sizeof(ev));

	return 0;
}

static void prov_complete(uint16_t net_idx, uint16_t addr)
{
	LOG_DBG("net_idx 0x%04x addr 0x%04x", net_idx, addr);

	net.net_idx = net_idx,
	net.local = addr;
	net.dst = addr;

	tester_send(BTP_SERVICE_ID_MESH, MESH_EV_PROVISIONED, CONTROLLER_INDEX,
		    NULL, 0);
}

static void prov_reset(void)
{
	int err;

	LOG_DBG("");

	err = bt_mesh_prov_enable(BT_MESH_PROV_ADV | BT_MESH_PROV_GATT);
	if (err && err != -EALREADY) {
		LOG_ERR("prov enable error %d", err);
	}
}

static const struct bt_mesh_comp *comp;

static struct bt_mesh_prov prov = {
	.uuid = dev_uuid,
	.static_val = static_auth,
	.static_val_len = sizeof(static_auth),
	.output_numeric = output_numeric,
	.output_string = output_string,
	.input = input,
	.link_open = link_open,
	.link_close = link_close,
	.complete = prov_complete,
	.reset = prov_reset,
};

static void config_prov(uint8_t *data, uint16_t len)
{
	const struct mesh_config_provisioning_cmd *cmd = (void *) data;

	LOG_DBG("");

	memcpy(dev_uuid, cmd->uuid, sizeof(dev_uuid));
	memcpy(static_auth, cmd->static_auth, sizeof(static_auth));

	prov.output_size = cmd->out_size;
	prov.output_actions = sys_le16_to_cpu(cmd->out_actions);
	prov.input_size = cmd->in_size;
	prov.input_actions = sys_le16_to_cpu(cmd->in_actions);

	tester_rsp(BTP_SERVICE_ID_MESH, MESH_CONFIG_PROVISIONING,
		   CONTROLLER_INDEX, BTP_STATUS_SUCCESS);
}

static void init(uint8_t *data, uint16_t len)
{
	uint8_t status = BTP_STATUS_SUCCESS;
	int err;

	LOG_DBG("");

	comp = model_handler_init();
	err = bt_mesh_init(&prov, comp);
	if (err) {
		status = BTP_STATUS_FAILED;
	}

	tester_rsp(BTP_SERVICE_ID_MESH, MESH_INIT, CONTROLLER_INDEX,
		   status);
}

static void start(uint8_t *data, uint16_t len)
{
	uint8_t status = BTP_STATUS_SUCCESS;
	bool is_ctx_restored = false;
	int err;

	LOG_DBG("");

	if (IS_ENABLED(CONFIG_BT_SETTINGS)) {
		/* Each Test Case starts with default model states. Not done after
		 * an IUT reset inside a Test Case (no MMDL service registration).
		 * If the node is already running (no IUT reset before the Test
		 * Case), MESH_START fails: the states cannot be cleared.
		 */
		if (has_test_state_clear_req) {
			if (bt_mesh_is_provisioned()) {
				LOG_ERR("Test state clear requested on a running node: "
					"IUT was not reset before the Test Case.");
				status = BTP_STATUS_FAILED;
			} else {
				err = tester_mesh_clear_test_state();
				if (err) {
					LOG_ERR("Failed to clear test state: err %d", err);
					status = BTP_STATUS_FAILED;
				}
			}
			has_test_state_clear_req = false;
		}

		settings_load();
	}

	/* Node already in a network (flash or current session): do not re-open PB-ADV. */
	if (!bt_mesh_is_provisioned()) {
		if (addr) {
			err = bt_mesh_provision(net_key, net_key_idx, flags, iv_index,
						addr, dev_key);
			if (err && err != -EALREADY) {
				status = BTP_STATUS_FAILED;
			}
		} else {
			err = bt_mesh_prov_enable(BT_MESH_PROV_ADV | BT_MESH_PROV_GATT);
			if (err && err != -EALREADY) {
				status = BTP_STATUS_FAILED;
			}
		}
	} else {
		if (!tester_mesh_restore_net_ctx()) {
			status = BTP_STATUS_FAILED;
		} else {
			is_ctx_restored = true;
		}
	}

	tester_rsp(BTP_SERVICE_ID_MESH, MESH_START, CONTROLLER_INDEX, status);

	/* Context restored from RRAM: let auto-pts get the PROVISIONED event,
	 * WID13 resets the Node in a case of absent keys.
	 */
	if (is_ctx_restored) {
		tester_send(BTP_SERVICE_ID_MESH, MESH_EV_PROVISIONED, CONTROLLER_INDEX,
			    NULL, 0);
	}
}

static void reset(uint8_t *data, uint16_t len)
{
	LOG_DBG("");

	tester_mesh_clear_net_ctx();
	tester_mesh_set_pts_addr(BT_MESH_ADDR_UNASSIGNED);
	bt_mesh_reset();

	tester_rsp(BTP_SERVICE_ID_MESH, MESH_RESET, CONTROLLER_INDEX,
		   BTP_STATUS_SUCCESS);
}

void tester_handle_mesh(uint8_t opcode, uint8_t index, uint8_t *data, uint16_t len)
{
	switch (opcode) {
	case MESH_READ_SUPPORTED_COMMANDS:
		supported_commands(data, len);
		break;
	case MESH_CONFIG_PROVISIONING:
		config_prov(data, len);
		break;
	case MESH_INIT:
		init(data, len);
		break;
	case MESH_START:
		start(data, len);
		break;
	case MESH_RESET:
		reset(data, len);
		break;
	default:
		tester_rsp(BTP_SERVICE_ID_MESH, opcode, index,
			   BTP_STATUS_UNKNOWN_CMD);
		break;
	}
}

void net_recv_ev(uint8_t ttl, uint8_t ctl, uint16_t src, uint16_t dst, const void *payload,
		 size_t payload_len)
{
	NET_BUF_SIMPLE_DEFINE(buf, UINT8_MAX);
	struct mesh_net_recv_ev *ev;

	LOG_DBG("ttl 0x%02x ctl 0x%02x src 0x%04x dst 0x%04x payload_len %zu",
		ttl, ctl, src, dst, payload_len);

	if (payload_len > net_buf_simple_tailroom(&buf)) {
		LOG_ERR("Payload size exceeds buffer size");
		return;
	}

	ev = net_buf_simple_add(&buf, sizeof(*ev));
	ev->ttl = ttl;
	ev->ctl = ctl;
	ev->src = sys_cpu_to_le16(src);
	ev->dst = sys_cpu_to_le16(dst);
	ev->payload_len = payload_len;
	net_buf_simple_add_mem(&buf, payload, payload_len);

	tester_send(BTP_SERVICE_ID_MESH, MESH_EV_NET_RECV, CONTROLLER_INDEX,
		    buf.data, buf.len);
}

static void model_bound_cb(uint16_t addr, const struct bt_mesh_model *model,
			   uint16_t key_idx)
{
	LOG_DBG("remote addr 0x%04x key_idx 0x%04x model %p",
		addr, key_idx, (void *)model);

	/* Do not touch model publication here: a server model with publication
	 * set sends an extra status on every state change.
	 */
	tester_mesh_set_pts_addr(addr);
}

static void model_unbound_cb(uint16_t addr, const struct bt_mesh_model *model,
			     uint16_t key_idx)
{
	LOG_DBG("remote addr 0x%04x key_idx 0x%04x model %p",
		addr, key_idx, (void *)model);
}

static void invalid_bearer_cb(uint8_t opcode)
{
	struct mesh_invalid_bearer_ev ev = {
		.opcode = opcode,
	};

	LOG_DBG("opcode 0x%02x", opcode);

	tester_send(BTP_SERVICE_ID_MESH, MESH_EV_INVALID_BEARER,
		    CONTROLLER_INDEX, (uint8_t *) &ev, sizeof(ev));
}

static void incomp_timer_exp_cb(void)
{
	tester_send(BTP_SERVICE_ID_MESH, MESH_EV_INCOMP_TIMER_EXP,
		    CONTROLLER_INDEX, NULL, 0);
}

static struct bt_mesh_test_cb mesh_test_cb = {
	.net_recv = net_recv_ev,
	.model_bound = model_bound_cb,
	.model_unbound = model_unbound_cb,
	.prov_invalid_bearer = invalid_bearer_cb,
	.trans_incomp_timer_exp = incomp_timer_exp_cb,
};

bool tester_mesh_get_net_idx_from_appkey_idx(uint16_t akey_idx, uint16_t *nkey_idx)
{
	uint16_t net_idxs[CONFIG_BT_MESH_SUBNET_COUNT];
	uint16_t appkeys_idxs[CONFIG_BT_MESH_APP_KEY_COUNT];
	ssize_t appkeys_cnt;

	/* Get all known subnets, do not proceed if there are no known ones. */
	ssize_t net_cnt = bt_mesh_subnets_get(net_idxs, ARRAY_SIZE(net_idxs), 0);

	if (net_cnt <= 0) {
		LOG_ERR("No known subnets, cannot proceed.");
		return false;
	}

	/* Walk through all known subnets. */
	for (ssize_t i = 0; i < net_cnt; i++) {
		/* Get all appkeys bound to the current subnet. */
		appkeys_cnt = bt_mesh_app_keys_get(net_idxs[i], appkeys_idxs,
						   ARRAY_SIZE(appkeys_idxs), 0);
		if (appkeys_cnt <= 0) {
			continue;
		}
		/* Walk through all appkeys bound to this subnet, try to solve. */
		for (ssize_t j = 0; j < appkeys_cnt; j++) {
			if (appkeys_idxs[j] == akey_idx) {
				*nkey_idx = net_idxs[i];
				return true;
			}
		}
	}

	return false;
}

void tester_mesh_set_state_reset_request(void)
{
	has_test_state_clear_req = true;
}

uint8_t tester_init_mesh(void)
{
	if (IS_ENABLED(CONFIG_BT_TESTING)) {
		bt_mesh_test_cb_register(&mesh_test_cb);
	}

	return BTP_STATUS_SUCCESS;
}

uint8_t tester_unregister_mesh(void)
{
	return BTP_STATUS_SUCCESS;
}
```

## src/model_handler.h
```c
/* model_handler.h - Bluetooth Mesh Models handler header */

/*
 * Copyright (c) 2021 Nordic Semiconductor ASA
 *
 * SPDX-License-Identifier: LicenseRef-Nordic-5-Clause
 */

#ifndef MODEL_HANDLER_H__
#define MODEL_HANDLER_H__

#include <zephyr/bluetooth/mesh.h>

#ifdef __cplusplus
extern "C" {
#endif

#define CUR_FAULTS_MAX 4
#define HEALTH_TEST_ID 0x00

const struct bt_mesh_comp *model_handler_init(void);

extern struct bt_mesh_onoff_cli onoff_cli;
extern struct bt_mesh_lvl_cli lvl_cli;
extern struct bt_mesh_dtt_cli dtt_cli;
extern struct bt_mesh_ponoff_cli ponoff_cli;
extern struct bt_mesh_plvl_cli plvl_cli;
extern struct bt_mesh_battery_cli battery_cli;
extern struct bt_mesh_loc_cli loc_cli;
extern struct bt_mesh_prop_cli prop_cli;
extern struct bt_mesh_sensor_cli sensor_cli;
extern struct bt_mesh_time_cli time_cli;
extern struct bt_mesh_lightness_cli lightness_cli;
extern struct bt_mesh_light_ctrl_cli light_ctrl_cli;
extern struct bt_mesh_light_ctl_cli light_ctl_cli;
extern struct bt_mesh_scene_cli scene_cli;
extern struct bt_mesh_light_xyl_cli xyl_cli;
extern struct bt_mesh_light_hsl_cli light_hsl_cli;
extern struct bt_mesh_scheduler_cli scheduler_cli;

struct model_data {
	const struct bt_mesh_model *model;
	uint16_t addr;
	uint16_t appkey_idx;
	/* NetKey Index the AppKey is bound to.
	 * Messages are encrypted with the AppKey, so they must be sent on this
	 * NetKey's SubNet.
	 */
	uint16_t net_idx;
};

struct net_ctx {
	uint16_t local;
	uint16_t dst;
	uint16_t net_idx;
};

extern struct net_ctx net;
extern uint16_t tester_pts_addr;

void sensor_data_set(uint8_t *data, uint16_t len);

bool tester_mesh_get_net_idx_from_appkey_idx(uint16_t akey_idx, uint16_t *nkey_idx);
void tester_mesh_set_state_reset_request(void);

#ifdef __cplusplus
}
#endif

#endif /* MODEL_HANDLER_H__ */
```
