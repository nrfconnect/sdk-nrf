## tests/wifi/crypto/testcase.yaml
```yaml
common:
  depends_on: wifi
  tags:
    - ci_build
    - sysbuild
    - drivers
    - ci_tests_drivers_nrf_wifi
tests:
  sample.nrf7120.wifi_crypto:
    sysbuild: true
    build_only: true
    integration_platforms:
      - nrf7120dk/nrf7120/cpuapp
    platform_allow: nrf7120dk/nrf7120/cpuapp
```

## tests/zephyr/arch/arm/arm_irq_advanced_features/testcase.yaml
```yaml
tests:
  nrf.extended.arch.arm.arm_irq_advanced_features:
    tags:
      - arm
      - interrupt
      - ci_tests_zephyr_arch_arm_arm_irq_advanced_features
    platform_allow:
      - nrf54ls05dk/nrf54ls05b/cpuapp
      - nrf54lv10dk/nrf54lv10a/cpuapp
      - nrf54lv10dk/nrf54lv10a/cpuapp/ns
    integration_platforms:
      - nrf54ls05dk/nrf54ls05b/cpuapp
```

## tests/zephyr/boards/nrf/comp/Kconfig
```kconfig
# Copyright (c) 2025, Nordic Semiconductor ASA
# SPDX-License-Identifier: LicenseRef-Nordic-5-Clause

source "tests/boards/nrf/comp/Kconfig"
```

## tests/zephyr/boards/nrf/comp/testcase.yaml
```yaml
common:
  harness_config:
    fixture: gpio_loopback
  tags:
    - drivers
    - comparator
    - ci_tests_zephyr_boards_nrf_comp
tests:
  nrf.extended.drivers.comparator.nrf_comp:
    platform_allow:
      - nrf54lv10dk/nrf54lv10a/cpuapp
      - nrf54lv10dk@0.2.0/nrf54lv10a/cpuapp
      - nrf7120pdk/nrf7120/cpuapp
    integration_platforms:
      - nrf54lv10dk/nrf54lv10a/cpuapp
      - nrf7120pdk/nrf7120/cpuapp
```

## tests/zephyr/boards/nrf/hwinfo/reset_cause/testcase.yaml
```yaml
common:
  tags:
    - drivers
    - hwinfo
    - ci_tests_zephyr_boards_nrf_hwinfo
  harness: console
  timeout: 30

tests:
  nrf.extended.drivers.hwinfo.reset_cause:
    harness_config:
      type: multi_line
      ordered: true
      regex:
        - "HW Info reset reason test on"
        - "PASS: RESET_PIN detected"
        - "PASS: reset causes were cleared"
        - "Supported reset causes are"
        - "RESET_PIN is supported"
        - "RESET_SOFTWARE is supported"
        - "RESET_WATCHDOG is supported"
        - "RESET_DEBUG is supported"
        - "RESET_LOW_POWER_WAKE is supported"
        - "RESET_CPU_LOCKUP is supported"
        - "HW Info reset reason test on"
        - "This boot is due to expected software reset"
        - "PASS: RESET_SOFTWARE detected"
        - "PASS: reset causes were cleared"
        - "Watchdog shall fire"
        - "HW Info reset reason test on"
        - "This boot is due to expected watchdog reset"
        - "PASS: RESET_WATCHDOG detected"
        - "PASS: reset causes were cleared"
        - "HW Info reset reason test on"
        - "This boot is due to expected cpu lockup reset"
        - "PASS: RESET_CPU_LOCKUP detected"
        - "PASS: reset causes were cleared"
        - "All tests done"
    platform_allow:
      - nrf54ls05dk/nrf54ls05b/cpuapp
      - nrf54ls05dk@0.0.0/nrf54ls05b/cpuapp
      - nrf54ls05dk@0.2.0/nrf54ls05b/cpuapp
      - nrf54lv10dk/nrf54lv10a/cpuapp
      - nrf54lv10dk@0.2.0/nrf54lv10a/cpuapp
      - nrf7120dk/nrf7120/cpuapp
    integration_platforms:
      - nrf54ls05dk/nrf54ls05b/cpuapp
```

## tests/zephyr/boards/nrf/qdec/testcase.yaml
```yaml
common:
  platform_allow:
    - nrf54ls05dk/nrf54ls05b/cpuapp
    - nrf54ls05dk@0.0.0/nrf54ls05b/cpuapp
    - nrf54ls05dk@0.2.0/nrf54ls05b/cpuapp
    - nrf7120dk/nrf7120/cpuapp
  integration_platforms:
    - nrf54ls05dk/nrf54ls05b/cpuapp
  harness: ztest
  harness_config:
    fixture: gpio_loopback
  tags:
    - drivers
    - sensors
    - qdec
    - ci_tests_zephyr_boards_nrf_qdec
tests:
  nrf.extended.drivers.sensor.qdec: {}
  nrf.extended.drivers.sensor.qdec.pm_runtime:
    tags:
      - pm
    extra_configs:
      - CONFIG_PM_DEVICE=y
      - CONFIG_PM_DEVICE_RUNTIME=y
```

## tests/zephyr/crypto/mbedtls_psa/testcase.yaml
```yaml
common:
  platform_exclude:
    - nrf54l15dk/nrf54l05/cpuapp
    - nrf54l15dk/nrf54l10/cpuapp
    - nrf54l15dk/nrf54l15/cpuapp
    - nrf54lm20dk/nrf54lm20a/cpuapp
    - nrf54ls05dk/nrf54ls05/cpuapp
    - nrf54lv10dk/nrf54lv10a/cpuapp
tests:
  crypto.mbedtls_psa.with_entropy_driver: {}
  crypto.mbedtls_psa.without_entropy_driver: {}
```

## tests/zephyr/drivers/adc/adc_accuracy_test/testcase.yaml
```yaml
common:
  tags:
    - drivers
    - ci_tests_zephyr_drivers_adc
tests:
  nrf.extended.drivers.adc.accuracy.ref_volt:
    harness_config:
      fixture: adc_ref_volt
    integration_platforms:
      - nrf54ls05dk/nrf54ls05b/cpuapp
    platform_allow:
      - nrf54ls05dk/nrf54ls05a/cpuapp
      - nrf54ls05dk/nrf54ls05b/cpuapp
      - nrf54lv10dk/nrf54lv10a/cpuapp
      - nrf54lv10dk/nrf54lv10a/cpuapp/ns
  nrf.extended.drivers.adc.accuracy.ref_volt.nrf9251:
    harness_config:
      # any setup that sets AINx to logic high
      fixture: gpio_loopback
    platform_allow:
      - nrf9251dk/nrf9251/cpuapp
      - nrf9251dk/nrf9251/cpuppr
    integration_platforms:
      - nrf9251dk/nrf9251/cpuapp
```

## tests/zephyr/drivers/adc/adc_api/Kconfig.sysbuild
```kconfig
#
# Copyright (c) 2026 Nordic Semiconductor ASA
#
# SPDX-License-Identifier: LicenseRef-Nordic-5-Clause
#

config SUPPORT_NETCORE_TESTAPP
	bool
	default y if SOC_NRF54H20_CPUAPP

choice NETCORE

config NETCORE_TESTAPP
	bool "testapp image"

endchoice

if !NETCORE_NONE

config NETCORE_IMAGE_NAME
	default "netcore_testapp" if NETCORE_TESTAPP

config NETCORE_IMAGE_PATH
	default "${ZEPHYR_NRF_MODULE_DIR}/tests/zephyr/drivers/adc/adc_api/netcore_testapp" if NETCORE_TESTAPP

endif # !NETCORE_NONE

source "share/sysbuild/Kconfig"
```

## tests/zephyr/drivers/adc/adc_api/testcase.yaml
```yaml
common:
  tags:
    - drivers
    - userspace
    - ci_tests_zephyr_drivers_adc
tests:
  nrf.extended.drivers.adc:
    integration_platforms:
      - nrf54ls05dk/nrf54ls05b/cpuapp
    platform_allow:
      - nrf54ls05dk/nrf54ls05b/cpuapp
      - nrf54ls05dk@0.0.0/nrf54ls05b/cpuapp
      - nrf54ls05dk@0.2.0/nrf54ls05b/cpuapp
      - nrf54lv10dk/nrf54lv10a/cpuapp
      - nrf54lv10dk/nrf54lv10a/cpuapp/ns

  nrf.extended.drivers.adc.with_netcore:
    integration_platforms:
      - nrf54h20dk/nrf54h20/cpuapp
    platform_allow:
      - nrf54h20dk/nrf54h20/cpuapp
    extra_args:
      - SB_CONFIG_NETCORE_TESTAPP=y
```

## tests/zephyr/drivers/adc/adc_error_cases/testcase.yaml
```yaml
common:
  tags:
    - drivers
    - ci_tests_zephyr_drivers_adc
tests:
  nrf.extended.drivers.adc_error_cases:
    integration_platforms:
      - nrf54ls05dk/nrf54ls05b/cpuapp
    platform_allow:
      - nrf54ls05dk/nrf54ls05a/cpuapp
      - nrf54ls05dk/nrf54ls05b/cpuapp
      - nrf54lv10dk/nrf54lv10a/cpuapp
      - nrf9251dk/nrf9251/cpuapp
      - nrf9251dk/nrf9251/cpuppr
```

## tests/zephyr/drivers/audio/dmic_api/testcase.yaml
```yaml
tests:
  nrf.extended.drivers.audio.dmic_api:
    tags:
      - dmic
      - ci_tests_zephyr_drivers_audio_dmic_api
    harness: ztest
    depends_on:
      - future_target
```

## tests/zephyr/drivers/clock_control/clock_control_api/testcase.yaml
```yaml
common:
  tags:
    - drivers
    - clock_control
    - ci_tests_zephyr_drivers_clock_control
  platform_allow:
    - nrf54ls05dk@0.0.0/nrf54ls05b/cpuapp
    - nrf54ls05dk/nrf54ls05b/cpuapp
    - nrf54lv10dk/nrf54lv10a/cpuapp
    - nrf54lv10dk@0.2.0/nrf54lv10a/cpuapp
    - nrf7120pdk/nrf7120/cpuapp
  integration_platforms:
    - nrf54ls05dk/nrf54ls05b/cpuapp
    - nrf54lv10dk/nrf54lv10a/cpuapp
    - nrf7120pdk/nrf7120/cpuapp
  timeout: 30

tests:
  nrf.extended.drivers.clock.clock_control_nrf5: {}
  nrf.extended.drivers.clock.clock_control_nrf5_lfclk_rc:
    extra_args: EXTRA_CONF_FILE="nrf_lfclk_rc.conf"
```

## tests/zephyr/drivers/clock_control/nrf_clock_calibration/testcase.yaml
```yaml
tests:
  nrf.extended.drivers.clock.nrf5_clock_calibration:
    tags:
      - drivers
      - clock_control
      - ci_tests_zephyr_drivers_clock_control
    extra_configs:
      - CONFIG_CLOCK_CONTROL_NRF=n
      - CONFIG_CLOCK_CONTROL_NRFX_CALIBRATION_MAX_SKIP=1
      - CONFIG_CLOCK_CONTROL_NRFX_CALIBRATION_TEMP_DIFF=2
      - CONFIG_CLOCK_CONTROL_NRFX_CALIBRATION_PERIOD=150
      - CONFIG_CLOCK_CONTROL_NRFX_CALIBRATION_DEBUG=y
      - CONFIG_CLOCK_CONTROL_NRFX_CALIBRATION_LF_ALWAYS_ON=n
      - CONFIG_CLOCK_CONTROL_NRFX_USES_TEMP_SENSOR=n
    platform_allow:
      - nrf54ls05dk/nrf54ls05b/cpuapp
      - nrf54ls05dk@0.0.0/nrf54ls05b/cpuapp
      - nrf54ls05dk@0.2.0/nrf54ls05b/cpuapp
      - nrf54lv10dk/nrf54lv10a/cpuapp
      - nrf54lv10dk/nrf54lv10a/cpuapp/ns
    integration_platforms:
      - nrf54ls05dk/nrf54ls05b/cpuapp
    timeout: 30
    extra_args: EXTRA_DTC_OVERLAY_FILE="clock_calibration.overlay"

  nrf.extended.drivers.clock.nrf5_clock_calibration.legacy:
    tags:
      - drivers
      - clock_control
      - ci_tests_zephyr_drivers_clock_control
    extra_configs:
      - CONFIG_CLOCK_CONTROL_NRF=y
      - CONFIG_CLOCK_CONTROL_NRF_K32SRC_RC=y
      - CONFIG_CLOCK_CONTROL_NRF_CALIBRATION_MAX_SKIP=1
      - CONFIG_CLOCK_CONTROL_NRF_CALIBRATION_TEMP_DIFF=2
      - CONFIG_CLOCK_CONTROL_NRF_CALIBRATION_PERIOD=150
      - CONFIG_CLOCK_CONTROL_NRF_CALIBRATION_DEBUG=y
      - CONFIG_CLOCK_CONTROL_NRF_CALIBRATION_LF_ALWAYS_ON=n
      - CONFIG_CLOCK_CONTROL_NRF_USES_TEMP_SENSOR=n
    platform_allow:
      - nrf54ls05dk/nrf54ls05a/cpuapp
      - nrf54ls05dk/nrf54ls05b/cpuapp
      - nrf54lv10dk/nrf54lv10a/cpuapp
      - nrf54lv10dk/nrf54lv10a/cpuapp/ns
    integration_platforms:
      - nrf54ls05dk/nrf54ls05b/cpuapp
    timeout: 30
```
