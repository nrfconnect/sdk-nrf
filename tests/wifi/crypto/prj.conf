## CMakeLists.txt
```
# SPDX-License-Identifier: LicenseRef-Nordic-5-Clause

cmake_minimum_required(VERSION 3.20.0)
find_package(Zephyr REQUIRED HINTS $ENV{ZEPHYR_BASE})
project(nrf_wifi_crypto)

target_sources(app PRIVATE src/main.c)
```

## Kconfig
```
#
# Copyright (c) 2025 Nordic Semiconductor ASA
#
# SPDX-License-Identifier: LicenseRef-Nordic-5-Clause
#
source "Kconfig.zephyr"
```

## prj.conf
```kconfig
# Copyright (c) 2025 Nordic Semiconductor ASA
#
# SPDX-License-Identifier: LicenseRef-Nordic-5-Clause
#
CONFIG_ZTEST=y
CONFIG_ENTROPY_GENERATOR=y
# Disable the Wi-Fi driver
CONFIG_WIFI=n
CONFIG_WIFI_NRF70=n
CONFIG_TEST_RANDOM_GENERATOR=y

# Logging
CONFIG_LOG=y
CONFIG_LOG_MODE_IMMEDIATE=y

# IPC Service
CONFIG_IPC_SERVICE=y
CONFIG_SPSC_PBUF=y
CONFIG_MBOX=y
CONFIG_IPC_SERVICE_BACKEND_ICMSG=y
CONFIG_IPC_SERVICE_BACKEND_ICMSG_WQ_ENABLE=y
CONFIG_IPC_SERVICE_BACKEND_ICMSG_WQ_STACK_SIZE=5600

# Test configuration
CONFIG_ZTEST_STACK_SIZE=5600
CONFIG_MAIN_STACK_SIZE=4096

# Memory
CONFIG_HEAP_MEM_POOL_SIZE=16384

CONFIG_SOC_NRF71_WIFI_BOOT=y
CONFIG_NRF_WIFI_KMU=y
CONFIG_NRF_WIFI_KMU_SLOT_MIN=128
CONFIG_NRF_WIFI_KMU_NUM_SLOTS=52
```

## src/main.c
```c
/*
 * Copyright (c) 2025 Nordic Semiconductor ASA
 *
 * SPDX-License-Identifier: LicenseRef-Nordic-5-Clause
 */

#include <zephyr/kernel.h>
#include <zephyr/logging/log.h>
#include <zephyr/sys/printk.h>
#include <zephyr/ztest.h>
#include <string.h>
#include <stdint.h>
#include <stdbool.h>
#include <errno.h>
#include <wifi_kmu/wifi_kmu.h>

LOG_MODULE_REGISTER(wifi_crypto_test, LOG_LEVEL_DBG);

ZTEST(wifi_crypto, test_main)
{
	uint32_t slot;
	uint32_t ccmp256_key[8] = {0x0C0D0E0F, 0x08090A0B, 0x04050607, 0x00010203,
				   0xF2BDD52F, 0x514A8A19, 0xCE371185, 0xC97C1F67};
	wifi_kmu_key_type_t type;
	uint32_t db_id;
	uint32_t key_index;
	uint32_t key_length;
	uint32_t dest_address;
	int err;

	/* First, test slot index rotation */

	/* Starting slot is randomised so can't be tested easily.
	 * Immediately request maximum number of slots, to force it to start
	 * at the beginning.
	 */
	slot = wifi_kmu_get_next_slot(CONFIG_NRF_WIFI_KMU_NUM_SLOTS * 16);

	slot = wifi_kmu_get_next_slot(16);
	zassert_equal(slot, CONFIG_NRF_WIFI_KMU_SLOT_MIN);

	slot = wifi_kmu_get_next_slot(32);
	zassert_equal(slot, CONFIG_NRF_WIFI_KMU_SLOT_MIN + 1);

	slot = wifi_kmu_get_next_slot(32);
	zassert_equal(slot, CONFIG_NRF_WIFI_KMU_SLOT_MIN + 3);

	/* Jump ahead to test wrap around behaviour */
	slot = wifi_kmu_get_next_slot((CONFIG_NRF_WIFI_KMU_NUM_SLOTS - 6) * 16);
	zassert_equal(slot, CONFIG_NRF_WIFI_KMU_SLOT_MIN + 5);

	/* There should be one slot remaining now */
	slot = wifi_kmu_get_next_slot(16);
	zassert_equal(slot, CONFIG_NRF_WIFI_KMU_SLOT_MIN + CONFIG_NRF_WIFI_KMU_NUM_SLOTS - 1);
	slot = wifi_kmu_get_next_slot(16);
	zassert_equal(slot, CONFIG_NRF_WIFI_KMU_SLOT_MIN);

	/* Jump ahead again */
	slot = wifi_kmu_get_next_slot((CONFIG_NRF_WIFI_KMU_NUM_SLOTS - 2) * 16);
	zassert_equal(slot, CONFIG_NRF_WIFI_KMU_SLOT_MIN + 1);

	/* Try to allocate 2 slots with only one slot remaining */
	slot = wifi_kmu_get_next_slot(32);
	zassert_equal(slot, CONFIG_NRF_WIFI_KMU_SLOT_MIN);

	/* Next, test actual encryption */
	type = PEER_UCST_ENC;
	db_id = 0;
	key_index = 0;
	key_length = wifi_kmu_get_key_size_in_bytes(type);

	dest_address = wifi_kmu_get_key_start_addr(type, db_id, key_index);
	zassert_not_equal(dest_address, wifi_kmu_key_addr_invalid);

	err = wifi_kmu_write_key(slot, dest_address, (uint8_t *)ccmp256_key, key_length);
	zassert_equal(err, 0);

	*(volatile uint32_t *)0x48086C04 = 1; /* NRF_WIFICORE_RPUSYS->EDCPERIP.EDCGPIO1OUT */
	while (*(volatile uint32_t *)0x48086C00 !=
	       2) { /* NRF_WIFICORE_RPUSYS->EDCPERIP.EDCGPIO0OUT */
	}
}

ZTEST_SUITE(wifi_crypto, NULL, NULL, NULL, NULL, NULL);
```
