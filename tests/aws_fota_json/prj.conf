## CMakeLists.txt
```
#
# Copyright (c) 2019 Nordic Semiconductor
#
# SPDX-License-Identifier: LicenseRef-BSD-5-Clause-Nordic
#

cmake_minimum_required(VERSION 3.13.1)
include($ENV{ZEPHYR_BASE}/cmake/app/boilerplate.cmake NO_POLICY_SCOPE)
project(json)

FILE(GLOB app_sources src/*.c)
target_sources(app PRIVATE ${app_sources})

target_sources(app
  PRIVATE
  ${ZEPHYR_BASE}/../nrf/subsys/net/lib/aws_fota/src/aws_fota_json.c
  )

target_include_directories(app
  PRIVATE
  ${ZEPHYR_BASE}/../nrf/subsys/net/lib/aws_fota/include/
  )

# Do this in a non-standard way as the Kconfig options of "aws_jobs/Kconfig"
# is not executed. Hence these can not be set through prj.conf.
target_compile_options(app
  PRIVATE
  -DCONFIG_AWS_FOTA_HOSTNAME_MAX_LEN=1024
  -DCONFIG_AWS_FOTA_FILE_PATH_MAX_LEN=1024
  )
```

## prj.conf
```kconfig
CONFIG_ZTEST=y
CONFIG_JSON_LIBRARY=y
CONFIG_ZTEST_STACKSIZE=4096
CONFIG_HEAP_MEM_POOL_SIZE=4096
CONFIG_HW_STACK_PROTECTION=y
```

## src/main.c
```c
/*
 * Copyright (c) 2019 Nordic Semiconductor ASA
 *
 * SPDX-License-Identifier: LicenseRef-BSD-5-Clause-Nordic
 */
#include <string.h>
#include <zephyr/types.h>
#include <stdbool.h>
#include <ztest.h>
#include <aws_fota_json.h>

static void test_notify_next(void)
{
	char expected_job_id[] = "9b5caac6-3e8a-45dd-9273-c1b995762f4a";
	char expected_hostname[] = "fota-update-bucket.s3.eu-central-1.amazonaws.com";
	char expected_file_path[] = "/update.bin?X-Amz-Algorithm=AWS4-HMAC-SHA256&X-Amz-Credential=AKIAWXEL53DXIU7W72AE%2F20190606%2Feu-central-1%2Fs3%2Faws4_request&X-Amz-Date=20190606T081505Z&X-Amz-Expires=604800&X-Amz-Signature=913e00b97efe5565a901df4ff0b87e4878a406941d711f59d45915035989adcc&X-Amz-SignedHeaders=host";

	char encoded[] = "{\"timestamp\":1559808907,\"execution\":{\"jobId\":\"9b5caac6-3e8a-45dd-9273-c1b995762f4a\",\"status\":\"QUEUED\",\"queuedAt\":1559808906,\"lastUpdatedAt\":1559808906,\"versionNumber\":1,\"executionNumber\":1,\"jobDocument\":{\"operation\":\"app_fw_update\",\"fwversion\":\"2\",\"size\":181124,\"location\":{\"protocol\":\"https:\",\"host\":\"fota-update-bucket.s3.eu-central-1.amazonaws.com\",\"path\":\"/update.bin?X-Amz-Algorithm=AWS4-HMAC-SHA256&X-Amz-Credential=AKIAWXEL53DXIU7W72AE%2F20190606%2Feu-central-1%2Fs3%2Faws4_request&X-Amz-Date=20190606T081505Z&X-Amz-Expires=604800&X-Amz-Signature=913e00b97efe5565a901df4ff0b87e4878a406941d711f59d45915035989adcc&X-Amz-SignedHeaders=host\"}}}}";
	int ret;
	char job_id[100];
	char hostname[100];
	char file_path[1000];

	/* Memset to ensure correct null-termination */
	memset(job_id, 0xff, sizeof(job_id));
	memset(hostname, 0xff, sizeof(hostname));
	memset(file_path, 0xff, sizeof(file_path));

	ret = aws_fota_parse_notify_next_document(encoded, sizeof(encoded) - 1,
			job_id, hostname, file_path);

	zassert_true(!strcmp(job_id, expected_job_id), NULL);
	zassert_true(!strcmp(hostname, expected_hostname), NULL);
	zassert_true(!strcmp(file_path, expected_file_path), NULL);
}

static void test_timestamp_only(void)
{
	int ret;
	char job_id[100];
	char hostname[100];
	char file_path[100];
	char encoded[] = "{\"timestamp\":1559808907}";

	ret = aws_fota_parse_notify_next_document(encoded, sizeof(encoded) - 1,
			job_id, hostname, file_path);

	zassert_equal(ret, 1,
		     "Timestamp decoded correctly");
}

static void test_update_job_exec_rsp_minimal(void)
{
	char encoded[] = "{\"timestamp\":4096,\"clientToken\":\"token\"}";
	char status[100];
	int ret;

	ret = aws_fota_parse_update_job_exec_state_rsp(encoded,
			sizeof(encoded) - 1, status);

	/* Only two last fields are set */
	zassert_equal(ret, 0b11000, "All fields decoded correctly");
}

static void test_update_job_exec_rsp(void)
{
	char expected_status[] = "IN_PROGRESS";
	char encoded[] = "{\"status\":\"IN_PROGRESS\",\"statusDetails\":{\"nextState\":\"download_firmware\"},\"expectedVersion\":\"1\",\"clientToken\": \"\"}";
	char status[100];
	int ret;

	memset(status, 0xff, sizeof(status));

	ret = aws_fota_parse_update_job_exec_state_rsp(encoded,
			sizeof(encoded) - 1, status);
	zassert_true(!strcmp(status, expected_status), NULL);
}


void test_main(void)
{
	ztest_test_suite(lib_json_test,
			 ztest_unit_test(test_update_job_exec_rsp_minimal),
			 ztest_unit_test(test_update_job_exec_rsp),
			 ztest_unit_test(test_timestamp_only),
			 ztest_unit_test(test_notify_next)
			 );

	ztest_run_test_suite(lib_json_test);
}
```
