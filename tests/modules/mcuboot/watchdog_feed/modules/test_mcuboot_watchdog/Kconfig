## tests/modules/mcuboot/watchdog_feed/modules/test_mcuboot_watchdog/Kconfig
```kconfig
#
# Copyright (c) 2026 Nordic Semiconductor
#
# SPDX-License-Identifier: LicenseRef-Nordic-5-Clause
#

config TEST_MCUBOOT_WATCHDOG
	bool "Enable test watchdog"

if TEST_MCUBOOT_WATCHDOG

config TEST_MCUBOOT_WATCHDOG_MAX_WINDOW_MS
	int "Maximum timeout window (e.g., 2000ms)"
	default 2000

config TEST_MCUBOOT_WATCHDOG_MIN_WINDOW_MS
	int "Minimum timeout window"
	default 0

config TEST_MCUBOOT_WATCHDOG_USE_MCUBOOT_STARTUP_DELAYS
	bool "Add a delay whenever MCUBoot status changes"
	select MCUBOOT_ACTION_HOOKS
	help
	  This adds two delays - one, before MCUBoot starts, and one,
	  when MCUBoot status changes to STARTUP.
	  If CONFIG_BOOT_WATCHDOG_FEED is enabled,
	  the watchdog should be fed in between these two delays.

if TEST_MCUBOOT_WATCHDOG_USE_MCUBOOT_STARTUP_DELAYS

config TEST_MCUBOOT_WATCHDOG_STARTUP_SINGLE_DELAY_TIME_MS
	int "Single delay time when MCUBoot status changes"
	default 1000

endif # TEST_MCUBOOT_WATCHDOG_USE_MCUBOOT_STARTUP_DELAYS

endif # TEST_MCUBOOT_WATCHDOG
```

## tests/modules/mcuboot/watchdog_feed/testcase.yaml
```yaml
tests:
  mcuboot.watchdog_feed:
    sysbuild: true
    tags:
      - mcuboot
      - sysbuild
      - ci_tests_modules_mcuboot
    platform_allow:
      - nrf54l15dk/nrf54l15/cpuapp
      - nrf54h20dk/nrf54h20/cpuapp
    integration_platforms:
      - nrf54l15dk/nrf54l15/cpuapp
      - nrf54h20dk/nrf54h20/cpuapp
```

## tests/nrf5340_audio/bt_le_audio_tx/Kconfig
```kconfig
config BT_BUF_EVT_RX_COUNT
	int
	default 10

config BT_BUF_ACL_TX_COUNT
	int
	default 5

config AUDIO_SAMPLE_RATE_48000_HZ
	bool
	default y

config BT_LE_AUDIO_TX_LOG_LEVEL
	int
	default 4

config AUDIO_DEV
	int
	default 1

config BT_CONN_TX_USER_DATA_SIZE
	int
	default 200

config BT_ISO_MAX_CIG
	int
	default 1

config BT_ISO_MAX_CHAN
	int
	default 2

config BT_ISO_TX_MTU
	int
	default 200


# Include Zephyr's Kconfig.
source "Kconfig"
```

## tests/nrf5340_audio/bt_le_audio_tx/testcase.yaml
```yaml
tests:
  nrf5340_audio.bt_le_audio_tx:
    sysbuild: true
    platform_allow: native_sim
    integration_platforms:
      - native_sim
    tags:
      - bt_le_audio_tx
      - nrf5340_audio_unit_tests
      - ci_tests_nrf5340_audio
```

## tests/nrf5340_audio/data_fifo/Kconfig
```kconfig
# Copyright (c) 2022 Nordic Semiconductor ASA
# SPDX-License-Identifier: LicenseRef-Nordic-5-Clause

module = DATA_FIFO
module-str = data-fifo
source "subsys/logging/Kconfig.template.log_config"

source "Kconfig.zephyr"
```

## tests/nrf5340_audio/lc3_file/testcase.yaml
```yaml
tests:
  nrf5340_audio.lc3_file:
    sysbuild: true
    platform_allow: qemu_cortex_m3
    integration_platforms:
      - qemu_cortex_m3
    tags: lc3_file nrf5340_audio_unit_tests sysbuild ci_tests_nrf5340_audio
```

## tests/nrf5340_audio/lc3_streamer/testcase.yaml
```yaml
tests:
  nrf5340_audio.lc3_streamer:
    sysbuild: true
    platform_allow: qemu_cortex_m3
    integration_platforms:
      - qemu_cortex_m3
    tags: lc3_streamer nrf5340_audio_unit_tests sysbuild ci_tests_nrf5340_audio
```

## tests/nrf5340_audio/macros/testcase.yaml
```yaml
tests:
  nrf5340_audio.macros_test:
    sysbuild: true
    platform_allow: qemu_cortex_m3
    integration_platforms:
      - qemu_cortex_m3
    tags: macros ignore_faults nrf5340_audio_unit_tests sysbuild
```

## tests/nrf5340_audio/max14690/testcase.yaml
```yaml
tests:
  nrf5340_audio.max14690_test:
    platform_allow: qemu_cortex_m3
    integration_platforms:
      - qemu_cortex_m3
    tags: max14690 nrf5340_audio_unit_tests
```

## tests/nrf5340_audio/pcm_stream_channel_modifier/Kconfig
```kconfig
# Copyright (c) 2022 Nordic Semiconductor ASA
# SPDX-License-Identifier: LicenseRef-Nordic-5-Clause

module = PSCM
module-str = pscm
source "subsys/logging/Kconfig.template.log_config"

source "Kconfig.zephyr"
```

## tests/nrf5340_audio/sd_card/testcase.yaml
```yaml
tests:
  nrf5340_audio.sd_card_test:
    sysbuild: true
    platform_allow: native_sim
    integration_platforms:
      - native_sim
    tags: macros nrf5340_audio_unit_tests sysbuild ci_tests_nrf5340_audio
    extra_args:
      - EXTRA_DTC_OVERLAY_FILE="ramdisk.overlay"
```

## tests/nrf5340_audio/server_store/Kconfig
```kconfig
# Copyright (c) 2025 Nordic Semiconductor ASA
# SPDX-License-Identifier: Apache-2.0

config BT_CONN
	bool
	default y

config BT_SMP
	bool
	default y

config BT_CENTRAL
	bool
	default y

config BT_MAX_CONN
	int
	default 5

config BT_MAX_PAIRED
	int
	default 5

config BT_ISO_CENTRAL
	bool
	default y

config BT_BAP_UNICAST
	bool
	default y

config BT_BAP_UNICAST_CLIENT
	bool
	default y

config BT_AUDIO_CODEC_CAP_MAX_DATA_SIZE
	int
	default 255

# REMOVABLE: Not used by server_store.c (only CAP_MAX_DATA_SIZE is referenced)
config BT_AUDIO_CODEC_CAP_MAX_METADATA_SIZE
	int
	default 255

# REMOVABLE: Unit tests don't transfer actual Bluetooth data; runtime buffers unnecessary
config BT_BUF_EVT_RX_COUNT
	int
	default 10

config BT_BUF_EVT_TX_COUNT
	int
	default 10

config BT_BUF_ACL_RX_COUNT
	int
	default 4

config BT_BUF_ACL_TX_COUNT
	int
	default 4

# REMOVABLE: Not referenced in server_store.c (only _CAP_ variants are used)
config BT_AUDIO_CODEC_CFG_MAX_DATA_SIZE
	int
	default 255

config BT_AUDIO_CODEC_CFG_MAX_METADATA_SIZE
	int
	default 255

config BT_BAP_UNICAST_CLIENT_ASE_SNK_COUNT
	int
	default 4

# REMOVABLE: Zephyr provides defaults; unnecessary for server_store unit tests
config BT_ISO_MAX_CIG
	int
	default 1

config BT_ISO_MAX_CHAN
	int
	default 6

config BT_BAP_UNICAST_CLIENT_GROUP_STREAM_COUNT
	int
	default 6

config BT_BAP_UNICAST_CLIENT_ASE_SRC_COUNT
	int
	default 4

config UNICAST_GROUP_STREAM_CNT
	int
	default 4

# REMOVABLE: Zephyr provides defaults; not specific to server_store testing
config BT_AUDIO_CODEC_LOG_LEVEL
	int
	default 2

config BT_AUDIO_LOG_LEVEL
	int
	default 2

config CODEC_CAP_COUNT_MAX
	int
	default 5

config BT_AUDIO_PREF_SINK_SAMPLE_RATE_VALUE
	int
	default 8

config BT_AUDIO_PREF_SOURCE_SAMPLE_RATE_VALUE
	int
	default 8

config AUDIO_SAMPLE_RATE_48000_HZ
	bool
	default y

config SERVER_STORE_LOG_LEVEL
	int
	default 4

config BLE_LOG_LEVEL
	int
	default 4

config LC3_BITRATE_MIN
	int
	default 32000

config LC3_BITRATE_MAX
	int
	default 124000

config AUDIO_FRAME_DURATION_US
	int
	default 10000

# Include Zephyr's Kconfig.
source "Kconfig"
source "subsys/bluetooth/audio/Kconfig"
source "subsys/bluetooth/Kconfig.logging"
```

## tests/nrf5340_audio/server_store/testcase.yaml
```yaml
tests:
  nrf5340_audio.server_store:
    sysbuild: true
    platform_allow:
      - native_sim
    integration_platforms:
      - native_sim
    tags:
      - server_store
      - sysbuild
      - ci_tests_nrf5340_audio
    timeout: 20
```

## tests/nrf5340_audio/sw_codec_lc3/testcase.yaml
```yaml
tests:
  nrf5340_audio.sw_codec_lc3_test:
    sysbuild: true
    platform_allow: nrf5340dk/nrf5340/cpuapp nrf5340_audio_dk/nrf5340/cpuapp
    integration_platforms:
      - nrf5340dk/nrf5340/cpuapp
      - nrf5340_audio_dk/nrf5340/cpuapp
    tags: sw_codec_lc3 sysbuild
    timeout: 20
```

## tests/nrf5340_audio/tone/testcase.yaml
```yaml
tests:
  nrf5340_audio.tone_test:
    platform_allow: qemu_cortex_m3
    integration_platforms:
      - qemu_cortex_m3
    tags: tone nrf5340_audio_unit_tests
```

## tests/nrf5340_audio/unicast_client_internal/testcase.yaml
```yaml
tests:
  nrf5340_audio.unicast_client_internal:
    sysbuild: true
    platform_allow:
      - native_sim
    integration_platforms:
      - native_sim
    tags:
      - unicast_client_internal
      - sysbuild
      - ci_tests_nrf5340_audio
    timeout: 20
```

## tests/nrf_audio/bt_le_audio_tx/Kconfig
```kconfig
config NRF_AUDIO_TX_LEAD_TIME_TGT_US
	int
	default 2500

config NRF_AUDIO_TX_LEAD_TIME_MIN_US
	int
	default 2000

config NRF_AUDIO_TX_LEAD_TIME_BASE_US
	int
	default 4700

config LC3_BITRATE_MIN
	int
	default 32000

config LC3_BITRATE_MAX
	int
	default 124000

config AUDIO_FRAME_DURATION_US
	int
	default 10000

config AUDIO_SAMPLE_RATE_48000_HZ
	bool
	default y

config BLE_LOG_LEVEL
	int
	default 4

config BT_LE_AUDIO_TX_LOG_LEVEL
	int
	default 4

config BT_BUF_EVT_RX_COUNT
	int
	default 10

config BT_BUF_ACL_TX_COUNT
	int
	default 5

config BT_CONN_TX_USER_DATA_SIZE
	int
	default 200

config BT_ISO_MAX_CIG
	int
	default 1

config BT_ISO_MAX_CHAN
	int
	default 3

config BT_ISO_TX_MTU
	int
	default 200

config BT_AUDIO_CODEC_CFG_MAX_DATA_SIZE
	int
	default 200

config BT_AUDIO_CODEC_CFG_MAX_METADATA_SIZE
	int
	default 200

config BT_TX_PROCESSOR_THREAD
	bool
	default y

config BT_TX_PROCESSOR_THREAD_PRIO
	int
	default -1

config AUDIO_SYNC_TIMER_USES_RTC
	bool
	default y

# Include Zephyr's Kconfig.
source "Kconfig"
```

## tests/nrf_audio/lc3_streamer/testcase.yaml
```yaml
tests:
  nrf_audio.lc3_streamer:
    sysbuild: true
    platform_allow: qemu_cortex_m3
    integration_platforms:
      - qemu_cortex_m3
    tags:
      - lc3_streamer
      - nrf_audio_unit_tests
      - sysbuild
      - ci_tests_nrf_audio
```

## tests/nrf_audio/macros/testcase.yaml
```yaml
tests:
  nrf_audio.macros_test:
    sysbuild: true
    platform_allow: qemu_cortex_m3
    integration_platforms:
      - qemu_cortex_m3
    tags:
      - macros
      - ignore_faults
      - nrf_audio_unit_tests
      - sysbuild
      - ci_tests_nrf_audio
```

## tests/nrf_audio/sd_card/Kconfig
```kconfig
# Temporary Kconfig file for SD card module

module = MODULE_SD_CARD
module-str = module-sd-card
source "subsys/logging/Kconfig.template.log_config"

source "Kconfig.zephyr"
```

## tests/nrf_audio/sd_card/testcase.yaml
```yaml
tests:
  nrf_audio.sd_card_test:
    sysbuild: true
    platform_allow: native_sim
    integration_platforms:
      - native_sim
    tags:
      - macros
      - nrf_audio_unit_tests
      - sysbuild
      - ci_tests_nrf_audio
    extra_args:
      - EXTRA_DTC_OVERLAY_FILE="ramdisk.overlay"
```

## tests/psa/testcase.yaml
```yaml
tests:
  psa.its.zephyr_backend:
    tags: tfm ci_build
    platform_allow: nrf52840dk_nrf52840
```

## tests/psa_crypto/testcase.yaml
```yaml
tests:
  crypto.cracen:
    sysbuild: true
    platform_allow:
      - nrf54l15dk/nrf54l15/cpuapp
      - nrf54l15dk/nrf54l15/cpuapp/ns
      - nrf7120dk/nrf7120/cpuapp

    tags:
      - tfm
      - psa_crypto
      - sysbuild
      - ci_tests_tfm
    integration_platforms:
      - nrf54l15dk/nrf54l15/cpuapp
      - nrf54l15dk/nrf54l15/cpuapp/ns
      - nrf7120dk/nrf7120/cpuapp
```

## tests/samples/bluetooth/samples_test_app/Kconfig.sysbuild
```kconfig
#
# Copyright (c) 2023 Nordic Semiconductor
#
# SPDX-License-Identifier: LicenseRef-Nordic-5-Clause
#

config PARTITION_MANAGER
	default n

config NRF_DEFAULT_IPC_RADIO
	default y

source "${ZEPHYR_BASE}/share/sysbuild/Kconfig"
```

## tests/sdp/app_fault_timer/Kconfig
```kconfig
#
# Copyright (c) 2025 Nordic Semiconductor ASA
#
# SPDX-License-Identifier: LicenseRef-Nordic-5-Clause
#

source "Kconfig.zephyr"
```
