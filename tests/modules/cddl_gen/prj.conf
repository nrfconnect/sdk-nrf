## CMakeLists.txt
```
#
# Copyright (c) 2020 Nordic Semiconductor
#
# SPDX-License-Identifier: LicenseRef-BSD-5-Clause-Nordic
#

cmake_minimum_required(VERSION 3.13.1)

find_package(Zephyr REQUIRED HINTS $ENV{ZEPHYR_BASE})
project(cddl_gen_decode)

target_sources(app PRIVATE src/main.c src/pet_decode.c src/pet_encode.c)
target_include_directories(app PRIVATE include)
```

## prj.conf
```kconfig
#
# Copyright (c) 2020 Nordic Semiconductor ASA
#
# SPDX-License-Identifier: LicenseRef-BSD-5-Clause-Nordic
#
CONFIG_ZTEST=y
CONFIG_CDDL_GEN=y
```

## src/main.c
```c
/*
 * Copyright (c) 2020 Nordic Semiconductor ASA
 *
 * SPDX-License-Identifier: LicenseRef-BSD-5-Clause-Nordic
 */

#include <string.h>
#include <zephyr/types.h>
#include <stdbool.h>
#include <ztest.h>

#include <pet_decode.h>

uint8_t buf[1024];

static void test_decode(void)
{
	/* Only for compilation testing */
	cbor_decode_Pet(NULL, 0, NULL, true);
	zassert_true(true, NULL);
}

void test_main(void)
{
	ztest_test_suite(lib_cddl_gen_test,
			 ztest_unit_test(test_decode)
			 );

	ztest_run_test_suite(lib_cddl_gen_test);
}
```

## include/pet_decode.h
```c
/* Generated with cddl_gen.py (https://github.com/oyvindronningstad/cddl_gen)
 */

#ifndef PET_DECODE_H__
#define PET_DECODE_H__

#include <stdint.h>
#include <stdbool.h>
#include <stddef.h>
#include <string.h>
#include "cbor_decode.h"
#include "types_pet_decode.h"



bool cbor_decode_Pet(
		const uint8_t * p_payload, size_t payload_len,
		Pet_t * p_result,
		bool complete);


#endif // PET_DECODE_H__
```

## include/pet_encode.h
```c
/* Generated with cddl_gen.py (https://github.com/oyvindronningstad/cddl_gen)
 */

#ifndef PET_ENCODE_H__
#define PET_ENCODE_H__

#include <stdint.h>
#include <stdbool.h>
#include <stddef.h>
#include <string.h>
#include "cbor_encode.h"
#include "types_pet_encode.h"



bool cbor_encode_Pet(
		uint8_t * p_payload, size_t payload_len,
		const Pet_t * p_input,
		size_t *p_payload_len_out);


#endif // PET_ENCODE_H__
```

## include/types_pet_decode.h
```c
/* Generated with cddl_gen.py (https://github.com/oyvindronningstad/cddl_gen)
 */

#ifndef TYPES_PET_DECODE_H__
#define TYPES_PET_DECODE_H__

#include <stdint.h>
#include <stdbool.h>
#include <stddef.h>
#include <string.h>
#include "cbor_decode.h"


typedef struct {
	cbor_string_type_t _Pet_name_tstr[3];
	size_t _Pet_name_tstr_count;
	cbor_string_type_t _Pet_birthday;
	union {
		uint32_t _Pet_species_cat;
		uint32_t _Pet_species_dog;
		uint32_t _Pet_species_other;
	};
	enum {
		_Pet_species_cat,
		_Pet_species_dog,
		_Pet_species_other,
	} _Pet_species_choice;
} Pet_t;


#endif // TYPES_PET_DECODE_H__
```

## include/types_pet_encode.h
```c
/* Generated with cddl_gen.py (https://github.com/oyvindronningstad/cddl_gen)
 */

#ifndef TYPES_PET_ENCODE_H__
#define TYPES_PET_ENCODE_H__

#include <stdint.h>
#include <stdbool.h>
#include <stddef.h>
#include <string.h>
#include "cbor_encode.h"


typedef struct {
	cbor_string_type_t _Pet_name_tstr[3];
	size_t _Pet_name_tstr_count;
	cbor_string_type_t _Pet_birthday;
	union {
		uint32_t _Pet_species_cat;
		uint32_t _Pet_species_dog;
		uint32_t _Pet_species_other;
	};
	enum {
		_Pet_species_cat,
		_Pet_species_dog,
		_Pet_species_other,
	} _Pet_species_choice;
} Pet_t;


#endif // TYPES_PET_ENCODE_H__
```

## src/pet_decode.c
```c
/* Generated with cddl_gen.py (https://github.com/oyvindronningstad/cddl_gen)
 */

#include <stdint.h>
#include <stdbool.h>
#include <stddef.h>
#include <string.h>
#include "cbor_decode.h"
#include "pet_decode.h"


static bool decode_Pet(
		cbor_state_t *p_state, Pet_t * p_result)
{
	cbor_print("decode_Pet\n");
	bool int_res;

	bool result = (((list_start_decode(p_state) && (int_res = (((list_start_decode(p_state) && (int_res = (multi_decode(1, 3, &(*p_result)._Pet_name_tstr_count, (void*)tstrx_decode, p_state, (&(*p_result)._Pet_name_tstr), sizeof(cbor_string_type_t))), ((list_end_decode(p_state)) && int_res))))
	&& ((bstrx_decode(p_state, (&(*p_result)._Pet_birthday))))
	&& ((union_start_code(p_state) && (int_res = ((((uintx32_expect_union(p_state, (1)))) && (((*p_result)._Pet_species_choice = _Pet_species_cat) || 1))
	|| (((uintx32_expect_union(p_state, (2)))) && (((*p_result)._Pet_species_choice = _Pet_species_dog) || 1))
	|| (((uintx32_expect_union(p_state, (3)))) && (((*p_result)._Pet_species_choice = _Pet_species_other) || 1))), union_end_code(p_state), int_res)))), ((list_end_decode(p_state)) && int_res)))));

	if (!result)
	{
		cbor_trace();
	}

	return result;
}



bool cbor_decode_Pet(
		const uint8_t * p_payload, size_t payload_len,
		Pet_t * p_result,
		bool complete)
{
	cbor_state_t state = {
		.p_payload = p_payload,
		.p_payload_end = p_payload + payload_len,
		.elem_count = 1
	};

	cbor_state_t state_backups[3];

	cbor_state_backups_t backups = {
		.p_backup_list = state_backups,
		.current_backup = 0,
		.num_backups = 3,
	};

	state.p_backups = &backups;

	bool result = decode_Pet(&state, p_result);

	if (!complete) {
		return result;
	}
	if (result) {
		if (state.p_payload == state.p_payload_end) {
			return true;
		} else {
			cbor_state_t *p_state = &state; // for printing.
			cbor_print("p_payload_end: 0x%x\r\n", (uint32_t)state.p_payload_end);
			cbor_trace();
		}
	}
	return false;
}
```

## src/pet_encode.c
```c
/* Generated with cddl_gen.py (https://github.com/oyvindronningstad/cddl_gen)
 */

#include <stdint.h>
#include <stdbool.h>
#include <stddef.h>
#include <string.h>
#include "cbor_encode.h"
#include "pet_encode.h"


static bool encode_Pet(
		cbor_state_t *p_state, const Pet_t * p_input)
{
	cbor_print("encode_Pet\n");
	uint32_t tmp_value;
	bool int_res;

	bool result = (((list_start_encode(p_state, 3) && (int_res = (((list_start_encode(p_state, 3) && (int_res = (multi_encode(1, 3, &(*p_input)._Pet_name_tstr_count, (void*)tstrx_encode, p_state, (&(*p_input)._Pet_name_tstr), sizeof(cbor_string_type_t))), ((list_end_encode(p_state, 3)) && int_res))))
	&& ((bstrx_encode(p_state, (&(*p_input)._Pet_birthday))))
	&& ((((*p_input)._Pet_species_choice == _Pet_species_cat) ? ((uintx32_encode(p_state, ((tmp_value=1, &tmp_value)))))
	: (((*p_input)._Pet_species_choice == _Pet_species_dog) ? ((uintx32_encode(p_state, ((tmp_value=2, &tmp_value)))))
	: (((*p_input)._Pet_species_choice == _Pet_species_other) ? ((uintx32_encode(p_state, ((tmp_value=3, &tmp_value)))))
	: false))))), ((list_end_encode(p_state, 3)) && int_res)))));

	if (!result)
	{
		cbor_trace();
	}

	return result;
}



bool cbor_encode_Pet(
		uint8_t * p_payload, size_t payload_len,
		const Pet_t * p_input,
		size_t *p_payload_len_out)
{
	cbor_state_t state = {
		.p_payload = p_payload,
		.p_payload_end = p_payload + payload_len,
		.elem_count = 1
	};

	cbor_state_t state_backups[3];

	cbor_state_backups_t backups = {
		.p_backup_list = state_backups,
		.current_backup = 0,
		.num_backups = 3,
	};

	state.p_backups = &backups;

	bool result = encode_Pet(&state, p_input);

	if (p_payload_len_out != NULL) {
		*p_payload_len_out = ((size_t)state.p_payload - (size_t)p_payload);
	}
	return result;
}
```
