## CMakeLists.txt
```
#
# Copyright (c) 2021 Nordic Semiconductor
#
# SPDX-License-Identifier: LicenseRef-Nordic-5-Clause
#

cmake_minimum_required(VERSION 3.20.0)

find_package(Zephyr REQUIRED HINTS $ENV{ZEPHYR_BASE})
project(test_cddl_gen)

FILE(GLOB app_sources src/*.c)
target_sources(app PRIVATE ${app_sources})

set(py_command
  cddl-gen
  -c ${CMAKE_CURRENT_LIST_DIR}/test.cddl
  code
  --output-cmake ${PROJECT_BINARY_DIR}/test.cmake
  -t Test
  -e
  )

execute_process(
  COMMAND ${py_command}
  COMMAND_ERROR_IS_FATAL ANY
  )

include(${PROJECT_BINARY_DIR}/test.cmake)

target_link_libraries(test PRIVATE zephyr_interface)
target_link_libraries(app PRIVATE test)
```

## prj.conf
```kconfig
#
# Copyright (c) 2021 Nordic Semiconductor ASA
#
# SPDX-License-Identifier: LicenseRef-Nordic-5-Clause
#
CONFIG_ZTEST=y
CONFIG_CDDL_GEN=y
```

## src/main.c
```c
/*
 * Copyright (c) 2021 Nordic Semiconductor ASA
 *
 * SPDX-License-Identifier: LicenseRef-Nordic-5-Clause
 */
#include <ztest.h>
#include "test_encode.h"

static void test_encode(void)
{
	struct Test test;

	zassert_true(&test != NULL, "Should not be NULL");
}

void test_main(void)
{
	ztest_test_suite(lib_cddl_gen_test,
	     ztest_unit_test(test_encode)
	 );

	ztest_run_test_suite(lib_cddl_gen_test);
}
```
