## CMakeLists.txt
```
#
# Copyright (c) 2021 Nordic Semiconductor
#
# SPDX-License-Identifier: LicenseRef-Nordic-5-Clause
#

cmake_minimum_required(VERSION 3.20.0)

find_package(Zephyr REQUIRED HINTS $ENV{ZEPHYR_BASE})
project(test_zcbor_raw_encode)

FILE(GLOB app_sources src/*.c)
target_sources(app PRIVATE ${app_sources})
```

## prj.conf
```kconfig
#
# Copyright (c) 2021-2023 Nordic Semiconductor ASA
#
# SPDX-License-Identifier: LicenseRef-Nordic-5-Clause
#
CONFIG_ZTEST=y
CONFIG_ZCBOR=y
```

## src/main.c
```c
/*
 * Copyright (c) 2021 Nordic Semiconductor ASA
 *
 * SPDX-License-Identifier: LicenseRef-Nordic-5-Clause
 */
#include <zephyr/ztest.h>
#include <zcbor_encode.h>

ZTEST(lib_zcbor_test3, test_raw_encode)
{
	uint8_t payload[32] = {0};
	uint8_t time[] = {1, 2, 3, 4, 5, 6, 7, 8};

	ZCBOR_STATE_E(states, 4, payload, sizeof(payload), 1);
	bool res;

	res = zcbor_list_start_encode(states, 3);
	res |= zcbor_list_start_encode(states, 2);
	res |= zcbor_tstr_put_lit(states, "Foo");
	res |= zcbor_tstr_put_lit(states, "Bar");
	res |= zcbor_list_end_encode(states, 0);
	res |= zcbor_bstr_put_arr(states, time);
	res |= zcbor_int32_put(states, 2);
	res |= zcbor_list_end_encode(states, 0);

	zassert_true(res, "Encoding should have been successful\n");
}

ZTEST_SUITE(lib_zcbor_test3, NULL, NULL, NULL, NULL, NULL);
```
