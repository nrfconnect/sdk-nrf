## tests/nrf_audio/rate_ctrl/testcase.yaml
```yaml
tests:
  nrf_audio.rate_control_test:
    sysbuild: true
    platform_allow: qemu_cortex_m3
    integration_platforms:
      - qemu_cortex_m3
    tags:
      - rate_control
      - sysbuild
      - ci_tests_nrf_audio
```

## tests/nrf_audio/regulator/Kconfig
```kconfig
#
# Copyright (c) 2026 Nordic Semiconductor ASA
#
# SPDX-License-Identifier: LicenseRef-Nordic-5-Clause
#

module = NRF_AUDIO_MODULE_REGULATOR
module-str = module-regulator
source "subsys/logging/Kconfig.template.log_config"

source "Kconfig.zephyr"
```

## tests/nrf_audio/regulator/testcase.yaml
```yaml
tests:
  nrf_audio.regulator_test:
    sysbuild: true
    platform_allow: qemu_cortex_m3
    integration_platforms:
      - qemu_cortex_m3
    tags:
      - regulator
      - sysbuild
      - ci_tests_nrf_audio
```

## tests/nrf_audio/sw_codec_g722/Kconfig
```kconfig
#
# SPDX-License-Identifier: LicenseRef-Nordic-5-Clause
#

config SW_CODEC_G722
	bool
	default y

config SW_CODEC_G722_COMPANY_ID
	hex
	default 0

config SW_CODEC_G722_VENDOR_CODEC_ID
	hex
	default 1

config AUDIO_SAMPLE_RATE_48000_HZ
	bool
	default y

config AUDIO_SAMPLE_RATE_HZ
	int
	default 48000

config AUDIO_BIT_DEPTH_BITS
	int
	default 16

config AUDIO_BIT_DEPTH_OCTETS
	int
	default 2

config AUDIO_FRAME_DURATION_US
	int
	default 10000

config AUDIO_ENCODE_CHANNELS_MAX
	int
	default 2

config AUDIO_DECODE_CHANNELS_MAX
	int
	default 2

config AUDIO_INPUT_CHANNELS
	int
	default 2

config AUDIO_OUTPUT_CHANNELS
	int
	default 2

config SW_CODEC_SELECT_LOG_LEVEL
	int
	default 3

config BLE_LOG_LEVEL
	int
	default 3

config SERVER_STORE_LOG_LEVEL
	int
	default 3

config CODEC_CAP_COUNT_MAX
	int
	default 5

config BT_AUDIO_PREF_SINK_SAMPLE_RATE_VALUE
	hex
	default 8

config BT_AUDIO_PREF_SOURCE_SAMPLE_RATE_VALUE
	hex
	default 8

config LC3_BITRATE_MIN
	int
	default 32000

config LC3_BITRATE_MAX
	int
	default 124000

config MONO_TO_ALL_RECEIVERS
	bool "Duplicate mono input to all output channels"
	default n

source "Kconfig"
```

## tests/samples/bluetooth/io_adapter/sample.yaml
```yaml
sample:
  description: Application for controlling gpios in Bluetooth Samples tests
  name: IO Adapter
tests:
  sample.bluetooth.io_adapter:
    sysbuild: true
    integration_platforms:
      - nrf5340dk/nrf5340/cpuapp
      - nrf54h20dk/nrf54h20/cpuapp
      - nrf54l15dk/nrf54l15/cpuapp
    platform_allow:
      - nrf5340dk/nrf5340/cpuapp
      - nrf54h20dk/nrf54h20/cpuapp
      - nrf54l15dk/nrf54l15/cpuapp
    tags:
      - bluetooth
      - ci_build
      - sysbuild
      - ci_tests_samples_bluetooth
    harness: console
    harness_config:
      type: multi_line
      ordered: true
      regex:
        - "Booting nRF Connect SDK"
```

## tests/samples/bluetooth/samples_test_app/sample.yaml
```yaml
sample:
  description: Appl with central role for testing basic Bluetooth functionality in BLE samples
  name: BLE Samples Test App
tests:
  sample.bluetooth.ble_samples_test_app:
    sysbuild: true
    harness: bluetooth
    integration_platforms:
      - nrf5340dk/nrf5340/cpuapp
      - nrf54h20dk/nrf54h20/cpuapp
      - nrf54l15dk/nrf54l15/cpuapp
    platform_allow:
      - nrf5340dk/nrf5340/cpuapp
      - nrf54h20dk/nrf54h20/cpuapp
      - nrf54l15dk/nrf54l15/cpuapp
    tags:
      - bluetooth
      - ci_build
      - sysbuild
      - ci_tests_samples_bluetooth
```

## tests/subsys/bluetooth/fast_pair/storage/factory_reset/boards/nrf54l15dk_nrf54l15_cpuapp.conf
```kconfig
#
# Copyright (c) 2026 Nordic Semiconductor ASA
#
# SPDX-License-Identifier: LicenseRef-Nordic-5-Clause
#

CONFIG_ZTEST_STACK_SIZE=2048
```

## tests/subsys/bluetooth/gatt_dm/testcase.yaml
```yaml
tests:
  bluetooth.gatt_dm:
    sysbuild: true
    platform_allow:
      - native_sim
      - nrf54l15dk/nrf54l15/cpuapp
    integration_platforms:
      - native_sim
      - nrf54l15dk/nrf54l15/cpuapp
    tags:
      - discovery_manager
      - sysbuild
      - bluetooth
      - ci_tests_subsys_bluetooth_gatt_dm
```

## tests/subsys/bluetooth/mesh/rpl/Kconfig
```kconfig
#
# Copyright (c) 2026 Nordic Semiconductor ASA
#
# SPDX-License-Identifier: LicenseRef-Nordic-5-Clause
#

config RPL_UNIT_TEST
	bool
	default y

config BT_MESH_CRPL
	int
	depends on RPL_UNIT_TEST
	default 8

config BT_MESH_RPL_STORE_TIMEOUT
	int
	depends on RPL_UNIT_TEST
	default 5

choice BT_MESH_RPL_STORAGE_MODE
	prompt "Replay protection list storage mode"
	default BT_MESH_RPL_STORAGE_MODE_ZMS if RPL_UNIT_TEST

config BT_MESH_RPL_STORAGE_MODE_ZMS
	bool "Persistent storage of RPL in Zephyr Memory Storage"
	depends on RPL_UNIT_TEST

endchoice

config BT_LOG_LEVEL
	int
	depends on RPL_UNIT_TEST
	default 0 if RPL_UNIT_TEST

source "Kconfig.zephyr"
```

## tests/subsys/bluetooth/mesh/rpl/testcase.yaml
```yaml
tests:
  bluetooth.mesh.rpl.ncs:
    platform_allow:
      - native_sim
    tags:
      - bluetooth
      - mesh
      - ci_tests_subsys_bluetooth_mesh
    integration_platforms:
      - native_sim
```

## tests/subsys/bootloader/bl_crypto/Kconfig
```kconfig
#
# Copyright (c) 2026 Nordic Semiconductor ASA
#
# SPDX-License-Identifier: LicenseRef-Nordic-5-Clause
#

if SOC_SERIES_NRF52 || SOC_SERIES_NRF53 || SOC_SERIES_NRF91

config SECURE_BOOT
	bool
	default y

config BL_ROT_VERIFY_EXT_API_AT_LEAST_REQUIRED
	default y

choice SB_CRYPTO_HASH
	default  SB_CRYPTO_CLIENT_SHA256
endchoice

choice SB_CRYPTO_SIG
	default  SB_CRYPTO_CLIENT_ECDSA_SECP256R1
endchoice

# To test FW_INFO_PROVIDE_EXT_API.
config BOOTLOADER_MCUBOOT
	bool
	default y

config FW_INFO
	bool
	default y

endif

if SOC_SERIES_NRF54L

choice SB_CRYPTO_SIG
	default SB_CRYPTO_CC310_ECDSA_SECP256R1 if HAS_HW_NRF_CC310
	default SB_CRYPTO_OBERON_ECDSA_SECP256R1
endchoice

choice SB_CRYPTO_HASH
	prompt "Hashing Implementation"
	default SB_CRYPTO_NONE if SB_CRYPTO_PSA_ED25519
	default SB_CRYPTO_CC310_SHA256 if HAS_HW_NRF_CC310
	default SB_CRYPTO_OBERON_SHA256
endchoice

endif

source "Kconfig.zephyr"
```

## tests/subsys/bootloader/bl_crypto/Kconfig.sysbuild
```kconfig
#
# Copyright (c) 2026 Nordic Semiconductor
#
# SPDX-License-Identifier: LicenseRef-Nordic-5-Clause
#

config SECURE_BOOT_APPCORE
	default y if SOC_SERIES_NRF52 || SOC_SERIES_NRF53 || SOC_SERIES_NRF91

config SECURE_BOOT_MONOTONIC_COUNTER
	default n if SOC_SERIES_NRF52 || SOC_SERIES_NRF53 || SOC_SERIES_NRF91

choice SECURE_BOOT_SIGNATURE_TYPE
	default SECURE_BOOT_SIGNATURE_TYPE_ECDSA if SOC_SERIES_NRF52 || SOC_SERIES_NRF53
	default SECURE_BOOT_SIGNATURE_TYPE_ECDSA if SOC_SERIES_NRF91
endchoice

source "share/sysbuild/Kconfig"
```

## tests/subsys/bootloader/bl_crypto/testcase.yaml
```yaml
tests:
  bootloader.bl_crypto:
    sysbuild: true
    platform_allow:
      - nrf52833dk/nrf52833
      - nrf52840dk/nrf52840
      - nrf52dk/nrf52832
      - nrf5340dk/nrf5340/cpuapp
      - nrf9151dk/nrf9151
      - nrf9160dk/nrf9160
      - nrf9161dk/nrf9161
      - nrf54l15dk/nrf54l05/cpuapp
      - nrf54l15dk/nrf54l10/cpuapp
      - nrf54l15dk/nrf54l15/cpuapp
      - nrf54lv10dk/nrf54lv10a/cpuapp
      - nrf54lc10dk/nrf54lc10a/cpuapp
      - nrf54lm20dk/nrf54lm20a/cpuapp
      - nrf54lm20dk/nrf54lm20b/cpuapp
    integration_platforms:
      - nrf52840dk/nrf52840
      - nrf9151dk/nrf9151
      - nrf9160dk/nrf9160
      - nrf9161dk/nrf9161
      - nrf54l15dk/nrf54l05/cpuapp
      - nrf54l15dk/nrf54l10/cpuapp
      - nrf54l15dk/nrf54l15/cpuapp
      - nrf54lv10dk/nrf54lv10a/cpuapp
      - nrf54lc10dk/nrf54lc10a/cpuapp
      - nrf54lm20dk/nrf54lm20a/cpuapp
      - nrf54lm20dk/nrf54lm20b/cpuapp
    tags:
      - b0
      - sysbuild
      - ci_tests_subsys_bootloader
```

## tests/subsys/bootloader/bl_validation/Kconfig.sysbuild
```kconfig
#
# Copyright (c) 2026 Nordic Semiconductor
#
# SPDX-License-Identifier: LicenseRef-Nordic-5-Clause
#

if SOC_SERIES_NRF54L

config SECURE_BOOT_GENERATE_DEFAULT_KMU_KEYFILE
	default y if SECURE_BOOT_APPCORE

endif

source "share/sysbuild/Kconfig"
```

## tests/subsys/bootloader/bl_validation_neg/sysbuild/bl_validation_neg/boards/nrf54l15dk_nrf54l15_cpuapp.conf
```kconfig
#
# Copyright (c) 2026 Nordic Semiconductor ASA
#
# SPDX-License-Identifier: LicenseRef-Nordic-5-Clause
#

CONFIG_SB_CRYPTO_PSA_ED25519=y
CONFIG_SB_CRYPTO_NONE=y
```

## tests/subsys/dfu/dfu_extra/testcase.yaml
```yaml
tests:
  dfu.dfu_extra:
    sysbuild: true
    platform_allow:
      - nrf54l15dk/nrf54l15/cpuapp
    integration_platforms:
      - nrf54l15dk/nrf54l15/cpuapp
    harness: console
    harness_config:
      type: multi_line
      ordered: true
      regex:
        - "DFU Extra Images Test"
        - "=== Extra Image 1 ==="
        - "=== Extra Image 2 ==="
        - "Done"
    tags:
      - dfu
      - sysbuild
      - ci_tests_subsys_dfu
```

## tests/subsys/dfu/dfu_target/mcuboot_bootloader/testcase.yaml
```yaml
tests:
  dfu.dfu_target.mcuboot:
    sysbuild: true
    platform_allow:
      - nrf9160dk/nrf9160
      - native_sim
      - qemu_cortex_m3
    integration_platforms:
      - nrf9160dk/nrf9160
      - native_sim
      - qemu_cortex_m3
    tags:
      - dfu
      - mcuboot
      - sysbuild
      - ci_tests_subsys_dfu
```
