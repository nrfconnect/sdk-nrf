## CMakeLists.txt
```
#
# SPDX-License-Identifier: LicenseRef-Nordic-5-Clause
#

cmake_minimum_required(VERSION 3.20.0)

find_package(Zephyr REQUIRED HINTS $ENV{ZEPHYR_BASE})
project(test_audio_datapath)

target_sources(app PRIVATE
  src/main.c
)

target_compile_definitions(app PRIVATE
  HEADSET=1
  GATEWAY=2
)

target_include_directories(app PRIVATE
  ${ZEPHYR_NRF_MODULE_DIR}/applications/nrf_audio/src/audio
  ${ZEPHYR_NRF_MODULE_DIR}/applications/nrf_audio/src/modules
  ${ZEPHYR_NRF_MODULE_DIR}/applications/nrf_audio/src/modules/audio_rate_control
  ${ZEPHYR_NRF_MODULE_DIR}/applications/nrf_audio/src/utils
  ${ZEPHYR_NRF_MODULE_DIR}/applications/nrf_audio/src/utils/macros
  ${ZEPHYR_NRF_MODULE_DIR}/applications/nrf_audio/src/bluetooth/bt_stream
  ${ZEPHYR_NRF_MODULE_DIR}/applications/nrf_audio/include
  ${ZEPHYR_NRF_MODULE_DIR}/include
)
```

## Kconfig
```
#
# SPDX-License-Identifier: LicenseRef-Nordic-5-Clause
#

config AUDIO_DEV
	int
	default 1

config AUDIO_FRAME_DURATION_US
	int
	default 10000

config AUDIO_SAMPLE_RATE_48000_HZ
	bool
	default y

config AUDIO_SAMPLE_RATE_HZ
	int
	default 48000

config AUDIO_BIT_DEPTH_16
	bool
	default y

config AUDIO_BIT_DEPTH_BITS
	int
	default 16

config AUDIO_BIT_DEPTH_OCTETS
	int
	default 2

config AUDIO_INPUT_CHANNELS
	int
	default 1

config AUDIO_OUTPUT_CHANNELS
	int
	default 2

config AUDIO_ENCODE_CHANNELS_MAX
	int
	default 1

config AUDIO_DECODE_CHANNELS_MAX
	int
	default 1

config AUDIO_MIN_PRES_DLY_US
	int
	default 3000

config AUDIO_MAX_PRES_DLY_US
	int
	default 60000

config BT_AUDIO_PRESENTATION_DELAY_US
	int
	default 10000

config FIFO_FRAME_SPLIT_NUM
	int
	default 20

config NRF_AUDIO_TX_LEAD_TIME_TGT_US
	int
	default 2500

config NRF_AUDIO_TX_LEAD_TIME_MIN_US
	int
	default 2000

config BT_BUF_EVT_RX_COUNT
	int
	default 10

config BT_BUF_ACL_TX_COUNT
	int
	default 5

module = AUDIO_DATAPATH
module-str = audio-datapath
source "subsys/logging/Kconfig.template.log_config"

source "Kconfig.zephyr"
```

## prj.conf
```kconfig
#
# SPDX-License-Identifier: LicenseRef-Nordic-5-Clause
#

CONFIG_ZTEST=y
CONFIG_NET_BUF=y
CONFIG_ZBUS=y
```

## src/main.c
```c
/*
 * SPDX-License-Identifier: LicenseRef-Nordic-5-Clause
 */

#include <zephyr/ztest.h>

/* Included to reach the static err_us_calculate() */
#include "audio_datapath.c"

ZTEST(suite_audio_datapath, test_err_us_no_wrap)
{
	int32_t err_us = err_us_calculate(1010, 1000);

	zassert_equal(err_us, 10, "err_us: %d", err_us);

	err_us = err_us_calculate(1000, 1010);
	zassert_equal(err_us, -10, "err_us: %d", err_us);
}

ZTEST(suite_audio_datapath, test_err_us_sdu_ref_wrapped)
{
	/* sdu_ref_us is 10 us after frame_start_ts_us, across the 32-bit wrap */
	int32_t err_us = err_us_calculate(5, UINT32_MAX - 4);

	zassert_equal(err_us, 10, "err_us: %d", err_us);
}

ZTEST(suite_audio_datapath, test_err_us_frame_start_wrapped)
{
	/* sdu_ref_us is 10 us before frame_start_ts_us, across the 32-bit wrap */
	int32_t err_us = err_us_calculate(UINT32_MAX - 4, 5);

	zassert_equal(err_us, -10, "err_us: %d", err_us);
}

ZTEST_SUITE(suite_audio_datapath, NULL, NULL, NULL, NULL, NULL);
```
