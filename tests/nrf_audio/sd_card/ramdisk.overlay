/*
 * Copyright (c) 2024 Nordic Semiconductor ASA
 *
 * SPDX-License-Identifier: LicenseRef-Nordic-5-Clause
 */

/ {
	ramdisk0 {
		compatible = "zephyr,ram-disk";
		disk-name = "SD";
		sector-size = <512>;
		sector-count = <10000>;
	};
};
