## CMakeLists.txt
```
#
# Copyright (c) 2026 Nordic Semiconductor ASA
#
# SPDX-License-Identifier: LicenseRef-Nordic-5-Clause
#

cmake_minimum_required(VERSION 3.20.0)

find_package(Zephyr REQUIRED HINTS $ENV{ZEPHYR_BASE})
project(test_hf_audio_clock)

target_sources(app PRIVATE
  src/main.c
  src/hf_audio_clock_tests.c
  ${ZEPHYR_NRF_MODULE_DIR}/applications/nrf_audio/src/modules/hf_audio_clock.c
)

target_compile_definitions(app PRIVATE
  NRFX_DECLARE_ONLY
  CONFIG_NRF_AUDIO_MODULE_RATE_CONTROL_LOG_LEVEL=0
)

target_include_directories(app PRIVATE
  ${CMAKE_CURRENT_SOURCE_DIR}/fakes
  ${ZEPHYR_NRF_MODULE_DIR}/applications/nrf_audio/src/modules
  ${ZEPHYR_NRF_MODULE_DIR}/applications/nrf_audio/src/modules/audio_rate_control
)
```

## prj.conf
```kconfig
# SPDX-License-Identifier: LicenseRef-Nordic-5-Clause

CONFIG_ZTEST=y
```

## src/main.c
```c
/*
 * Copyright (c) 2026 Nordic Semiconductor ASA
 *
 * SPDX-License-Identifier: LicenseRef-Nordic-5-Clause
 */

#include <zephyr/fff.h>
#include <zephyr/ztest.h>

DEFINE_FFF_GLOBALS;

extern void hf_audio_clock_test_prepare(void *fixture);

ZTEST_SUITE(suite_hf_audio_clock, NULL, NULL, hf_audio_clock_test_prepare, NULL, NULL);
```

## src/hf_audio_clock_tests.c
```c
/*
 * Copyright (c) 2026 Nordic Semiconductor ASA
 *
 * SPDX-License-Identifier: LicenseRef-Nordic-5-Clause
 */

#include <errno.h>

#include <zephyr/fff.h>
#include <zephyr/ztest.h>

#include "nrfx_clock_hfclkaudio.h"
#include "hf_audio_clock.h"
#include "audio_rate_control.h"

#define TEST_APLL_FREQ_CENTER 0x9BA6
#define TEST_APLL_FREQ_MIN 0x8FD8
#define TEST_APLL_FREQ_MAX 0xA774

DECLARE_FAKE_VALUE_FUNC(int, audio_rate_control_register, enum audio_rate_control_type,
			struct audio_rate_control_ops const *const);
DECLARE_FAKE_VALUE_FUNC(int, nrfx_clock_divider_set, nrf_clock_domain_t, nrf_clock_hfclk_div_t);
DECLARE_FAKE_VALUE_FUNC(int, nrfx_clock_hfclkaudio_init, nrfx_clock_hfclkaudio_event_handler_t);
DECLARE_FAKE_VOID_FUNC(nrfx_clock_hfclkaudio_config_set, uint16_t);
DECLARE_FAKE_VOID_FUNC(nrfx_clock_hfclkaudio_start);

DEFINE_FAKE_VALUE_FUNC(int, audio_rate_control_register, enum audio_rate_control_type,
		       struct audio_rate_control_ops const *const);
DEFINE_FAKE_VALUE_FUNC(int, nrfx_clock_divider_set, nrf_clock_domain_t, nrf_clock_hfclk_div_t);
DEFINE_FAKE_VALUE_FUNC(int, nrfx_clock_hfclkaudio_init, nrfx_clock_hfclkaudio_event_handler_t);
DEFINE_FAKE_VOID_FUNC(nrfx_clock_hfclkaudio_config_set, uint16_t);
DEFINE_FAKE_VOID_FUNC(nrfx_clock_hfclkaudio_start);

extern struct audio_rate_control_ops hf_audio_clock_rate_control_ops;

void hf_audio_clock_test_prepare(void *fixture)
{
	ARG_UNUSED(fixture);
	RESET_FAKE(nrfx_clock_divider_set);
	RESET_FAKE(nrfx_clock_hfclkaudio_init);
	RESET_FAKE(nrfx_clock_hfclkaudio_config_set);
	RESET_FAKE(nrfx_clock_hfclkaudio_start);
	nrfx_clock_divider_set_fake.return_val = 0;
	nrfx_clock_hfclkaudio_init_fake.return_val = 0;
	zassert_equal(hf_audio_clock_init(), 0, "Clock setup failed");
	RESET_FAKE(nrfx_clock_divider_set);
	RESET_FAKE(nrfx_clock_hfclkaudio_init);
	RESET_FAKE(nrfx_clock_hfclkaudio_config_set);
	RESET_FAKE(nrfx_clock_hfclkaudio_start);
}

/* Verify that the center frequency is correctly adjusted based on the configuration value. */
ZTEST(suite_hf_audio_clock, test_update_calibrated)
{
	int32_t error_us = 331;

	zassert_equal(hf_audio_clock_rate_control_ops.cfg_set(
			      (struct audio_rate_control_cfg const *)&error_us),
		      0, NULL);
	zassert_equal(nrfx_clock_hfclkaudio_config_set_fake.arg0_val, TEST_APLL_FREQ_CENTER - 1000,
		      NULL);
}

/* Verify non-calibrated updates apply corrections relative to the current frequency. */
ZTEST(suite_hf_audio_clock, test_update_uses_current_frequency_without_calibration)
{
	int32_t error_us = -331, calibration_error_us = 662;

	zassert_equal(hf_audio_clock_rate_control_ops.cfg_set(
			      (struct audio_rate_control_cfg const *)&calibration_error_us),
		      0, NULL);

	zassert_equal(hf_audio_clock_rate_control_ops.update(&error_us), 0, NULL);
	zassert_equal(nrfx_clock_hfclkaudio_config_set_fake.call_count, 2, NULL);
	zassert_equal(nrfx_clock_hfclkaudio_config_set_fake.arg0_val, TEST_APLL_FREQ_CENTER - 1000,
		      NULL);
}

/* Verify out-of-range calibrated updates fail without reconfiguring the clock. */
ZTEST(suite_hf_audio_clock, test_update_rejects_out_of_range_calibration)
{
	int32_t error_us = 1000000;
	unsigned int config_call_count;

	config_call_count = nrfx_clock_hfclkaudio_config_set_fake.call_count;
	zassert_equal(hf_audio_clock_rate_control_ops.cfg_set(
			      (struct audio_rate_control_cfg const *)&error_us),
		      -EINVAL, NULL);
	zassert_equal(nrfx_clock_hfclkaudio_config_set_fake.call_count, config_call_count, NULL);
}

/* Verify NULL update inputs are rejected without reconfiguring the clock. */
ZTEST(suite_hf_audio_clock, test_update_rejects_null_pointer)
{
	unsigned int config_call_count = nrfx_clock_hfclkaudio_config_set_fake.call_count;

	zassert_equal(hf_audio_clock_rate_control_ops.update(NULL), -EINVAL, NULL);
	zassert_equal(nrfx_clock_hfclkaudio_config_set_fake.call_count, config_call_count, NULL);
}

/* Verify NULL calibration inputs are rejected without reconfiguring the clock. */
ZTEST(suite_hf_audio_clock, test_cfg_set_rejects_null_pointer)
{
	unsigned int config_call_count = nrfx_clock_hfclkaudio_config_set_fake.call_count;

	zassert_equal(hf_audio_clock_rate_control_ops.cfg_set(NULL), -EINVAL, NULL);
	zassert_equal(nrfx_clock_hfclkaudio_config_set_fake.call_count, config_call_count, NULL);
}

/* Verify non-calibrated updates clamp values below the supported frequency range. */
ZTEST(suite_hf_audio_clock, test_update_clamps_without_calibration)
{
	int32_t error_us = 1000000;

	zassert_equal(hf_audio_clock_rate_control_ops.update(&error_us), -EOVERFLOW, NULL);
	zassert_equal(nrfx_clock_hfclkaudio_config_set_fake.call_count, 1, NULL);
	zassert_equal(nrfx_clock_hfclkaudio_config_set_fake.arg0_val, TEST_APLL_FREQ_MIN, NULL);
}

/* Verify non-calibrated updates clamp values above the supported frequency range. */
ZTEST(suite_hf_audio_clock, test_update_clamps_without_calibration_at_upper_bound)
{
	int32_t error_us = -1000000;

	zassert_equal(hf_audio_clock_rate_control_ops.update(&error_us), -EOVERFLOW, NULL);
	zassert_equal(nrfx_clock_hfclkaudio_config_set_fake.call_count, 1, NULL);
	zassert_equal(nrfx_clock_hfclkaudio_config_set_fake.arg0_val, TEST_APLL_FREQ_MAX, NULL);
}

/* Verify initialization sets the divider and center frequency before starting the clock. */
ZTEST(suite_hf_audio_clock, test_init_configures_and_starts_clock)
{
	nrfx_clock_hfclkaudio_init_fake.return_val = 0;

	zassert_equal(hf_audio_clock_init(), 0, NULL);
	zassert_equal(nrfx_clock_divider_set_fake.call_count, 1, NULL);
	zassert_equal(nrfx_clock_divider_set_fake.arg0_val, NRF_CLOCK_DOMAIN_HFCLK, NULL);
	zassert_equal(nrfx_clock_divider_set_fake.arg1_val, NRF_CLOCK_HFCLK_DIV_1, NULL);
	zassert_equal(nrfx_clock_hfclkaudio_config_set_fake.arg0_val, TEST_APLL_FREQ_CENTER, NULL);
	/* The clock driver is initialized without an event handler. */
	zassert_equal(nrfx_clock_hfclkaudio_init_fake.arg0_val, NULL, NULL);
	zassert_equal(nrfx_clock_hfclkaudio_start_fake.call_count, 1, NULL);
}

/* Verify an already initialized nrfx clock is accepted and started normally. */
ZTEST(suite_hf_audio_clock, test_init_accepts_already_initialized_clock)
{
	nrfx_clock_hfclkaudio_init_fake.return_val = -EALREADY;

	zassert_equal(hf_audio_clock_init(), 0, NULL);
	zassert_equal(nrfx_clock_hfclkaudio_start_fake.call_count, 1, NULL);
}

/* Verify divider setup errors stop initialization before later driver calls. */
ZTEST(suite_hf_audio_clock, test_init_returns_divider_error)
{
	nrfx_clock_divider_set_fake.return_val = -EIO;

	zassert_equal(hf_audio_clock_init(), -EIO, NULL);
	zassert_equal(nrfx_clock_hfclkaudio_config_set_fake.call_count, 0, NULL);
	zassert_equal(nrfx_clock_hfclkaudio_init_fake.call_count, 0, NULL);
	zassert_equal(nrfx_clock_hfclkaudio_start_fake.call_count, 0, NULL);
}

/* Verify clock-driver initialization errors are returned without starting the clock. */
ZTEST(suite_hf_audio_clock, test_init_returns_clock_init_error)
{
	nrfx_clock_hfclkaudio_init_fake.return_val = -EIO;

	zassert_equal(hf_audio_clock_init(), -EIO, NULL);
	zassert_equal(nrfx_clock_hfclkaudio_start_fake.call_count, 0, NULL);
}

/* Verify startup registers the audio PLL and exposes the correct control operations. */
ZTEST(suite_hf_audio_clock, test_registers_audio_pll)
{
	zassert_equal(audio_rate_control_register_fake.call_count, 1, NULL);
	zassert_equal(audio_rate_control_register_fake.arg0_val, AUDIO_PLL, NULL);
	zassert_equal(audio_rate_control_register_fake.arg1_val, &hf_audio_clock_rate_control_ops,
		      NULL);
	zassert_equal(hf_audio_clock_rate_control_ops.update, hf_audio_clock_update, NULL);
	zassert_not_null(hf_audio_clock_rate_control_ops.cfg_set, NULL);
	zassert_equal(hf_audio_clock_rate_control_ops.initialize, hf_audio_clock_init, NULL);
}
```

## src/nrfx_clock.h
```c
/*
 * Copyright (c) 2026 Nordic Semiconductor ASA
 *
 * SPDX-License-Identifier: LicenseRef-Nordic-5-Clause
 */

#ifndef NRFX_CLOCK_H__
#define NRFX_CLOCK_H__

#include <stdbool.h>

/* Test-only declarations intentionally shadow nrfx hardware headers. */

typedef enum {
	NRF_CLOCK_DOMAIN_HFCLK,
} nrf_clock_domain_t;

typedef enum {
	NRF_CLOCK_HFCLK_DIV_1,
} nrf_clock_hfclk_div_t;

int nrfx_clock_divider_set(nrf_clock_domain_t domain, nrf_clock_hfclk_div_t div);

#endif
```

## src/nrfx_clock_hfclkaudio.h
```c
/*
 * Copyright (c) 2026 Nordic Semiconductor ASA
 *
 * SPDX-License-Identifier: LicenseRef-Nordic-5-Clause
 */

#ifndef NRFX_CLOCK_HFCLKAUDIO_H__
#define NRFX_CLOCK_HFCLKAUDIO_H__

#include <stdint.h>

/* Test-only declarations intentionally shadow nrfx hardware headers. */

typedef void (*nrfx_clock_hfclkaudio_event_handler_t)(void);

int nrfx_clock_hfclkaudio_init(nrfx_clock_hfclkaudio_event_handler_t event_handler);
void nrfx_clock_hfclkaudio_start(void);
void nrfx_clock_hfclkaudio_config_set(uint16_t freq_value);

#endif
```
