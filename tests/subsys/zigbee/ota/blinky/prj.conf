## CMakeLists.txt
```
#
# Copyright (c) 2020 Nordic Semiconductor ASA
#
# SPDX-License-Identifier: LicenseRef-BSD-5-Clause-Nordic
#

cmake_minimum_required(VERSION 3.13.1)

find_package(Zephyr REQUIRED HINTS $ENV{ZEPHYR_BASE})

project("Blinky")

target_sources(app PRIVATE
  src/main.c
)
```

## Kconfig
```
#
# Copyright (c) 2020 Nordic Semiconductor ASA
#
# SPDX-License-Identifier: LicenseRef-BSD-5-Clause-Nordic
#

menu "Blinky Sample Settings"

config BLINKY_LED_MASK
	hex "Mask of DK LEDs"
	range 0x1 0xF
	default 0xF
	help
	  The default setting blinks all LEDs.

endmenu

menu "Zephyr Kernel"
source "Kconfig.zephyr"
endmenu
```

## sample.yaml
```
sample:
  name: Blinky
  description: Minimal sample, the smallest possible Zephyr application for OTA testing purpose.
tests:
  zigbee.ota.blinky_led1:
    build_only: true
    extra_args: CONF_FILE='common.conf;blinky_led1.conf'
    build_on_all: true
    platform_whitelist: nrf52840dk_nrf52840 nrf52833dk_nrf52833
    tags: ci_build
  zigbee.ota.blinky_led2:
    build_only: true
    extra_args: CONF_FILE='common.conf;blinky_led2.conf'
    build_on_all: true
    platform_whitelist: nrf52840dk_nrf52840 nrf52833dk_nrf52833
    tags: ci_build
```

## prj.conf
```kconfig
#
# Copyright (c) 2020 Nordic Semiconductor ASA
#
# SPDX-License-Identifier: LicenseRef-BSD-5-Clause-Nordic
#

# Common configuration for the smallest possible flash size.

# Build
CONFIG_SIZE_OPTIMIZATIONS=y

# Mask for blinking LED1
CONFIG_BLINKY_LED_MASK=0x1

# Enable mcumgr.
CONFIG_MCUMGR=y

# Ensure an MCUboot-compatible binary is generated.
CONFIG_BOOTLOADER_MCUBOOT=y

# Enable DK LED and Buttons library
CONFIG_DK_LIBRARY=y
CONFIG_GPIO=y

# Switch off all unnecessary modules for minimal image in flash size.
# Console
CONFIG_CONSOLE=n
CONFIG_UART_CONSOLE=n
CONFIG_STDOUT_CONSOLE=n
CONFIG_PRINTK=n
CONFIG_EARLY_CONSOLE=n
CONFIG_THREAD_STACK_INFO=n
CONFIG_THREAD_CUSTOM_DATA=n
CONFIG_FPU=n
CONFIG_DYNAMIC_INTERRUPTS=n
CONFIG_IRQ_OFFLOAD=n
CONFIG_SYS_POWER_MANAGEMENT=n
CONFIG_I2C=n
CONFIG_WATCHDOG=n
CONFIG_PINMUX=n
CONFIG_SPI=n
CONFIG_SERIAL=n
CONFIG_FLASH=n
CONFIG_NRF_ENABLE_ICACHE=n
CONFIG_ARM_MPU=n
CONFIG_THREAD_STACK_INFO=n
CONFIG_ERRNO=n
CONFIG_TIMESLICING=n
CONFIG_TIMEOUT_64BIT=n
CONFIG_USE_SEGGER_RTT=n
CONFIG_PRINTK64=n
CONFIG_ASSERT_VERBOSE=n
CONFIG_RESET_ON_FATAL_ERROR=n
CONFIG_NUM_PREEMPT_PRIORITIES=0
```

## src/main.c
```c
/*
 * Copyright (c) 2020 Nordic Semiconductor ASA
 *
 * SPDX-License-Identifier: LicenseRef-BSD-5-Clause-Nordic
 */

#include <zephyr.h>
#include <dk_buttons_and_leds.h>

void main(void)
{
	int blink_status = 0;

	dk_leds_init();

	while (1) {
		blink_status ^= CONFIG_BLINKY_LED_MASK;
		dk_set_leds(blink_status);
		k_sleep(K_MSEC(100));
	}
}
```
