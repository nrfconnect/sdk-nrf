## tests/subsys/zigbee/osif/logger/testcase.yaml
```yaml
tests:
  zigbee.osif.logger:
    platform_whitelist: nrf52840dk_nrf52840
    tags: osif_logger
```

## tests/subsys/zigbee/osif/nvram/testcase.yaml
```yaml
tests:
  zigbee.osif.nvram:
    sysbuild: true
    platform_allow: nrf52840dk/nrf52840 nrf52833dk/nrf52833 nrf5340dk/nrf5340/cpuapp
    tags: zigbee_nvram sysbuild
    integration_platforms:
      - nrf52840dk/nrf52840
      - nrf52833dk/nrf52833
      - nrf5340dk/nrf5340/cpuapp
```

## tests/subsys/zigbee/osif/serial/serial_async_api/testcase.yaml
```yaml
tests:
  zigbee.osif.serial.async:
    sysbuild: true
    depends_on: gpio
    platform_allow: nrf52840dk/nrf52840 nrf52833dk/nrf52833 nrf5340dk/nrf5340/cpuapp
    tags: osif_serial sysbuild
    harness: ztest
    harness_config:
      fixture: gpio_loopback
```

## tests/subsys/zigbee/osif/serial/serial_basic_api/testcase.yaml
```yaml
tests:
  zigbee.osif.serial.basic:
    depends_on: gpio
    platform_allow: nrf52840dk_nrf52840 nrf52833dk_nrf52833 nrf5340dk_nrf5340_cpuapp
    tags: osif_serial
    harness: ztest
    harness_config:
      fixture: gpio_loopback
  zigbee.osif.serial.basic.sysbuild:
    sysbuild: true
    depends_on: gpio
    platform_allow: nrf52840dk_nrf52840 nrf52833dk_nrf52833 nrf5340dk_nrf5340_cpuapp
    tags: osif_serial sysbuild
    harness: ztest
    harness_config:
      fixture: gpio_loopback
```

## tests/subsys/zigbee/osif/serial/serial_via_logger/testcase.yaml
```yaml
tests:
  zigbee.osif.serial.logger:
    sysbuild: true
    platform_allow: nrf52840dk/nrf52840 nrf52833dk/nrf52833 nrf5340dk/nrf5340/cpuapp
    tags: osif_logger sysbuild
    integration_platforms:
      - nrf52840dk/nrf52840
      - nrf52833dk/nrf52833
      - nrf5340dk/nrf5340/cpuapp
```

## tests/subsys/zigbee/osif/timer/testcase.yaml
```yaml
tests:
  zigbee.osif.timer:
    platform_allow: nrf52840dk_nrf52840 nrf52833dk_nrf52833
    tags: zigbee_osif
```

## tests/subsys/zigbee/osif/timer_counter/testcase.yaml
```yaml
tests:
  zigbee.osif.timer.counter:
    sysbuild: true
    platform_allow: nrf52840dk/nrf52840 nrf52833dk/nrf52833 nrf5340dk/nrf5340/cpuapp
    tags: zigbee_osif sysbuild ci_tests_subsys_zigbee
    integration_platforms:
      - nrf52840dk/nrf52840
      - nrf52833dk/nrf52833
      - nrf5340dk/nrf5340/cpuapp
```

## tests/subsys/zigbee/osif/timer_ktimer/testcase.yaml
```yaml
tests:
  zigbee.osif.timer.ktimer:
    platform_allow: nrf52840dk_nrf52840 nrf52833dk_nrf52833 nrf5340dk_nrf5340_cpuapp
    tags: zigbee_osif
    integration_platforms:
      - nrf52840dk_nrf52840
      - nrf52833dk_nrf52833
      - nrf5340dk_nrf5340_cpuapp
```

## tests/subsys/zigbee/ota/blinky/Kconfig
```kconfig
#
# Copyright (c) 2020 Nordic Semiconductor ASA
#
# SPDX-License-Identifier: LicenseRef-BSD-5-Clause-Nordic
#

menu "Blinky Sample Settings"

config BLINKY_LED_MASK
	hex "Mask of DK LEDs"
	range 0x1 0xF
	default 0xF
	help
	  The default setting blinks all LEDs.

endmenu

menu "Zephyr Kernel"
source "Kconfig.zephyr"
endmenu
```

## tests/subsys/zigbee/ota/blinky/sample.yaml
```yaml
sample:
  name: Blinky
  description: Minimal sample, the smallest possible Zephyr application for OTA testing purpose.
tests:
  zigbee.ota.blinky_led1:
    build_only: true
    extra_args: CONF_FILE='common.conf;blinky_led1.conf'
    build_on_all: true
    platform_whitelist: nrf52840dk_nrf52840 nrf52833dk_nrf52833
    tags: ci_build
  zigbee.ota.blinky_led2:
    build_only: true
    extra_args: CONF_FILE='common.conf;blinky_led2.conf'
    build_on_all: true
    platform_whitelist: nrf52840dk_nrf52840 nrf52833dk_nrf52833
    tags: ci_build
```

## tests/subsys/zigbee/zboss_api/alarm_api/testcase.yaml
```yaml
tests:
  zigbee.zboss_api.alarm_api:
    sysbuild: true
    platform_allow: nrf52840dk/nrf52840 nrf52833dk/nrf52833 nrf5340dk/nrf5340/cpuapp
    tags: zboss_api_alarm sysbuild
    integration_platforms:
      - nrf52840dk/nrf52840
      - nrf52833dk/nrf52833
      - nrf5340dk/nrf5340/cpuapp
```

## tests/subsys/zigbee/zboss_api/callback_api/testcase.yaml
```yaml
tests:
  zigbee.zboss_api.callback_api:
    platform_allow: nrf52840dk/nrf52840 nrf52833dk/nrf52833 nrf5340dk/nrf5340/cpuapp
    tags: zboss_api_callback
    integration_platforms:
      - nrf52840dk/nrf52840
      - nrf52833dk/nrf52833
      - nrf5340dk/nrf5340/cpuapp
```

## tests/tfm/secure_services/testcase.yaml
```yaml
tests:
  tfm.secure_services:
    sysbuild: true
    platform_allow:
      - nrf5340dk/nrf5340/cpuapp/ns
      - nrf9151dk/nrf9151/ns
      - nrf9160dk/nrf9160/ns
      - nrf9161dk/nrf9161/ns
    tags: tfm secure_services sysbuild
    integration_platforms:
      - nrf5340dk/nrf5340/cpuapp/ns
      - nrf9151dk/nrf9151/ns
      - nrf9160dk/nrf9160/ns
      - nrf9161dk/nrf9161/ns
```

## tests/tfm/tfm_psa_test/boards/nrf54l15dk_nrf54l15_cpuapp_ns.conf
```kconfig
# enable/Disable features that 54l supports/does not support

CONFIG_TFM_PARTITION_PROTECTED_STORAGE=n


CONFIG_TFM_PSA_TEST_CRYPTO=n
CONFIG_TFM_PSA_TEST_PROTECTED_STORAGE=n
CONFIG_TFM_PSA_TEST_STORAGE=n
CONFIG_TFM_PSA_TEST_INITIAL_ATTESTATION=n

CONFIG_TFM_PSA_TEST_INTERNAL_TRUSTED_STORAGE=y
```

## tests/tfm/tfm_psa_test/testcase.yaml
```yaml
common:
  tags: sysbuild tfm ci_tests_tfm
  build_only: true
  sysbuild: true
  platform_allow:
    - nrf5340dk/nrf5340/cpuapp/ns
    - nrf9151dk/nrf9151/ns
    - nrf9160dk/nrf9160/ns
    - nrf9161dk/nrf9161/ns
  integration_platforms:
    - nrf5340dk/nrf5340/cpuapp/ns
    - nrf9151dk/nrf9151/ns
    - nrf9160dk/nrf9160/ns
    - nrf9161dk/nrf9161/ns
  harness: console
  harness_config:
    type: multi_line
    regex:
      - "\\*\\*\\*\\*\\* PSA Architecture Test Suite - Version .* \\*\\*\\*\\*\\*"
      - "TOTAL FAILED *: 0"
tests:
  tfm.psa_test_storage_lvl1:
    tags: tfm_lvl1
    extra_args:
      - CONFIG_TFM_PSA_TEST_STORAGE=y
      - CONFIG_TFM_ISOLATION_LEVEL=1
    timeout: 130
    platform_allow:
      - nrf54l15dk/nrf54l15/cpuapp/ns
    integration_platforms:
      - nrf54l15dk/nrf54l15/cpuapp/ns
  tfm.psa_test_storage_lvl2:
    tags: tfm_lvl2
    extra_args:
      - CONFIG_TFM_PSA_TEST_STORAGE=y
    timeout: 130
    platform_allow:
      - nrf54l15dk/nrf54l15/cpuapp/ns
    integration_platforms:
      - nrf54l15dk/nrf54l15/cpuapp/ns
  tfm.psa_test_crypto_lvl1:
    tags: tfm_lvl1
    extra_args:
      - CONFIG_TFM_PSA_TEST_CRYPTO=y
      - CONFIG_TFM_ISOLATION_LEVEL=1
    timeout: 120
    platform_allow:
      - nrf54l15dk/nrf54l15/cpuapp/ns
    integration_platforms:
      - nrf54l15dk/nrf54l15/cpuapp/ns
  tfm.psa_test_crypto_lvl2:
    tags: tfm_lvl2
    extra_args:
      - CONFIG_TFM_PSA_TEST_CRYPTO=y
    timeout: 120
    platform_allow:
      - nrf54l15dk/nrf54l15/cpuapp/ns
    integration_platforms:
      - nrf54l15dk/nrf54l15/cpuapp/ns
  tfm.psa_test_initial_attestation_lvl1:
    tags: tfm_lvl1
    extra_args:
      - CONFIG_TFM_PSA_TEST_INITIAL_ATTESTATION=y
      - CONFIG_TFM_ISOLATION_LEVEL=1
      - CONFIG_TFM_PARTITION_INITIAL_ATTESTATION=y
      - CONFIG_TFM_NRF_PROVISIONING=y
      - CONFIG_NRF_APPROTECT_LOCK=y
      - CONFIG_NRF_SECURE_APPROTECT_LOCK=y
  tfm.psa_test_initial_attestation_lvl2:
    tags: tfm_lvl2
    extra_args:
      - CONFIG_TFM_PSA_TEST_INITIAL_ATTESTATION=y
      - CONFIG_TFM_PARTITION_INITIAL_ATTESTATION=y
      - CONFIG_TFM_NRF_PROVISIONING=y
      - CONFIG_NRF_APPROTECT_LOCK=y
      - CONFIG_NRF_SECURE_APPROTECT_LOCK=y
```

## tests/tfm/tfm_regression_test/boards/nrf5340dk_nrf5340_cpuapp_ns.conf
```kconfig
# Using the following configuration for TFM UART1 allows both secure and
# non-secure UART output to arrive on the two COM ports available on the
# newer (>=2.0.0) dev-kits.
# Users of older versioned dev-kits should take appropriate actions in
# order to get both UART outputs. See: https://developer.nordicsemi.com/nRF_Connect_SDK/doc/latest/nrf/ug_tfm.html#id7
CONFIG_TFM_UART1_RXD_PIN=32
CONFIG_TFM_UART1_TXD_PIN=33
CONFIG_TFM_UART1_CTS_PIN=10
CONFIG_TFM_UART1_RTS_PIN=11
```

## tests/tfm/tfm_regression_test/boards/nrf54l15dk_nrf54l15_cpuapp_ns.conf
```kconfig
#
# Copyright (c) 2024 Nordic Semiconductor ASA
#
# SPDX-License-Identifier: LicenseRef-Nordic-5-Clause
#

# The tests need more RAM
CONFIG_PM_PARTITION_SIZE_TFM_SRAM=0x16000

# NCSDK-22598: Attestation support for nRF54L15 is not implemented yet
# So disable it for now
CONFIG_TFM_PARTITION_INITIAL_ATTESTATION=n
CONFIG_TFM_NRF_PROVISIONING=n
```

## tests/tfm/tfm_regression_test/boards/nrf7120dk_nrf7120_cpuapp_ns.conf
```kconfig
#
# Copyright (c) 2025 Nordic Semiconductor ASA
#
# SPDX-License-Identifier: LicenseRef-Nordic-5-Clause
#

# The tests need more RAM
CONFIG_PM_PARTITION_SIZE_TFM_SRAM=0x17000

# WZN-7352: Attestation support for nRF7120 is not implemented yet
# So disable it for now
CONFIG_TFM_PARTITION_INITIAL_ATTESTATION=n
CONFIG_TFM_NRF_PROVISIONING=n
```

## tests/tfm/tfm_regression_test/testcase.yaml
```yaml
common:
  tags: tfm ci_tests_tfm
  build_only: true
  harness: console
  harness_config:
    type: multi_line
    regex:
      - "Non-Secure system starting..."
      - "\\#\\#\\#\\# Execute test suites for the Non-secure area \\#\\#\\#\\#"
      - "\\*\\*\\* End of Non-secure test suites \\*\\*\\*"

tests:
  tfm.regression_ipc_lvl1:
    sysbuild: true
    tags: tfm_lvl1 sysbuild ci_tests_tfm
    extra_args: CONFIG_TFM_IPC=y CONFIG_TFM_ISOLATION_LEVEL=1
    timeout: 200
    platform_allow:
      - nrf5340dk/nrf5340/cpuapp/ns
      - nrf54l15pdk/nrf54l15/cpuapp/ns
      - nrf9151dk/nrf9151/ns
      - nrf9160dk/nrf9160/ns
      - nrf9161dk/nrf9161/ns
    integration_platforms:
      - nrf5340dk/nrf5340/cpuapp/ns
      - nrf54l15pdk/nrf54l15/cpuapp/ns
      - nrf9151dk/nrf9151/ns
      - nrf9160dk/nrf9160/ns
      - nrf9161dk/nrf9161/ns
  tfm.regression_ipc_lvl2.cc3xx:
    sysbuild: true
    tags: tfm_lvl2 sysbuild ci_tests_tfm
    extra_args: CONFIG_PSA_CRYPTO_DRIVER_CC3XX=y CONFIG_PSA_CRYPTO_DRIVER_OBERON=n
    timeout: 200
    platform_allow:
      - nrf5340dk/nrf5340/cpuapp/ns
      - nrf9151dk/nrf9151/ns
      - nrf9160dk/nrf9160/ns
      - nrf9161dk/nrf9161/ns
    integration_platforms:
      - nrf5340dk/nrf5340/cpuapp/ns
      - nrf9151dk/nrf9151/ns
      - nrf9160dk/nrf9160/ns
      - nrf9161dk/nrf9161/ns
  tfm.regression_ipc_lvl2.oberon:
    sysbuild: true
    tags: tfm_lvl2 sysbuild ci_tests_tfm
    extra_args: CONFIG_PSA_CRYPTO_DRIVER_CC3XX=n CONFIG_PSA_CRYPTO_DRIVER_OBERON=y
    timeout: 200
    platform_allow:
      - nrf5340dk/nrf5340/cpuapp/ns
      - nrf9151dk/nrf9151/ns
      - nrf9160dk/nrf9160/ns
      - nrf9161dk/nrf9161/ns
    integration_platforms:
      - nrf5340dk/nrf5340/cpuapp/ns
      - nrf9151dk/nrf9151/ns
      - nrf9160dk/nrf9160/ns
      - nrf9161dk/nrf9161/ns
  tfm.regression_ipc_lvl2.cc3xx_oberon:
    sysbuild: true
    tags: tfm_lvl2 sysbuild ci_tests_tfm
    extra_args: CONFIG_PSA_CRYPTO_DRIVER_CC3XX=y CONFIG_PSA_CRYPTO_DRIVER_OBERON=y
    timeout: 200
    platform_allow:
      - nrf5340dk/nrf5340/cpuapp/ns
      - nrf9151dk/nrf9151/ns
      - nrf9160dk/nrf9160/ns
      - nrf9161dk/nrf9161/ns
    integration_platforms:
      - nrf5340dk/nrf5340/cpuapp/ns
      - nrf9151dk/nrf9151/ns
      - nrf9160dk/nrf9160/ns
      - nrf9161dk/nrf9161/ns
  tfm.regression_ipc_lvl2.cracen:
    sysbuild: true
    tags: tfm_lvl2 sysbuild ci_tests_tfm
    extra_args: CONFIG_PSA_CRYPTO_DRIVER_CRACEN=y CONFIG_PSA_CRYPTO_DRIVER_OBERON=n
    timeout: 200
    platform_allow:
      - nrf54l15pdk/nrf54l15/cpuapp/ns
    integration_platforms:
      - nrf54l15pdk/nrf54l15/cpuapp/ns
  tfm.regression_sfn_lvl1:
    sysbuild: true
    tags: tfm_lvl1 sysbuild ci_tests_tfm
    extra_args: CONFIG_TFM_SFN=y CONFIG_TFM_ISOLATION_LEVEL=1
    timeout: 200
    platform_allow:
      - nrf5340dk/nrf5340/cpuapp/ns
      - nrf54l15pdk/nrf54l15/cpuapp/ns
      - nrf9151dk/nrf9151/ns
      - nrf9160dk/nrf9160/ns
      - nrf9161dk/nrf9161/ns
    integration_platforms:
      - nrf5340dk/nrf5340/cpuapp/ns
      - nrf54l15pdk/nrf54l15/cpuapp/ns
      - nrf9151dk/nrf9151/ns
      - nrf9160dk/nrf9160/ns
      - nrf9161dk/nrf9161/ns
  tfm.regression_fp_hardabi:
    sysbuild: true
    tags: tfm_fp sysbuild ci_tests_tfm
    extra_args: CONFIG_FPU=y CONFIG_FP_HARDABI=y
    platform_allow:
      - nrf5340dk/nrf5340/cpuapp/ns
      - nrf54l15pdk/nrf54l15/cpuapp/ns
      - nrf9151dk/nrf9151/ns
      - nrf9160dk/nrf9160/ns
      - nrf9161dk/nrf9161/ns
    integration_platforms:
      - nrf5340dk/nrf5340/cpuapp/ns
      - nrf54l15pdk/nrf54l15/cpuapp/ns
      - nrf9151dk/nrf9151/ns
      - nrf9160dk/nrf9160/ns
      - nrf9161dk/nrf9161/ns
```

## tests/unity/Kconfig
```kconfig
#
# Copyright (c) 2019 Nordic Semiconductor
#
# SPDX-License-Identifier: LicenseRef-Nordic-5-Clause
#

config UNITY
	bool "Use Unity test framework"

config UNITY_CFG_YAML_TEMPLATE_FILE
	string "Unity config template file"
	default "tests/unity/unity_cfg.yaml.template"
	help
	  Template file location. Location is relative to the NCS root path.
```

## tests/unity/at_cmd_parser/at_params/sample.yaml
```yaml
sample:
  description: AT params test
  name: at_params_test
tests:
  test_build:
    build_only: true
    build_on_all: true
    platform_whitelist: native_posix
    tags: ci_build
```

## tests/unity/example_test/Kconfig
```kconfig
# Config options for logger sample app
#
# Copyright (c) 2019 Nordic Semiconductor ASA
#
# SPDX-License-Identifier: LicenseRef-Nordic-5-Clause
#

mainmenu "Example unity test"

menu "Unit under test configuration"

config UUT_PARAM_CHECK
	bool "Enabled function parameter check"

endmenu

source "Kconfig.zephyr"
```

## tests/unity/example_test/testcase.yaml
```yaml
tests:
  unity.example_test:
    sysbuild: true
    tags:
      - example
      - sysbuild
      - ci_tests_unity
    integration_platforms:
      - native_sim
    platform_allow:
      - native_sim
```

## tests/unity/wrap_test/testcase.yaml
```yaml
tests:
  unity.wrap_test:
    sysbuild: true
    tags:
      - wrap_test
      - sysbuild
      - ci_tests_unity
    platform_allow:
      - native_sim
    integration_platforms:
      - native_sim
```
