## tests/subsys/nfc/rpc/client/testcase.yaml
```yaml
tests:
  nfc.rpc.client:
    sysbuild: true
    platform_allow: native_sim
    tags: nfc ci_build sysbuild ci_tests_subsys_nfc
    integration_platforms:
      - native_sim
```

## tests/subsys/nfc/rpc/server/testcase.yaml
```yaml
tests:
  nfc.rpc.server:
    sysbuild: true
    platform_allow: native_sim
    tags: nfc ci_build sysbuild
    integration_platforms:
      - native_sim
```

## tests/subsys/nrf_compress/decompression/lzma/Kconfig
```kconfig
#
# Copyright (c) 2024 Nordic Semiconductor ASA
#
# SPDX-License-Identifier: LicenseRef-Nordic-5-Clause
#

config NRF_COMPRESS_COMPRESSION
	default y

source "Kconfig.zephyr"
```

## tests/subsys/nrf_compress/decompression/lzma/Kconfig.sysbuild
```kconfig
config PARTITION_MANAGER
	default n if !BOARD_IS_NON_SECURE

source "${ZEPHYR_BASE}/share/sysbuild/Kconfig"
```

## tests/subsys/nrf_compress/decompression/lzma/boards/nrf5340dk_nrf5340_cpuapp_ns.conf
```kconfig
# Copyright (c) 2026 Nordic Semiconductor ASA
#
# SPDX-License-Identifier: LicenseRef-Nordic-5-Clause

# Disable TF-M copying input buffers internally.
# This lowers security but is needed here because there are calls to psa_hash_update()
# with input lengths close to 66500. An alternative solution would be to do smaller calls.
CONFIG_TFM_SFN=y
CONFIG_TFM_PSA_FRAMEWORK_HAS_MM_IOVEC=y
```

## tests/subsys/nrf_compress/decompression/mcuboot_update/Kconfig
```kconfig
#
# Copyright (c) 2024 Nordic Semiconductor
#
# SPDX-License-Identifier: LicenseRef-Nordic-5-Clause
#

config UPDATE_SLOT_NUMBER
	int "Image update number"
	range 0 3
	default 0
	help
	  Should be set to the image containing the firmware to mark for upgrade

source "Kconfig.zephyr"
```

## tests/subsys/nrf_compress/decompression/mcuboot_update/sysbuild/mcuboot/boards/nrf52840dk_nrf52840.conf
```kconfig
#
# Copyright (c) 2024 Nordic Semiconductor
#
# SPDX-License-Identifier: LicenseRef-Nordic-5-Clause
#

# Ensure that the qspi driver is enabled by default
CONFIG_NORDIC_QSPI_NOR=y
```

## tests/subsys/nrf_compress/decompression/mcuboot_update/sysbuild/mcuboot/boards/nrf5340dk_nrf5340_cpuapp.conf
```kconfig
#
# Copyright (c) 2025 Nordic Semiconductor
#
# SPDX-License-Identifier: LicenseRef-Nordic-5-Clause
#

# Disable fprotect as it seems it is not able to cover larger
# MCUboot, that results from ed25519 enabled with decompression
CONFIG_FPROTECT=n
```

## tests/subsys/nrf_compress/decompression/mcuboot_update/sysbuild/mcuboot/boards/nrf54h20dk_nrf54h20_cpuapp.conf
```kconfig
# Copyright (c) 2025 Nordic Semiconductor ASA
#
# SPDX-License-Identifier: LicenseRef-Nordic-5-Clause
#

CONFIG_SPI_NOR=n

CONFIG_FPROTECT=n

CONFIG_BOOT_WATCHDOG_FEED=n

# Power domains forced on by default on boot, no need
# to manage them in bootloader.
CONFIG_POWER_DOMAIN=n
```

## tests/subsys/nrf_compress/decompression/mcuboot_update/sysbuild/mcuboot/boards/nrf54l15dk_nrf54l15_cpuapp.conf
```kconfig
#
# Copyright (c) 2024 Nordic Semiconductor
#
# SPDX-License-Identifier: LicenseRef-Nordic-5-Clause
#

# Ensure that the SPI NOR driver is enabled by default
CONFIG_SPI_NOR=n

# TODO: below are not yet supported and need fixing
CONFIG_FPROTECT=n

CONFIG_BOOT_WATCHDOG_FEED=n
```

## tests/subsys/nrf_profiler/testcase.yaml
```yaml
tests:
  nrf_profiler.core:
    sysbuild: true
    platform_exclude: native_posix qemu_x86 qemu_cortex_m3
    platform_allow:
      - nrf52dk/nrf52832
      - nrf52840dk/nrf52840
      - nrf5340dk/nrf5340/cpuapp/ns
      - nrf9160dk/nrf9160/ns
    integration_platforms:
      - nrf52dk/nrf52832
      - nrf52840dk/nrf52840
      - nrf5340dk/nrf5340/cpuapp/ns
      - nrf9160dk/nrf9160/ns
    tags: nrf_profiler sysbuild
```

## tests/subsys/nrf_rpc/rpc_utils/client/testcase.yaml
```yaml
tests:
  nrf_rpc.rpc_utils.client:
    sysbuild: true
    platform_allow: native_sim
    tags:
      - ci_build
      - sysbuild
      - ci_tests_subsys_nrf_rpc
    integration_platforms:
      - native_sim
```

## tests/subsys/nrf_rpc/rpc_utils/server/dts/bindings/mock-temp-sensor.yaml
```yaml
# Copyright (c) 2025 Nordic Semiconductor ASA
# SPDX-License-Identifier: LicenseRef-Nordic-5-Clause

description: Mock temperature sensor for testing

compatible: "mock-temp-sensor"

include: base.yaml
```

## tests/subsys/nrf_security/kmu_push/testcase.yaml
```yaml
tests:
  kmu_push.kmu_push:
    sysbuild: true
    platform_allow:
      - nrf54l15dk/nrf54l15/cpuapp
      - nrf54lm20dk/nrf54lm20a/cpuapp
      - nrf54lm20dk/nrf54lm20b/cpuapp
      - nrf54lv10dk/nrf54lv10a/cpuapp
    integration_platforms:
      - nrf54l15dk/nrf54l15/cpuapp
      - nrf54lm20dk/nrf54lm20a/cpuapp
      - nrf54lm20dk/nrf54lm20b/cpuapp
      - nrf54lv10dk/nrf54lv10a/cpuapp
    tags:
      - sysbuild
      - crypto
      - ci_crypto
      - ci_tests_crypto
```

## tests/subsys/nrf_security/psa_core_lite/testcase.yaml
```yaml
tests:
  # PSA core lite: Ed25519
  psa_core_lite.ed25519:
    sysbuild: true
    platform_allow:
      - nrf54l15dk/nrf54l15/cpuapp
    integration_platforms:
      - nrf54l15dk/nrf54l15/cpuapp
    tags:
      - sysbuild
      - crypto
      - ci_crypto
      - ci_tests_crypto
    extra_args: >
      EXTRA_CONF_FILE="lite.conf;eddsa.conf"
  # PSA core lite: ECDSA
  psa_core_lite.ecdsa:
    sysbuild: true
    platform_allow:
      - nrf54l15dk/nrf54l15/cpuapp
    integration_platforms:
      - nrf54l15dk/nrf54l15/cpuapp
    tags:
      - crypto
      - ci_crypto
      - ci_tests_crypto
      - sysbuild
    extra_args: >
      EXTRA_CONF_FILE="lite.conf;ecdsa.conf"
  # Oberon PSA crypto: Ed25519
  psa_core_oberon.ed25519:
    sysbuild: true
    platform_allow:
      - nrf54l15dk/nrf54l15/cpuapp
    integration_platforms:
      - nrf54l15dk/nrf54l15/cpuapp
    tags:
      - crypto
      - ci_crypto
      - ci_tests_crypto
      - sysbuild
    extra_args: >
      EXTRA_CONF_FILE="eddsa.conf"
  # Oberon PSA crypto: ECDSA
  psa_core_oberon.ecdsa:
    sysbuild: true
    platform_allow:
      - nrf54l15dk/nrf54l15/cpuapp
    integration_platforms:
      - nrf54l15dk/nrf54l15/cpuapp
    tags:
      - crypto
      - ci_crypto
      - ci_tests_crypto
      - sysbuild
    extra_args: >
      EXTRA_CONF_FILE="ecdsa.conf"
  # PSA core lite: Ed25519 + encrypt + RNG
  psa_core_lite.ed25519.encrypt.rng:
    sysbuild: true
    platform_allow:
      - nrf54l15dk/nrf54l15/cpuapp
    integration_platforms:
      - nrf54l15dk/nrf54l15/cpuapp
    tags:
      - sysbuild
      - crypto
      - ci_crypto
      - ci_tests_crypto
    extra_args: >
      EXTRA_CONF_FILE="lite.conf;eddsa.conf;encrypt.conf;rng.conf"
  # PSA core lite: ECDSA + encrypt + RNG
  psa_core_lite.ecdsa.encrypt.rng:
    sysbuild: true
    platform_allow:
      - nrf54l15dk/nrf54l15/cpuapp
    integration_platforms:
      - nrf54l15dk/nrf54l15/cpuapp
    tags:
      - crypto
      - ci_crypto
      - ci_tests_crypto
      - sysbuild
    extra_args: >
      EXTRA_CONF_FILE="lite.conf;ecdsa.conf;encrypt.conf;rng.conf"
  # Oberon PSA crypto: Ed25519 + encrypt + RNG
  psa_core_oberon.ed25519.encrypt.rng:
    sysbuild: true
    platform_allow:
      - nrf54l15dk/nrf54l15/cpuapp
    integration_platforms:
      - nrf54l15dk/nrf54l15/cpuapp
    tags:
      - crypto
      - ci_crypto
      - ci_tests_crypto
      - sysbuild
    extra_args: >
      EXTRA_CONF_FILE="eddsa.conf;encrypt.conf;rng.conf"
  # ECDSA + Oberon PSA crypto: ECDSA + encrypt + RNG
  psa_core_oberon.ecdsa.encrypt.rng:
    sysbuild: true
    platform_allow:
      - nrf54l15dk/nrf54l15/cpuapp
    integration_platforms:
      - nrf54l15dk/nrf54l15/cpuapp
    tags:
      - crypto
      - ci_crypto
      - ci_tests_crypto
      - sysbuild
    extra_args: >
      EXTRA_CONF_FILE="ecdsa.conf;encrypt.conf;rng.conf"
  # PSA core lite: ECDSA + AES-KW + encrypt
  psa_core_lite.ecdsa.aes_kw.encrypt:
    sysbuild: true
    platform_allow:
      - nrf54l15dk/nrf54l15/cpuapp
    integration_platforms:
      - nrf54l15dk/nrf54l15/cpuapp
    tags:
      - crypto
      - ci_crypto
      - ci_tests_crypto
      - sysbuild
    extra_args: >
      EXTRA_CONF_FILE="lite.conf;ecdsa.conf;key_wrap.conf;encrypt.conf"
  # Oberon PSA crypto: ECDSA + AES-KW + encrypt
  psa_core_oberon.ecdsa.aes_kw.encrypt:
    sysbuild: true
    platform_allow:
      - nrf54l15dk/nrf54l15/cpuapp
    integration_platforms:
      - nrf54l15dk/nrf54l15/cpuapp
    tags:
      - crypto
      - ci_crypto
      - ci_tests_crypto
      - sysbuild
    extra_args: >
      EXTRA_CONF_FILE="ecdsa.conf;key_wrap.conf;encrypt.conf"
```

## tests/subsys/nrf_security/psa_xof/testcase.yaml
```yaml
tests:
  psa_xof.cracen:
    sysbuild: true
    platform_allow:
      - nrf54l15dk/nrf54l15/cpuapp
      - nrf54l15dk/nrf54l10/cpuapp
      - nrf54l15dk/nrf54l05/cpuapp
      - nrf54lm20dk/nrf54lm20a/cpuapp
      - nrf54lm20dk/nrf54lm20b/cpuapp
      - nrf54lv10dk/nrf54lv10a/cpuapp
    integration_platforms:
      - nrf54l15dk/nrf54l15/cpuapp
      - nrf54lm20dk/nrf54lm20a/cpuapp
      - nrf54lm20dk/nrf54lm20b/cpuapp
      - nrf54lv10dk/nrf54lv10a/cpuapp
    tags:
      - sysbuild
      - crypto
      - ci_crypto
      - ci_tests_crypto
  psa_xof.cracen.small_pool:
    sysbuild: true
    platform_allow:
      - nrf54l15dk/nrf54l15/cpuapp
      - nrf54l15dk/nrf54l10/cpuapp
      - nrf54l15dk/nrf54l05/cpuapp
      - nrf54lm20dk/nrf54lm20a/cpuapp
      - nrf54lm20dk/nrf54lm20b/cpuapp
      - nrf54lv10dk/nrf54lv10a/cpuapp
    integration_platforms:
      - nrf54l15dk/nrf54l15/cpuapp
      - nrf54lm20dk/nrf54lm20a/cpuapp
      - nrf54lm20dk/nrf54lm20b/cpuapp
      - nrf54lv10dk/nrf54lv10a/cpuapp
    extra_configs:
      - CONFIG_CRACEN_XOF_OUT_POOL_BUF_SIZE=168
    tags:
      - sysbuild
      - crypto
      - ci_crypto
      - ci_tests_crypto
```

## tests/subsys/partition_manager/region/Kconfig.sysbuild
```kconfig
#
# Copyright (c) 2024 Nordic Semiconductor
#
# SPDX-License-Identifier: LicenseRef-Nordic-5-Clause
#

config PM_EXTERNAL_FLASH_MCUBOOT_SECONDARY
	default y if BOARD_NRF5340DK_NRF5340_CPUAPP

source "${ZEPHYR_BASE}/share/sysbuild/Kconfig"
```

## tests/subsys/partition_manager/region/testcase.yaml
```yaml
common:
  build_only: true
  tags: partition_manager
tests:
  regions.little_fs:
    sysbuild: true
    platform_allow: nrf5340dk/nrf5340/cpuapp
    integration_platforms:
      - nrf5340dk/nrf5340/cpuapp
    extra_configs:
      - CONFIG_FILE_SYSTEM_LITTLEFS=y
      - CONFIG_PM_PARTITION_REGION_LITTLEFS_EXTERNAL=y
    tags: sysbuild
  regions.nvs_storage:
    sysbuild: true
    platform_allow: nrf5340dk/nrf5340/cpuapp
    integration_platforms:
      - nrf5340dk/nrf5340/cpuapp
    extra_configs:
      - CONFIG_NVS=y
      - CONFIG_PM_PARTITION_REGION_NVS_STORAGE_EXTERNAL=y
    tags: sysbuild
  regions.settings_storage:
    sysbuild: true
    platform_allow: nrf5340dk/nrf5340/cpuapp
    integration_platforms:
      - nrf5340dk/nrf5340/cpuapp
    extra_configs:
      - CONFIG_FCB=y
      - CONFIG_SETTINGS=y
      - CONFIG_SETTINGS_FCB=y
      - CONFIG_PM_PARTITION_REGION_SETTINGS_STORAGE_EXTERNAL=y
    tags: sysbuild
  regions.settings_storage_tfm:
    sysbuild: true
    platform_allow: nrf5340dk/nrf5340/cpuapp/ns
    integration_platforms:
      - nrf5340dk/nrf5340/cpuapp/ns
    extra_configs:
      - CONFIG_FCB=y
      - CONFIG_SETTINGS=y
      - CONFIG_SETTINGS_FCB=y
      - CONFIG_PM_PARTITION_REGION_SETTINGS_STORAGE_EXTERNAL=y
    tags: sysbuild
```

## tests/subsys/partition_manager/static_pm_file/testcase.yaml
```yaml
common:
  tags: partition_manager ci_tests_subsys_partition_manager
tests:
  static_pm_file.sysbuild:
    sysbuild: true
    platform_allow: nrf5340dk/nrf5340/cpuapp
    integration_platforms:
      - nrf5340dk/nrf5340/cpuapp
    extra_args:
      - PM_STATIC_YML_FILE=test_file.yml
    tags: sysbuild
  static_pm_file.child_parent:
    platform_allow: nrf5340dk/nrf5340/cpuapp
    integration_platforms:
      - nrf5340dk/nrf5340/cpuapp
    extra_args:
      - PM_STATIC_YML_FILE=${CMAKE_CURRENT_SOURCE_DIR}/test_file.yml
```

## tests/subsys/pcd/testcase.yaml
```yaml
tests:
  dfu.pcd.sysbuild:
    sysbuild: true
    platform_allow: nrf5340dk/nrf5340/cpuapp
    integration_platforms:
      - nrf5340dk/nrf5340/cpuapp
    tags:
      - pcd
      - sysbuild
      - ci_tests_subsys_pcd
```

## tests/subsys/profiler/testcase.yaml
```yaml
tests:
  profiler.core:
    platform_exclude: native_posix qemu_x86 qemu_cortex_m3
    integration_platforms:
      - nrf51dk_nrf51422
      - nrf52dk_nrf52832
      - nrf52840dk_nrf52840
      - nrf9160dk_nrf9160ns
    tags: profiler
```

## tests/subsys/rtt/testcase.yaml
```yaml
tests:
  rtt.logging:
    tags: ci_tests_subsys_rtt
    harness: pytest
    harness_config:
      pytest_dut_scope: session
      pytest_root:
        - "pytest/test_rtt.py::test_rtt_logging"
    timeout: 30
    platform_allow:
      - nrf52dk/nrf52832
      - nrf52840dk/nrf52840
      - nrf5340dk/nrf5340/cpuapp
      - nrf54l15dk/nrf54l05/cpuapp
      - nrf54l15dk/nrf54l10/cpuapp
      - nrf54l15dk/nrf54l15/cpuapp
      - nrf54lm20dk/nrf54lm20a/cpuapp
      - nrf54ls05dk/nrf54ls05b/cpuapp
      - nrf54ls05dk@0.0.0/nrf54ls05b/cpuapp
      - nrf54lv10dk/nrf54lv10a/cpuapp
      - nrf54lv10dk/nrf54lv10a/cpuapp/ns
      - nrf7120dk/nrf7120/cpuapp
    integration_platforms:
      - nrf52840dk/nrf52840
      - nrf5340dk/nrf5340/cpuapp
      - nrf54l15dk/nrf54l15/cpuapp
      - nrf54lm20dk/nrf54lm20a/cpuapp
      - nrf7120dk/nrf7120/cpuapp
```

## tests/subsys/sdfw_services/client/testcase.yaml
```yaml
tests:
  ssf.client:
    sysbuild: true
    platform_allow: native_sim
    integration_platforms:
      - native_sim
    tags:
      - ssf
      - sysbuild
      - ci_tests_subsys_sdfw_services
```

## tests/subsys/sdfw_services/client_notif/testcase.yaml
```yaml
tests:
  ssf.client_notif:
    platform_allow: native_posix
    integration_platforms:
      - native_posix
    tags: ssf
```
