## tests/subsys/dfu/dfu_target_mcuboot_flatten/Kconfig
```kconfig
#
# Copyright (c) 2026 Nordic Semiconductor ASA
#
# SPDX-License-Identifier: LicenseRef-Nordic-5-Clause
#

config DFU_TARGET_NO_FLATTEN
        default y

source "Kconfig.zephyr"
```

## tests/subsys/dfu/dfu_target_mcuboot_flatten/testcase.yaml
```yaml
tests:
  dfu.dfu_target.mcuboot.flatten:
    platform_allow:
      - native_sim
    integration_platforms:
      - native_sim
    tags:
      - dfu
      - mcuboot
      - ci_tests_subsys_dfu
```

## tests/subsys/dfu/dfu_target_stream/testcase.yaml
```yaml
# Since we need the storage partition we limit the set of allowed platforms.
tests:
  dfu.target_stream:
    sysbuild: true
    tags:
      - target_stream
      - sysbuild
      - ci_tests_subsys_dfu
    platform_allow:
      - nrf52840dk/nrf52840
      - nrf9160dk/nrf9160
      - nrf5340dk/nrf5340/cpuapp
      - native_sim
      - nrf54l15dk/nrf54l05/cpuapp
      - nrf54l15dk/nrf54l10/cpuapp
      - nrf54l15dk/nrf54l15/cpuapp
      - nrf54lv10dk/nrf54lv10a/cpuapp
      - nrf54lc10dk/nrf54lc10a/cpuapp
      - nrf54lm20dk/nrf54lm20a/cpuapp
      - nrf54lm20dk/nrf54lm20b/cpuapp
      - nrf54ls05dk/nrf54ls05a/cpuapp
      - nrf54ls05dk/nrf54ls05b/cpuapp
    integration_platforms:
      - nrf52840dk/nrf52840
      - native_sim
      - nrf54l15dk/nrf54l05/cpuapp
      - nrf54l15dk/nrf54l10/cpuapp
      - nrf54l15dk/nrf54l15/cpuapp
      - nrf54lv10dk/nrf54lv10a/cpuapp
      - nrf54lc10dk/nrf54lc10a/cpuapp
      - nrf54lm20dk/nrf54lm20a/cpuapp
      - nrf54lm20dk/nrf54lm20b/cpuapp
      - nrf54ls05dk/nrf54ls05a/cpuapp
      - nrf54ls05dk/nrf54ls05b/cpuapp
  dfu.target_stream.store_progress:
    sysbuild: true
    tags:
      - target_stream
      - sysbuild
      - ci_tests_subsys_dfu
    extra_args: OVERLAY_CONFIG=overlay-store-progress.conf
    # Since we need the storage partition (and hence PM) allow some nRF devices
    # only.
    platform_allow:
      - nrf52840dk/nrf52840
      - nrf9160dk/nrf9160
      - nrf5340dk/nrf5340/cpuapp
      - native_sim
      - nrf54l15dk/nrf54l05/cpuapp
      - nrf54l15dk/nrf54l10/cpuapp
      - nrf54l15dk/nrf54l15/cpuapp
      - nrf54lv10dk/nrf54lv10a/cpuapp
      - nrf54lc10dk/nrf54lc10a/cpuapp
      - nrf54lm20dk/nrf54lm20a/cpuapp
      - nrf54lm20dk/nrf54lm20b/cpuapp
      - nrf54ls05dk/nrf54ls05a/cpuapp
      - nrf54ls05dk/nrf54ls05b/cpuapp
    integration_platforms:
      - nrf52840dk/nrf52840
      - native_sim
      - nrf54l15dk/nrf54l05/cpuapp
      - nrf54l15dk/nrf54l10/cpuapp
      - nrf54l15dk/nrf54l15/cpuapp
      - nrf54lv10dk/nrf54lv10a/cpuapp
      - nrf54lc10dk/nrf54lc10a/cpuapp
      - nrf54lm20dk/nrf54lm20a/cpuapp
      - nrf54lm20dk/nrf54lm20b/cpuapp
      - nrf54ls05dk/nrf54ls05a/cpuapp
      - nrf54ls05dk/nrf54ls05b/cpuapp
```

## tests/subsys/emds/emds_flash/testcase.yaml
```yaml
tests:
  emds.flash:
    sysbuild: true
    platform_allow:
      - nrf54l15dk/nrf54l15/cpuapp
    tags:
      - emds
      - sysbuild
      - ci_tests_subsys_emds
    integration_platforms:
      - nrf54l15dk/nrf54l15/cpuapp
```

## tests/subsys/event_manager_proxy/testcase.yaml
```yaml
common:
  sysbuild: true
  tags:
    - event_manager_proxy
    - sysbuild
    - ci_tests_subsys_event_manager_proxy

tests:
  event_manager_proxy.event_manager_proxy:
    platform_allow:
      - nrf5340dk/nrf5340/cpuapp
      - nrf54h20dk/nrf54h20/cpuapp
      - nrf54l15dk/nrf54l15/cpuapp
      - nrf54lm20dk/nrf54lm20a/cpuapp
      - nrf54lm20dk/nrf54lm20b/cpuapp
      - nrf54lv10dk/nrf54lv10a/cpuapp
      - nrf54lc10dk/nrf54lc10a/cpuapp
      - nrf7120dk/nrf7120/cpuapp
      - nrf9251dk/nrf9251/cpuapp
    integration_platforms:
      - nrf5340dk/nrf5340/cpuapp
      - nrf54l15dk/nrf54l15/cpuapp
    extra_args:
      - platform:nrf54h20:event_manager_proxy_SNIPPET=nordic-ppr
      - platform:nrf9251:event_manager_proxy_SNIPPET=nordic-ppr
      - platform:nrf54l:event_manager_proxy_SNIPPET=nordic-flpr
      - platform:nrf7120:event_manager_proxy_SNIPPET=nordic-flpr
    timeout: 20
```

## tests/subsys/ipc/ipc_latency/Kconfig.sysbuild
```kconfig
# Copyright 2025 Nordic Semiconductor ASA
#
# SPDX-License-Identifier: LicenseRef-Nordic-5-Clause

if SUPPORT_NETCORE

choice NETCORE
	default NETCORE_REMOTE

config NETCORE_REMOTE
	bool "remote image"

endchoice

config NETCORE_IMAGE_NAME
	default "remote" if NETCORE_REMOTE

config NETCORE_IMAGE_PATH
	default "$(APP_DIR)/remote" if NETCORE_REMOTE

endif # SUPPORT_NETCORE

source "share/sysbuild/Kconfig"
```

## tests/subsys/ipc/ipc_reconnect/Kconfig.sysbuild
```kconfig
# Copyright 2026 Nordic Semiconductor ASA
#
# SPDX-License-Identifier: LicenseRef-Nordic-5-Clause

if SUPPORT_NETCORE

choice NETCORE
	default NETCORE_REMOTE

config NETCORE_REMOTE
	bool "remote image"

endchoice

config NETCORE_IMAGE_NAME
	default "remote" if NETCORE_REMOTE

config NETCORE_IMAGE_PATH
	default "${APP_DIR}/remote" if NETCORE_REMOTE

endif # SUPPORT_NETCORE

if SUPPORT_FLPRCORE && !SUPPORT_NETCORE

choice FLPRCORE
	default FLPRCORE_REMOTE

config FLPRCORE_REMOTE
	bool "remote image"

endchoice

config FLPRCORE_IMAGE_NAME
	default "remote" if FLPRCORE_REMOTE

config FLPRCORE_IMAGE_PATH
	default "${APP_DIR}/remote" if FLPRCORE_REMOTE

endif # SUPPORT_FLPRCORE && !SUPPORT_NETCORE

source "share/sysbuild/Kconfig"
```

## tests/subsys/ipc/ipc_reconnect/testcase.yaml
```yaml
common:
  tags:
    - subsys
    - ipc
    - ci_tests_subsys_ipc
  sysbuild: true
  harness: console
  harness_config:
    type: multi_line
    regex:
      - "Instance opened"
      - "Endpoint registered"
      - "Waiting for binding"
      - "IPC endpoint bound"
      - "Message 0 sent"
      - "Message 0 received"
      - "Message 1 sent"
      - "Message 1 received"
      - "Message 2 sent"
      - "Message 2 received"
      - "Disconnecting"
      - "IPC endpoint deregistered"
      - "IPC instance closed"
      - "Reconnecting"
      - "Instance opened"
      - "Endpoint registered"
      - "Waiting for binding"
      - "IPC endpoint bound"
      - "Message 2 sent"
      - "Message 2 received"

tests:
  subsys.ipc.ipc_reconnect.icmsg:
    platform_allow:
      - nrf5340dk/nrf5340/cpuapp
      - nrf54h20dk/nrf54h20/cpuapp
      - nrf54l15dk/nrf54l15/cpuapp
      - nrf54lm20dk/nrf54lm20a/cpuapp
      - nrf54lm20dk/nrf54lm20b/cpuapp
      - nrf54lv10dk/nrf54lv10a/cpuapp
      - nrf54lc10dk/nrf54lc10a/cpuapp
      - nrf7120dk/nrf7120/cpuapp
      - nrf9251dk/nrf9251/cpuapp
    integration_platforms:
      - nrf54h20dk/nrf54h20/cpuapp
      - nrf54l15dk/nrf54l15/cpuapp
      - nrf7120dk/nrf7120/cpuapp
      - nrf9251dk/nrf9251/cpuapp
    extra_args:
      - ipc_reconnect_EXTRA_DTC_OVERLAY_FILE="boards/ipc0_icmsg.overlay"
      - remote_EXTRA_DTC_OVERLAY_FILE="boards/ipc0_icmsg.overlay"
      - platform:nrf54l:ipc_reconnect_SNIPPET=nordic-flpr
      - platform:nrf9251:ipc_reconnect_SNIPPET=nordic-ppr
```

## tests/subsys/net/lib/aws_iot/testcase.yaml
```yaml
tests:
  net.lib.aws_iot:
    sysbuild: true
    platform_allow: native_sim
    integration_platforms:
      - native_sim
    tags:
      - aws_iot
      - sysbuild
      - ci_tests_subsys_net
  net.lib.aws_iot.resubscribe_on_session_present:
    sysbuild: true
    platform_allow: native_sim
    integration_platforms:
      - native_sim
    extra_configs:
      - CONFIG_AWS_IOT_RESUBSCRIBE_ON_SESSION_PRESENT=y
    tags:
      - aws_iot
      - sysbuild
      - ci_tests_subsys_net
```

## tests/subsys/net/lib/connect_by_name/Kconfig
```kconfig
#
# Copyright (c) 2026 Nordic Semiconductor ASA
#
# SPDX-License-Identifier: LicenseRef-Nordic-5-Clause
#

config TEST_MODEM_READINESS
	bool "Test modem readiness with a faked AT interface"

source "Kconfig.zephyr"
```

## tests/subsys/net/lib/connect_by_name/testcase.yaml
```yaml
tests:
  net.lib.connect_by_name:
    sysbuild: true
    platform_allow:
      - native_sim
    integration_platforms:
      - native_sim
    tags:
      - connect_by_name
      - sysbuild
      - ci_tests_subsys_net
  net.lib.connect_by_name.no_readiness:
    sysbuild: true
    platform_allow:
      - native_sim
    integration_platforms:
      - native_sim
    extra_configs:
      - CONFIG_CONNECT_BY_NAME_READINESS=n
    tags:
      - connect_by_name
      - sysbuild
      - ci_tests_subsys_net
  net.lib.connect_by_name.modem_readiness:
    sysbuild: true
    platform_allow:
      - native_sim
    integration_platforms:
      - native_sim
    extra_configs:
      - CONFIG_CONNECT_BY_NAME_READINESS=n
      - CONFIG_TEST_MODEM_READINESS=y
    tags:
      - connect_by_name
      - sysbuild
      - ci_tests_subsys_net
```

## tests/subsys/net/lib/mqtt_helper/testcase.yaml
```yaml
tests:
  net.lib.mqtt_helper:
    sysbuild: true
    platform_allow:
      - qemu_cortex_m3
      - native_sim
    integration_platforms:
      - native_sim
    tags:
      - mqtt_helper
      - sysbuild
      - ci_tests_subsys_net
  net.lib.mqtt_helper.ipv4_only:
    sysbuild: true
    platform_allow:
      - qemu_cortex_m3
      - native_sim
    integration_platforms:
      - native_sim
    tags:
      - mqtt_helper
      - sysbuild
      - ci_tests_subsys_net
    extra_configs:
      - CONFIG_NET_IPV4=y
      - CONFIG_NET_IPV6=n
  net.lib.mqtt_helper.ipv6_only:
    sysbuild: true
    platform_allow:
      - qemu_cortex_m3
      - native_sim
    integration_platforms:
      - native_sim
    tags:
      - mqtt_helper
      - sysbuild
      - ci_tests_subsys_net
    extra_configs:
      - CONFIG_NET_IPV4=n
      - CONFIG_NET_IPV6=y
```

## tests/subsys/net/lib/net_host_connect/testcase.yaml
```yaml
tests:
  net.lib.net_host_connect:
    sysbuild: true
    platform_allow:
      - native_sim
    integration_platforms:
      - native_sim
    tags:
      - net_host_connect
      - sysbuild
      - ci_tests_subsys_net
```

## tests/subsys/net/lib/nrf_cloud/dns/Kconfig
```kconfig
#
# Copyright (c) 2026 Nordic Semiconductor ASA
#
# SPDX-License-Identifier: LicenseRef-Nordic-5-Clause
#

config TEST_NRF_CLOUD_IPV6
	bool "Test with CONFIG_NRF_CLOUD_IPV6"

config TEST_NRF_CLOUD_STATIC_IPV4
	bool "Test with CONFIG_NRF_CLOUD_STATIC_IPV4"

source "Kconfig.zephyr"
```

## tests/subsys/net/lib/nrf_cloud/dns/testcase.yaml
```yaml
common:
  sysbuild: true
  platform_allow:
    - native_sim
  integration_platforms:
    - native_sim
  tags:
    - nrf_cloud_test
    - nrf_cloud_lib
    - sysbuild
    - ci_tests_subsys_net
tests:
  net.lib.nrf_cloud.dns: {}
  net.lib.nrf_cloud.dns.ipv6:
    extra_configs:
      - CONFIG_TEST_NRF_CLOUD_IPV6=y
  net.lib.nrf_cloud.dns.static_ipv4:
    extra_configs:
      - CONFIG_TEST_NRF_CLOUD_STATIC_IPV4=y
```

## tests/subsys/net/lib/nrf_cloud/transport/testcase.yaml
```yaml
tests:
  net.lib.nrf_cloud.transport:
    sysbuild: true
    platform_allow:
      - native_sim
    integration_platforms:
      - native_sim
    tags:
      - nrf_cloud_test
      - nrf_cloud_lib
      - sysbuild
      - ci_tests_subsys_net
```

## tests/subsys/net/lib/ready_resolve/Kconfig
```kconfig
#
# Copyright (c) 2026 Nordic Semiconductor ASA
#
# SPDX-License-Identifier: LicenseRef-Nordic-5-Clause
#

config TEST_MODEM_READINESS
	bool "Test modem readiness with a faked AT interface"

# Takes precedence over the library default
config READY_RESOLVE_TRACK_MODEM
	default y if TEST_MODEM_READINESS

source "Kconfig.zephyr"
```

## tests/subsys/net/lib/tls_credentials_keygen_kmu/testcase.yaml
```yaml
tests:
  net.lib.tls_credentials_keygen_kmu:
    sysbuild: true
    platform_allow:
      - nrf7120dk/nrf7120/cpuapp/ns
      - nrf54lm20dk/nrf54lm20a/cpuapp/ns
    integration_platforms:
      - nrf7120dk/nrf7120/cpuapp/ns
    tags:
      - sysbuild
      - ci_tests_subsys_net
```

## tests/subsys/nrf_compress/decompression/arm_thumb/testcase.yaml
```yaml
common:
  sysbuild: true
  tags:
    - compress
    - decompression
    - arm_thumb
    - sysbuild
    - ci_tests_subsys_nrf_compress
  platform_allow:
    - native_sim
    - nrf52840dk/nrf52840
    - nrf5340dk/nrf5340/cpuapp
    - nrf5340dk/nrf5340/cpuapp/ns
    - nrf54h20dk/nrf54h20/cpuapp
    - nrf54l15dk/nrf54l15/cpuapp
    - nrf54lc10dk/nrf54lc10a/cpuapp
    - nrf54lm20dk/nrf54lm20a/cpuapp
    - nrf54lm20dk/nrf54lm20b/cpuapp
    - nrf54ls05dk/nrf54ls05a/cpuapp
    - nrf54ls05dk/nrf54ls05b/cpuapp
    - nrf54lv10dk/nrf54lv10a/cpuapp
  integration_platforms:
    - native_sim
    - nrf54h20dk/nrf54h20/cpuapp
    - nrf54l15dk/nrf54l15/cpuapp
    - nrf54lc10dk/nrf54lc10a/cpuapp
    - nrf54lm20dk/nrf54lm20a/cpuapp
    - nrf54lm20dk/nrf54lm20b/cpuapp
    - nrf54ls05dk/nrf54ls05a/cpuapp
    - nrf54ls05dk/nrf54ls05b/cpuapp
    - nrf54lv10dk/nrf54lv10a/cpuapp
tests:
  nrf_compress.decompression.arm_thumb.static: {}
```

## tests/subsys/nrf_compress/decompression/lzma/testcase.yaml
```yaml
common:
  sysbuild: true
  tags:
    - compress
    - decompression
    - lzma
    - sysbuild
    - ci_tests_subsys_nrf_compress
  platform_allow:
    - native_sim
    - nrf52840dk/nrf52840
    - nrf5340dk/nrf5340/cpuapp
    - nrf5340dk/nrf5340/cpuapp/ns
    - nrf54h20dk/nrf54h20/cpuapp
    - nrf54l15dk/nrf54l15/cpuapp
    - nrf54lc10dk/nrf54lc10a/cpuapp
    - nrf54lm20dk/nrf54lm20a/cpuapp
    - nrf54lm20dk/nrf54lm20b/cpuapp
    - nrf54lv10dk/nrf54lv10a/cpuapp
  integration_platforms:
    - native_sim
    - nrf54h20dk/nrf54h20/cpuapp
    - nrf54l15dk/nrf54l15/cpuapp
    - nrf54lc10dk/nrf54lc10a/cpuapp
    - nrf54lm20dk/nrf54lm20a/cpuapp
    - nrf54lm20dk/nrf54lm20b/cpuapp
    - nrf54lv10dk/nrf54lv10a/cpuapp
tests:
  nrf_compress.decompression.lzma.static: {}
  nrf_compress.decompression.lzma.dynamic:
    extra_configs:
      - CONFIG_NRF_COMPRESS_MEMORY_TYPE_MALLOC=y
      - CONFIG_COMMON_LIBC_MALLOC=y
      - CONFIG_COMMON_LIBC_MALLOC_ARENA_SIZE=162000
  nrf_compress.decompression.lzma.external_dict:
    extra_configs:
      - CONFIG_NRF_COMPRESS_EXTERNAL_DICTIONARY=y
```

## tests/subsys/nrf_compress/decompression/mcuboot_update/testcase.yaml
```yaml
common:
  sysbuild: true
  tags:
    - sysbuild
    - ci_tests_subsys_nrf_compress
  harness: console
  harness_config:
    type: multi_line
    ordered: true
    regex:
      - "Starting bootloader"
      - "Image index: 0, Swap type: none"
      - "Bootloader chainload address offset:"
      - "Jumping to the first image slot"
      - "Starting bootloader"
      - "Image index: 0, Swap type: perm"
      - "Image 0 upgrade secondary slot -> primary slot"
      - "Erasing the primary slot"
      - "Image 0 copying the secondary slot to the primary slot"
      - "Bootloader chainload address offset:"
      - "Jumping to the first image slot"
      - "Booting nRF Connect SDK"
      - "Compressed image running"
tests:
  nrf_compress.decompression.mcuboot_update:
    extra_args:
      - mcuboot_CONFIG_NRF_RTC_TIMER_USER_CHAN_COUNT=0
    platform_allow:
      - nrf52840dk/nrf52840
      - nrf5340dk/nrf5340/cpuapp
    integration_platforms:
      - nrf52840dk/nrf52840
      - nrf5340dk/nrf5340/cpuapp
  # Split off from the scenario above: NRF_RTC_TIMER_USER_CHAN_COUNT is only
  # defined where the RTC is the system timer. nRF54L and nRF54H use the GRTC,
  # so the setting cannot be applied on these boards.
  nrf_compress.decompression.mcuboot_update.grtc:
    platform_allow:
      - nrf54l15dk/nrf54l15/cpuapp
      - nrf54h20dk/nrf54h20/cpuapp
    integration_platforms:
      - nrf54l15dk/nrf54l15/cpuapp
      - nrf54h20dk/nrf54h20/cpuapp
```
