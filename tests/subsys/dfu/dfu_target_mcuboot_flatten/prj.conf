## CMakeLists.txt
```
#
# Copyright (c) 2026 Nordic Semiconductor
#
# SPDX-License-Identifier: LicenseRef-Nordic-5-Clause
#

cmake_minimum_required(VERSION 3.20.0)

find_package(Zephyr REQUIRED HINTS $ENV{ZEPHYR_BASE})
project(dfu_target_mcuboot_flatten_test)

target_sources(app PRIVATE
  src/main.c
  src/flatten_fake.c
)

target_include_directories(app PRIVATE
  src
)
```

## Kconfig
```
#
# Copyright (c) 2026 Nordic Semiconductor ASA
#
# SPDX-License-Identifier: LicenseRef-Nordic-5-Clause
#

config DFU_TARGET_NO_FLATTEN
        default y

source "Kconfig.zephyr"
```

## prj.conf
```kconfig
#
# Copyright (c) 2026 Nordic Semiconductor ASA
#
# SPDX-License-Identifier: LicenseRef-Nordic-5-Clause
#

CONFIG_ZTEST=y
CONFIG_FLASH=y
CONFIG_FLASH_PAGE_LAYOUT=y
CONFIG_FLASH_MAP=y
CONFIG_STREAM_FLASH=y
CONFIG_STREAM_FLASH_ERASE=y
CONFIG_IMG_MANAGER=y
CONFIG_BOOTLOADER_MCUBOOT=y
CONFIG_DFU_TARGET=y
CONFIG_DFU_TARGET_STREAM_FLATTEN=n
CONFIG_DFU_TARGET_MCUBOOT=y
CONFIG_DFU_TARGET_MODEM_DELTA=n
CONFIG_DFU_TARGET_FULL_MODEM=n
CONFIG_DFU_TARGET_SMP=n
CONFIG_UPDATEABLE_IMAGE_NUMBER=1
```

## boards/native_sim.conf
```kconfig
#
# Copyright (c) 2026 Nordic Semiconductor ASA
#
# SPDX-License-Identifier: LicenseRef-Nordic-5-Clause
#

CONFIG_FLASH_SIMULATOR_DOUBLE_WRITES=y
```

## src/main.c
```c
/*
 * Copyright (c) 2026 Nordic Semiconductor ASA
 *
 * SPDX-License-Identifier: LicenseRef-Nordic-5-Clause
 */

#include <zephyr/ztest.h>
#include <zephyr/devicetree.h>
#include <dfu/dfu_target_mcuboot.h>
#include <dfu/dfu_target_stream.h>
#include <flatten_fake.h>

#define SLOT1_NODE DT_NODELABEL(slot1_partition)

#define EXPECTED_SEC_BASE  DT_REG_ADDR(SLOT1_NODE)
#define EXPECTED_SEC_SIZE  DT_REG_SIZE(SLOT1_NODE)
#define EXPECTED_LAST_BYTE (EXPECTED_SEC_BASE + EXPECTED_SEC_SIZE - 1)

#define TEST_FILE_SIZE 256

static uint8_t stream_buf[4096] __aligned(4);

static void flatten_fake_reset(void)
{
	RESET_FAKE(stream_flash_flatten_page);
}

static void mcuboot_stream_setup(void)
{
	int err;

	flatten_fake_reset();

	err = dfu_target_mcuboot_set_buf(stream_buf, sizeof(stream_buf));
	zassert_ok(err, NULL);

	err = dfu_target_mcuboot_init(TEST_FILE_SIZE, 0, NULL);
	zassert_ok(err, NULL);

	err = dfu_target_mcuboot_write((const uint8_t[]){ 0x3d, 0xb8, 0xf3, 0x96 }, 4);
	zassert_ok(err, NULL);
}

ZTEST(dfu_target_mcuboot_flatten, test_done_success_flattens_last_slot_byte)
{
	struct stream_flash_ctx *stream;
	int err;

	mcuboot_stream_setup();
	stream = dfu_target_stream_get_stream();

	err = dfu_target_mcuboot_done(true);
	zassert_ok(err, NULL);

	zassert_equal(stream_flash_flatten_page_fake.call_count, 1);
	zassert_equal_ptr(stream_flash_flatten_page_fake.arg0_val, stream);
	zassert_equal(stream_flash_flatten_page_fake.arg1_val, EXPECTED_LAST_BYTE);
	zassert_equal(stream_flash_flatten_page_fake.arg1_val,
		      stream->offset + stream->available - 1);
}

ZTEST(dfu_target_mcuboot_flatten, test_done_abort_does_not_flatten)
{
	int err;

	mcuboot_stream_setup();

	err = dfu_target_mcuboot_done(false);
	zassert_ok(err, NULL);

	zassert_equal(stream_flash_flatten_page_fake.call_count, 0);
}

ZTEST(dfu_target_mcuboot_flatten, test_reset_flattens_partition_base)
{
	struct stream_flash_ctx *stream;
	int err;

	mcuboot_stream_setup();
	stream = dfu_target_stream_get_stream();

	err = dfu_target_mcuboot_reset();
	zassert_ok(err, NULL);

	zassert_equal(stream_flash_flatten_page_fake.call_count, 1);
	zassert_equal_ptr(stream_flash_flatten_page_fake.arg0_val, stream);
	zassert_equal(stream_flash_flatten_page_fake.arg1_val, EXPECTED_SEC_BASE);
	zassert_equal(stream_flash_flatten_page_fake.arg1_val, stream->offset);
}

ZTEST(dfu_target_mcuboot_flatten, test_done_propagates_flatten_error)
{
	int err;

	mcuboot_stream_setup();
	stream_flash_flatten_page_fake.return_val = -EIO;

	err = dfu_target_mcuboot_done(true);
	zassert_equal(err, -EIO, NULL);
	zassert_equal(stream_flash_flatten_page_fake.call_count, 1);
}

ZTEST_SUITE(dfu_target_mcuboot_flatten, NULL, NULL, NULL, NULL, NULL);
```

## src/flatten_fake.c
```c
/*
 * Copyright (c) 2026 Nordic Semiconductor ASA
 *
 * SPDX-License-Identifier: LicenseRef-Nordic-5-Clause
 */

#include <flatten_fake.h>

DEFINE_FFF_GLOBALS;

DEFINE_FAKE_VALUE_FUNC2(int, stream_flash_flatten_page, struct stream_flash_ctx *, off_t);
```

## src/flatten_fake.h
```c
/*
 * Copyright (c) 2026 Nordic Semiconductor ASA
 *
 * SPDX-License-Identifier: LicenseRef-Nordic-5-Clause
 */

#ifndef FLATTEN_FAKE_H__
#define FLATTEN_FAKE_H__

#include <zephyr/fff.h>
#include <zephyr/storage/stream_flash.h>

DECLARE_FAKE_VALUE_FUNC2(int, stream_flash_flatten_page, struct stream_flash_ctx *, off_t);

#endif /* FLATTEN_FAKE_H__ */
```
