## tests/subsys/dfu/dfu_extra/Kconfig.sysbuild
```kconfig
#
# Copyright (c) 2025 Nordic Semiconductor ASA
#
# SPDX-License-Identifier: LicenseRef-Nordic-5-Clause
#

config PARTITION_MANAGER
	default n

config BOOT_IMG_HASH_ALG_SHA512
	default n

source "share/sysbuild/Kconfig"
```

## tests/subsys/dfu/dfu_extra/sysbuild/mcuboot/boards/nrf54l15dk_nrf54l15_cpuapp.conf
```kconfig
#
# Copyright (c) 2025 Nordic Semiconductor ASA
#
# SPDX-License-Identifier: LicenseRef-Nordic-5-Clause
#

# nRF54L15DK uses SPI NOR external flash
CONFIG_GPIO=y
CONFIG_SPI=y
CONFIG_SPI_NOR=y
CONFIG_SPI_NOR_SFDP_DEVICETREE=y
CONFIG_SPI_NOR_FLASH_LAYOUT_PAGE_SIZE=4096
```

## tests/subsys/dfu/dfu_multi_image/testcase.yaml
```yaml
tests:
  dfu.dfu_multi_image:
    sysbuild: true
    platform_allow: native_sim
    integration_platforms:
      - native_sim
    tags:
      - dfu
      - sysbuild
      - ci_tests_subsys_dfu
```

## tests/subsys/dfu/dfu_target/mcuboot/testcase.yaml
```yaml
tests:
  dfu.dfu_target.mcuboot:
    sysbuild: true
    platform_allow:
      - nrf52840dk/nrf52840
      - nrf52dk/nrf52832
      - nrf9160dk/nrf9160
      - native_posix
      - qemu_cortex_m3
    integration_platforms:
      - nrf52840dk/nrf52840
      - nrf52dk/nrf52832
      - nrf9160dk/nrf9160
      - native_posix
      - qemu_cortex_m3
    tags: dfu mcuboot sysbuild
```

## tests/subsys/dfu/dfu_target/smp/testcase.yaml
```yaml
tests:
  dfu.dfu_target.smp:
    sysbuild: true
    platform_allow: native_sim
    integration_platforms:
      - native_sim
    tags:
      - dfu
      - smp
      - sysbuild
      - ci_tests_subsys_dfu
```

## tests/subsys/dfu/dfu_target/suit/Kconfig
```kconfig
#
# Copyright (c) 2024 Nordic Semiconductor ASA
#
# SPDX-License-Identifier: LicenseRef-Nordic-5-Clause
#

menuconfig TESTS_SUIT_DFU_TARGET_SUIT_CACHE_PROCESSING
	bool "Run tests for processing of SUIT cache partition by the SUIT DFU target"
	imply DFU_TARGET_SUIT_CACHE_PROCESSING

menuconfig TESTS_SUIT_DFU_TARGET_SUIT_SINGLE_PARTITION
	bool "Run tests for processing of the dfu_partition only by the DFU target"

menuconfig TESTS_SUIT_DFU_TARGET_SUIT_CACHE_IPUC_PROCESSING
	bool "Run tests for processing of SUIT cache IPUC-based partition by the SUIT DFU target"
	imply DFU_TARGET_SUIT_CACHE_PROCESSING

config SUIT_CACHE_SDFW_IPUC_ID
	default 10
	depends on TESTS_SUIT_DFU_TARGET_SUIT_CACHE_IPUC_PROCESSING

source "Kconfig.zephyr"
```

## tests/subsys/dfu/dfu_target/suit/boards/native_sim.conf
```kconfig
#
# Copyright (c) 2024 Nordic Semiconductor ASA
#
# SPDX-License-Identifier: LicenseRef-Nordic-5-Clause
#

CONFIG_ZCBOR=y
CONFIG_ZCBOR_CANONICAL=y
CONFIG_FLASH_SIMULATOR=y
CONFIG_FLASH_SIMULATOR_DOUBLE_WRITES=y
CONFIG_FLASH=y
```

## tests/subsys/dfu/dfu_target/suit/boards/nrf54h20dk_nrf54h20_cpuapp.conf
```kconfig
#
# Copyright (c) 2024 Nordic Semiconductor ASA
#
# SPDX-License-Identifier: LicenseRef-Nordic-5-Clause
#

# Enable logging
CONFIG_LOG=y
CONFIG_LOG_BACKEND_UART=y
CONFIG_LOG_MODE_DEFERRED=y
```

## tests/subsys/dfu/dfu_target/suit/testcase.yaml
```yaml
tests:
  dfu.dfu_target.suit.single_partition:
    sysbuild: true
    platform_allow:
      - nrf54h20dk/nrf54h20/cpuapp
      - native_sim
    integration_platforms:
      - nrf54h20dk/nrf54h20/cpuapp
      - native_sim
    extra_args: OVERLAY_CONFIG=single_partition.conf
    tags:
      - dfu
      - sysbuild
      - ci_tests_subsys_dfu
  dfu.dfu_target.suit.cache_processing:
    sysbuild: true
    platform_allow:
      - nrf54h20dk/nrf54h20/cpuapp
      - native_sim
    integration_platforms:
      - nrf54h20dk/nrf54h20/cpuapp
      - native_sim
    extra_args: OVERLAY_CONFIG=cache_processing.conf
    tags:
      - dfu
      - sysbuild
      - ci_tests_subsys_dfu
  dfu.dfu_target.suit.cache_ipuc_processing:
    sysbuild: true
    platform_allow:
      - nrf54h20dk/nrf54h20/cpuapp
      - native_sim
    integration_platforms:
      - nrf54h20dk/nrf54h20/cpuapp
      - native_sim
    extra_args: OVERLAY_CONFIG=cache_ipuc_processing.conf
    tags:
      - dfu
      - sysbuild
      - ci_tests_subsys_dfu
```

## tests/subsys/dfu/dfu_target_flash/testcase.yaml
```yaml
tests:
  dfu_target_flash:
    platform_whitelist: native_posix
    tags: dfu mcuboot
```

## tests/subsys/dfu/dfu_target_mcuboot/testcase.yaml
```yaml
tests:
  dfu.dfu_target_mcuboot:
    tags: dfu mcuboot
    integration_platforms:
      - nrf52840dk_nrf52840
      - nrf52dk_nrf52832
      - nrf51dk_nrf51422
      - nrf9160dk_nrf9160
      - nrf5340dk_nrf5340_cpuapp
      - native_posix
```

## tests/subsys/dfu/dfu_target_stream/boards/native_posix_64.conf
```kconfig
#
# Copyright (c) 2020 Nordic Semiconductor ASA
#
# SPDX-License-Identifier: LicenseRef-BSD-5-Clause-Nordic
#

CONFIG_FLASH_SIMULATOR_DOUBLE_WRITES=y
```

## tests/subsys/dfu/dfu_target_stream/boards/nrf52840dk_nrf52840.conf
```kconfig
#
# Copyright (c) 2020 Nordic Semiconductor ASA
#
# SPDX-License-Identifier: LicenseRef-BSD-5-Clause-Nordic
#

CONFIG_MPU_ALLOW_FLASH_WRITE=y
```

## tests/subsys/dfu/dfu_target_stream/boards/nrf9160dk_nrf9160ns.conf
```kconfig
#
# Copyright (c) 2020 Nordic Semiconductor ASA
#
# SPDX-License-Identifier: LicenseRef-Nordic-5-Clause
#

CONFIG_MPU_ALLOW_FLASH_WRITE=y
```

## tests/subsys/dfu/image_signing/testcase.yaml
```yaml
tests:
  dfu.image_signing:
    sysbuild: true
    platform_allow:
      - nrf54l15dk/nrf54l15/cpuapp
      - nrf54h20dk/nrf54h20/cpuapp
    integration_platforms:
      - nrf54l15dk/nrf54l15/cpuapp
      - nrf54h20dk/nrf54h20/cpuapp
    tags:
      - dfu
      - sysbuild
      - ci_tests_subsys_dfu

  dfu.image_signing.sysbuild:
    sysbuild: true
    platform_allow:
      - nrf54l15dk/nrf54l15/cpuapp
      - nrf54h20dk/nrf54h20/cpuapp
    integration_platforms:
      - nrf54l15dk/nrf54l15/cpuapp
      - nrf54h20dk/nrf54h20/cpuapp
    tags:
      - dfu
      - sysbuild
      - ci_tests_subsys_dfu
    extra_args:
      - SB_CONFIG_MCUBOOT_SYSBUILD_SIGN=y
```

## tests/subsys/emds/emds_api/boards/nrf52840dk_nrf52840.conf
```kconfig
#
# Copyright (c) 2024 Nordic Semiconductor ASA
#
# SPDX-License-Identifier: LicenseRef-Nordic-5-Clause
#
################################################################################
# Application overlay - nrf52840dk_nrf52840

CONFIG_SOC_FLASH_NRF_PARTIAL_ERASE=y
CONFIG_SOC_FLASH_NRF_PARTIAL_ERASE_MS=2
```

## tests/subsys/emds/emds_api/testcase.yaml
```yaml
tests:
  emds.api:
    sysbuild: true
    platform_allow: nrf52840dk/nrf52840 nrf54l15dk/nrf54l15/cpuapp
    tags: emds sysbuild ci_tests_subsys_emds
    integration_platforms:
      - nrf52840dk/nrf52840
      - nrf54l15dk/nrf54l15/cpuapp
```

## tests/subsys/esb/esb_samples/testcase.yaml
```yaml
common:
  tags:
    - esb
    - ci_tests_subsys_esb
  harness: pytest
  build: false

tests:
  test.sample.esb.same_boards_connected:
    integration_platforms:
      - nrf52840dk/nrf52840
      - nrf54l15dk/nrf54l15/cpuapp
      - nrf54h20dk/nrf54h20/cpurad
    platform_allow: &platform_allow_basic
      - nrf52840dk/nrf52840
      - nrf5340dk/nrf5340/cpunet
      - nrf54h20dk/nrf54h20/cpurad
      - nrf54l15dk/nrf54l15/cpuapp
      - nrf54lm20dk/nrf54lm20b/cpuapp
      - nrf54ls05dk/nrf54ls05b/cpuapp
      - nrf54lc10dk/nrf54lc10a/cpuapp
      - nrf54lv10dk/nrf54lv10a/cpuapp
    required_applications:
      - application: sample.esb.prx.build
        path: $ZEPHYR_NRF_MODULE_DIR/samples/esb/esb_prx
    harness_config:
      required_devices:
        - application: sample.esb.ptx.build
          path: $ZEPHYR_NRF_MODULE_DIR/samples/esb/esb_ptx

  test.sample.esb.nrf54h20_with_other_board:
    integration_platforms:
      - nrf52840dk/nrf52840
      - nrf54l15dk/nrf54l15/cpuapp
      - nrf54lm20dk/nrf54lm20b/cpuapp
    platform_allow: *platform_allow_basic
    platform_exclude:
      - nrf54h20dk/nrf54h20/cpurad
    required_applications:
      - application: sample.esb.prx.build
        path: $ZEPHYR_NRF_MODULE_DIR/samples/esb/esb_prx
    harness_config:
      required_devices:
        - application: sample.esb.ptx.build
          path: $ZEPHYR_NRF_MODULE_DIR/samples/esb/esb_ptx
          platform: nrf54h20dk/nrf54h20/cpurad

  test.sample.esb.dynamic_irq:
    integration_platforms:
      - nrf5340dk/nrf5340/cpunet
      - nrf54h20dk/nrf54h20/cpurad
    platform_allow:
      - nrf5340dk/nrf5340/cpunet
      - nrf52840dk/nrf52840
      - nrf54l15dk/nrf54l15/cpuapp
      - nrf54h20dk/nrf54h20/cpurad
    required_applications:
      - application: sample.esb.prx.dynamic_irq
        path: $ZEPHYR_NRF_MODULE_DIR/samples/esb/esb_prx
    harness_config:
      required_devices:
        - application: sample.esb.ptx.dynamic_irq
          path: $ZEPHYR_NRF_MODULE_DIR/samples/esb/esb_ptx

  test.sample.esb.fast_switching:
    integration_platforms:
      - nrf54h20dk/nrf54h20/cpurad
    platform_allow:
      - nrf54h20dk/nrf54h20/cpurad
    required_applications:
      - application: sample.esb.prx.fast_switching
        path: $ZEPHYR_NRF_MODULE_DIR/samples/esb/esb_prx
    harness_config:
      required_devices:
        - application: sample.esb.ptx.fast_switching
          path: $ZEPHYR_NRF_MODULE_DIR/samples/esb/esb_ptx
```

## tests/subsys/event_manager/testcase.yaml
```yaml
tests:
  event_manager.core:
    integration_platforms:
      - nrf51dk_nrf51422
      - nrf52dk_nrf52832
      - nrf52840dk_nrf52840
      - nrf9160dk_nrf9160_ns
      - qemu_cortex_m3
    tags: event_manager
  event_manager.size_enabled:
    extra_args: OVERLAY_CONFIG=overlay-event_size.conf
    integration_platforms:
      - nrf51dk_nrf51422
      - nrf52dk_nrf52832
      - nrf52840dk_nrf52840
      - nrf9160dk_nrf9160_ns
      - qemu_cortex_m3
    tags: event_manager
```

## tests/subsys/event_manager_proxy/Kconfig
```kconfig
#
# Copyright (c) 2022 Nordic Semiconductor ASA
#
# SPDX-License-Identifier: LicenseRef-Nordic-5-Clause
#

menu "Zephyr Kernel"
source "Kconfig.zephyr"
endmenu

menu "Event manager proxy test settings"

config APP_INCLUDE_REMOTE_IMAGE
	bool "Include remote image as sub image"
	depends on SOC_NRF5340_CPUAPP
	default y if (BOARD_NRF5340DK_NRF5340_CPUAPP || BOARD_NRF5340DK_NRF5340_CPUAPP_NS)
	select PARTITION_MANAGER_ENABLED if SOC_NRF5340_CPUAPP

config APP_REMOTE_BOARD
	string "The name of the CORE to be used by remote image"
	depends on APP_INCLUDE_REMOTE_IMAGE

config APP_SYSTEM_INIT_PRIO
	int "The application preparation initializaition priority"
	default 0
	help
	  The priority of initialization of everything that have to happen
	  before the proxy initialation.
	  The remote core is initialized here if required.

config APP_PROXY_INIT_PRIO
	int "Proxy initialization priority"
	default 1
	help
	  The Event manager proxy initialization priority.
	  Make sure that initialization happens before registration and starting.

config APP_PROXY_REGISTER_PRIO
	int "Proxy registration priority"
	default 2
	help
	  The Event manager proxy registration priority.
	  The moment when all the modules reqisters to the required events to remote.
	  Make sure that it happens after the proxy itself is initialized but before
	  it is started.

config APP_PROXY_START_PRIO
	int "Proxy start priority"
	default 5
	help
	  The Event manager proxy starting priority.
	  The moment when Event manager is started.
	  After this time no more remote event registration is allowed.
	  Make sure that it happens after event proxy registration.

rsource "common_events/Kconfig"
endmenu
```

## tests/subsys/event_manager_proxy/Kconfig.sysbuild
```kconfig
#
# Copyright (c) 2023 Nordic Semiconductor ASA
#
# SPDX-License-Identifier: LicenseRef-Nordic-5-Clause
#

config PARTITION_MANAGER
	default n

config REMOTE_BOARD
	string
	default "nrf5340dk/nrf5340/cpunet" if BOARD_NRF5340DK
	default "nrf54h20dk/nrf54h20/cpuppr" if BOARD_NRF54H20DK_NRF54H20_CPUAPP
	default "nrf54l15dk/nrf54l15/cpuflpr" if BOARD_NRF54L15DK_NRF54L15_CPUAPP
	default "nrf54lm20dk/nrf54lm20a/cpuflpr" if BOARD_NRF54LM20DK_NRF54LM20A_CPUAPP
	default "nrf54lv10dk/nrf54lv10a/cpuflpr" if BOARD_NRF54LV10DK_NRF54LV10A_CPUAPP

source "share/sysbuild/Kconfig"
```

## tests/subsys/event_manager_proxy/boards/nrf5340dk_nrf5340_cpuapp.conf
```kconfig
#
# Copyright (c) 2022 Nordic Semiconductor ASA
#
# SPDX-License-Identifier: LicenseRef-Nordic-5-Clause
#

CONFIG_SOC_NRF53_CPUNET_ENABLE=y
CONFIG_PARTITION_MANAGER_ENABLED=y
CONFIG_EVENT_MANAGER_PROXY_BIND_TIMEOUT_MS=4000
```

## tests/subsys/event_manager_proxy/boards/nrf5340dk_nrf5340_cpuapp_icmsg.conf
```kconfig
#
# Copyright (c) 2022 Nordic Semiconductor ASA
#
# SPDX-License-Identifier: LicenseRef-Nordic-5-Clause
#

CONFIG_SOC_NRF53_CPUNET_ENABLE=y
CONFIG_APP_REMOTE_BOARD="nrf5340dk/nrf5340/cpunet"
```

## tests/subsys/event_manager_proxy/boards/nrf54lm20dk_nrf54lm20b_cpuapp.conf
```kconfig
#
# Copyright (c) 2026 Nordic Semiconductor ASA
#
# SPDX-License-Identifier: LicenseRef-Nordic-5-Clause
#

CONFIG_EVENT_MANAGER_PROXY_BIND_TIMEOUT_MS=4000
```

## tests/subsys/event_manager_proxy/boards/nrf54lv10dk_nrf54lv10a_cpuapp.conf
```kconfig
#
# Copyright (c) 2025 Nordic Semiconductor ASA
#
# SPDX-License-Identifier: LicenseRef-Nordic-5-Clause
#

CONFIG_EVENT_MANAGER_PROXY_BIND_TIMEOUT_MS=4000
```
