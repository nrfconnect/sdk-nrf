/*
 * Copyright (c) 2026 Nordic Semiconductor ASA
 *
 * SPDX-License-Identifier: LicenseRef-Nordic-5-Clause
 */

#include <samples/cellular/nrf91_crypto_partitions.dtsi>

/ {
	sensor_sim_1: sensor_sim_1 {
		compatible = "nordic,sensor-sim";
		acc-signal = "wave";
	};

	sensor_sim_2: sensor_sim_2 {
		compatible = "nordic,sensor-sim";
		acc-signal = "wave";
	};

	sensor_sim_3: sensor_sim_3 {
		compatible = "nordic,sensor-sim";
		acc-signal = "wave";
	};
};
