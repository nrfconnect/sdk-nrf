/*
 * Copyright (c) 2022 Nordic Semiconductor ASA
 *
 * SPDX-License-Identifier: LicenseRef-Nordic-5-Clause
 */
#include <zephyr/dt-bindings/ipc_service/static_vrings.h>

&ipc0 {
	zephyr,priority = <0 PRIO_PREEMPT>;
};
