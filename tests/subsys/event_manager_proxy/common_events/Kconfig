## tests/subsys/event_manager_proxy/common_events/Kconfig
```kconfig
#
# Copyright (c) 2022 Nordic Semiconductor
#
# SPDX-License-Identifier: LicenseRef-Nordic-5-Clause
#

config APP_DATA_EVENT
	bool "Test Data event"

config APP_SIMPLE_EVENT
	bool "Test simple event"

config APP_TEST_EVENT
	bool "Test management event"
```

## tests/subsys/fw_info/testcase.yaml
```yaml
tests:
  fw_info.core:
    sysbuild: true
    platform_allow:
      - nrf9160dk/nrf9160
      - nrf52840dk/nrf52840
      - nrf52dk/nrf52832
      - nrf5340dk/nrf5340/cpuapp
    integration_platforms:
      - nrf52840dk/nrf52840
    tags:
      - b0
      - fw_info
      - sysbuild
      - ci_tests_subsys_fw_info
  fw_info.core.no_pm:
    sysbuild: true
    platform_allow:
      - nrf9160dk/nrf9160
      - nrf52840dk/nrf52840
      - nrf52dk/nrf52832
      - nrf5340dk/nrf5340/cpuapp
      - nrf54l15dk/nrf54l15/cpuapp
    integration_platforms:
      - nrf54l15dk/nrf54l15/cpuapp
      - nrf52840dk/nrf52840
    extra_args:
      - SB_CONFIG_PARTITION_MANAGER=n
    tags:
      - b0
      - fw_info
      - sysbuild
      - ci_tests_subsys_fw_info
```

## tests/subsys/ipc/ipc_latency/testcase.yaml
```yaml
common:
  tags:
    - subsys
    - ipc
    - ci_tests_subsys_nfc
  harness: ztest
  sysbuild: true

tests:
  subsys.ipc.ipc_latency.app_rad.default_backend:
    platform_allow:
      - nrf5340dk/nrf5340/cpuapp
      - nrf54h20dk/nrf54h20/cpuapp
    integration_platforms:
      - nrf5340dk/nrf5340/cpuapp
      - nrf54h20dk/nrf54h20/cpuapp
  subsys.ipc.ipc_latency.app_rad.icmsg_backend:
    platform_allow:
      - nrf5340dk/nrf5340/cpuapp
      - nrf54h20dk/nrf54h20/cpuapp
    integration_platforms:
      - nrf5340dk/nrf5340/cpuapp
      - nrf54h20dk/nrf54h20/cpuapp
    extra_args:
      - FILE_SUFFIX=icmsg
  subsys.ipc.ipc_latency.app_rad.nrf54h.mram_always_on:
    platform_allow:
      - nrf54h20dk/nrf54h20/cpuapp
    integration_platforms:
      - nrf54h20dk/nrf54h20/cpuapp
    extra_configs:
      - CONFIG_MRAM_LATENCY=y
      - CONFIG_MRAM_LATENCY_AUTO_REQ=y
  subsys.ipc.ipc_latency.app_rad.nrf54h.s2ram:
    platform_allow:
      - nrf54h20dk/nrf54h20/cpuapp
    integration_platforms:
      - nrf54h20dk/nrf54h20/cpuapp
    extra_configs:
      - CONFIG_PM=y
      - CONFIG_PM_S2RAM=y
      - CONFIG_PM_DEVICE=y
      - CONFIG_PM_DEVICE_RUNTIME=y
      - CONFIG_POWEROFF=y
```

## tests/subsys/kmu/hello_for_kmu/Kconfig.sysbuild
```kconfig
#
# Copyright 2025 Nordic Semiconductor ASA
#
# SPDX-License-Identifier: LicenseRef-Nordic-5-Clause
#

config PARTITION_MANAGER
	default n

source "share/sysbuild/Kconfig"
```

## tests/subsys/kmu/hello_for_kmu/testcase.yaml
```yaml
common:
  sysbuild: true
  tags:
    - mcuboot
    - kmu
    - ci_tests_subsys_kmu
  platform_allow:
    - nrf54l15dk/nrf54l15/cpuapp
tests:
  mcuboot.kmu.west.provision.basic:
    timeout: 180
    platform_allow:
      - nrf54lm20dk/nrf54lm20a/cpuapp
      - nrf54lv10dk/nrf54lv10a/cpuapp
      - nrf54lv10dk/nrf54lv10a/cpuapp/ns
    tags:
      - pytest
    harness: pytest
    harness_config:
      pytest_root:
        - "../pytest/test_kmu_provision.py"
  mcuboot.kmu.west_flash_default_provision:
    platform_allow:
      - nrf54lm20dk/nrf54lm20a/cpuapp
      - nrf54lv10dk/nrf54lv10a/cpuapp
      - nrf54lv10dk/nrf54lv10a/cpuapp/ns
    harness: console
    harness_config:
      type: one_line
      regex:
        - "Hello World! (.*)"
    extra_args:
      - SB_CONFIG_MCUBOOT_GENERATE_DEFAULT_KMU_KEYFILE=y
  mcuboot.kmu.west_flash_default_provision_with_b0:
    tags:
      - nsib
    harness: console
    harness_config:
      type: one_line
      regex:
        - "Hello World! (.*)"
    extra_args:
      - SB_CONFIG_SECURE_BOOT_APPCORE=y
      - SB_CONFIG_SECURE_BOOT_GENERATE_DEFAULT_KMU_KEYFILE=y
      - SB_CONFIG_MCUBOOT_GENERATE_DEFAULT_KMU_KEYFILE=y
```

## tests/subsys/kmu/revoke/testcase.yaml
```yaml
common:
  sysbuild: true
  timeout: 180
  tags:
    - pytest
    - mcuboot
    - kmu
    - ci_tests_subsys_kmu
  platform_allow:
    - nrf54l15dk/nrf54l15/cpuapp
    - nrf54lm20dk/nrf54lm20a/cpuapp
    - nrf54lv10dk/nrf54lv10a/cpuapp
  harness: pytest
  harness_config:
    pytest_root:
      - "../pytest/test_kmu_revoke_in_app.py"
tests:
  mcuboot.kmu.west.provision.revoke: {}
```

## tests/subsys/kmu/verify_west_ncs_provision/testcase.yaml
```yaml
common:
  timeout: 120
  tags:
    - pytest
    - kmu
    - ci_tests_subsys_kmu
  platform_allow:
    - nrf54l15dk/nrf54l15/cpuapp
    - nrf54lm20dk/nrf54lm20a/cpuapp
    - nrf54lv10dk/nrf54lv10a/cpuapp
    - nrf54lv10dk/nrf54lv10a/cpuapp/ns
tests:
  kmu.west.provision.verify_keys_in_app:
    harness: pytest
    harness_config:
      pytest_root:
        - "../pytest/test_kmu_verify_keys_in_app.py"
```

## tests/subsys/mpsl/pm/testcase.yaml
```yaml
tests:
  mpsl.pm:
    platform_allow: native_posix
    integration_platforms:
      - native_posix
    tags: pm ci_tests_subsys_mpsl
```

## tests/subsys/net/lib/app_jwt/testcase.yaml
```yaml
tests:
  net.lib.app_jwt:
    sysbuild: true
    platform_allow:
      - native_sim
    integration_platforms:
      - native_sim
    tags:
      - fota
      - sysbuild
      - ci_tests_subsys_net
```

## tests/subsys/net/lib/aws_fota/aws_fota_json/testcase.yaml
```yaml
tests:
  net.lib.aws_fota.aws_fota_json:
    sysbuild: true
    platform_allow:
      - native_sim
      - nrf52840dk/nrf52840
      - nrf9160dk/nrf9160
      - qemu_cortex_m3
    integration_platforms:
      - native_sim
    tags:
      - aws
      - fota
      - json
      - sysbuild
      - ci_tests_subsys_net
```

## tests/subsys/net/lib/aws_jobs/testcase.yaml
```yaml
tests:
  net.lib.aws_jobs:
    sysbuild: true
    platform_allow:
      - native_sim
      - qemu_cortex_m3
    integration_platforms:
      - native_sim
      - qemu_cortex_m3
    tags:
      - aws
      - sysbuild
      - ci_tests_subsys_net
```

## tests/subsys/net/lib/azure_iot_hub/dps/testcase.yaml
```yaml
tests:
  net.lib.azure_iot_hub_dps:
    sysbuild: true
    platform_allow: native_sim
    integration_platforms:
      - native_sim
    tags:
      - azure_iot_hub_dps
      - sysbuild
      - ci_tests_subsys_net
```

## tests/subsys/net/lib/azure_iot_hub/iot_hub/testcase.yaml
```yaml
tests:
  net.lib.azure_iot_hub.iot_hub:
    sysbuild: true
    platform_allow:
      - qemu_cortex_m3
      - native_sim
    integration_platforms:
      - native_sim
    tags:
      - azure_iot_hub
      - sysbuild
      - ci_tests_subsys_net
```

## tests/subsys/net/lib/azure_iot_hub/mqtt/Kconfig
```kconfig
#
# Copyright (c) 2022 Nordic Semiconductor
#
# SPDX-License-Identifier: LicenseRef-Nordic-5-Clause
#

source "Kconfig.zephyr"

source "$(ZEPHYR_NRF_MODULE_DIR)/subsys/net/lib/azure_iot_hub/Kconfig"
```

## tests/subsys/net/lib/azure_iot_hub/testcase.yaml
```yaml
tests:
  net.lib.azure_iot_hub:
    platform_allow: nrf9160dk_nrf9160 qemu_x86 native_posix
    tags: azure_iot_hub
```

## tests/subsys/net/lib/download_client/boards/native_sim.conf
```kconfig
CONFIG_ASAN=y
CONFIG_NET_TCP=y
CONFIG_NET_TCP_ISN_RFC6528=n
CONFIG_NET_UDP=y
CONFIG_MBEDTLS=n
```

## tests/subsys/net/lib/download_client/boards/qemu_cortex_m3.conf
```kconfig
CONFIG_NET_TCP=y
CONFIG_NET_TCP_ISN_RFC6528=n
CONFIG_NET_UDP=y
CONFIG_TEST_RANDOM_GENERATOR=y
CONFIG_NET_SLIP_TAP=n
```

## tests/subsys/net/lib/download_client/testcase.yaml
```yaml
tests:
  net.lib.download_client:
    sysbuild: true
    tags: fota sysbuild ci_tests_subsys_net
    platform_allow: native_sim qemu_cortex_m3
    integration_platforms:
      - native_sim
```

## tests/subsys/net/lib/downloader/testcase.yaml
```yaml
tests:
  net.lib.downloader:
    sysbuild: true
    tags:
      - fota
      - sysbuild
      - ci_tests_subsys_net
    platform_allow:
      - native_sim
    integration_platforms:
      - native_sim
```

## tests/subsys/net/lib/fota_download/Kconfig
```kconfig
#
# Copyright (c) 2024 Nordic Semiconductor
#
# SPDX-License-Identifier: LicenseRef-Nordic-5-Clause
#

source "Kconfig.zephyr"

# Needed to allow mocking of tfm functions
config MOCK_TFM_PLATFORM_S0_FUNCTIONS
	bool
	default y
	depends on BUILD_WITH_TFM
```

## tests/subsys/net/lib/fota_download/boards/nrf9160dk_nrf9160_ns.conf
```kconfig
#
# Copyright (c) 2021 Nordic Semiconductor ASA
#
# SPDX-License-Identifier: LicenseRef-Nordic-5-Clause
#

# Disable this since we write our own mock for 'spm_s0_active()'
CONFIG_SPM_SERVICE_S0_ACTIVE=n
CONFIG_SPM_SERVICE_BUSY_WAIT=n
```

## tests/subsys/net/lib/fota_download/boards/nrf9160dk_nrf9160ns.conf
```kconfig
#
# Copyright (c) 2021 Nordic Semiconductor ASA
#
# SPDX-License-Identifier: LicenseRef-BSD-5-Clause-Nordic
#

# Disable this since we write our own mock for 'spm_s0_active()'
CONFIG_SPM_SECURE_SERVICES=n
```

## tests/subsys/net/lib/fota_download/boards/qemu_x86.conf
```kconfig
#
# Copyright (c) 2021 Nordic Semiconductor ASA
#
# SPDX-License-Identifier: LicenseRef-Nordic-5-Clause
#

CONFIG_FLASH_SIMULATOR=y
CONFIG_FLASH_SIMULATOR_DOUBLE_WRITES=y
```

## tests/subsys/net/lib/fota_download/testcase.yaml
```yaml
tests:
  net.lib.fota_download:
    sysbuild: true
    tags: aws fota sysbuild ci_tests_subsys_net
    platform_allow: nrf9160dk/nrf9160 nrf9160dk/nrf9160/ns
    integration_platforms:
      - nrf9160dk/nrf9160
      - nrf9160dk/nrf9160/ns
```
