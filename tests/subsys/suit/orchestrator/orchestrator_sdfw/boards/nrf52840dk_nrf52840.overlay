/*
 * Copyright (c) 2023 Nordic Semiconductor ASA
 *
 * SPDX-License-Identifier: LicenseRef-Nordic-5-Clause
 */

&flash0 {
	partitions {
		compatible = "fixed-partitions";
		#address-cells = <1>;
		#size-cells = <1>;

		/* Use the last 40KB of NVM as suit storage. */
		suit_storage: partition@f6000 {
			reg = <0xf6000 DT_SIZE_K(40)>;
		};
	};
};
