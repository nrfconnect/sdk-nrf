## tests/subsys/suit/integrated_fetch/testcase.yaml
```yaml
tests:
  suit-platform.integration.memptr_streamer:
    platform_allow: nrf52840dk/nrf52840 native_posix native_posix/native/64
    tags: suit-processor suit_platform
    integration_platforms:
      - nrf52840dk/nrf52840
      - native_posix
```

## tests/subsys/suit/invoke/testcase.yaml
```yaml
tests:
  suit-platform.integration.invoke:
    platform_allow:
      - native_sim
      - native_sim/native/64
    tags:
      - suit-processor
      - suit_platform
      - suit
      - ci_tests_subsys_suit
    integration_platforms:
      - native_sim
      - native_sim/native/64
```

## tests/subsys/suit/ipuc/boards/native_posix.conf
```kconfig
#
# Copyright (c) 2024 Nordic Semiconductor ASA
#
# SPDX-License-Identifier: LicenseRef-Nordic-5-Clause
#

CONFIG_FLASH_SIMULATOR=y
CONFIG_FLASH_SIMULATOR_DOUBLE_WRITES=y
```

## tests/subsys/suit/ipuc/testcase.yaml
```yaml
tests:
  suit-platform.integration.ipuc:
    platform_allow: native_sim
    tags:
      - suit_platform
      - suit
      - ci_tests_subsys_suit
    integration_platforms:
      - native_sim
```

## tests/subsys/suit/manifest_variables/testcase.yaml
```yaml
tests:
  suit-platform.integration.manifest_variables:
    platform_allow: native_sim
    tags:
      - suit_platform
      - suit
      - ci_tests_subsys_suit
    integration_platforms:
      - native_sim
```

## tests/subsys/suit/mci/testcase.yaml
```yaml
tests:
  suit-processor.integration.suit_mci:
    platform_allow:
      - native_sim
      - native_sim/native/64
    tags:
      - suit-mci
      - suit
      - ci_tests_subsys_suit
    integration_platforms:
      - native_sim
```

## tests/subsys/suit/memptr_sink/testcase.yaml
```yaml
tests:
  suit-platform.integration.memptr_sink:
    platform_allow: nrf52840dk/nrf52840 native_posix native_posix/native/64
    tags: suit-processor suit_platform
    integration_platforms:
      - nrf52840dk/nrf52840
      - native_posix
```

## tests/subsys/suit/mocks/nrfx/Kconfig
```kconfig
#
# Copyright (c) 2024 Nordic Semiconductor ASA
#
# SPDX-License-Identifier: LicenseRef-Nordic-5-Clause
#

config MOCK_NRFX
	bool "Include nrfx headers mocks"
```

## tests/subsys/suit/mocks/sdfw/Kconfig
```kconfig
#
# Copyright (c) 2024 Nordic Semiconductor ASA
#
# SPDX-License-Identifier: LicenseRef-Nordic-5-Clause
#
#

config MOCK_SDFW
	bool

config MOCK_SDFW_ARBITER
	bool "Include SDFW arbiter mocks"
	select MOCK_SDFW

config MOCK_SDFW_RESET_MGR
	bool "Include SDFW reset_mgr mocks"
	select MOCK_SDFW

config MOCK_SDFW_VPRS
	bool "Include SDFW vprs mocks"
	select MOCK_SDFW
```

## tests/subsys/suit/orchestrator/orchestrator_app/Kconfig
```kconfig
#
# Copyright (c) 2024 Nordic Semiconductor ASA
#
# SPDX-License-Identifier: LicenseRef-Nordic-5-Clause
#

menuconfig TESTS_SUIT_ORCHESTRATOR_APP_MINIMAL_PROCESSING
	bool "Run tests for minimal envelope processing by the SUIT application orchestrator"
	default n

menuconfig TESTS_SUIT_ORCHESTRATOR_APP_FULL_PROCESSING
	bool "Run tests for full envelope processing by the SUIT application orchestrator"
	default n

source "Kconfig.zephyr"
```

## tests/subsys/suit/orchestrator/orchestrator_app/testcase.yaml
```yaml
tests:
  suit.integration.orchestrator_app.minimal:
    platform_allow: native_posix
    tags: suit suit_orchestrator_app suit_orchestrator_app_minimal
    timeout: 240
    extra_args: OVERLAY_CONFIG=minimal_processing.conf
    integration_platforms:
      - native_posix

  suit.integration.orchestrator_app.full:
    platform_allow: native_posix
    tags: suit suit_orchestrator_app suit_orchestrator_app_full
    timeout: 240
    extra_args: OVERLAY_CONFIG=full_processing.conf
    integration_platforms:
      - native_posix
```

## tests/subsys/suit/orchestrator/orchestrator_sdfw/testcase.yaml
```yaml
tests:
  suit.integration.orchestrator:
    platform_allow: nrf52840dk/nrf52840 native_posix native_posix/native/64
    tags: suit suit_orchestrator
    timeout: 240
    integration_platforms:
      - nrf52840dk/nrf52840
      - native_posix
```

## tests/subsys/suit/orchestrator/orchestrator_sdfw_nrf54h20/testcase.yaml
```yaml
tests:
  suit.integration.orchestrator_nrf54h20:
    platform_allow: native_posix
    tags: suit suit_orchestrator nrf54h20 ci_tests_subsys_suit
    integration_platforms:
      - native_posix
```

## tests/subsys/suit/ram_sink/testcase.yaml
```yaml
tests:
  suit-platform.integration.ram_sink:
    platform_allow: nrf52840dk/nrf52840 native_posix native_posix/native/64
    tags: suit-processor suit_platform
    integration_platforms:
      - nrf52840dk/nrf52840
      - native_posix
```

## tests/subsys/suit/sink_selector/boards/native_posix_64.conf
```kconfig
#
# Copyright (c) 2023 Nordic Semiconductor ASA
#
# SPDX-License-Identifier: LicenseRef-Nordic-5-Clause
#

CONFIG_FLASH_SIMULATOR=y
```

## tests/subsys/suit/sink_selector/testcase.yaml
```yaml
tests:
  suit-platform.integration.sink_selector:
    platform_allow:
      - native_sim
      - native_sim/native/64
    tags:
      - suit-processor
      - suit_platform
      - suit
      - ci_tests_subsys_suit
    integration_platforms:
      - native_sim
```

## tests/subsys/suit/storage/Kconfig
```kconfig
#
# Copyright (c) 2025 Nordic Semiconductor ASA
#
# SPDX-License-Identifier: LicenseRef-Nordic-5-Clause
#

rsource "../tests/Kconfig"

source "Kconfig.zephyr"
```

## tests/subsys/suit/storage/testcase.yaml
```yaml
tests:
  suit-processor.integration.suit_storage:
    platform_allow:
      - nrf52840dk/nrf52840
      - native_sim
      - native_sim/native/64
    tags:
      - suit-processor
      - suit_storage
      - suit
      - ci_tests_subsys_suit
    integration_platforms:
      - nrf52840dk/nrf52840
      - native_sim
```

## tests/subsys/suit/storage_nrf54h20/testcase.yaml
```yaml
tests:
  suit-processor.integration.suit_storage_nrf54h20:
    platform_allow: native_posix
    tags: suit-processor suit_storage suit ci_tests_subsys_suit
    integration_platforms:
      - native_posix
```

## tests/subsys/suit/suit_memptr_storage/testcase.yaml
```yaml
tests:
  suit-platform.integration.common.memptr_storage:
    platform_allow:
      - nrf52840dk/nrf52840
      - native_sim
      - native_sim/native/64
    tags:
      - suit-processor
      - suit_platform
      - suit_memptr_storage
      - suit
      - ci_tests_subsys_suit
    integration_platforms:
      - nrf52840dk/nrf52840
      - native_sim
```

## tests/subsys/suit/tests/sdfw/Kconfig
```kconfig
#
# Copyright (c) 2025 Nordic Semiconductor ASA
#
# SPDX-License-Identifier: LicenseRef-Nordic-5-Clause
#

config SUPPORT_SUIT_STORAGE_LAYOUT_TEST
	default y
	depends on SUIT_STORAGE
```

## tests/subsys/suit/unit/app_specific/suit_plat_fetch_app/Kconfig
```kconfig
#
# Copyright (c) 2024 Nordic Semiconductor ASA
#
# SPDX-License-Identifier: LicenseRef-Nordic-5-Clause
#

# Include and define MOCK_* Kconfigs
rsource "../../mocks/Kconfig"

source "Kconfig.zephyr"
```

## tests/subsys/suit/unit/app_specific/suit_plat_fetch_app/testcase.yaml
```yaml
tests:
  suit.unit.platform_app.fetch:
    type: unit
    tags: >-
      suit
      suit_platform
      suit_platform_app_specific
      suit_plat_fetch_domain_specific_is_type_supported
      suit_plat_fetch_integrated_domain_specific_is_type_supported
      suit_plat_fetch_domain_specific
      suit_plat_fetch_integrated_domain_specific
```

## tests/subsys/suit/unit/app_specific/suit_plat_retrieve_manifest_app/testcase.yaml
```yaml
tests:
  suit.unit.platform_app.retreve_manifest:
    type: unit
    tags: >-
      suit
      suit_platform
      suit_plat_app
      suit_plat_retrieve_manifest_domain_specific
```

## tests/subsys/suit/unit/mocks/Kconfig
```kconfig
#
# Copyright (c) 2023 Nordic Semiconductor ASA
#
# SPDX-License-Identifier: LicenseRef-Nordic-5-Clause
#

menuconfig MOCK_SUIT_MCI
	bool "Include SUIT MCI mocks"

if MOCK_SUIT_MCI
config MOCK_SUIT_MCI_GENERIC_IDS
	bool "Mock suit_generic_ids.c implementation"
	default y
	help
	  If not enabled, the module implementation will be included.

config MOCK_SUIT_MCI_UTILS
	bool "Mock utils.c implementation"
	default y
	help
	  If not enabled, the module implementation will be included.
endif # MOCK_SUIT_MCI

config MOCK_SUIT_STORAGE
	bool "Include SUIT storage mocks"

menuconfig MOCK_SUIT_UTILS
	bool "Include SUIT utils mocks"

if MOCK_SUIT_UTILS
config MOCK_SUIT_PLAT_DECODE_UTIL
	bool "Mock suit_plat_decode_util.c implementation"
	default y
	help
	  If not enabled, the module implementation will be included.

endif # MOCK_SUIT_UTILS

config MOCK_SUIT_METADATA
	bool "Include SUIT manifest metadata types and conversion mocks"

config MOCK_SUIT_PROCESSOR
	bool "Include SUIT processor mocks"

config MOCK_SUIT_LOG
	bool "Include minimal logging support in SUIT components"
	default y if LOG

config MOCK_SUIT_CRYPTO
	bool "Mock PSA crypto API"

config MOCK_SUIT_KERNEL
	bool "Mock zephyr kernel API"

config MOCK_SUIT_PLAT_CHECK_COMPONENT_COMPATIBILITY
	bool "Mock suit_plat_component_compatibility_check"

config MOCK_SUIT_MEMPTR_STORAGE
	bool "Include memory pointer storage headers"

config MOCK_SUIT_PLATFORM_INTERNAL
	bool "Mock suit_platform_internal"

config MOCK_SUIT_PLATFORM
	bool "Mock suit_plat_retrieve_manifest"

config MOCK_DIGEST_SINK
	bool "Mock stream sinks"

config MOCK_GENERIC_ADDRESS_STREAMER
	bool "Mock stream sources"

config MOCK_DFU_CACHE_STREAMER
	bool "Mock dfu cache streamer"

config MOCK_FETCH_SOURCE_STREAMER
	bool "Mock fetch source streamer"

config MOCK_DFU_CACHE_SINK
	bool "Mock dfu cache sink"

config MOCK_SDFW_BUILTIN_KEYS
	bool "Mock SDFW builtin keys handling"

config MOCK_SUIT_MEMORY_LAYOUT
	bool "Mock SUIT memory layout module"
```
