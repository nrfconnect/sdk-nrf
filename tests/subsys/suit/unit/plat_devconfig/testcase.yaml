## tests/subsys/suit/unit/plat_devconfig/testcase.yaml
```yaml
tests:
  suit.unit.platform.devconfig:
    type: unit
    tags: >-
      suit
      suit_platform
      suit_plat_sequence_completed
      suit_plat_authorize_sequence_num
      ci_tests_subsys_suit
```

## tests/subsys/suit/unit/suit_decrypt_filter/testcase.yaml
```yaml
tests:
  suit.unit.suit_decrypt_filter:
    type: unit
    tags:
      - suit
      - suit_decrypt_filter
      - ci_tests_subsys_suit
```

## tests/subsys/suit/unit/suit_metadata/testcase.yaml
```yaml
tests:
  suit.unit.metadata:
    type: unit
    tags: >-
      suit
      suit_metadata
      suit_metadata_version_from_array
      ci_tests_subsys_suit
```

## tests/subsys/suit/unit/suit_plat_authorize_component_id/Kconfig
```kconfig
#
# Copyright (c) 2023 Nordic Semiconductor ASA
#
# SPDX-License-Identifier: LicenseRef-Nordic-5-Clause
#

# Include and define MOCK_* Kconfigs
rsource "../mocks/Kconfig"

config CHECK_IMAGE_MATCH_TEST
	bool "Define and set to true to disable suit_plat_check_image_match fake"
	default true

source "Kconfig.zephyr"
```

## tests/subsys/suit/unit/suit_plat_authorize_component_id/testcase.yaml
```yaml
tests:
  suit.unit.platform.suit_plat_authorize_component_id:
    type: unit
    tags: >-
      suit
      suit_platform
      suit_plat_authorize_component_id
```

## tests/subsys/suit/unit/suit_plat_authorize_process_dependency/testcase.yaml
```yaml
tests:
  suit.unit.platform.suit_plat_authorize_process_dependency:
    type: unit
    tags: >-
      suit
      suit_platform
      suit_plat_authorize_process_dependency
```

## tests/subsys/suit/unit/suit_plat_check_image_match/testcase.yaml
```yaml
tests:
  suit.unit.platform.suit_plat_check_image_match:
    type: unit
    tags: >-
      suit
      suit_platform
      suit_plat_check_image_match
```

## tests/subsys/suit/unit/suit_plat_class_check/Kconfig
```kconfig
#
# Copyright (c) 2023 Nordic Semiconductor ASA
#
# SPDX-License-Identifier: LicenseRef-Nordic-5-Clause
#

# Include and define MOCK_* Kconfigs
rsource "../mocks/Kconfig"

config MAX_NUMBER_OF_MANIFEST_CLASS_IDS
	int  "Maximum number of supported manifest class IDs that can be handled"
	range 1 200
	default 8 if SOC_SOC_SERIES_NRF54HX
	default 5 if SOC_NRF52840
	default 5 if SOC_POSIX
	help
	  Check SUIT_STORAGE_N_ENVELOPES

source "Kconfig.zephyr"
```

## tests/subsys/suit/unit/suit_plat_class_check/testcase.yaml
```yaml
tests:
  suit.unit.platform.suit_plat_class_check:
    type: unit
    tags: >-
      suit
      suit_platform
      suit_plat_class_check
```

## tests/subsys/suit/unit/suit_plat_component_compatibility/testcase.yaml
```yaml
tests:
  suit.unit.platform.suit_plat_component_compatibility:
    type: unit
    tags: >-
      suit
      suit_platform
      suit_plat_component_compatibility
      ci_tests_subsys_suit
```

## tests/subsys/suit/unit/suit_plat_components/testcase.yaml
```yaml
tests:
  suit.unit.platform.suit_plat_components:
    type: unit
    tags: >-
      suit
      suit_platform
      suit_plat_components
      ci_tests_subsys_suit
```

## tests/subsys/suit/unit/suit_plat_digest_cache/Kconfig
```kconfig
#
# Copyright (c) 2023 Nordic Semiconductor ASA
#
# SPDX-License-Identifier: LicenseRef-Nordic-5-Clause
#

# Include and define MOCK_* Kconfigs
rsource "../mocks/Kconfig"

config SUIT_DIGEST_CACHE_SIZE
	int "Maximum number of entries in the digest cache"
	default 3

source "Kconfig.zephyr"
```

## tests/subsys/suit/unit/suit_plat_digest_cache/testcase.yaml
```yaml
tests:
  suit.unit.platform.suit_plat_digest_cache:
    type: unit
    tags: >-
      suit
      suit_platform
      suit_plat_digest_cache
      ci_tests_subsys_suit
```

## tests/subsys/suit/unit/suit_plat_memptr_size_update/testcase.yaml
```yaml
tests:
  suit.unit.platform.suit_plat_memptr_size_update:
    type: unit
    tags: >-
      suit
      suit_platform
      suit_plat_memptr_size_update
      ci_tests_subsys_suit
```

## tests/subsys/suit/unit/suit_plat_override_image_size/testcase.yaml
```yaml
tests:
  suit.unit.platform.override_image_size:
    type: unit
    tags: >-
      suit
      suit_platform
      suit_plat_override_image_size
      suit_plat_create_component_handle
```

## tests/subsys/suit/unit/suit_plat_retrieve_manifest/testcase.yaml
```yaml
tests:
  suit.unit.platform.retrieve_manifest:
    type: unit
    tags: >-
      suit
      suit_platform
      suit_plat_retrieve_manifest
      ci_tests_subsys_suit
```

## tests/subsys/suit/unit/suit_plat_version/testcase.yaml
```yaml
tests:
  suit.unit.platform.version:
    type: unit
    tags: >-
      suit
      suit_platform
      suit_plat_version
      ci_tests_subsys_suit
```

## tests/subsys/suit/unit/suit_plat_version_app_specific/testcase.yaml
```yaml
tests:
  suit.unit.platform.version.app:
    type: unit
    tags: >-
      suit
      suit_platform
      suit_plat_version
      suit_plat_version_domain_specific
      ci_tests_subsys_suit
```

## tests/subsys/suit/unit/suit_run_nrf54h20/testcase.yaml
```yaml
tests:
  suit.unit.platform.run_nrf54h20:
    type: unit
    tags:
      - suit
      - suit_platform
      - suit_run_nrf54h20
      - ci_tests_subsys_suit
```

## tests/subsys/swo/testcase.yaml
```yaml
tests:
  swo.logging:
    tags: ci_tests_subsys_swo
    harness: pytest
    harness_config:
      pytest_dut_scope: session
      pytest_root:
        - "pytest/test_swo.py::test_swo_logging"
    timeout: 30
    platform_allow:
      - nrf52dk/nrf52832
      - nrf52840dk/nrf52840
      - nrf5340dk/nrf5340/cpuapp
      - nrf54l15dk/nrf54l05/cpuapp
      - nrf54l15dk/nrf54l10/cpuapp
      - nrf54l15dk/nrf54l15/cpuapp
      - nrf54lm20dk/nrf54lm20a/cpuapp
      - nrf54lv10dk/nrf54lv10a/cpuapp
      - nrf54lv10dk/nrf54lv10a/cpuapp/ns
      - nrf7120pdk/nrf7120/cpuapp
    integration_platforms:
      - nrf52840dk/nrf52840
      - nrf5340dk/nrf5340/cpuapp
      - nrf54l15dk/nrf54l15/cpuapp
      - nrf54lm20dk/nrf54lm20a/cpuapp
      - nrf7120pdk/nrf7120/cpuapp
```

## tests/subsys/usb/negotiated_speed/testcase.yaml
```yaml
common:
  tags:
    - usb
    - ci_samples_zephyr_subsys_usb
  harness: pytest

tests:
  usb.negotiated_speed:
    min_ram: 128
    depends_on: usbd
    integration_platforms:
      - nrf54h20dk/nrf54h20/cpuapp
    platform_allow:
      - nrf54h20dk/nrf54h20/cpuapp
      - nrf54lm20dk/nrf54lm20a/cpuapp
    extra_configs:
      - CONFIG_LOG_DEFAULT_LEVEL=3
      - CONFIG_APP_MSC_STORAGE_RAM=y
```

## tests/subsys/west_debug/Kconfig.sysbuild
```kconfig
#
# Copyright (c) 2026 Nordic Semiconductor ASA
#
# SPDX-License-Identifier: LicenseRef-Nordic-5-Clause
#

config PARTITION_MANAGER
	default n if !(SOC_NRF5340_CPUAPP && BOARD_IS_NON_SECURE)

source "share/sysbuild/Kconfig"
```

## tests/subsys/west_flash/testcase.yaml
```yaml
common:
  tags: ci_tests_subsys_west_flash
  harness: pytest
  harness_config:
    pytest_root:
      - "pytest/test_west_flash.py"
  platform_allow:
    - nrf52dk/nrf52832
    - nrf52840dk/nrf52840
    - nrf5340dk/nrf5340/cpuapp
    - nrf5340dk/nrf5340/cpuapp/ns
    - nrf5340dk/nrf5340/cpunet
    - nrf54h20dk/nrf54h20/cpuapp
    - nrf54h20dk/nrf54h20/cpuflpr
    - nrf54h20dk/nrf54h20/cpuflpr/xip
    - nrf54h20dk/nrf54h20/cpuppr
    - nrf54h20dk/nrf54h20/cpuppr/xip
    - nrf54h20dk/nrf54h20/cpurad
    - nrf54l15dk/nrf54l05/cpuapp
    - nrf54l15dk/nrf54l10/cpuapp
    - nrf54l15dk/nrf54l10/cpuapp/ns
    - nrf54l15dk/nrf54l15/cpuapp
    - nrf54l15dk/nrf54l15/cpuapp/ns
    - nrf54l15dk/nrf54l15/cpuflpr
    - nrf54l15dk/nrf54l15/cpuflpr/xip
    - nrf54lm20dk/nrf54lm20a/cpuapp
    - nrf54lm20dk/nrf54lm20a/cpuapp/ns
    - nrf54lm20dk/nrf54lm20a/cpuflpr
    - nrf54ls05dk/nrf54ls05b/cpuapp
    - nrf54lv10dk/nrf54lv10a/cpuapp
    - nrf54lv10dk/nrf54lv10a/cpuapp/ns
    - nrf54lv10dk/nrf54lv10a/cpuflpr
  integration_platforms:
    - nrf54lm20dk/nrf54lm20a/cpuapp

tests:
  subsys.west_flash: {}
```

## tests/subsys/zigbee/osif/crypto/boards/nrf5340dk_nrf5340_cpuapp.conf
```kconfig
#
# Copyright (c) 2022 Nordic Semiconductor ASA
#
# SPDX-License-Identifier: LicenseRef-Nordic-5-Clause
#

CONFIG_MAIN_STACK_SIZE=2048

# Use software cryptography on nRF5340
CONFIG_CRYPTO=n
CONFIG_CRYPTO_NRF_ECB=n
# CONFIG_ZIGBEE_USE_SOFTWARE_AES is defined in CMakeLists
# because of unsatisfied dependency to CONFIG_ZIGBEE.
# CONFIG_NRF_OBERON=y is added below because it is not enabled
# by the CONFIG_ZIGBEE_USE_SOFTWARE_AES.
CONFIG_NRF_OBERON=y
```

## tests/subsys/zigbee/osif/crypto/testcase.yaml
```yaml
tests:
  zigbee.osif.crypto:
    sysbuild: true
    platform_allow: nrf52840dk/nrf52840 nrf52833dk/nrf52833 nrf5340dk/nrf5340/cpuapp
    tags: osif_crypto sysbuild
    integration_platforms:
      - nrf52840dk/nrf52840
      - nrf52833dk/nrf52833
      - nrf5340dk/nrf5340/cpuapp
```
