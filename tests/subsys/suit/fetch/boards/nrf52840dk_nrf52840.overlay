/*
 * Copyright (c) 2025 Nordic Semiconductor ASA
 *
 * SPDX-License-Identifier: LicenseRef-Nordic-5-Clause
 */

&flash0 {
	partitions {
		compatible = "fixed-partitions";
		#address-cells = <1>;
		#size-cells = <1>;

		/* Use the last 48KB of NVM as suit storage. */
		suit_storage: partition@f4000 {
			reg = <0xf4000 DT_SIZE_K(48)>;
		};
	};
};
