## CMakeLists.txt
```
#
# Copyright (c) 2025 Nordic Semiconductor ASA
#
# SPDX-License-Identifier: LicenseRef-Nordic-5-Clause
#

cmake_minimum_required(VERSION 3.20.0)

find_package(Zephyr REQUIRED HINTS $ENV{ZEPHYR_BASE})
project(west_debug)

target_sources(app PRIVATE src/main.c)
```

## Kconfig.sysbuild
```
#
# Copyright (c) 2026 Nordic Semiconductor ASA
#
# SPDX-License-Identifier: LicenseRef-Nordic-5-Clause
#

config PARTITION_MANAGER
	default n if !(SOC_NRF5340_CPUAPP && BOARD_IS_NON_SECURE)

source "share/sysbuild/Kconfig"
```

## prj.conf
```kconfig
CONFIG_BOOT_BANNER=n
CONFIG_NCS_BOOT_BANNER=n

CONFIG_PRINTK=n
CONFIG_LOG=n
CONFIG_CONSOLE=n
CONFIG_UART_CONSOLE=n
CONFIG_SERIAL=n
```

## src/main.c
```c
/*
 * Copyright (c) 2025 Nordic Semiconductor ASA
 *
 * SPDX-License-Identifier: LicenseRef-Nordic-5-Clause
 */

#include <zephyr/kernel.h>

volatile int counter = 1;
volatile int counter2 = 1;
volatile int counter3 = 1;

int main(void)
{
	while (true) {
		k_busy_wait(500000);
		counter++;
		if (counter > 1000) {
			counter = 0;
		}
		counter2++;
		if (counter2 > 1000) {
			counter2 = 0;
		}
		counter3++;
		if (counter3 > 1000) {
			counter3 = 0;
		}
	}
}
```
