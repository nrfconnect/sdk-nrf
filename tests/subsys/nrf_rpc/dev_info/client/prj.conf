## CMakeLists.txt
```
#
# Copyright (c) 2024 Nordic Semiconductor ASA
#
# SPDX-License-Identifier: LicenseRef-Nordic-5-Clause
#
cmake_minimum_required(VERSION 3.20.0)

find_package(Zephyr REQUIRED HINTS $ENV{ZEPHYR_BASE})
project(nrf_rpc_dev_info_client_test)

FILE(GLOB app_sources src/*.c)

target_include_directories(app PRIVATE
  ${ZEPHYR_NRF_MODULE_DIR}/subsys/nrf_rpc/dev_info/common
  ${ZEPHYR_NRF_MODULE_DIR}/subsys/nrf_rpc/dev_info/client
  ../common
)

target_sources(app PRIVATE
  ${app_sources}
  ../common/nrf_rpc_single_thread.c
)

# Enforce single-threaded nRF RPC command processing.
target_link_options(app PUBLIC
  -Wl,--wrap=nrf_rpc_os_init,--wrap=nrf_rpc_os_thread_pool_send
)
```

## prj.conf
```kconfig
#
# Copyright (c) 2024 Nordic Semiconductor ASA
#
# SPDX-License-Identifier: LicenseRef-Nordic-5-Clause
#

# Ztest configuration
CONFIG_ZTEST=y
CONFIG_TEST_RANDOM_GENERATOR=y

CONFIG_NRF_RPC_CALLBACK_PROXY=n

CONFIG_NRF_RPC=y
CONFIG_MOCK_NRF_RPC=y
CONFIG_MOCK_NRF_RPC_TRANSPORT=y

CONFIG_KERNEL_MEM_POOL=y
CONFIG_HEAP_MEM_POOL_SIZE=4096
CONFIG_NRF_RPC_DEV_INFO=y
```

## src/dev_info_suite.c
```c
/*
 * Copyright (c) 2024 Nordic Semiconductor ASA
 *
 * SPDX-License-Identifier: LicenseRef-Nordic-5-Clause
 */

#include "zephyr/ztest_assert.h"
#include <ncs_commit.h>
#include <mock_nrf_rpc_transport.h>
#include <test_rpc_env.h>

#include <rpc_utils_ids.h>
#include <nrf_rpc/nrf_rpc_dev_info.h>

#include <zephyr/kernel.h>
#include <zephyr/ztest.h>

static void nrf_rpc_err_handler(const struct nrf_rpc_err_report *report)
{
	zassert_ok(report->code);
}

static void tc_setup(void *f)
{
	mock_nrf_rpc_tr_expect_add(RPC_INIT_REQ, RPC_INIT_RSP);
	zassert_ok(nrf_rpc_init(nrf_rpc_err_handler));
	mock_nrf_rpc_tr_expect_reset();
}

ZTEST(dev_info_rpc_client, test_get_version)
{
	const char *commit = NCS_COMMIT_STRING;
	const char *version = 0;

	mock_nrf_rpc_tr_expect_add(RPC_CMD(RPC_UTIL_DEV_INFO_GET_VERSION),
				   RPC_RSP(0x6C, STRING_TO_TUPLE(NCS_COMMIT_STRING)));
	version = nrf_rpc_get_ncs_commit_sha();
	mock_nrf_rpc_tr_expect_done();

	zexpect_str_equal(commit, version);
}

ZTEST(dev_info_rpc_client, test_invoke_shell_cmd)
{

	const size_t argc = 2;
	static const char *const argv[] = {"say", "hello", NULL};
	const char *hello = "HelloWorld\0";
	char *reply = NULL;

	mock_nrf_rpc_tr_expect_add(
		RPC_CMD(RPC_UTIL_DEV_INFO_INVOKE_SHELL_CMD, 0x6a, 's', 'a', 'y', ' ', 'h', 'e', 'l',
			'l', 'o', '\0'),
		RPC_RSP(0x6b, 'H', 'e', 'l', 'l', 'o', 'W', 'o', 'r', 'l', 'd', '\0'));
	reply = nrf_rpc_invoke_remote_shell_cmd(argc, (char **)argv);
	mock_nrf_rpc_tr_expect_done();

	zexpect_str_equal(hello, reply);

	if (reply) {
		k_free(reply);
	}
}

ZTEST_SUITE(dev_info_rpc_client, NULL, NULL, tc_setup, NULL, NULL);
```
