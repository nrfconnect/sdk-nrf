## prj.conf
```kconfig
#
# Copyright (c) 2024 Nordic Semiconductor ASA
#
# SPDX-License-Identifier: LicenseRef-Nordic-5-Clause
#

# Ztest configuration
CONFIG_ZTEST=y
CONFIG_TEST_RANDOM_GENERATOR=y

CONFIG_NRF_RPC_CALLBACK_PROXY=n

CONFIG_NRF_RPC=y
CONFIG_MOCK_NRF_RPC=y
CONFIG_MOCK_NRF_RPC_TRANSPORT=y

CONFIG_KERNEL_MEM_POOL=y
CONFIG_HEAP_MEM_POOL_SIZE=4096
CONFIG_NRF_RPC_UTILS=y
CONFIG_NRF_RPC_UTILS_SERVER=y
CONFIG_NRF_RPC_UTILS_DEV_INFO=y
CONFIG_NRF_RPC_UTILS_REMOTE_SHELL=y
CONFIG_NRF_RPC_UTILS_DIE_TEMP=y
CONFIG_SHELL_BACKEND_SERIAL=n
CONFIG_SHELL_AUTOSTART=n
```

## app.overlay
```dts
/*
 * Copyright (c) 2025 Nordic Semiconductor ASA
 *
 * SPDX-License-Identifier: LicenseRef-Nordic-5-Clause
 */

/ {
	temp: temp-sensor {
		compatible = "mock-temp-sensor";
		status = "okay";
	};
};
```

## dts/bindings/mock-temp-sensor.yaml
```yaml
# Copyright (c) 2025 Nordic Semiconductor ASA
# SPDX-License-Identifier: LicenseRef-Nordic-5-Clause

description: Mock temperature sensor for testing

compatible: "mock-temp-sensor"

include: base.yaml
```

## src/die_temp_suite.c
```c
/*
 * Copyright (c) 2025 Nordic Semiconductor ASA
 *
 * SPDX-License-Identifier: LicenseRef-Nordic-5-Clause
 */

#include <mock_nrf_rpc_transport.h>
#include <test_rpc_env.h>
#include <rpc_utils_group.h>
#include <nrf_rpc/rpc_utils/die_temp.h>
#include "mock_temp_sensor.h"

#include <zephyr/kernel.h>
#include <zephyr/ztest.h>
#include <zephyr/drivers/sensor.h>

#include "../common/die_temp_test_data.h"

/* Note: device_is_ready() failure is not testable in unit tests as it
 * depends on Zephyr's device initialization infrastructure.
 */

/* Test data structure mapping sensor values to their CBOR-encoded byte sequences.
 * CBOR encoding according to RFC 8949.
 */
struct temp_cbor_test_case {
	const char *name;
	struct sensor_value sensor_val;
	mock_nrf_rpc_pkt_t expected_response;
};

/* Helper macros to convert centidegrees to sensor_value components.
 * sensor_value format: val1=integer degrees, val2=fractional part in microseconds
 * Formula: centidegrees → val1 = centidegrees / 100, val2 = (centidegrees % 100) * 10000
 */
#define CENTIDEG_TO_VAL1(centideg) ((centideg) / 100)
#define CENTIDEG_TO_VAL2(centideg) (((centideg) % 100) * 10000)

#define TEMP_TEST_CASE(test_name, temp_centidegrees, cbor_bytes)                                   \
	{.name = test_name,                                                                        \
	 .sensor_val = {.val1 = CENTIDEG_TO_VAL1(temp_centidegrees),                               \
			.val2 = CENTIDEG_TO_VAL2(temp_centidegrees)},                              \
	 .expected_response = RPC_RSP(NRF_RPC_DIE_TEMP_SUCCESS, UNPACK cbor_bytes)}

/* Test cases are defined using X-macros from common header to ensure
 * client and server tests use identical values. See die_temp_test_data.h
 * for complete documentation of test coverage and CBOR encoding details.
 */
#define X(name, centidegrees, cbor_bytes) TEMP_TEST_CASE(name, centidegrees, cbor_bytes),
static const struct temp_cbor_test_case temp_success_cases[] = {
	DIE_TEMP_TEST_CASES
};
#undef X

ZTEST(rpc_utils_server_die_temp, test_die_temp_fetch_failed)
{
	mock_temp_sensor_set_fetch_result(-EIO);

	mock_nrf_rpc_tr_expect_add(RPC_RSP(NRF_RPC_DIE_TEMP_ERR_FETCH_FAILED, 0x00), NO_RSP);
	mock_nrf_rpc_tr_receive(RPC_CMD(RPC_UTIL_DIE_TEMP_GET));
	mock_nrf_rpc_tr_expect_done();

	mock_temp_sensor_set_fetch_result(0);
}

ZTEST(rpc_utils_server_die_temp, test_die_temp_channel_get_failed)
{
	mock_temp_sensor_set_fetch_result(0);
	mock_temp_sensor_set_channel_get_result(-ENOTSUP);

	mock_nrf_rpc_tr_expect_add(RPC_RSP(NRF_RPC_DIE_TEMP_ERR_CHANNEL_GET_FAILED, 0x00), NO_RSP);
	mock_nrf_rpc_tr_receive(RPC_CMD(RPC_UTIL_DIE_TEMP_GET));
	mock_nrf_rpc_tr_expect_done();

	mock_temp_sensor_set_channel_get_result(0);
}

ZTEST(rpc_utils_server_die_temp, test_die_temp_success_cases)
{
	for (size_t i = 0; i < ARRAY_SIZE(temp_success_cases); i++) {
		const struct temp_cbor_test_case *test_case = &temp_success_cases[i];

		TC_PRINT("Testing case: %s\n", test_case->name);

		mock_temp_sensor_set_fetch_result(0);
		mock_temp_sensor_set_channel_get_result(0);
		mock_temp_sensor_set_value((struct sensor_value *)&test_case->sensor_val);

		mock_nrf_rpc_tr_expect_add(test_case->expected_response, NO_RSP);
		mock_nrf_rpc_tr_receive(RPC_CMD(RPC_UTIL_DIE_TEMP_GET));
		mock_nrf_rpc_tr_expect_done();
	}
}

static void tc_setup(void *f)
{
	mock_nrf_rpc_tr_expect_add(RPC_INIT_REQ, RPC_INIT_RSP);
	zassert_ok(nrf_rpc_init(NULL));
	mock_nrf_rpc_tr_expect_reset();

	mock_temp_sensor_set_fetch_result(0);
	mock_temp_sensor_set_channel_get_result(0);
}

ZTEST_SUITE(rpc_utils_server_die_temp, NULL, NULL, tc_setup, NULL, NULL);
```

## src/mock_temp_sensor.c
```c
/*
 * Copyright (c) 2025 Nordic Semiconductor ASA
 *
 * SPDX-License-Identifier: LicenseRef-Nordic-5-Clause
 */

#include <zephyr/device.h>
#include <zephyr/drivers/sensor.h>
#include <zephyr/kernel.h>

/* Mock temperature sensor for testing die_temp RPC */

struct mock_temp_sensor_data {
	struct sensor_value value;
	int fetch_result;
	int channel_get_result;
};

static struct mock_temp_sensor_data mock_data = {
	.value = {0, 0},
	.fetch_result = 0,
	.channel_get_result = 0,
};

void mock_temp_sensor_set_value(struct sensor_value *val)
{
	mock_data.value = *val;
}

void mock_temp_sensor_set_fetch_result(int result)
{
	mock_data.fetch_result = result;
}

void mock_temp_sensor_set_channel_get_result(int result)
{
	mock_data.channel_get_result = result;
}

static int mock_temp_sensor_sample_fetch(const struct device *dev, enum sensor_channel chan)
{
	struct mock_temp_sensor_data *data = dev->data;

	ARG_UNUSED(chan);

	return data->fetch_result;
}

static int mock_temp_sensor_channel_get(const struct device *dev, enum sensor_channel chan,
					struct sensor_value *val)
{
	struct mock_temp_sensor_data *data = dev->data;

	if (chan != SENSOR_CHAN_DIE_TEMP) {
		return -ENOTSUP;
	}

	if (data->channel_get_result != 0) {
		return data->channel_get_result;
	}

	*val = data->value;
	return 0;
}

static int mock_temp_sensor_init(const struct device *dev)
{
	ARG_UNUSED(dev);
	return 0;
}

static const struct sensor_driver_api mock_temp_sensor_api = {
	.sample_fetch = mock_temp_sensor_sample_fetch,
	.channel_get = mock_temp_sensor_channel_get,
};

DEVICE_DT_DEFINE(DT_NODELABEL(temp), mock_temp_sensor_init, NULL, &mock_data, NULL, POST_KERNEL,
		 CONFIG_SENSOR_INIT_PRIORITY, &mock_temp_sensor_api);
```

## src/mock_temp_sensor.h
```c
/*
 * Copyright (c) 2025 Nordic Semiconductor ASA
 *
 * SPDX-License-Identifier: LicenseRef-Nordic-5-Clause
 */

#ifndef MOCK_TEMP_SENSOR_H_
#define MOCK_TEMP_SENSOR_H_

#include <zephyr/drivers/sensor.h>
#include <stdbool.h>

/**
 * @brief Set the mock temperature sensor value.
 *
 * @param val Pointer to sensor_value to return on channel_get
 */
void mock_temp_sensor_set_value(struct sensor_value *val);

/**
 * @brief Set the result code for sample_fetch operations.
 *
 * @param result Error code to return from sample_fetch (0 for success)
 */
void mock_temp_sensor_set_fetch_result(int result);

/**
 * @brief Set the result code for channel_get operations.
 *
 * @param result Error code to return from channel_get (0 for success)
 */
void mock_temp_sensor_set_channel_get_result(int result);

#endif /* MOCK_TEMP_SENSOR_H_ */
```

## src/rpc_utils_suite.c
```c
/*
 * Copyright (c) 2024 Nordic Semiconductor ASA
 *
 * SPDX-License-Identifier: LicenseRef-Nordic-5-Clause
 */

#include <ncs_commit.h>
#include <mock_nrf_rpc_transport.h>
#include <test_rpc_env.h>
#include <rpc_utils_group.h>

#include <zephyr/kernel.h>
#include <zephyr/ztest.h>
#include <zephyr/shell/shell.h>
#include <zephyr/shell/shell_dummy.h>

static void nrf_rpc_err_handler(const struct nrf_rpc_err_report *report)
{
	zassert_ok(report->code);
}

static void tc_setup(void *f)
{
	mock_nrf_rpc_tr_expect_add(RPC_INIT_REQ, RPC_INIT_RSP);
	zassert_ok(nrf_rpc_init(nrf_rpc_err_handler));
	mock_nrf_rpc_tr_expect_reset();
}

ZTEST(rpc_utils_server, test_get_server_version)
{
	const char *commit = NCS_COMMIT_STRING;

	mock_nrf_rpc_tr_expect_add(RPC_RSP(0x6C, STRING_TO_TUPLE(commit)), NO_RSP);
	mock_nrf_rpc_tr_receive(RPC_CMD(RPC_UTIL_DEV_INFO_GET_VERSION));
	mock_nrf_rpc_tr_expect_done();
}

static int cmd_hello(struct shell *sh, size_t argc, char **argv)
{
	shell_print(sh, "Hello world");
	return 0;
}

SHELL_CMD_REGISTER(hello, NULL, "Help text", cmd_hello);

ZTEST(rpc_utils_server, test_invoke_shell_cmd)
{
	/*
	 * shell_print() macro only works when the shell is started, and the shell is started
	 * on another thread. To make unit tests more robust, start the shell explicitly.
	 */
	zassert_ok(shell_start(shell_backend_dummy_get_ptr()));
	mock_nrf_rpc_tr_expect_add(RPC_RSP(0x6f, '\r', '\n', 'H', 'e', 'l', 'l', 'o', ' ', 'w', 'o',
					   'r', 'l', 'd', '\r', '\n'),
				   NO_RSP);
	mock_nrf_rpc_tr_receive(
		RPC_CMD(RPC_UTIL_DEV_INFO_INVOKE_SHELL_CMD, 0x65, 'h', 'e', 'l', 'l', 'o'));
	mock_nrf_rpc_tr_expect_done();
}

ZTEST_SUITE(rpc_utils_server, NULL, NULL, tc_setup, NULL, NULL);
```
