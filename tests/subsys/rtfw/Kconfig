## tests/subsys/rtfw/Kconfig
```kconfig
#
# Copyright (c) 2026 Nordic Semiconductor
#
# SPDX-License-Identifier: LicenseRef-Nordic-5-Clause
#

mainmenu "RTFW tests"

source "Kconfig.zephyr"

config RTFW_TEST
	default y

config RTFW_TEST_PREINIT
	bool "Test the RTFW API before initialization"
	depends on ZTEST
	help
	  Build only the tests which exercise public APIs before the
	  singleton framework is initialized. Twister runs this variant in
	  a separate native_sim process so it does not depend on test order
	  or require stopping the framework workqueue.

config RTFW_TEST_NO_EVENT_HANDLER
	bool "Test delivery without an event handler"
	depends on ZTEST && !RTFW_TEST_PREINIT
	help
	  Initialize RTFW without an application event callback and verify
	  that bounded delivery still releases every queued event. Twister
	  runs this variant separately because the singleton callback
	  configuration is immutable after initialization.
```

## tests/zephyr/boards/nrf/i2c/i2c_slave/testcase.yaml
```yaml
common:
  depends_on: i2c
  tags:
    - drivers
    - i2c
    - ci_tests_zephyr_boards_nrf_i2c
  harness: ztest
  harness_config:
    fixture: i2c_loopback

tests:
  nrf.extended.boards.nrf.i2c.i2c_slave:
    platform_allow:
      - nrf54ls05dk/nrf54ls05a/cpuapp
      - nrf54ls05dk/nrf54ls05b/cpuapp
      - nrf54lc10dk/nrf54lc10a/cpuapp
      - nrf54lc10dk/nrf54lc10a/cpuapp/ns
      - nrf9251dk/nrf9251/cpuapp
      - nrf9251dk/nrf9251/cpuppr
      - nrf7120dk/nrf7120e/cpuapp
    integration_platforms:
      - nrf54ls05dk/nrf54ls05b/cpuapp
  nrf.extended.boards.nrf.i2c.i2c_slave.fast:
    platform_allow:
      - nrf54ls05dk/nrf54ls05a/cpuapp
      - nrf54ls05dk/nrf54ls05b/cpuapp
      - nrf54lc10dk/nrf54lc10a/cpuapp
      - nrf54lc10dk/nrf54lc10a/cpuapp/ns
      - nrf9251dk/nrf9251/cpuapp
      - nrf9251dk/nrf9251/cpuppr
      - nrf7120dk/nrf7120e/cpuapp
    integration_platforms:
      - nrf54ls05dk/nrf54ls05b/cpuapp
    extra_args:
      - EXTRA_DTC_OVERLAY_FILE="${ZEPHYR_TEST_DIR}/i2c_speed_fast.overlay"
  nrf.extended.boards.nrf.i2c.i2c_slave.fast_plus:
    depends_on:
      - future_target
    extra_args:
      - EXTRA_DTC_OVERLAY_FILE=${ZEPHYR_TEST_DIR}/i2c_speed_fast_plus.overlay"
```

## tests/zephyr/boards/nrf/rram/boards/nrf54ls05dk_nrf54ls05a_cpuapp.conf
```kconfig
#
# Copyright (c) 2026 Nordic Semiconductor ASA
#
# SPDX-License-Identifier: LicenseRef-Nordic-5-Clause
#

CONFIG_NRF_RRAM_WRITE_BUFFER_SIZE=8
```

## tests/zephyr/boards/nrf/uarte/testcase.yaml
```yaml
common:
  tags:
    - drivers
    - uart
    - ci_tests_zephyr_boards_nrf_uarte
  harness: ztest
  harness_config:
    fixture: gpio_loopback
  depends_on: gpio

tests:
  nrf.extended.boards.nrf.uarte:
    platform_allow:
      - nrf54ls05dk/nrf54ls05a/cpuapp
      - nrf54ls05dk/nrf54ls05b/cpuapp
    integration_platforms:
      - nrf54ls05dk/nrf54ls05b/cpuapp
```

## tests/zephyr/drivers/can/api/testcase.yaml
```yaml
common:
  tags:
    - drivers
    - can
  harness: ztest
  platform_allow:
    - nrf54l15dk/nrf54l15/cpuapp
    - nrf54lm20dk/nrf54lm20a/cpuapp
    - nrf54lm20dk/nrf54lm20b/cpuapp
  integration_platforms:
    - nrf54l15dk/nrf54l15/cpuapp
tests:
  nrf.extended.drivers.can.api.nrf_scan: {}
  nrf.extended.drivers.can.api.nrf_scan.pm:
    extra_configs:
      - CONFIG_PM_DEVICE=y
      - CONFIG_PM_DEVICE_RUNTIME=y
```

## tests/zephyr/drivers/can/host/testcase.yaml
```yaml
common:
  tags:
    - drivers
    - can
  harness: pytest
  platform_allow:
    - nrf54l15dk/nrf54l15/cpuapp
    - nrf54lm20dk/nrf54lm20a/cpuapp
    - nrf54lm20dk/nrf54lm20b/cpuapp
  integration_platforms:
    - nrf54l15dk/nrf54l15/cpuapp
tests:
  drivers.can.host.extended:
    harness_config:
      pytest_dut_scope: session
      fixture: scan
```

## tests/zephyr/drivers/disk/disk_performance/testcase.yaml
```yaml
common:
  harness: ztest
  tags:
    - disk
    - ci_tests_zephyr_drivers_disk
tests:
  nrf.extended.drivers.disk.disk_performance.sdhc:
    harness: ztest
    harness_config:
      fixture: sdcard
    platform_allow:
      - nrf54h20dk/nrf54h20/cpuapp
      - nrf54l15dk/nrf54l15/cpuapp
    integration_platforms:
      - nrf54h20dk/nrf54h20/cpuapp
      - nrf54l15dk/nrf54l15/cpuapp
```

## tests/zephyr/drivers/flash/common/Kconfig
```kconfig
# Copyright (c) 2024, Nordic Semiconductor ASA
# SPDX-License-Identifier: LicenseRef-Nordic-5-Clause

# Device/scenario dependent information that is not available in
# other ways.

config TEST_DRIVER_FLASH_SIZE
	int "Size of flash device under test"
	default -1
	help
	  Expected flash device size the test will validate against. If the flash driver does not
	  support the get_size() API, leave this set as -1 to skip the test.

config TEST_FORCE_STORAGE_PARTITION
	bool "Force testing the storage partition area"
	help
	  This test prioritizes testing spi nor flash over
	  the storage area by default. Set this config to prioritize
	  testing the storage partition instead.

source "Kconfig.zephyr"
```

## tests/zephyr/drivers/flash/negative_tests/testcase.yaml
```yaml
common:
  tags:
    - drivers
    - flash
    - ci_tests_zephyr_drivers_flash_negative_tests
tests:
  nrf.extended.drivers.flash.negative_tests:
    platform_allow:
      - nrf54lc10dk/nrf54lc10a/cpuapp
      - nrf9251dk/nrf9251/cpuapp
    integration_platforms:
      - nrf54lc10dk/nrf54lc10a/cpuapp
```

## tests/zephyr/drivers/spi/spi_controller_peripheral/testcase.yaml
```yaml
common:
  # depends_on: spi
  tags:
    - drivers
    - spi
    - ci_tests_zephyr_drivers_spi
  harness: ztest
  harness_config:
    fixture: gpio_spi_loopback
  timeout: 15


tests:
  nrf.extended.drivers.spi.spi_mode0:
    extra_configs:
      - CONFIG_TESTED_SPI_MODE=0
    extra_args: EXTRA_DTC_OVERLAY_FILE="${ZEPHYR_TEST_DIR}/250khz.overlay"
    platform_allow: &default_platform_allow
      - nrf54ls05dk/nrf54ls05a/cpuapp
      - nrf54ls05dk/nrf54ls05b/cpuapp
      - nrf54lc10dk/nrf54lc10a/cpuapp
      - nrf54lc10dk/nrf54lc10a/cpuapp/ns
      - nrf9251dk/nrf9251/cpuapp
      - nrf9251dk/nrf9251/cpuppr
      - nrf7120dk/nrf7120/cpuapp/ns
      - nrf7120dk/nrf7120e/cpuapp
    integration_platforms:
      - nrf54ls05dk/nrf54ls05b/cpuapp

  nrf.extended.drivers.spi.spi_mode1:
    extra_configs:
      - CONFIG_TESTED_SPI_MODE=1
    extra_args: EXTRA_DTC_OVERLAY_FILE="${ZEPHYR_TEST_DIR}/500khz.overlay"
    platform_allow: *default_platform_allow
    integration_platforms:
      - nrf54ls05dk/nrf54ls05b/cpuapp

  nrf.extended.drivers.spi.spi_mode2:
    extra_configs:
      - CONFIG_TESTED_SPI_MODE=2
    extra_args: EXTRA_DTC_OVERLAY_FILE="${ZEPHYR_TEST_DIR}/1mhz.overlay"
    platform_allow: *default_platform_allow
    integration_platforms:
      - nrf54ls05dk/nrf54ls05b/cpuapp

  nrf.extended.drivers.spi.spi_mode3:
    extra_configs:
      - CONFIG_TESTED_SPI_MODE=3
    extra_args: EXTRA_DTC_OVERLAY_FILE="${ZEPHYR_TEST_DIR}/2mhz.overlay"
    platform_allow: *default_platform_allow
    integration_platforms:
      - nrf54ls05dk/nrf54ls05b/cpuapp

  nrf.extended.drivers.spi.spi_1M333333Hz:
    extra_configs:
      - CONFIG_TESTED_SPI_MODE=0
    extra_args: EXTRA_DTC_OVERLAY_FILE="${ZEPHYR_TEST_DIR}/1m333333hz.overlay"
    platform_allow: *default_platform_allow
    integration_platforms:
      - nrf54ls05dk/nrf54ls05b/cpuapp

  nrf.extended.drivers.spi.spi_2M666666Hz:
    extra_configs:
      - CONFIG_TESTED_SPI_MODE=0
    extra_args: EXTRA_DTC_OVERLAY_FILE="${ZEPHYR_TEST_DIR}/2m666666hz.overlay"
    platform_allow: *default_platform_allow
    integration_platforms:
      - nrf54ls05dk/nrf54ls05b/cpuapp

  nrf.extended.drivers.spi.spi_4MHz:
    extra_configs:
      - CONFIG_TESTED_SPI_MODE=2
    extra_args: EXTRA_DTC_OVERLAY_FILE="${ZEPHYR_TEST_DIR}/4mhz.overlay"
    platform_allow: *default_platform_allow
    integration_platforms:
      - nrf54ls05dk/nrf54ls05b/cpuapp

  nrf.extended.drivers.spi.spi_8MHz:
    extra_configs:
      - CONFIG_TESTED_SPI_MODE=1
    extra_args: EXTRA_DTC_OVERLAY_FILE="${ZEPHYR_TEST_DIR}/8mhz.overlay"
    platform_allow: *default_platform_allow
    integration_platforms:
      - nrf54ls05dk/nrf54ls05b/cpuapp

  # No Fast SPI instance on nrf54ls05a/b
  # No Fast SPI instance on nrf54lc10a
  # Missing test setup for nrf9251dk SPI fast instance

  nrf.extended.drivers.spi.pm_runtime:
    extra_configs:
      - CONFIG_PM_DEVICE=y
      - CONFIG_PM_DEVICE_RUNTIME=y
    platform_allow: *default_platform_allow
    integration_platforms:
      - nrf54ls05dk/nrf54ls05b/cpuapp

  nrf.extended.drivers.spi.direct_xfer:
    platform_allow: *default_platform_allow
    extra_configs:
      - CONFIG_SPI_NRFX_RAM_BUFFER_SIZE=0

  nrf.extended.drivers.spi.direct_xfer.no_prealloc:
    platform_allow: *default_platform_allow
    extra_configs:
      - CONFIG_SPI_NRFX_RAM_BUFFER_SIZE=0
      - CONFIG_PREALLOC_BUFFERS=n

  nrf.extended.drivers.spi.spi_mode0.fast_spis:
    harness_config:
      fixture: spim_mosi_toggles
    extra_configs:
      - CONFIG_TESTED_SPI_MODE=0
    extra_args:
      - FILE_SUFFIX=fast_spis
    platform_allow: &fast_spis_platform_allow
      - nrf54lm20dk/nrf54lm20a/cpuapp
      - nrf54lm20dk/nrf54lm20b/cpuapp
    integration_platforms:
      - nrf54lm20dk/nrf54lm20a/cpuapp

  nrf.extended.drivers.spi.spi_mode1.fast_spis:
    harness_config:
      fixture: spim_mosi_toggles
    extra_configs:
      - CONFIG_TESTED_SPI_MODE=1
    extra_args:
      - FILE_SUFFIX=fast_spis
    platform_allow: *fast_spis_platform_allow
    integration_platforms:
      - nrf54lm20dk/nrf54lm20a/cpuapp

  nrf.extended.drivers.spi.spi_mode2.fast_spis:
    harness_config:
      fixture: spim_mosi_toggles
    extra_configs:
      - CONFIG_TESTED_SPI_MODE=2
    extra_args:
      - FILE_SUFFIX=fast_spis
    platform_allow: *fast_spis_platform_allow
    integration_platforms:
      - nrf54lm20dk/nrf54lm20a/cpuapp

  nrf.extended.drivers.spi.spi_mode3.fast_spis:
    harness_config:
      fixture: spim_mosi_toggles
    extra_configs:
      - CONFIG_TESTED_SPI_MODE=3
    extra_args:
      - FILE_SUFFIX=fast_spis
    platform_allow: *fast_spis_platform_allow
    integration_platforms:
      - nrf54lm20dk/nrf54lm20a/cpuapp
```

## tests/zephyr/drivers/uart/uart_async_dual/testcase.yaml
```yaml
common:
  tags:
    - drivers
    - uart
    - ci_tests_zephyr_drivers_uart
  timeout: 120
  harness: ztest
  harness_config:
    fixture: uart_loopback
  sysbuild: true
tests:
  nrf.extended.drivers.uart.async_dual:
    platform_allow: &platform_allow_common
      - nrf7120dk/nrf7120/cpuapp
      - nrf9251dk/nrf9251/cpuapp
    integration_platforms: &integration_platforms_common
      - nrf7120dk/nrf7120/cpuapp
      - nrf9251dk/nrf9251/cpuapp
  nrf.extended.drivers.uart.async_dual.busy_sim:
    platform_allow: *platform_allow_common
    integration_platforms: *integration_platforms_common
    extra_configs:
      - CONFIG_TEST_BUSY_SIM=y
  nrf.extended.drivers.uart.async_dual.pm_runtime:
    platform_allow: *platform_allow_common
    integration_platforms: *integration_platforms_common
    extra_configs:
      - CONFIG_PM_DEVICE_RUNTIME=y
      - CONFIG_PM_DEVICE=y
  nrf.extended.drivers.uart.async_dual.pm_runtime.busy_sim:
    platform_allow: *platform_allow_common
    integration_platforms: *integration_platforms_common
    extra_configs:
      - CONFIG_PM_DEVICE_RUNTIME=y
      - CONFIG_PM_DEVICE=y
      - CONFIG_TEST_BUSY_SIM=y
  nrf.extended.drivers.uart.async_dual.pm_runtime.explicit:
    platform_allow: *platform_allow_common
    integration_platforms: *integration_platforms_common
    extra_configs:
      - CONFIG_PM_RUNTIME_IN_TEST=y
  nrf.extended.drivers.uart.async_dual.no_tx_chopped:
    platform_allow: *platform_allow_common
    integration_platforms: *integration_platforms_common
    extra_configs:
      - CONFIG_TEST_CHOPPED_TX=n
      - CONFIG_UARTE_NRFX_UARTE_COUNT_BYTES_WITH_TIMER=n
      - CONFIG_UARTE_NRFX_UARTE_COUNT_BYTES_WITH_TIMER_LEGACY=n
      - CONFIG_UART_1_NRF_HW_ASYNC=n
  nrf.extended.drivers.uart.async_dual.ppr.9251:
    platform_allow: &platform_nrf92_ppr
      - nrf9251dk/nrf9251/cpuppr
    integration_platforms: *platform_nrf92_ppr
    extra_configs:
      - CONFIG_IPC_SERVICE=y
      - CONFIG_MBOX=y
      - CONFIG_GPPI_EXT_ALLOCATOR_CLI=y
  nrf.extended.drivers.uart.async_dual.busy_sim.ppr.9251:
    platform_allow: *platform_nrf92_ppr
    integration_platforms: *platform_nrf92_ppr
    extra_configs:
      - CONFIG_IPC_SERVICE=y
      - CONFIG_MBOX=y
      - CONFIG_GPPI_EXT_ALLOCATOR_CLI=y
      - CONFIG_TEST_BUSY_SIM=y
  nrf.extended.drivers.uart.async_dual.pm_runtime.ppr.9251:
    platform_allow: *platform_nrf92_ppr
    integration_platforms: *platform_nrf92_ppr
    extra_configs:
      - CONFIG_IPC_SERVICE=y
      - CONFIG_MBOX=y
      - CONFIG_GPPI_EXT_ALLOCATOR_CLI=y
      - CONFIG_PM_DEVICE_RUNTIME=y
      - CONFIG_PM_DEVICE=y
  nrf.extended.drivers.uart.async_dual.pm_runtime.busy_sim.ppr.9251:
    platform_allow: *platform_nrf92_ppr
    integration_platforms: *platform_nrf92_ppr
    extra_configs:
      - CONFIG_IPC_SERVICE=y
      - CONFIG_MBOX=y
      - CONFIG_GPPI_EXT_ALLOCATOR_CLI=y
      - CONFIG_PM_DEVICE_RUNTIME=y
      - CONFIG_PM_DEVICE=y
      - CONFIG_TEST_BUSY_SIM=y
  nrf.extended.drivers.uart.async_dual.pm_runtime.explicit.ppr.9251:
    platform_allow: *platform_nrf92_ppr
    integration_platforms: *platform_nrf92_ppr
    extra_configs:
      - CONFIG_IPC_SERVICE=y
      - CONFIG_MBOX=y
      - CONFIG_GPPI_EXT_ALLOCATOR_CLI=y
      - CONFIG_PM_RUNTIME_IN_TEST=y
  nrf.extended.drivers.uart.async_dual.no_tx_chopped.ppr.9251:
    platform_allow: *platform_nrf92_ppr
    integration_platforms: *platform_nrf92_ppr
    extra_configs:
      - CONFIG_IPC_SERVICE=y
      - CONFIG_MBOX=y
      - CONFIG_GPPI_EXT_ALLOCATOR_CLI=y
      - CONFIG_TEST_CHOPPED_TX=n
      - CONFIG_UARTE_NRFX_UARTE_COUNT_BYTES_WITH_TIMER=n
      - CONFIG_UARTE_NRFX_UARTE_COUNT_BYTES_WITH_TIMER_LEGACY=n
      - CONFIG_UART_1_NRF_HW_ASYNC=n
```

## tests/zephyr/drivers/uart/uart_elementary/testcase.yaml
```yaml
common:
  tags:
    - drivers
    - uart
    - ci_tests_zephyr_drivers_uart
  depends_on: gpio
  harness: ztest
  harness_config:
    fixture: gpio_loopback
  timeout: 30
  filter: CONFIG_SERIAL_SUPPORT_INTERRUPT
  platform_allow:
    - nrf54ls05dk/nrf54ls05a/cpuapp
    - nrf54ls05dk/nrf54ls05b/cpuapp
    - nrf54lc10dk/nrf54lc10a/cpuapp
    - nrf54lc10dk/nrf54lc10a/cpuflpr
    - nrf9251dk/nrf9251/cpuapp
    - nrf9251dk/nrf9251/cpuflpr
    - nrf9251dk/nrf9251/cpuppr
    - nrf7120dk/nrf7120/cpuapp/ns
    - nrf7120dk/nrf7120e/cpuapp
  integration_platforms:
    - nrf54ls05dk/nrf54ls05b/cpuapp

tests:
  nrf.extended.drivers.uart.uart_elementary: {}

  nrf.extended.drivers.uart.uart_elementary_dual:
    platform_exclude:
      - nrf9251dk/nrf9251/cpuflpr
    extra_args:
      - FILE_SUFFIX="dual_uart"
    extra_configs:
      - CONFIG_DUAL_UART_TEST=y

  nrf.extended.drivers.uart.uart_elementary_dual_setup_mismatch:
    platform_exclude:
      - nrf9251dk/nrf9251/cpuflpr
    extra_args:
      - FILE_SUFFIX="dual_uart"
    extra_configs:
      - CONFIG_DUAL_UART_TEST=y
      - CONFIG_SETUP_MISMATCH_TEST=y

  nrf.extended.drivers.uart.uart_elementary_dual.pm:
    platform_exclude:
      - nrf9251dk/nrf9251/cpuflpr
    extra_args:
      - FILE_SUFFIX="dual_uart"
    extra_configs:
      - CONFIG_DUAL_UART_TEST=y
      - CONFIG_PM_DEVICE=y
      - CONFIG_PM_DEVICE_RUNTIME=y
```
