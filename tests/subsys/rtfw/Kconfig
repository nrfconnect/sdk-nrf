## tests/zephyr/modules/tf-m/regression/Kconfig.sysbuild
```kconfig
#
# Copyright (c) 2026 Nordic Semiconductor ASA
#
# SPDX-License-Identifier: LicenseRef-Nordic-5-Clause
#

config TEST_PROVISIONING_IMAGE
	bool "Build the TF-M provisioning image as a build-only image"
	depends on SOC_SERIES_NRF54L
	default y
	help
	  The nRF54L board configurations for this test enable
	  CONFIG_TFM_NRF_PROVISIONING, so TF-M only boots on a provisioned device.
	  This test does not provision the device itself, so the provisioning_image
	  sample is built alongside it as a build-only image, which excludes it from
	  "west flash" and from any merged hex. The pytest harness programs and runs
	  it before the test image.

source "share/sysbuild/Kconfig"
```

## tests/zephyr/subsys/sd/sdmmc/testcase.yaml
```yaml
common:
  tags:
    - drivers
    - sdhc
    - ci_tests_subsys_sd
tests:
  nrf.extended.sd.sdmmc:
    harness: ztest
    harness_config:
      fixture: sdcard
    platform_allow:
      - nrf54h20dk/nrf54h20/cpuapp
      - nrf54l15dk/nrf54l15/cpuapp
    integration_platforms:
      - nrf54h20dk/nrf54h20/cpuapp
      - nrf54l15dk/nrf54l15/cpuapp
```

## tests/zephyr/subsys/secure_storage/psa/its/testcase.yaml
```yaml
common:
  sysbuild: true
  tags:
    - sysbuild
    - psa
    - crypto
    - ci_tests_crypto

# Twister concatenates list fields from 'common' into every scenario instead of
# letting the scenario override them, so platform_allow/integration_platforms
# are set per scenario here to keep each one restricted to its own platforms.

tests:
  nrf.extended.secure_storage.psa.its.secure_storage.store.zms:
    platform_allow:
      - nrf54l15dk/nrf54l15/cpuapp
      - nrf9151dk/nrf9151
      - nrf52840dk/nrf52840
    integration_platforms:
      - nrf54l15dk/nrf54l15/cpuapp
      - nrf9151dk/nrf9151
      - nrf52840dk/nrf52840
    extra_args:
      - EXTRA_DTC_OVERLAY_FILE=${ZEPHYR_BASE}/tests/subsys/secure_storage/psa/its/zms.overlay
      - EXTRA_CONF_FILE=\
        ${ZEPHYR_BASE}/tests/subsys/secure_storage/psa/its/overlay-secure_storage.conf;\
        ${ZEPHYR_BASE}/tests/subsys/secure_storage/psa/its/overlay-store_zms.conf;\
        ${ZEPHYR_BASE}/tests/subsys/secure_storage/psa/its/overlay-transform_default.conf;\
        transform_default.conf

  # Split off from the scenarios above and below that use transform_default.conf:
  # native_sim has no hardware unique key, so HW_UNIQUE_KEY is not available and
  # that fragment has no effect there.
  nrf.extended.secure_storage.psa.its.secure_storage.store.zms.native_sim:
    platform_allow: native_sim
    integration_platforms:
      - native_sim
    extra_args:
      - EXTRA_DTC_OVERLAY_FILE=${ZEPHYR_BASE}/tests/subsys/secure_storage/psa/its/zms.overlay
      - EXTRA_CONF_FILE=\
        ${ZEPHYR_BASE}/tests/subsys/secure_storage/psa/its/overlay-secure_storage.conf;\
        ${ZEPHYR_BASE}/tests/subsys/secure_storage/psa/its/overlay-store_zms.conf;\
        ${ZEPHYR_BASE}/tests/subsys/secure_storage/psa/its/overlay-transform_default.conf

  nrf.extended.secure_storage.backward_compatibility.psa.its.secure_storage.store.settings:
    platform_allow:
      - nrf54l15dk/nrf54l15/cpuapp
      - nrf9151dk/nrf9151
      - nrf52840dk/nrf52840
    integration_platforms:
      - nrf54l15dk/nrf54l15/cpuapp
      - nrf9151dk/nrf9151
      - nrf52840dk/nrf52840
    extra_args: "EXTRA_CONF_FILE=\
      ${ZEPHYR_BASE}/tests/subsys/secure_storage/psa/its/overlay-secure_storage.conf;\
      ${ZEPHYR_BASE}/tests/subsys/secure_storage/psa/its/overlay-transform_default.conf;\
      ${ZEPHYR_BASE}/tests/subsys/secure_storage/psa/its/overlay-store_settings.conf;\
      transform_default.conf;\
      store_settings.conf"

  nrf.extended.secure_storage.backward_compatibility.psa.its.secure_storage.store.settings.native_sim:
    platform_allow: native_sim
    integration_platforms:
      - native_sim
    extra_args: "EXTRA_CONF_FILE=\
      ${ZEPHYR_BASE}/tests/subsys/secure_storage/psa/its/overlay-secure_storage.conf;\
      ${ZEPHYR_BASE}/tests/subsys/secure_storage/psa/its/overlay-transform_default.conf;\
      ${ZEPHYR_BASE}/tests/subsys/secure_storage/psa/its/overlay-store_settings.conf;\
      store_settings.conf"

  nrf.extended.secure_storage.backward_compatibility.psa.its.secure_storage.custom.transform:
    platform_allow:
      - native_sim
      - nrf54l15dk/nrf54l15/cpuapp
      - nrf9151dk/nrf9151
      - nrf52840dk/nrf52840
    integration_platforms:
      - native_sim
      - nrf54l15dk/nrf54l15/cpuapp
      - nrf9151dk/nrf9151
      - nrf52840dk/nrf52840
    extra_args: "EXTRA_CONF_FILE=\
      ${ZEPHYR_BASE}/tests/subsys/secure_storage/psa/its/overlay-secure_storage.conf;\
      ${ZEPHYR_BASE}/tests/subsys/secure_storage/psa/its/overlay-transform_custom.conf;\
      ${ZEPHYR_BASE}/tests/subsys/secure_storage/psa/its/overlay-store_settings.conf;\
      store_settings.conf"

  nrf.extended.secure_storage.backward_compatibility.psa.its.secure_storage.custom.store:
    platform_allow:
      - nrf54l15dk/nrf54l15/cpuapp
      - nrf9151dk/nrf9151
      - nrf52840dk/nrf52840
    integration_platforms:
      - nrf54l15dk/nrf54l15/cpuapp
      - nrf9151dk/nrf9151
      - nrf52840dk/nrf52840
    extra_args: "EXTRA_CONF_FILE=\
      ${ZEPHYR_BASE}/tests/subsys/secure_storage/psa/its/overlay-secure_storage.conf;\
      ${ZEPHYR_BASE}/tests/subsys/secure_storage/psa/its/overlay-transform_default.conf;\
      ${ZEPHYR_BASE}/tests/subsys/secure_storage/psa/its/overlay-store_custom.conf;\
      transform_default.conf"

  nrf.extended.secure_storage.backward_compatibility.psa.its.secure_storage.custom.store.native_sim:
    platform_allow: native_sim
    integration_platforms:
      - native_sim
    extra_args: "EXTRA_CONF_FILE=\
      ${ZEPHYR_BASE}/tests/subsys/secure_storage/psa/its/overlay-secure_storage.conf;\
      ${ZEPHYR_BASE}/tests/subsys/secure_storage/psa/its/overlay-transform_default.conf;\
      ${ZEPHYR_BASE}/tests/subsys/secure_storage/psa/its/overlay-store_custom.conf"

  nrf.extended.secure_storage.backward_compatibility.psa.its.secure_storage.custom.both:
    platform_allow:
      - native_sim
      - nrf54l15dk/nrf54l15/cpuapp
      - nrf9151dk/nrf9151
      - nrf52840dk/nrf52840
    integration_platforms:
      - native_sim
      - nrf54l15dk/nrf54l15/cpuapp
      - nrf9151dk/nrf9151
      - nrf52840dk/nrf52840
    extra_args: "EXTRA_CONF_FILE=\
      ${ZEPHYR_BASE}/tests/subsys/secure_storage/psa/its/overlay-secure_storage.conf;\
      ${ZEPHYR_BASE}/tests/subsys/secure_storage/psa/its/overlay-transform_custom.conf;\
      ${ZEPHYR_BASE}/tests/subsys/secure_storage/psa/its/overlay-store_custom.conf"
```
