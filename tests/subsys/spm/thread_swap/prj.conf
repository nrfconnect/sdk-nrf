## CMakeLists.txt
```
#
# Copyright (c) 2020 Nordic Semiconductor ASA
#
# SPDX-License-Identifier: LicenseRef-Nordic-5-Clause
#

cmake_minimum_required(VERSION 3.20.0)

find_package(Zephyr REQUIRED HINTS $ENV{ZEPHYR_BASE})
project(NONE)

zephyr_compile_options(-Wno-deprecated-declarations)
FILE(GLOB app_sources src/*.c)
target_sources(app PRIVATE ${app_sources})
```

## prj.conf
```kconfig
#
# Copyright (c) 2020 Nordic Semiconductor ASA
#
# SPDX-License-Identifier: LicenseRef-Nordic-5-Clause
#

CONFIG_BUILD_WITH_TFM=n
CONFIG_SPM=y
CONFIG_ZTEST=y
CONFIG_ZTEST_THREAD_PRIORITY=0
```

## src/main.c
```c
/*
 * Copyright (c) 2020 Nordic Semiconductor ASA
 *
 * SPDX-License-Identifier: LicenseRef-Nordic-5-Clause
 */

#include <zephyr/ztest.h>
#include <secure_services.h>
#include <zephyr/kernel.h>

static struct k_work_delayable interrupting_work;
static volatile bool work_done;

static void work_func(struct k_work *work)
{
	work_done = true;

	/* Call the secure service here as well, to test the added complexity of
	 * calling secure services from two threads.
	 */
	spm_busy_wait(20000);
}

void test_spm_service_thread_swap1(void)
{
	int err;

	work_done = false;

	/* Set up interrupting_work to fire while spm_busy_wait() is executing.
	 * This tests that it is safe to switch threads while a secure service
	 * is running.
	 */
	k_work_init_delayable(&interrupting_work, work_func);
	err = k_work_reschedule(&interrupting_work, K_MSEC(10));
	zassert_equal(1, err, "k_work_reschedule failed: %d\n", err);

	/* Call into the secure service which will be interrupted. If the
	 * scheduler is locked before entering secure services, it will prevent
	 * work_func from being run until after the below function returns, but
	 * this is valid behavior.
	 */
	spm_busy_wait(20000);
	zassert_true(work_done, "work_func should have interrupted wait.");
}

void test_main(void)
{
	ztest_test_suite(test_spm_service_thread_swap,
			ztest_unit_test(test_spm_service_thread_swap1)
			);
	ztest_run_test_suite(test_spm_service_thread_swap);
}
```
