## tests/subsys/spm/secure_services/testcase.yaml
```yaml
tests:
  spm.secure_services:
    platform_allow: nrf9160dk_nrf9160_ns nrf5340dk_nrf5340_cpuapp_ns
    tags: spm secure_services
```

## tests/subsys/spm/thread_swap/testcase.yaml
```yaml
tests:
  spm.secure_services.thread_swap:
    platform_allow: nrf9160dk_nrf9160_ns nrf5340dk_nrf5340_cpuapp_ns
    integration_platforms:
      - nrf9160dk_nrf9160_ns
      - nrf5340dk_nrf5340_cpuapp_ns
    tags: spm secure_services thread_swap
```

## tests/subsys/storage/flash_map/testcase.yaml
```yaml
common:
  tags: ci_tests_subsys_storage_partition_macros

tests:
  subsys.storage.partition_macros:
    platform_allow:
      - nrf54h20dk/nrf54h20/cpuapp
      - nrf52840dk/nrf52840
    integration_platforms:
      - nrf54h20dk/nrf54h20/cpuapp
      - nrf52840dk/nrf52840
```

## tests/subsys/storage/partition_macros/Kconfig.sysbuild
```kconfig
#
# Copyright (c) 2026 Nordic Semiconductor ASA
#
# SPDX-License-Identifier: LicenseRef-Nordic-5-Clause
#

if !SOC_SERIES_NRF54H
config PARTITION_MANAGER
	default n
endif

source "share/sysbuild/Kconfig"
```

## tests/subsys/suit/cache/testcase.yaml
```yaml
tests:
  suit-platform.integration.suit_cache:
    platform_allow:
      - nrf52840dk/nrf52840
      - native_sim
      - native_sim/native/64
    tags:
      - suit
      - suit_cache
      - ci_tests_subsys_suit
    integration_platforms:
      - nrf52840dk/nrf52840
      - native_sim
```

## tests/subsys/suit/cache_fetch/testcase.yaml
```yaml
tests:
  suit-platform.integration.cache_streamer:
    platform_allow: nrf52840dk/nrf52840 native_posix native_posix/native/64
    tags: suit-processor suit_cache suit_stream
    integration_platforms:
      - nrf52840dk/nrf52840
      - native_posix
```

## tests/subsys/suit/cache_pool_digest/boards/nrf54h20dk_nrf54h20_cpuapp.conf
```kconfig
#
# Copyright (c) 2024 Nordic Semiconductor ASA
#
# SPDX-License-Identifier: LicenseRef-Nordic-5-Clause
#

CONFIG_NULL_POINTER_EXCEPTION_DETECTION_NONE=y
CONFIG_SERIAL=y
CONFIG_CONSOLE=y
CONFIG_UART_CONSOLE=y

#Logging and printk is using standard UART.
CONFIG_LOG_MODE_DEFERRED=y
CONFIG_LOG_BACKEND_UART=y
CONFIG_LOG_PRINTK=y
CONFIG_LOG_BUFFER_SIZE=8192
CONFIG_SUIT_CACHEX_ERASE_BLOCK_SIZE=128
```

## tests/subsys/suit/cache_pool_digest/testcase.yaml
```yaml
common:
  sysbuild: true
tests:
  suit-platform.integration.cache_pool_digest:
    platform_allow: nrf54h20dk/nrf54h20/cpuapp native_posix native_posix/native/64
    tags: suit suit_cache digest
    integration_platforms:
      - native_posix
```

## tests/subsys/suit/cache_sink/testcase.yaml
```yaml
common:
  sysbuild: true
tests:
  suit-platform.integration.cache_sink:
    platform_allow:
      - nrf54h20dk/nrf54h20/cpuapp
      - native_sim
      - native_sim/native/64
    tags:
      - suit
      - suit_cache
      - ci_tests_subsys_suit
    integration_platforms:
      - native_sim
```

## tests/subsys/suit/check_content/testcase.yaml
```yaml
tests:
  suit.integration.check_content:
    platform_allow:
      - nrf52840dk/nrf52840
      - native_sim
    tags:
      - suit
      - suit_plat_check_content
      - ci_tests_subsys_suit
    timeout: 240
    integration_platforms:
      - nrf52840dk/nrf52840
      - native_sim
```

## tests/subsys/suit/check_image_match/testcase.yaml
```yaml
tests:
  suit.integration.check_image_match:
    platform_allow:
      - nrf52840dk/nrf52840
      - native_sim
    tags:
      - suit
      - suit_plat_check_image_match
      - ci_tests_subsys_suit
    timeout: 240
    integration_platforms:
      - nrf52840dk/nrf52840
      - native_sim
```

## tests/subsys/suit/component_compatibility_check/boards/native_sim.conf
```kconfig
#
# Copyright (c) 2024 Nordic Semiconductor ASA
#
# SPDX-License-Identifier: LicenseRef-Nordic-5-Clause
#

CONFIG_FLASH_SIMULATOR=y
# Mock processor IDs, defined in nrfx
CONFIG_MOCK_NRFX=y
```

## tests/subsys/suit/component_compatibility_check/testcase.yaml
```yaml
tests:
  suit-platform.integration.suit_component_compatibility_check:
    platform_allow: native_sim
    tags:
      - suit_storage
      - suit
      - ci_tests_subsys_suit
    integration_platforms:
      - native_sim
```

## tests/subsys/suit/copy/testcase.yaml
```yaml
tests:
  suit-platform.integration.copy:
    platform_allow: nrf52840dk_nrf52840 native_posix native_posix_64
    tags: suit-processor suit_platform
    integration_platforms:
      - nrf52840dk_nrf52840
      - native_posix
      - native_posix_64
```

## tests/subsys/suit/decompress_filter/testcase.yaml
```yaml
tests:
  suit.integration.decompress_filter:
    platform_allow:
      - native_sim
      - native_sim/native/64
    tags:
      - suit
      - suit_decompress_filter
      - ci_tests_subsys_suit
    integration_platforms:
      - native_sim
```

## tests/subsys/suit/decrypt_filter/testcase.yaml
```yaml
tests:
  suit.integration.decrypt_filter:
    platform_allow:
      - nrf52840dk/nrf52840
      - native_sim
      - native_sim/native/64
    tags:
      - suit
      - suit_decrypt_filter
      - ci_tests_subsys_suit
    integration_platforms:
      - nrf52840dk/nrf52840
      - native_sim
```

## tests/subsys/suit/digest/testcase.yaml
```yaml
tests:
  suit.integration.digest:
    platform_allow:
      - nrf52840dk/nrf52840
      - native_sim
      - native_sim/native/64
    tags:
      - suit
      - suit_digest
      - ci_tests_subsys_suit
    timeout: 240
    integration_platforms:
      - nrf52840dk/nrf52840
      - native_sim
```

## tests/subsys/suit/digest_sink/testcase.yaml
```yaml
tests:
  suit.integration.digest_sink:
    platform_allow:
      - nrf52840dk/nrf52840
      - native_sim
      - native_sim/native/64
    tags:
      - suit
      - suit_digest_sink
      - ci_tests_subsys_suit
    timeout: 240
    integration_platforms:
      - nrf52840dk/nrf52840
      - native_sim
```

## tests/subsys/suit/envelope_decoder/testcase.yaml
```yaml
tests:
  suit-processor.integration.envelope_decoder:
    platform_allow:
      - native_sim
      - native_sim/native/64
    build_only: true
    tags:
      - suit-processor
      - envelope-decoder
      - suit
      - ci_tests_subsys_suit
```

## tests/subsys/suit/execution_mode/testcase.yaml
```yaml
tests:
  suit-platform.integration.common.execution_mode:
    platform_allow: nrf52840dk/nrf52840 native_posix native_posix/native/64
    tags: suit-processor suit_platform suit_execution_mode
    integration_platforms:
      - nrf52840dk/nrf52840
      - native_posix
```

## tests/subsys/suit/fetch/Kconfig
```kconfig
#
# Copyright (c) 2024 Nordic Semiconductor ASA
#
# SPDX-License-Identifier: LicenseRef-Nordic-5-Clause
#

# Include and define MOCK_* Kconfigs
rsource "../mocks/Kconfig"
rsource "../tests/Kconfig"

choice TEST_SUIT_PLATFORM_FETCH_VARIANT
	prompt "SUIT platform implementation variant to test"
	default TEST_SUIT_PLATFORM_FETCH_VARIANT_SDFW

config TEST_SUIT_PLATFORM_FETCH_VARIANT_APP
	bool "Local or application"
	depends on SUIT_PLATFORM_VARIANT_APP
	select FLASH_IPUC
	select SUIT_ENVELOPE_INFO
	select SUIT_CACHE_RW
	select SUIT_STREAM_SINK_CACHE
	select SUIT_STREAM_FETCH_SOURCE_MGR

config TEST_SUIT_PLATFORM_FETCH_VARIANT_SDFW
	bool "Bootloader or SDFW"
	depends on SUIT_PLATFORM_VARIANT_SDFW
	select MOCK_SDFW_ARBITER
	select SUIT_EXECUTION_MODE
	select SUIT_MCI
	select SUIT_STREAM_FILTER_DECRYPT
	select SUIT_CRYPTO
	select SUIT_STORAGE

endchoice # TEST_SUIT_PLATFORM_FETCH_VARIANT

if TEST_SUIT_PLATFORM_FETCH_VARIANT_APP

config SUIT_CACHE_SDFW_IPUC_ID
	default 254

config SUIT_CACHE_APP_IPUC_ID
	default 255

endif # TEST_SUIT_PLATFORM_FETCH_VARIANT_APP

source "Kconfig.zephyr"
```

## tests/subsys/suit/fetch/testcase.yaml
```yaml
tests:
  suit-platform.integration.fetch:
    platform_allow:
      - nrf52840dk/nrf52840
      - native_sim
      - native_sim/native/64
    tags:
      - suit-processor
      - suit_platform
      - suit
      - ci_tests_subsys_suit
    integration_platforms:
      - nrf52840dk/nrf52840
      - native_sim
      - native_sim/native/64

  suit-platform.integration.fetch.app:
    platform_allow:
      - native_sim
      - native_sim/native/64
    tags:
      - suit-processor
      - suit_platform
      - suit
      - ci_tests_subsys_suit
    extra_configs:
      - CONFIG_SUIT_PLATFORM_VARIANT_APP=y
    integration_platforms:
      - native_sim
      - native_sim/native/64
```

## tests/subsys/suit/fetch_integrated_payload_flash/testcase.yaml
```yaml
tests:
  suit-processor.integration.fetch_integrated_payload_flash:
    platform_allow: nrf52840dk/nrf52840 native_posix native_posix/native/64
    tags: suit-processor integrated-payload fetch MRAM suit ci_tests_subsys_suit
    integration_platforms:
      - nrf52840dk/nrf52840
      - native_posix
```

## tests/subsys/suit/fetch_source_mgr/testcase.yaml
```yaml
tests:
  suit-platform.integration.fetch_source_mgr:
    platform_allow:
      - native_sim
      - native_sim/native/64
    tags:
      - suit_platform
      - suit
      - ci_tests_subsys_suit
    integration_platforms:
      - native_sim
```

## tests/subsys/suit/flash_sink/testcase.yaml
```yaml
tests:
  suit-platform.integration.flash_sink:
    platform_allow:
      - nrf52840dk/nrf52840
      - native_sim
      - native_sim/native/64
    tags:
      - suit-processor
      - suit_platform
      - suit
      - ci_tests_subsys_suit
    integration_platforms:
      - nrf52840dk/nrf52840
      - native_sim
  suit-platform.integration.flash_sink.nrf54h20:
    sysbuild: true
    platform_allow:
      - nrf54h20dk/nrf54h20/cpuapp
      - native_sim
      - native_sim/native/64
    tags:
      - suit-processor
      - suit_platform
      - suit
      - ci_tests_subsys_suit
    integration_platforms:
      - native_sim
```
