/*
 * Copyright (c) 2025 Nordic Semiconductor ASA
 *
 * SPDX-License-Identifier: LicenseRef-Nordic-5-Clause
 */

#include "../../nrf54h20dk_nrf54h20_cpuapp_memory_map.dtsi"

/ {
	chosen {
		zephyr,code-partition = &boot_partition;
	};
};

boot_partition: &cpuapp_boot_partition {
	label = "mcuboot";
};
