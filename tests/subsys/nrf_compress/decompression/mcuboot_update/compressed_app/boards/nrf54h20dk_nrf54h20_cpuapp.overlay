/*
 * Copyright (c) 2025 Nordic Semiconductor ASA
 *
 * SPDX-License-Identifier: LicenseRef-Nordic-5-Clause
 */

#include "../../sysbuild/nrf54h20dk_nrf54h20_cpuapp_memory_map.dtsi"

/ {
	chosen {
		zephyr,code-partition = &cpuapp_slot0_partition;
	};
};
