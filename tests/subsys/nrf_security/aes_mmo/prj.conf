## CMakeLists.txt
```
#
# Copyright (c) 2026 Nordic Semiconductor ASA
#
# SPDX-License-Identifier: LicenseRef-Nordic-5-Clause
#

cmake_minimum_required(VERSION 3.20.0)

find_package(Zephyr REQUIRED HINTS $ENV{ZEPHYR_BASE})
project(aes_mmo)

target_sources(app PRIVATE src/main.c)
```

## prj.conf
```kconfig
#
# Copyright (c) 2026 Nordic Semiconductor ASA
#
# SPDX-License-Identifier: LicenseRef-Nordic-5-Clause
#
CONFIG_ZTEST=y
CONFIG_ZTEST_STACK_SIZE=16384

CONFIG_SYS_CLOCK_TICKS_PER_SEC=1000
CONFIG_MAIN_STACK_SIZE=16384
CONFIG_HEAP_MEM_POOL_SIZE=16384

CONFIG_CONSOLE=y
CONFIG_LOG=y

CONFIG_PSA_CRYPTO=y

CONFIG_PSA_CRYPTO_DRIVER_CRACEN=y

CONFIG_MBEDTLS_ENABLE_HEAP=y
CONFIG_MBEDTLS_HEAP_SIZE=8192

# AES-MMO uses the running digest as the AES key, so no AES key type or key size
# configuration is involved.
CONFIG_PSA_WANT_ALG_AES_MMO_ZIGBEE=y
```

## src/main.c
```c
/*
 * Copyright (c) 2026 Nordic Semiconductor ASA
 *
 * SPDX-License-Identifier: LicenseRef-Nordic-5-Clause
 */

/*
 * AES-MMO known-answer tests against the PSA API.
 *
 * PSA_ALG_AES_MMO_ZIGBEE (Zigbee specification, clause B.6) is a Merkle-Damgard
 * hash over a Matyas-Meyer-Oseas compression function built from AES-128. CRACEN
 * has no hardware mode for it, so the driver runs one hardware AES-ECB operation
 * per message block and does the chaining in software. The chaining and the
 * padding are therefore what these tests aim at: the multipart tests split the
 * same message at every offset that can leave the block buffer in a different
 * state, and the vectors cover each branch of the padding rule.
 */

#include <zephyr/kernel.h>
#include <zephyr/ztest.h>
#include <psa/crypto.h>
#include <string.h>

#include "aes_mmo_vectors.h"

/* The longest message in the corpus, allocated once instead of on the stack. */
static uint8_t message[AES_MMO_MAX_MESSAGE_LENGTH];

static void *setup_crypto(void)
{
	zassert_equal(psa_crypto_init(), PSA_SUCCESS, "PSA Crypto initialization failed");
	return NULL;
}

ZTEST_SUITE(aes_mmo_psa, NULL, setup_crypto, NULL, NULL, NULL);

/* The one vector with an external source: the Zigbee install code example. */
ZTEST(aes_mmo_psa, test_install_code)
{
	uint8_t digest[AES_MMO_DIGEST_SIZE];
	size_t digest_length = 0;
	psa_status_t status;

	status = psa_hash_compute(PSA_ALG_AES_MMO_ZIGBEE, aes_mmo_install_code,
				  sizeof(aes_mmo_install_code), digest, sizeof(digest),
				  &digest_length);

	zassert_equal(status, PSA_SUCCESS, "psa_hash_compute failed: %d", (int)status);
	zassert_equal(digest_length, AES_MMO_DIGEST_SIZE, "unexpected digest length: %u",
		      (unsigned int)digest_length);
	zassert_mem_equal(digest, aes_mmo_install_code_digest, AES_MMO_DIGEST_SIZE,
			  "install code digest mismatch");
}

ZTEST(aes_mmo_psa, test_single_part)
{
	for (size_t i = 0; i < ARRAY_SIZE(aes_mmo_vectors); i++) {
		const struct aes_mmo_vector *v = &aes_mmo_vectors[i];
		uint8_t digest[AES_MMO_DIGEST_SIZE];
		size_t digest_length = 0;
		psa_status_t status;

		aes_mmo_fill_pattern(message, v->len);

		status = psa_hash_compute(PSA_ALG_AES_MMO_ZIGBEE, message, v->len, digest,
					  sizeof(digest), &digest_length);

		zassert_equal(status, PSA_SUCCESS, "len %u: psa_hash_compute failed: %d",
			      (unsigned int)v->len, (int)status);
		zassert_equal(digest_length, AES_MMO_DIGEST_SIZE, "len %u: digest length %u",
			      (unsigned int)v->len, (unsigned int)digest_length);
		zassert_mem_equal(digest, v->digest, AES_MMO_DIGEST_SIZE, "len %u: digest mismatch",
				  (unsigned int)v->len);
	}
}

/* Feeding the message in fragments must not change the digest, whichever way the
 * fragments straddle the 16-byte block boundary.
 */
ZTEST(aes_mmo_psa, test_multipart)
{
	static const size_t chunk_sizes[] = {1, 2, 7, 15, 16, 17, 31, 32};

	for (size_t i = 0; i < ARRAY_SIZE(aes_mmo_vectors); i++) {
		const struct aes_mmo_vector *v = &aes_mmo_vectors[i];

		aes_mmo_fill_pattern(message, v->len);

		for (size_t c = 0; c < ARRAY_SIZE(chunk_sizes); c++) {
			psa_hash_operation_t operation = PSA_HASH_OPERATION_INIT;
			uint8_t digest[AES_MMO_DIGEST_SIZE];
			size_t digest_length = 0;
			size_t offset = 0;
			psa_status_t status;

			status = psa_hash_setup(&operation, PSA_ALG_AES_MMO_ZIGBEE);
			zassert_equal(status, PSA_SUCCESS, "psa_hash_setup failed: %d",
				      (int)status);

			while (offset < v->len) {
				size_t chunk = MIN(chunk_sizes[c], v->len - offset);

				status = psa_hash_update(&operation, message + offset, chunk);
				zassert_equal(status, PSA_SUCCESS,
					      "len %u chunk %u: update failed: %d",
					      (unsigned int)v->len, (unsigned int)chunk_sizes[c],
					      (int)status);
				offset += chunk;
			}

			status = psa_hash_finish(&operation, digest, sizeof(digest),
						 &digest_length);
			zassert_equal(status, PSA_SUCCESS, "len %u chunk %u: finish failed: %d",
				      (unsigned int)v->len, (unsigned int)chunk_sizes[c],
				      (int)status);
			zassert_mem_equal(digest, v->digest, AES_MMO_DIGEST_SIZE,
					  "len %u chunk %u: digest mismatch", (unsigned int)v->len,
					  (unsigned int)chunk_sizes[c]);
		}
	}
}

/* A cloned operation must continue from the same state as the original. */
ZTEST(aes_mmo_psa, test_clone)
{
	psa_hash_operation_t operation = PSA_HASH_OPERATION_INIT;
	psa_hash_operation_t clone = PSA_HASH_OPERATION_INIT;
	uint8_t digest[AES_MMO_DIGEST_SIZE];
	uint8_t clone_digest[AES_MMO_DIGEST_SIZE];
	size_t digest_length = 0;
	psa_status_t status;

	/* Split so that the clone starts with a partially filled block. */
	const size_t split = 20;
	const size_t len = 33;

	aes_mmo_fill_pattern(message, len);

	zassert_equal(psa_hash_setup(&operation, PSA_ALG_AES_MMO_ZIGBEE), PSA_SUCCESS);
	zassert_equal(psa_hash_update(&operation, message, split), PSA_SUCCESS);

	status = psa_hash_clone(&operation, &clone);
	zassert_equal(status, PSA_SUCCESS, "psa_hash_clone failed: %d", (int)status);

	zassert_equal(psa_hash_update(&operation, message + split, len - split), PSA_SUCCESS);
	zassert_equal(psa_hash_finish(&operation, digest, sizeof(digest), &digest_length),
		      PSA_SUCCESS);

	zassert_equal(psa_hash_update(&clone, message + split, len - split), PSA_SUCCESS);
	zassert_equal(psa_hash_finish(&clone, clone_digest, sizeof(clone_digest), &digest_length),
		      PSA_SUCCESS);

	zassert_mem_equal(digest, clone_digest, AES_MMO_DIGEST_SIZE, "clone digest mismatch");
}

ZTEST(aes_mmo_psa, test_compare)
{
	uint8_t corrupted[AES_MMO_DIGEST_SIZE];
	psa_status_t status;

	status = psa_hash_compare(PSA_ALG_AES_MMO_ZIGBEE, aes_mmo_install_code,
				  sizeof(aes_mmo_install_code), aes_mmo_install_code_digest,
				  AES_MMO_DIGEST_SIZE);
	zassert_equal(status, PSA_SUCCESS, "psa_hash_compare failed: %d", (int)status);

	memcpy(corrupted, aes_mmo_install_code_digest, sizeof(corrupted));
	corrupted[AES_MMO_DIGEST_SIZE - 1] ^= 0x01;

	status = psa_hash_compare(PSA_ALG_AES_MMO_ZIGBEE, aes_mmo_install_code,
				  sizeof(aes_mmo_install_code), corrupted, sizeof(corrupted));
	zassert_equal(status, PSA_ERROR_INVALID_SIGNATURE,
		      "corrupted digest was accepted: %d", (int)status);
}

ZTEST(aes_mmo_psa, test_output_buffer_too_small)
{
	uint8_t digest[AES_MMO_DIGEST_SIZE - 1];
	size_t digest_length = 0;
	psa_status_t status;

	status = psa_hash_compute(PSA_ALG_AES_MMO_ZIGBEE, aes_mmo_install_code,
				  sizeof(aes_mmo_install_code), digest, sizeof(digest),
				  &digest_length);

	zassert_equal(status, PSA_ERROR_BUFFER_TOO_SMALL, "small buffer accepted: %d",
		      (int)status);
}

/* Zigbee clause B.6 encodes the message length in 16 bits, so longer messages are
 * outside the domain of the algorithm and must be rejected rather than wrapped.
 */
ZTEST(aes_mmo_psa, test_message_too_long)
{
	psa_hash_operation_t operation = PSA_HASH_OPERATION_INIT;
	psa_status_t status;

	memset(message, 0, sizeof(message));

	zassert_equal(psa_hash_setup(&operation, PSA_ALG_AES_MMO_ZIGBEE), PSA_SUCCESS);
	zassert_equal(psa_hash_update(&operation, message, AES_MMO_MAX_MESSAGE_LENGTH),
		      PSA_SUCCESS);

	status = psa_hash_update(&operation, message, 1);
	zassert_equal(status, PSA_ERROR_INVALID_ARGUMENT, "over-long message accepted: %d",
		      (int)status);

	psa_hash_abort(&operation);
}
```

## src/aes_mmo_vectors.h
```c
/*
 * Copyright (c) 2026 Nordic Semiconductor ASA
 *
 * SPDX-License-Identifier: LicenseRef-Nordic-5-Clause
 */

/*
 * AES-MMO (Zigbee) test vectors.
 *
 * The first vector is the install code example from the Zigbee specification:
 * hashing an install code together with its CRC yields the link key, which makes
 * it the one vector in this file with an external source.
 *
 * The remaining vectors cover the padding rule of Zigbee clause B.6 around every
 * boundary that matters: an empty message, a message that leaves no room for the
 * length field (13, 14, 15 bytes), exact block multiples, and the longest message
 * the 16-bit length field can express (8191 bytes). Their messages are generated
 * by aes_mmo_fill_pattern() instead of being stored, and their digests come from an
 * independent Python implementation that reproduces the install code vector above.
 */

#ifndef AES_MMO_VECTORS_H
#define AES_MMO_VECTORS_H

#include <stddef.h>
#include <stdint.h>

#define AES_MMO_DIGEST_SIZE 16

/* Longest message that AES-MMO accepts: the bit length must fit in 16 bits. */
#define AES_MMO_MAX_MESSAGE_LENGTH 8191

/* Zigbee specification install code example, install code followed by its CRC. */
static const uint8_t aes_mmo_install_code[] = {0x83, 0xFE, 0xD3, 0x40, 0x7A, 0x93, 0x97, 0x23,
					       0xA5, 0xC6, 0x39, 0xB2, 0x69, 0x16, 0xD5, 0x05,
					       0xC3, 0xB5};

/* The link key that the install code above derives to. */
static const uint8_t aes_mmo_install_code_digest[AES_MMO_DIGEST_SIZE] = {
	0x66, 0xB6, 0x90, 0x09, 0x81, 0xE1, 0xEE, 0x3C,
	0xA4, 0x20, 0x6B, 0x6B, 0x86, 0x1C, 0x02, 0xBB};

struct aes_mmo_vector {
	size_t len;
	uint8_t digest[AES_MMO_DIGEST_SIZE];
};

static const struct aes_mmo_vector aes_mmo_vectors[] = {
	{ .len = 0,
	  .digest = {0xba, 0xd7, 0x8e, 0x72, 0x6c, 0x1e, 0xc0, 0x2b,
		     0x7e, 0xbf, 0xe9, 0x2b, 0x23, 0xd9, 0xec, 0x34} },
	{ .len = 1,
	  .digest = {0x11, 0xde, 0x54, 0x51, 0xd6, 0x5f, 0xf5, 0xec,
		     0xaf, 0x25, 0x2b, 0x04, 0x93, 0xd5, 0x6f, 0xc8} },
	{ .len = 13,
	  .digest = {0xdd, 0x1d, 0x14, 0x52, 0x8d, 0x1e, 0x8b, 0xc3,
		     0xf8, 0x37, 0x63, 0xeb, 0xe7, 0x84, 0xf3, 0xc4} },
	{ .len = 14,
	  .digest = {0x0f, 0x63, 0x31, 0xff, 0x9d, 0x0d, 0x13, 0x91,
		     0x33, 0x31, 0x02, 0x64, 0x89, 0x3a, 0x5d, 0x55} },
	{ .len = 15,
	  .digest = {0xd0, 0x27, 0xdc, 0xb9, 0x5e, 0x18, 0xf7, 0x2b,
		     0x25, 0x52, 0xf9, 0x5c, 0x82, 0x70, 0x51, 0x7b} },
	{ .len = 16,
	  .digest = {0x97, 0x36, 0x78, 0xb6, 0x0e, 0x18, 0x73, 0x03,
		     0x42, 0xd3, 0x3b, 0xbf, 0xcb, 0x42, 0xeb, 0x2a} },
	{ .len = 17,
	  .digest = {0x54, 0x1a, 0xef, 0xf9, 0xd9, 0xd2, 0x5b, 0x88,
		     0x84, 0xf0, 0x08, 0x18, 0xb5, 0xba, 0x0f, 0x4f} },
	{ .len = 31,
	  .digest = {0xca, 0x59, 0xba, 0x92, 0x8e, 0xe1, 0x37, 0xc8,
		     0xb9, 0x54, 0xac, 0x9b, 0xe1, 0xad, 0x99, 0x4f} },
	{ .len = 32,
	  .digest = {0x7f, 0xc8, 0x92, 0x23, 0x77, 0xf1, 0x7e, 0xb6,
		     0x16, 0x27, 0x6b, 0xa9, 0xb2, 0xd4, 0x65, 0x73} },
	{ .len = 33,
	  .digest = {0xef, 0x4d, 0xf5, 0x70, 0xe9, 0xb1, 0x26, 0x5b,
		     0x71, 0x83, 0x15, 0x95, 0x56, 0x59, 0x96, 0x96} },
	{ .len = 64,
	  .digest = {0x9c, 0xc8, 0x18, 0x91, 0x74, 0x29, 0x15, 0x3b,
		     0x3e, 0xb9, 0xf9, 0xfe, 0x57, 0x33, 0x11, 0x9f} },
	{ .len = 255,
	  .digest = {0x0f, 0x93, 0x16, 0x5e, 0xf5, 0x0d, 0x2f, 0x25,
		     0x7b, 0x05, 0x9b, 0x1e, 0x7e, 0x2b, 0xdb, 0x50} },
	{ .len = 1000,
	  .digest = {0x58, 0xe6, 0x86, 0x6d, 0x56, 0x6f, 0x5d, 0x9e,
		     0x64, 0x4d, 0x20, 0x37, 0x2b, 0xa0, 0x7f, 0xcb} },
	{ .len = 8191,
	  .digest = {0xb8, 0x6f, 0xdd, 0x0d, 0x04, 0xb9, 0x11, 0x3b,
		     0x9f, 0x66, 0x10, 0x7f, 0x44, 0x57, 0x79, 0xb6} },
};

/* The message pattern that the digests above were computed over. */
static inline void aes_mmo_fill_pattern(uint8_t *buffer, size_t len)
{
	for (size_t i = 0; i < len; i++) {
		buffer[i] = (uint8_t)(i * 7 + 3);
	}
}

#endif /* AES_MMO_VECTORS_H */
```
