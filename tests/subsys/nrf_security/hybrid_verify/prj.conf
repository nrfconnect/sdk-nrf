## CMakeLists.txt
```
#
# Copyright (c) 2026 Nordic Semiconductor ASA
#
# SPDX-License-Identifier: LicenseRef-Nordic-5-Clause
#

cmake_minimum_required(VERSION 3.20.0)

find_package(Zephyr REQUIRED HINTS $ENV{ZEPHYR_BASE})
project(hybrid_verify)

target_include_directories(app PRIVATE
  ${ZEPHYR_NRF_MODULE_DIR}/tests/subsys/nrf_security/ml_dsa/src
  ${ZEPHYR_NRF_MODULE_DIR}/subsys/nrf_security/src/drivers/cracen/cracenpsa/src
)

target_sources(app PRIVATE src/main.c)
```

## prj.conf
```kconfig
#
# Copyright (c) 2026 Nordic Semiconductor ASA
#
# SPDX-License-Identifier: LicenseRef-Nordic-5-Clause
#

# Test framework, stack and heap sizes
CONFIG_ZTEST=y
CONFIG_ZTEST_STACK_SIZE=32768
CONFIG_MAIN_STACK_SIZE=2048
CONFIG_HEAP_MEM_POOL_SIZE=16384
CONFIG_SPEED_OPTIMIZATIONS=y

# Console output and stack usage diagnostics
CONFIG_CONSOLE=y
CONFIG_PRINTK=y
CONFIG_THREAD_STACK_INFO=y
CONFIG_INIT_STACKS=y

# PSA Crypto with CRACEN as the only driver
CONFIG_PSA_CRYPTO=y
CONFIG_PSA_CRYPTO_DRIVER_OBERON=n
CONFIG_PSA_CRYPTO_DRIVER_CRACEN=y

# Mbed TLS heap
CONFIG_MBEDTLS_ENABLE_HEAP=y
CONFIG_MBEDTLS_HEAP_SIZE=8192

# Feature under test
CONFIG_CRACEN_HYBRID_VERIFY=y
CONFIG_CRACEN_HYBRID_VERIFY_ML_DSA_44=y
CONFIG_CRACEN_HYBRID_VERIFY_ML_DSA_65=y
CONFIG_CRACEN_HYBRID_VERIFY_ML_DSA_87=y

# ECDSA verification on P-256 and P-384, and the hashes it uses
CONFIG_PSA_WANT_KEY_TYPE_ECC_PUBLIC_KEY=y
CONFIG_PSA_WANT_ALG_ECDSA=y
CONFIG_PSA_WANT_ECC_SECP_R1_256=y
CONFIG_PSA_WANT_ECC_SECP_R1_384=y
CONFIG_PSA_WANT_ALG_SHA_256=y
CONFIG_PSA_WANT_ALG_SHA_384=y
CONFIG_PSA_WANT_ALG_SHA_512=y
```

## src/main.c
```c
/*
 * Copyright (c) 2026 Nordic Semiconductor ASA
 *
 * SPDX-License-Identifier: LicenseRef-Nordic-5-Clause
 */

#include <zephyr/kernel.h>
#include <zephyr/ztest.h>
#include <psa/crypto.h>
#include <cracen_psa_hybrid_verify.h>
#include <cracen/statuscodes.h>
#include <internal/ecc/cracen_ecdsa.h>
#include <silexpk/ec_curves.h>
#include <sxsymcrypt/hashdefs.h>
#include <string.h>

#include "ecdsa_vectors.h"
#include "ml_dsa_vectors.h"

#define BENCHMARK_ITERATIONS 10

/* ML-DSA sizes, FIPS 204, Table 2 */
#define ML_DSA_44_PUBLIC_KEY_SIZE 1312
#define ML_DSA_87_SIGNATURE_SIZE  4627

#if !defined(PSA_WANT_KEY_TYPE_ML_DSA_PUBLIC_KEY)
BUILD_ASSERT(PSA_EXPORT_PUBLIC_KEY_MAX_SIZE < ML_DSA_44_PUBLIC_KEY_SIZE,
	     "PSA public-key buffers are sized for ML-DSA without ML-DSA in the PSA configuration");
#endif /* !PSA_WANT_KEY_TYPE_ML_DSA_PUBLIC_KEY */

/* An ML-DSA known-answer test paired with an ECDSA signature over the same
 * message. The curve and the hash algorithm are only needed to verify the
 * ECDSA component on its own in the benchmark.
 */
struct hybrid_profile {
	const char *name;
	const uint8_t *message;
	size_t message_length;
	struct cracen_hybrid_verify_ml_dsa ml_dsa;
	struct cracen_hybrid_verify_ecdsa ecdsa;
	const struct sx_pk_ecurve *curve;
	const struct sxhashalg *hashalg;
	psa_key_id_t ml_dsa_key_id;
};

static struct hybrid_profile profiles[] = {
	{
		.name = "ML-DSA-44 + P-256/SHA-256",
		.message = ml_dsa44_kat_msg,
		.message_length = sizeof(ml_dsa44_kat_msg),
		.ml_dsa = {
			.alg = PSA_ALG_ML_DSA,
			.key_bits = 128,
			.public_key = ml_dsa44_kat_pk,
			.public_key_length = sizeof(ml_dsa44_kat_pk),
			.signature = ml_dsa44_kat_sig,
			.signature_length = sizeof(ml_dsa44_kat_sig),
		},
		.ecdsa = {
			.alg = PSA_ALG_ECDSA(PSA_ALG_SHA_256),
			.family = PSA_ECC_FAMILY_SECP_R1,
			.key_bits = 256,
			.public_key = ecdsa_p256_sha256_pub,
			.public_key_length = sizeof(ecdsa_p256_sha256_pub),
			.signature = ecdsa_p256_sha256_sig,
			.signature_length = sizeof(ecdsa_p256_sha256_sig),
		},
		.curve = &sx_curve_nistp256,
		.hashalg = &sxhashalg_sha2_256,
	},
	{
		.name = "ML-DSA-65 + P-384/SHA-384",
		.message = ml_dsa_kat_msg,
		.message_length = sizeof(ml_dsa_kat_msg),
		.ml_dsa = {
			.alg = PSA_ALG_ML_DSA,
			.key_bits = 192,
			.public_key = ml_dsa_kat_pk,
			.public_key_length = sizeof(ml_dsa_kat_pk),
			.signature = ml_dsa_kat_sig,
			.signature_length = sizeof(ml_dsa_kat_sig),
		},
		.ecdsa = {
			.alg = PSA_ALG_ECDSA(PSA_ALG_SHA_384),
			.family = PSA_ECC_FAMILY_SECP_R1,
			.key_bits = 384,
			.public_key = ecdsa_p384_sha384_pub,
			.public_key_length = sizeof(ecdsa_p384_sha384_pub),
			.signature = ecdsa_p384_sha384_sig,
			.signature_length = sizeof(ecdsa_p384_sha384_sig),
		},
		.curve = &sx_curve_nistp384,
		.hashalg = &sxhashalg_sha2_384,
	},
	{
		/* Digest shorter than the curve operand, so it is padded. */
		.name = "ML-DSA-87 + P-384/SHA-256",
		.message = ml_dsa87_kat_msg,
		.message_length = sizeof(ml_dsa87_kat_msg),
		.ml_dsa = {
			.alg = PSA_ALG_ML_DSA,
			.key_bits = 256,
			.public_key = ml_dsa87_kat_pk,
			.public_key_length = sizeof(ml_dsa87_kat_pk),
			.signature = ml_dsa87_kat_sig,
			.signature_length = sizeof(ml_dsa87_kat_sig),
		},
		.ecdsa = {
			.alg = PSA_ALG_ECDSA(PSA_ALG_SHA_256),
			.family = PSA_ECC_FAMILY_SECP_R1,
			.key_bits = 384,
			.public_key = ecdsa_p384_sha256_pub,
			.public_key_length = sizeof(ecdsa_p384_sha256_pub),
			.signature = ecdsa_p384_sha256_sig,
			.signature_length = sizeof(ecdsa_p384_sha256_sig),
		},
		.curve = &sx_curve_nistp384,
		.hashalg = &sxhashalg_sha2_256,
	},
	{
		/* Digest longer than the curve operand, so it is truncated. */
		.name = "ML-DSA-65 + P-256/SHA-512",
		.message = ml_dsa_kat_msg,
		.message_length = sizeof(ml_dsa_kat_msg),
		.ml_dsa = {
			.alg = PSA_ALG_ML_DSA,
			.key_bits = 192,
			.public_key = ml_dsa_kat_pk,
			.public_key_length = sizeof(ml_dsa_kat_pk),
			.signature = ml_dsa_kat_sig,
			.signature_length = sizeof(ml_dsa_kat_sig),
		},
		.ecdsa = {
			.alg = PSA_ALG_ECDSA(PSA_ALG_SHA_512),
			.family = PSA_ECC_FAMILY_SECP_R1,
			.key_bits = 256,
			.public_key = ecdsa_p256_sha512_pub,
			.public_key_length = sizeof(ecdsa_p256_sha512_pub),
			.signature = ecdsa_p256_sha512_sig,
			.signature_length = sizeof(ecdsa_p256_sha512_sig),
		},
		.curve = &sx_curve_nistp256,
		.hashalg = &sxhashalg_sha2_512,
	},
};

/* Corrupted copies of the vectors under test, kept out of the test stacks. */
static uint8_t ml_dsa_signature_copy[ML_DSA_87_SIGNATURE_SIZE];
static uint8_t ecdsa_signature_copy[PSA_ECDSA_SIGNATURE_SIZE(521)];

static psa_status_t verify_profile(const struct hybrid_profile *profile)
{
	return cracen_hybrid_verify(&profile->ml_dsa, &profile->ecdsa, profile->message,
				    profile->message_length);
}

static void *setup_crypto(void)
{
	psa_status_t status = psa_crypto_init();

	zassert_equal(status, PSA_SUCCESS, "PSA Crypto initialization failed: %d", status);

	/* The keys are only used to benchmark against psa_verify_message(). */
	if (!IS_ENABLED(PSA_WANT_ALG_ML_DSA)) {
		return NULL;
	}

	for (size_t i = 0; i < ARRAY_SIZE(profiles); i++) {
		psa_key_attributes_t attributes = PSA_KEY_ATTRIBUTES_INIT;

		psa_set_key_type(&attributes, PSA_KEY_TYPE_ML_DSA_PUBLIC_KEY);
		psa_set_key_usage_flags(&attributes, PSA_KEY_USAGE_VERIFY_MESSAGE);
		psa_set_key_algorithm(&attributes, profiles[i].ml_dsa.alg);

		status = psa_import_key(&attributes, profiles[i].ml_dsa.public_key,
					profiles[i].ml_dsa.public_key_length,
					&profiles[i].ml_dsa_key_id);
		psa_reset_key_attributes(&attributes);
		zassert_equal(status, PSA_SUCCESS, "%s: public-key import failed: %d",
			      profiles[i].name, status);
	}

	return NULL;
}

static void teardown_crypto(void *fixture)
{
	ARG_UNUSED(fixture);

	for (size_t i = 0; i < ARRAY_SIZE(profiles); i++) {
		if (profiles[i].ml_dsa_key_id != PSA_KEY_ID_NULL) {
			(void)psa_destroy_key(profiles[i].ml_dsa_key_id);
			profiles[i].ml_dsa_key_id = PSA_KEY_ID_NULL;
		}
	}
}

ZTEST_SUITE(hybrid_verify, NULL, setup_crypto, NULL, NULL, teardown_crypto);

ZTEST(hybrid_verify, test_valid_signatures)
{
	for (size_t i = 0; i < ARRAY_SIZE(profiles); i++) {
		psa_status_t status = verify_profile(&profiles[i]);

		zassert_equal(status, PSA_SUCCESS, "%s: verification failed: %d",
			      profiles[i].name, status);
	}
}

ZTEST(hybrid_verify, test_invalid_ml_dsa_signature)
{
	for (size_t i = 0; i < ARRAY_SIZE(profiles); i++) {
		struct hybrid_profile profile = profiles[i];

		memcpy(ml_dsa_signature_copy, profile.ml_dsa.signature,
		       profile.ml_dsa.signature_length);
		ml_dsa_signature_copy[0] ^= 1;
		profile.ml_dsa.signature = ml_dsa_signature_copy;

		zassert_equal(verify_profile(&profile), PSA_ERROR_INVALID_SIGNATURE,
			      "%s: invalid ML-DSA signature was accepted", profile.name);
	}
}

ZTEST(hybrid_verify, test_invalid_ecdsa_signature)
{
	for (size_t i = 0; i < ARRAY_SIZE(profiles); i++) {
		struct hybrid_profile profile = profiles[i];

		memcpy(ecdsa_signature_copy, profile.ecdsa.signature,
		       profile.ecdsa.signature_length);
		ecdsa_signature_copy[0] ^= 1;
		profile.ecdsa.signature = ecdsa_signature_copy;

		zassert_equal(verify_profile(&profile), PSA_ERROR_INVALID_SIGNATURE,
			      "%s: invalid ECDSA signature was accepted", profile.name);
	}
}

ZTEST(hybrid_verify, test_both_signatures_invalid)
{
	struct hybrid_profile profile = profiles[1];

	memcpy(ml_dsa_signature_copy, profile.ml_dsa.signature, profile.ml_dsa.signature_length);
	memcpy(ecdsa_signature_copy, profile.ecdsa.signature, profile.ecdsa.signature_length);
	ml_dsa_signature_copy[0] ^= 1;
	ecdsa_signature_copy[0] ^= 1;
	profile.ml_dsa.signature = ml_dsa_signature_copy;
	profile.ecdsa.signature = ecdsa_signature_copy;

	zassert_equal(verify_profile(&profile), PSA_ERROR_INVALID_SIGNATURE,
		      "invalid signatures were accepted");
}

/* The components must cover the same message, so an ECDSA signature over
 * another message must not be accepted just because the ML-DSA component is
 * valid.
 */
ZTEST(hybrid_verify, test_ecdsa_signature_over_other_message)
{
	struct hybrid_profile profile = profiles[2];

	profile.ecdsa = profiles[1].ecdsa;

	zassert_equal(verify_profile(&profile), PSA_ERROR_INVALID_SIGNATURE,
		      "ECDSA signature over another message was accepted");
}

ZTEST(hybrid_verify, test_bad_ecdsa_inputs)
{
	struct hybrid_profile profile = profiles[1];

	profile.ecdsa.signature_length--;
	zassert_equal(verify_profile(&profile), PSA_ERROR_INVALID_ARGUMENT,
		      "bad ECDSA signature length was accepted");

	/* Public key without the uncompressed-format prefix. */
	profile = profiles[1];
	profile.ecdsa.public_key++;
	profile.ecdsa.public_key_length--;
	zassert_equal(verify_profile(&profile), PSA_ERROR_INVALID_ARGUMENT,
		      "ECDSA public key without 0x04 prefix was accepted");

	/* Curve size that does not match the public key. */
	profile = profiles[1];
	profile.ecdsa.key_bits = 256;
	zassert_equal(verify_profile(&profile), PSA_ERROR_INVALID_ARGUMENT,
		      "mismatched ECDSA curve size was accepted");

	/* Algorithm that is not ECDSA. */
	profile = profiles[1];
	profile.ecdsa.alg = PSA_ALG_SHA_384;
	zassert_equal(verify_profile(&profile), PSA_ERROR_INVALID_ARGUMENT,
		      "non-ECDSA algorithm was accepted");
}

ZTEST(hybrid_verify, test_bad_ml_dsa_inputs)
{
	struct hybrid_profile profile = profiles[1];

	profile.ml_dsa.signature_length--;
	zassert_equal(verify_profile(&profile), PSA_ERROR_INVALID_ARGUMENT,
		      "bad ML-DSA signature length was accepted");

	/* Parameter set that does not match the key and signature lengths. */
	profile = profiles[1];
	profile.ml_dsa.key_bits = 256;
	zassert_equal(verify_profile(&profile), PSA_ERROR_INVALID_ARGUMENT,
		      "mismatched ML-DSA parameter set was accepted");

	/* Parameter set that does not exist. */
	profile = profiles[1];
	profile.ml_dsa.key_bits = 512;
	zassert_equal(verify_profile(&profile), PSA_ERROR_NOT_SUPPORTED,
		      "unknown ML-DSA parameter set was accepted");
}

ZTEST(hybrid_verify, test_missing_arguments)
{
	struct hybrid_profile profile = profiles[1];

	zassert_equal(cracen_hybrid_verify(&profile.ml_dsa, &profile.ecdsa, NULL,
					   profile.message_length),
		      PSA_ERROR_INVALID_ARGUMENT, "missing message was accepted");

	zassert_equal(cracen_hybrid_verify(NULL, &profile.ecdsa, profile.message,
					   profile.message_length),
		      PSA_ERROR_INVALID_ARGUMENT, "missing ML-DSA component was accepted");

	zassert_equal(cracen_hybrid_verify(&profile.ml_dsa, NULL, profile.message,
					   profile.message_length),
		      PSA_ERROR_INVALID_ARGUMENT, "missing ECDSA component was accepted");
}

/* A failing ECDSA verification must leave the PKE available for the next one. */
ZTEST(hybrid_verify, test_pke_released_after_failure)
{
	struct hybrid_profile invalid = profiles[1];

	memcpy(ecdsa_signature_copy, invalid.ecdsa.signature, invalid.ecdsa.signature_length);
	ecdsa_signature_copy[0] ^= 1;
	invalid.ecdsa.signature = ecdsa_signature_copy;

	for (size_t i = 0; i < 2; i++) {
		zassert_equal(verify_profile(&invalid), PSA_ERROR_INVALID_SIGNATURE,
			      "invalid iteration %zu returned wrong result", i);
		zassert_equal(verify_profile(&profiles[1]), PSA_SUCCESS,
			      "valid iteration %zu failed after PKE error", i);
	}
}

#if defined(PSA_WANT_ALG_ML_DSA)
static void benchmark_profile(const struct hybrid_profile *profile)
{
	uint64_t ecdsa_cycles = 0;
	uint64_t ml_dsa_cycles = 0;
	uint64_t sequential_cycles = 0;
	uint64_t hybrid_cycles = 0;
	uint64_t sequential_average;
	uint64_t hybrid_average;
	uint64_t reduction_hundredths = 0;
	size_t unused_stack;
	psa_status_t psa_status;
	int sx_status;

	for (size_t i = 0; i < BENCHMARK_ITERATIONS; i++) {
		uint64_t start = k_cycle_get_64();

		sx_status = cracen_ecdsa_verify_message(profile->ecdsa.public_key + 1,
						       profile->hashalg, profile->message,
						       profile->message_length, profile->curve,
						       profile->ecdsa.signature);
		ecdsa_cycles += k_cycle_get_64() - start;
		zassert_equal(sx_status, SX_OK, "ECDSA component failed: %d", sx_status);

		start = k_cycle_get_64();
		psa_status = psa_verify_message(profile->ml_dsa_key_id, profile->ml_dsa.alg,
						profile->message, profile->message_length,
						profile->ml_dsa.signature,
						profile->ml_dsa.signature_length);
		ml_dsa_cycles += k_cycle_get_64() - start;
		zassert_equal(psa_status, PSA_SUCCESS, "ML-DSA component failed: %d", psa_status);

		start = k_cycle_get_64();
		sx_status = cracen_ecdsa_verify_message(profile->ecdsa.public_key + 1,
						       profile->hashalg, profile->message,
						       profile->message_length, profile->curve,
						       profile->ecdsa.signature);
		psa_status = psa_verify_message(profile->ml_dsa_key_id, profile->ml_dsa.alg,
						profile->message, profile->message_length,
						profile->ml_dsa.signature,
						profile->ml_dsa.signature_length);
		sequential_cycles += k_cycle_get_64() - start;
		zassert_equal(sx_status, SX_OK, "sequential ECDSA failed: %d", sx_status);
		zassert_equal(psa_status, PSA_SUCCESS, "sequential ML-DSA failed: %d", psa_status);

		start = k_cycle_get_64();
		zassert_equal(verify_profile(profile), PSA_SUCCESS,
			      "hybrid verification failed");
		hybrid_cycles += k_cycle_get_64() - start;
	}

	sequential_average = sequential_cycles / BENCHMARK_ITERATIONS;
	hybrid_average = hybrid_cycles / BENCHMARK_ITERATIONS;
	if (sequential_average > hybrid_average) {
		reduction_hundredths =
			(sequential_average - hybrid_average) * 10000 / sequential_average;
	}

	printk("hybrid_verify %s: ecdsa_avg_us=%llu ml_dsa_avg_us=%llu\n", profile->name,
	       (unsigned long long)k_cyc_to_us_floor64(ecdsa_cycles / BENCHMARK_ITERATIONS),
	       (unsigned long long)k_cyc_to_us_floor64(ml_dsa_cycles / BENCHMARK_ITERATIONS));
	printk("hybrid_verify %s: sequential_avg_us=%llu hybrid_avg_us=%llu reduction=%llu.%02llu%%"
	       " iterations=%d\n", profile->name,
	       (unsigned long long)k_cyc_to_us_floor64(sequential_average),
	       (unsigned long long)k_cyc_to_us_floor64(hybrid_average),
	       (unsigned long long)(reduction_hundredths / 100),
	       (unsigned long long)(reduction_hundredths % 100), BENCHMARK_ITERATIONS);

	if (k_thread_stack_space_get(k_current_get(), &unused_stack) == 0) {
		printk("hybrid_verify %s: unused_test_stack_bytes=%zu\n", profile->name,
		       unused_stack);
	}
}

ZTEST(hybrid_verify, test_benchmark)
{
	for (size_t i = 0; i < ARRAY_SIZE(profiles); i++) {
		benchmark_profile(&profiles[i]);
	}
}
#else

ZTEST(hybrid_verify, test_ml_dsa_not_in_psa)
{
	psa_key_attributes_t attributes = PSA_KEY_ATTRIBUTES_INIT;
	psa_key_id_t key_id = PSA_KEY_ID_NULL;
	psa_status_t status;

	psa_set_key_type(&attributes, PSA_KEY_TYPE_ML_DSA_PUBLIC_KEY);
	psa_set_key_usage_flags(&attributes, PSA_KEY_USAGE_VERIFY_MESSAGE);
	psa_set_key_algorithm(&attributes, PSA_ALG_ML_DSA);

	status = psa_import_key(&attributes, ml_dsa44_kat_pk, sizeof(ml_dsa44_kat_pk), &key_id);
	if (status == PSA_SUCCESS) {
		(void)psa_destroy_key(key_id);
	}

	zassert_equal(status, PSA_ERROR_NOT_SUPPORTED,
		      "ML-DSA public-key import returned %d", status);
}
#endif /* PSA_WANT_ALG_ML_DSA */
```

## src/ecdsa_vectors.h
```c
/*
 * Copyright (c) 2026 Nordic Semiconductor ASA
 *
 * SPDX-License-Identifier: LicenseRef-Nordic-5-Clause
 */

/*
 * ECDSA test vectors for the hybrid verification profiles. Every signature
 * covers the message of the ML-DSA known-answer test it is paired with, so
 * that both components of a profile verify the same message. All of them use
 * the private scalar d = 2, which is irrelevant to verification.
 *
 * Generated with python-cryptography.
 */

#ifndef ECDSA_VECTORS_H
#define ECDSA_VECTORS_H

#include <stdint.h>

/* SECP256R1 public key for d = 2, uncompressed */
static const uint8_t ecdsa_p256_sha256_pub[] = {
	0x04, 0x7c, 0xf2, 0x7b, 0x18, 0x8d, 0x03, 0x4f, 0x7e, 0x8a, 0x52, 0x38,
	0x03, 0x04, 0xb5, 0x1a, 0xc3, 0xc0, 0x89, 0x69, 0xe2, 0x77, 0xf2, 0x1b,
	0x35, 0xa6, 0x0b, 0x48, 0xfc, 0x47, 0x66, 0x99, 0x78, 0x07, 0x77, 0x55,
	0x10, 0xdb, 0x8e, 0xd0, 0x40, 0x29, 0x3d, 0x9a, 0xc6, 0x9f, 0x74, 0x30,
	0xdb, 0xba, 0x7d, 0xad, 0xe6, 0x3c, 0xe9, 0x82, 0x29, 0x9e, 0x04, 0xb7,
	0x9d, 0x22, 0x78, 0x73, 0xd1,
};

/* SECP256R1/SHA256 signature over ml_dsa44_kat_msg */
static const uint8_t ecdsa_p256_sha256_sig[] = {
	0x1b, 0x59, 0x86, 0x35, 0xc2, 0x0f, 0xbc, 0x79, 0x36, 0x23, 0x3d, 0x40,
	0x42, 0x2a, 0x0b, 0xab, 0xc7, 0x3b, 0x20, 0xe0, 0x4f, 0x47, 0x32, 0x7f,
	0xf7, 0xcb, 0x08, 0xe5, 0xb8, 0xa2, 0x94, 0xbf, 0x19, 0xfc, 0x19, 0xc4,
	0x14, 0xbd, 0x63, 0x7d, 0x84, 0x13, 0x28, 0xf1, 0xb1, 0x31, 0xcf, 0x69,
	0x2f, 0xc7, 0x75, 0x68, 0x05, 0xd5, 0xc4, 0x47, 0x4f, 0x09, 0xc6, 0x05,
	0x02, 0xcf, 0x2e, 0x69,
};

/* SECP384R1 public key for d = 2, uncompressed */
static const uint8_t ecdsa_p384_sha384_pub[] = {
	0x04, 0x08, 0xd9, 0x99, 0x05, 0x7b, 0xa3, 0xd2, 0xd9, 0x69, 0x26, 0x00,
	0x45, 0xc5, 0x5b, 0x97, 0xf0, 0x89, 0x02, 0x59, 0x59, 0xa6, 0xf4, 0x34,
	0xd6, 0x51, 0xd2, 0x07, 0xd1, 0x9f, 0xb9, 0x6e, 0x9e, 0x4f, 0xe0, 0xe8,
	0x6e, 0xbe, 0x0e, 0x64, 0xf8, 0x5b, 0x96, 0xa9, 0xc7, 0x52, 0x95, 0xdf,
	0x61, 0x8e, 0x80, 0xf1, 0xfa, 0x5b, 0x1b, 0x3c, 0xed, 0xb7, 0xbf, 0xe8,
	0xdf, 0xfd, 0x6d, 0xba, 0x74, 0xb2, 0x75, 0xd8, 0x75, 0xbc, 0x6c, 0xc4,
	0x3e, 0x90, 0x4e, 0x50, 0x5f, 0x25, 0x6a, 0xb4, 0x25, 0x5f, 0xfd, 0x43,
	0xe9, 0x4d, 0x39, 0xe2, 0x2d, 0x61, 0x50, 0x1e, 0x70, 0x0a, 0x94, 0x0e,
	0x80,
};

/* SECP384R1/SHA384 signature over ml_dsa_kat_msg */
static const uint8_t ecdsa_p384_sha384_sig[] = {
	0x9c, 0x9a, 0x5e, 0x59, 0x57, 0x34, 0x20, 0x00, 0x7e, 0x8b, 0x65, 0x1f,
	0x7e, 0x62, 0xda, 0x5e, 0x0b, 0xcf, 0xee, 0xca, 0x34, 0x74, 0xcd, 0x58,
	0x7c, 0xb5, 0xc7, 0xea, 0x4e, 0x04, 0xba, 0x1f, 0x55, 0xec, 0xb6, 0x06,
	0x86, 0xcc, 0xde, 0xff, 0x91, 0x61, 0xd6, 0x5a, 0x75, 0xb2, 0xe1, 0x25,
	0x1e, 0x39, 0x46, 0x22, 0x2f, 0x18, 0x7d, 0x26, 0x73, 0xdc, 0xcc, 0x64,
	0x62, 0x6a, 0x7c, 0xde, 0x69, 0x7b, 0xc8, 0x19, 0x61, 0x91, 0x9c, 0xfc,
	0xb5, 0x39, 0x26, 0x01, 0x59, 0x94, 0x2b, 0x85, 0xe2, 0x37, 0x5d, 0xc0,
	0x0d, 0x6e, 0xe3, 0xb8, 0x71, 0x18, 0xeb, 0xdf, 0xc3, 0x9d, 0xc5, 0x5f,
};

/* SECP384R1 public key for d = 2, uncompressed */
static const uint8_t ecdsa_p384_sha256_pub[] = {
	0x04, 0x08, 0xd9, 0x99, 0x05, 0x7b, 0xa3, 0xd2, 0xd9, 0x69, 0x26, 0x00,
	0x45, 0xc5, 0x5b, 0x97, 0xf0, 0x89, 0x02, 0x59, 0x59, 0xa6, 0xf4, 0x34,
	0xd6, 0x51, 0xd2, 0x07, 0xd1, 0x9f, 0xb9, 0x6e, 0x9e, 0x4f, 0xe0, 0xe8,
	0x6e, 0xbe, 0x0e, 0x64, 0xf8, 0x5b, 0x96, 0xa9, 0xc7, 0x52, 0x95, 0xdf,
	0x61, 0x8e, 0x80, 0xf1, 0xfa, 0x5b, 0x1b, 0x3c, 0xed, 0xb7, 0xbf, 0xe8,
	0xdf, 0xfd, 0x6d, 0xba, 0x74, 0xb2, 0x75, 0xd8, 0x75, 0xbc, 0x6c, 0xc4,
	0x3e, 0x90, 0x4e, 0x50, 0x5f, 0x25, 0x6a, 0xb4, 0x25, 0x5f, 0xfd, 0x43,
	0xe9, 0x4d, 0x39, 0xe2, 0x2d, 0x61, 0x50, 0x1e, 0x70, 0x0a, 0x94, 0x0e,
	0x80,
};

/* SECP384R1/SHA256 signature over ml_dsa87_kat_msg */
static const uint8_t ecdsa_p384_sha256_sig[] = {
	0xe4, 0x75, 0xb4, 0x4c, 0x34, 0xe1, 0x1d, 0xdd, 0x47, 0x0d, 0x56, 0x82,
	0x07, 0x68, 0x6d, 0xef, 0x25, 0xcd, 0x63, 0x1e, 0xdb, 0x07, 0xfb, 0xa9,
	0xc2, 0x56, 0x16, 0x7c, 0x2c, 0x6d, 0x68, 0x4b, 0xe3, 0xd0, 0x30, 0xf4,
	0xc0, 0x28, 0xb6, 0x03, 0x68, 0x4e, 0x14, 0xd6, 0x9b, 0xff, 0x8e, 0x36,
	0xe0, 0xb5, 0x65, 0xff, 0x63, 0x22, 0xf8, 0x16, 0xe2, 0x21, 0xff, 0xdf,
	0xc3, 0x86, 0x1c, 0xe6, 0x2d, 0xf3, 0x20, 0x38, 0x29, 0xd3, 0xbb, 0x35,
	0xec, 0xb3, 0xd1, 0x6d, 0x0e, 0x9e, 0x89, 0x33, 0x29, 0x15, 0x00, 0x15,
	0x84, 0xe0, 0x99, 0x41, 0xdb, 0x88, 0x13, 0x4d, 0x2b, 0xa6, 0x7e, 0x8b,
};

/* SECP256R1 public key for d = 2, uncompressed */
static const uint8_t ecdsa_p256_sha512_pub[] = {
	0x04, 0x7c, 0xf2, 0x7b, 0x18, 0x8d, 0x03, 0x4f, 0x7e, 0x8a, 0x52, 0x38,
	0x03, 0x04, 0xb5, 0x1a, 0xc3, 0xc0, 0x89, 0x69, 0xe2, 0x77, 0xf2, 0x1b,
	0x35, 0xa6, 0x0b, 0x48, 0xfc, 0x47, 0x66, 0x99, 0x78, 0x07, 0x77, 0x55,
	0x10, 0xdb, 0x8e, 0xd0, 0x40, 0x29, 0x3d, 0x9a, 0xc6, 0x9f, 0x74, 0x30,
	0xdb, 0xba, 0x7d, 0xad, 0xe6, 0x3c, 0xe9, 0x82, 0x29, 0x9e, 0x04, 0xb7,
	0x9d, 0x22, 0x78, 0x73, 0xd1,
};

/* SECP256R1/SHA512 signature over ml_dsa_kat_msg */
static const uint8_t ecdsa_p256_sha512_sig[] = {
	0x4d, 0x41, 0x3a, 0x25, 0x48, 0x09, 0x74, 0x66, 0xbf, 0x1d, 0xf5, 0xf4,
	0xdc, 0xab, 0x44, 0x8d, 0x4d, 0xd6, 0x46, 0x20, 0x07, 0xbf, 0xb9, 0x51,
	0xc3, 0xda, 0xc3, 0xc2, 0x4f, 0x5f, 0x9f, 0xf3, 0xfb, 0xa0, 0xc9, 0xd8,
	0xb0, 0x6a, 0x58, 0x2f, 0xe0, 0xb3, 0xb9, 0x8a, 0xd1, 0x67, 0x59, 0xb1,
	0x74, 0x94, 0xa5, 0x9e, 0x35, 0x7d, 0x6e, 0x3b, 0x94, 0x8b, 0xdf, 0xe7,
	0x13, 0x27, 0x65, 0x03,
};

#endif /* ECDSA_VECTORS_H */
```
