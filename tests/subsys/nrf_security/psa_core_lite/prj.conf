## CMakeLists.txt
```
#
# Copyright (c) 2025 Nordic Semiconductor ASA
#
# SPDX-License-Identifier: LicenseRef-Nordic-5-Clause
#

cmake_minimum_required(VERSION 3.20.0)

find_package(Zephyr REQUIRED HINTS $ENV{ZEPHYR_BASE})
project("PSA core lite unit tests")

# Add test sources
if(CONFIG_PSA_CORE_LITE_HAS_RSA)
  target_sources(app PRIVATE src/main_rsa.c)
elseif(CONFIG_PSA_NEED_CRACEN_KMU_DRIVER)
  target_sources(app PRIVATE src/main_kmu.c)
endif()

# Hashing is not dependent on keys
if(CONFIG_PSA_CORE_LITE_HAS_HASH OR CONFIG_PSA_CRYPTO_DRIVER_OBERON)
  target_sources(app PRIVATE src/hash.c)
endif()
```

## prj.conf
```kconfig
#
# Copyright (c) 2025 Nordic Semiconductor ASA
#
# SPDX-License-Identifier: LicenseRef-Nordic-5-Clause
#
CONFIG_ZTEST=y

# The Zephyr CMSIS emulation assumes that ticks are ms, currently
CONFIG_SYS_CLOCK_TICKS_PER_SEC=1000

CONFIG_MAIN_STACK_SIZE=16384
CONFIG_HEAP_MEM_POOL_SIZE=8192

# Enable logging
CONFIG_CONSOLE=y
CONFIG_LOG=y

CONFIG_PSA_CRYPTO=y

# Only relevant for Oberon PSA Crypto
CONFIG_MBEDTLS_PSA_STATIC_KEY_SLOTS=y

# Enable PSA core lite for these unit-tests
CONFIG_PSA_CORE_LITE=y
```

## ecdh_hkdf.conf
```kconfig
#
# Copyright (c) 2026 Nordic Semiconductor ASA
#
# SPDX-License-Identifier: LicenseRef-Nordic-5-Clause
#
CONFIG_PSA_WANT_ALG_ECDH=y
CONFIG_PSA_WANT_ALG_HKDF=y
CONFIG_PSA_WANT_ALG_HMAC=y
CONFIG_PSA_WANT_ALG_SHA_512=y
CONFIG_PSA_WANT_KEY_TYPE_DERIVE=y
CONFIG_PSA_WANT_ECC_MONTGOMERY_255=y
```

## key_wrap.conf
```kconfig
#
# Copyright (c) 2026 Nordic Semiconductor ASA
#
# SPDX-License-Identifier: LicenseRef-Nordic-5-Clause
#
CONFIG_PSA_WANT_ALG_ECB_NO_PADDING=y
CONFIG_PSA_WANT_ALG_AES_KW=y
```

## mac.conf
```kconfig
#
# Copyright (c) 2026 Nordic Semiconductor ASA
#
# SPDX-License-Identifier: LicenseRef-Nordic-5-Clause
#
CONFIG_PSA_WANT_ALG_HMAC=y
CONFIG_PSA_WANT_ALG_SHA_512=y
```

## rsa.conf
```kconfig
#
# Copyright (c) 2026 Nordic Semiconductor ASA
#
# SPDX-License-Identifier: LicenseRef-Nordic-5-Clause
#
CONFIG_PSA_WANT_ALG_RSA_PKCS1V15_SIGN=y
CONFIG_PSA_WANT_ALG_RSA_PSS=y
CONFIG_PSA_WANT_KEY_TYPE_RSA_PUBLIC_KEY=y
CONFIG_PSA_WANT_RSA_KEY_SIZE_2048=y
CONFIG_PSA_WANT_RSA_KEY_SIZE_3072=y
CONFIG_PSA_WANT_ALG_SHA_256=y
CONFIG_PSA_WANT_ALG_SHA_384=y
```

## rsa_decrypt.conf
```kconfig
#
# Copyright (c) 2026 Nordic Semiconductor ASA
#
# SPDX-License-Identifier: LicenseRef-Nordic-5-Clause
#
CONFIG_PSA_WANT_ALG_RSA_OAEP=y
CONFIG_PSA_WANT_ALG_RSA_PKCS1V15_SIGN=y
CONFIG_PSA_WANT_ALG_RSA_PSS=y
CONFIG_PSA_WANT_KEY_TYPE_RSA_KEY_PAIR_IMPORT=y
CONFIG_PSA_WANT_KEY_TYPE_RSA_PUBLIC_KEY=y
CONFIG_PSA_WANT_RSA_KEY_SIZE_2048=y
CONFIG_PSA_WANT_RSA_KEY_SIZE_3072=y
CONFIG_PSA_WANT_ALG_SHA_256=y
```

## boards/nrf54lm20dk_nrf54lm20a_cpuapp.conf
```kconfig
#
# Copyright (c) 2025 Nordic Semiconductor ASA
#
# SPDX-License-Identifier: LicenseRef-Nordic-5-Clause
#
CONFIG_PSA_CRYPTO_DRIVER_OBERON=n
CONFIG_PSA_CRYPTO_DRIVER_CRACEN=y
```

## src/hash.c
```c
/*
 * Copyright (c) 2025 Nordic Semiconductor ASA
 *
 * SPDX-License-Identifier: LicenseRef-Nordic-5-Clause
 */
#include <zephyr/kernel.h>
#include <zephyr/ztest.h>
#include <psa/crypto.h>
#include <string.h>
#include <util/util_macro.h>
#include <nrf_security_mem_helpers.h>

#define SHA256_HASH_SIZE	(32)
#define SHA384_HASH_SIZE	(48)
#define SHA512_HASH_SIZE	(64)

#ifndef ARRAY_SIZE
#define ARRAY_SIZE(x) (sizeof(x) / sizeof((x)[0]))
#endif


/* Test string without null-termination (6 octets)*/
static uint8_t ecdsa_secp256r1_msg[6] = "sample";

/* SHA-256 hash of the string "sample" (6 octets)*/
static uint8_t ecdsa_secp256r1_hash[SHA256_HASH_SIZE] = {
	0xaf, 0x2b, 0xdb, 0xe1, 0xaa, 0x9b, 0x6e, 0xc1, 0xe2, 0xad, 0xe1, 0xd6,
	0x94, 0xf4, 0x1f, 0xc7, 0x1a, 0x83, 0x1d, 0x02, 0x68, 0xe9, 0x89, 0x15,
	0x62, 0x11, 0x3d, 0x8a, 0x62, 0xad, 0xd1, 0xbf
};

/* Test string without null-termination (6 octets)*/
static uint8_t ecdsa_secp384r1_msg[6] = "sample";

/* SHA-384 hash of the string "sample" (6 octets)*/
static uint8_t ecdsa_secp384r1_hash[SHA384_HASH_SIZE] = {
	0x9a, 0x90, 0x83, 0x50, 0x5b, 0xc9, 0x22, 0x76, 0xae, 0xc4, 0xbe, 0x31,
	0x26, 0x96, 0xef, 0x7b, 0xf3, 0xbf, 0x60, 0x3f, 0x4b, 0xbd, 0x38, 0x11,
	0x96, 0xa0, 0x29, 0xf3, 0x40, 0x58, 0x53, 0x12, 0x31, 0x3b, 0xca, 0x4a,
	0x9b, 0x5b, 0x89, 0x0e, 0xfe, 0xe4, 0x2c, 0x77, 0xb1, 0xee, 0x25, 0xfe
};

/* Ed25518ph test message (used only by hash test) */
static uint8_t ed25519ph_msg[3] = {
	0x61, 0x62, 0x63
};

/* SHA-512 Hash of message '0x61, 0x62, 0x63' (hex input, 3 octets)*/
static uint8_t ed25519ph_hash[SHA512_HASH_SIZE] = {
	0xdd, 0xaf, 0x35, 0xa1, 0x93, 0x61, 0x7a, 0xba, 0xcc, 0x41, 0x73, 0x49,
	0xae, 0x20, 0x41, 0x31, 0x12, 0xe6, 0xfa, 0x4e, 0x89, 0xa9, 0x7e, 0xa2,
	0x0a, 0x9e, 0xee, 0xe6, 0x4b, 0x55, 0xd3, 0x9a, 0x21, 0x92, 0x99, 0x2a,
	0x27, 0x4f, 0xc1, 0xa8, 0x36, 0xba, 0x3c, 0x23, 0xa3, 0xfe, 0xeb, 0xbd,
	0x45, 0x4d, 0x44, 0x23, 0x64, 0x3c, 0xe8, 0x0e, 0x2a, 0x9a, 0xc9, 0x4f,
	0xa5, 0x4c, 0xa4, 0x9f
};

static void test_hash_compute(psa_algorithm_t alg, const uint8_t *input, size_t input_length,
			      uint8_t *hash, size_t hash_size)
{
	psa_status_t err;
	size_t hash_length;
	uint8_t calculated_hash[SHA512_HASH_SIZE];

	err = psa_hash_compute(alg, input, input_length, calculated_hash, hash_size, &hash_length);
	zassert_equal(err, PSA_SUCCESS, "Failed to hash Alg: %d, Err: %d", alg, err);
	zassert_equal(hash_size, hash_length, "Hash size mismatch. Got %d, expected %d",
		      hash_length, hash_size);

	if (constant_memcmp(calculated_hash, hash, hash_size) != 0) {
		zassert_false(true, "Hash calculate mismatched results");
	}
}

static void test_hash_incremental(psa_algorithm_t alg, const uint8_t *input, size_t input_length,
				  uint8_t *hash, size_t hash_size)
{
	psa_status_t err;
	size_t hash_length;
	uint8_t calculated_hash[SHA512_HASH_SIZE];
	psa_hash_operation_t operation = PSA_HASH_OPERATION_INIT;

	err = psa_hash_setup(&operation, alg);
	zassert_equal(err, PSA_SUCCESS, "Failed to setup hash Alg: %d, Err: %d", alg, err);

	err = psa_hash_update(&operation, input, input_length);
	zassert_equal(err, PSA_SUCCESS, "Failed to update hash Alg: %d, Err: %d", alg, err);

	err = psa_hash_finish(&operation, calculated_hash, hash_size, &hash_length);
	zassert_equal(err, PSA_SUCCESS, "Failed to finish hash Alg: %d, Err: %d", alg, err);

	err = psa_hash_abort(&operation);
	zassert_equal(err, PSA_SUCCESS, "Failed to abort hash Alg: %d, Err: %d", alg, err);

	zassert_equal(hash_size, hash_length, "Hash size mismatch. Got %d, expected %d",
		      hash_length, hash_size);

	if (constant_memcmp(calculated_hash, hash, hash_size) != 0) {
		zassert_false(true, "Hash incremental mismathed results");
	}
}


void test_hash(void)
{
	bool ran_hash = false;

	if (IS_ENABLED(PSA_WANT_ALG_SHA_256)) {
		psa_algorithm_t alg = PSA_ALG_SHA_256;

		test_hash_compute(alg, ecdsa_secp256r1_msg, ARRAY_SIZE(ecdsa_secp256r1_msg),
				  ecdsa_secp256r1_hash, SHA256_HASH_SIZE);


		test_hash_incremental(alg, ecdsa_secp256r1_msg, ARRAY_SIZE(ecdsa_secp256r1_msg),
				  ecdsa_secp256r1_hash, SHA256_HASH_SIZE);

		ran_hash = true;
	}

	if (IS_ENABLED(PSA_WANT_ALG_SHA_384)) {
		psa_algorithm_t alg = PSA_ALG_SHA_384;

		test_hash_compute(alg, ecdsa_secp384r1_msg, ARRAY_SIZE(ecdsa_secp384r1_msg),
				  ecdsa_secp384r1_hash, SHA384_HASH_SIZE);


		test_hash_incremental(alg, ecdsa_secp384r1_msg, ARRAY_SIZE(ecdsa_secp384r1_msg),
				  ecdsa_secp384r1_hash, SHA384_HASH_SIZE);

		ran_hash = true;
	}

	if (IS_ENABLED(PSA_WANT_ALG_SHA_512)) {
		psa_algorithm_t alg = PSA_ALG_SHA_512;

		test_hash_compute(alg, ed25519ph_msg, ARRAY_SIZE(ed25519ph_msg),
				  ed25519ph_hash, SHA512_HASH_SIZE);

		test_hash_incremental(alg, ed25519ph_msg, ARRAY_SIZE(ed25519ph_msg),
				  ed25519ph_hash, SHA512_HASH_SIZE);

		ran_hash = true;
	}

	zassert_true(ran_hash, "Did not run any hash calculation, check configs!");
}
```

## src/main_rsa.c
```c
/*
 * Copyright (c) 2025 Nordic Semiconductor ASA
 *
 * SPDX-License-Identifier: LicenseRef-Nordic-5-Clause
 */
#include <zephyr/kernel.h>
#include <zephyr/ztest.h>
#include <psa/crypto.h>
#include <string.h>
#include <util/util_macro.h>
#include <nrf_security_mem_helpers.h>

#include "vectors_rsa.h"

extern void test_hash(void);

/* RSA verification */
static void init_rsa_key(psa_key_attributes_t *attributes, psa_key_type_t key_type,
			 psa_algorithm_t alg, psa_key_usage_t usage, size_t key_size_bits)
{
	psa_set_key_usage_flags(attributes, usage);
	psa_set_key_lifetime(attributes, PSA_KEY_LIFETIME_VOLATILE);
	psa_set_key_algorithm(attributes, alg);
	psa_set_key_type(attributes, key_type);
	psa_set_key_bits(attributes, key_size_bits);
}

static void test_rsa_verify_message(psa_key_attributes_t *attributes,
				    const uint8_t *pub_key, size_t pub_key_size,
				    const uint8_t *message, size_t message_size,
				    psa_algorithm_t alg, const char *key_label,
				    const uint8_t *signature, size_t signature_size)
{
	psa_status_t err;
	mbedtls_svc_key_id_t key_id = MBEDTLS_SVC_KEY_ID_INIT;

	err = psa_import_key(attributes, pub_key, pub_key_size, &key_id);
	zassert_equal(err, PSA_SUCCESS,
		      "Failed to import key for '%s'. Err: %d", key_label, err);

	err = psa_verify_message(key_id, alg, message, message_size, signature, signature_size);
	zassert_equal(err, PSA_SUCCESS,
		      "Failed to verify for '%s'. Err: %d",
		      key_label, err);

	err = psa_destroy_key(key_id);
	zassert_equal(err, PSA_SUCCESS,
		      "Failed to destroy key for '%s'. Err: %d",
		      key_label, err);
}

static void test_rsa_verify_hash(psa_key_attributes_t *attributes,
				 const uint8_t *pub_key, size_t pub_key_size,
				 const uint8_t *digest, size_t digest_size,
				 psa_algorithm_t alg, const char *key_label,
				 const uint8_t *signature, size_t signature_size)
{
	psa_status_t err;
	mbedtls_svc_key_id_t key_id = MBEDTLS_SVC_KEY_ID_INIT;

	err = psa_import_key(attributes, pub_key, pub_key_size, &key_id);
	zassert_equal(err, PSA_SUCCESS,
		      "Failed to import key for '%s'. Err: %d", key_label, err);

	err = psa_verify_hash(key_id, alg, digest, digest_size, signature, signature_size);
	zassert_equal(err, PSA_SUCCESS,
		      "Failed to verify for '%s'. Err: %d",
		      key_label, err);

	err = psa_destroy_key(key_id);
	zassert_equal(err, PSA_SUCCESS,
		      "Failed to destroy key for '%s' key. Err: %d",
		      key_label, err);
}

/* RSA PSS tests */

/**
 * @brief Function to test RSA PSS verify hash with 2048 bit key
 */
static void test_rsa_pss_2048_verify_message(void)
{
	psa_key_attributes_t attributes = {0};
	psa_algorithm_t alg = PSA_ALG_RSA_PSS(PSA_ALG_SHA_256);
	static const char key_label[] = "RSA PSS 2048 (verify message)";

	init_rsa_key(&attributes, PSA_KEY_TYPE_RSA_PUBLIC_KEY, alg, PSA_KEY_USAGE_VERIFY_MESSAGE,
		     RSA_2048_KEY_BIT_SIZE);

	test_rsa_verify_message(&attributes,
				rsa_pss_2048_pubkey, sizeof(rsa_pss_2048_pubkey),
				rsa_pss_2048_msg, sizeof(rsa_pss_2048_msg),
				alg, key_label,
				rsa_pss_2048_signature, sizeof(rsa_pss_2048_signature));
}

/**
 * @brief Function to test RSA PSS verify hash with 2048 bit key
 */
static void test_rsa_pss_2048_verify_hash(void)
{
	psa_key_attributes_t attributes = {0};
	psa_algorithm_t alg = PSA_ALG_RSA_PSS(PSA_ALG_SHA_256);
	static const char key_label[] = "RSA PSS 2048 (verify hash)";

	init_rsa_key(&attributes, PSA_KEY_TYPE_RSA_PUBLIC_KEY, alg, PSA_KEY_USAGE_VERIFY_HASH,
		     RSA_2048_KEY_BIT_SIZE);

	test_rsa_verify_hash(&attributes,
			     rsa_pss_2048_pubkey, sizeof(rsa_pss_2048_pubkey),
			     rsa_pss_2048_hash, sizeof(rsa_pss_2048_hash),
			     alg, key_label,
			     rsa_pss_2048_signature, sizeof(rsa_pss_2048_signature));
}

/* RSA PKCS#1 v1.5 tests */

/**
 * @brief Function to test RSA PKCS#1 v1.5 verify hash with 2048 bit key
 */
static void test_rsa_pkcs1v15_2048_verify_message(void)
{
	psa_key_attributes_t attributes = {0};
	psa_algorithm_t alg = PSA_ALG_RSA_PKCS1V15_SIGN(PSA_ALG_SHA_256);
	static const uint8_t key_label[] = "RSA PKCS#1 v1.5 2048 (verify message)";

	init_rsa_key(&attributes, PSA_KEY_TYPE_RSA_PUBLIC_KEY, alg, PSA_KEY_USAGE_VERIFY_MESSAGE,
		     RSA_2048_KEY_BIT_SIZE);

	test_rsa_verify_message(&attributes,
				rsa_pkcs1v15_2048_pubkey, sizeof(rsa_pkcs1v15_2048_pubkey),
				rsa_pkcs1v15_2048_msg, sizeof(rsa_pkcs1v15_2048_msg),
				alg, key_label,
				rsa_pkcs1v15_2048_signature, sizeof(rsa_pkcs1v15_2048_signature));
}

/**
 * @brief Function to test RSA PKCS#1 v1.5 verify hash with 2048 bit key
 */
static void test_rsa_pkcs1v15_2048_verify_hash(void)
{
	psa_key_attributes_t attributes = {0};
	psa_algorithm_t alg = PSA_ALG_RSA_PKCS1V15_SIGN(PSA_ALG_SHA_256);
	static uint8_t key_label[] = "RSA PKCS#1 v1.5 2048 (verify hash)";

	init_rsa_key(&attributes, PSA_KEY_TYPE_RSA_PUBLIC_KEY, alg, PSA_KEY_USAGE_VERIFY_HASH,
		     RSA_2048_KEY_BIT_SIZE);

	test_rsa_verify_hash(&attributes,
			     rsa_pkcs1v15_2048_pubkey, sizeof(rsa_pkcs1v15_2048_pubkey),
			     rsa_pkcs1v15_2048_hash, sizeof(rsa_pkcs1v15_2048_hash),
			     alg, key_label,
			     rsa_pkcs1v15_2048_signature, sizeof(rsa_pkcs1v15_2048_signature));
}

/**
 * @brief Function to test RSA PSS verify message with 3072 bit key
 */
static void test_rsa_pss_3072_verify_message(void)
{
	psa_key_attributes_t attributes = {0};
	psa_algorithm_t alg = PSA_ALG_RSA_PSS(PSA_ALG_SHA_384);
	static const char key_label[] = "RSA PSS 3072 (verify message)";

	init_rsa_key(&attributes, PSA_KEY_TYPE_RSA_PUBLIC_KEY, alg, PSA_KEY_USAGE_VERIFY_MESSAGE,
		     RSA_3072_KEY_BIT_SIZE);

	test_rsa_verify_message(&attributes,
				rsa_pss_3072_pubkey, sizeof(rsa_pss_3072_pubkey),
				rsa_pss_3072_msg, sizeof(rsa_pss_3072_msg),
				alg, key_label,
				rsa_pss_3072_signature, sizeof(rsa_pss_3072_signature));
}

/**
 * @brief Function to test RSA PSS verify hash with 3072 bit key
 */
static void test_rsa_pss_3072_verify_hash(void)
{
	psa_key_attributes_t attributes = {0};
	psa_algorithm_t alg = PSA_ALG_RSA_PSS(PSA_ALG_SHA_384);
	static const char key_label[] = "RSA PSS 3072 (verify hash)";

	init_rsa_key(&attributes, PSA_KEY_TYPE_RSA_PUBLIC_KEY, alg, PSA_KEY_USAGE_VERIFY_HASH,
		     RSA_3072_KEY_BIT_SIZE);

	test_rsa_verify_hash(&attributes,
			     rsa_pss_3072_pubkey, sizeof(rsa_pss_3072_pubkey),
			     rsa_pss_3072_hash, sizeof(rsa_pss_3072_hash),
			     alg, key_label,
			     rsa_pss_3072_signature, sizeof(rsa_pss_3072_signature));
}

static void test_rsa_pkcs1v15_3072_verify_message(void)
{
	psa_key_attributes_t attributes = {0};
	psa_algorithm_t alg = PSA_ALG_RSA_PKCS1V15_SIGN(PSA_ALG_SHA_384);
	static uint8_t key_label[] = "RSA PKCS#1 v1.5 3072 (verify message)";

	init_rsa_key(&attributes, PSA_KEY_TYPE_RSA_PUBLIC_KEY, alg, PSA_KEY_USAGE_VERIFY_MESSAGE,
		     RSA_3072_KEY_BIT_SIZE);

	test_rsa_verify_message(&attributes,
				rsa_pkcs1v15_3072_pubkey, sizeof(rsa_pkcs1v15_3072_pubkey),
				rsa_pkcs1v15_3072_msg, sizeof(rsa_pkcs1v15_3072_msg),
				alg, key_label,
				rsa_pkcs1v15_3072_signature, sizeof(rsa_pkcs1v15_3072_signature));
}

static void test_rsa_pkcs1v15_3072_verify_hash(void)
{
	psa_key_attributes_t attributes = {0};
	psa_algorithm_t alg = PSA_ALG_RSA_PKCS1V15_SIGN(PSA_ALG_SHA_384);
	static uint8_t key_label[] = "RSA PKCS#1 v1.5 3072 (verify hash)";

	init_rsa_key(&attributes, PSA_KEY_TYPE_RSA_PUBLIC_KEY, alg, PSA_KEY_USAGE_VERIFY_HASH,
		     RSA_3072_KEY_BIT_SIZE);

	test_rsa_verify_hash(&attributes,
			     rsa_pkcs1v15_3072_pubkey, sizeof(rsa_pkcs1v15_3072_pubkey),
			     rsa_pkcs1v15_3072_hash, sizeof(rsa_pkcs1v15_3072_hash),
			     alg, key_label,
			     rsa_pkcs1v15_3072_signature, sizeof(rsa_pkcs1v15_3072_signature));
}

void test_verify_rsa(void)
{
	bool ran_verify = false;
	/* RSA PSS 2048 with SHA-256 */
	if (IS_ENABLED_ALL(PSA_WANT_ALG_RSA_PSS, PSA_WANT_RSA_KEY_SIZE_2048,
			   PSA_WANT_ALG_SHA_256)) {
		test_rsa_pss_2048_verify_message();
		test_rsa_pss_2048_verify_hash();
		ran_verify = true;
	}

	/* RSA PKCS#1 v1.5 2048 with SHA-256 */
	if (IS_ENABLED_ALL(PSA_WANT_ALG_RSA_PKCS1V15_SIGN, PSA_WANT_RSA_KEY_SIZE_2048,
			   PSA_WANT_ALG_SHA_256)) {
		test_rsa_pkcs1v15_2048_verify_message();
		test_rsa_pkcs1v15_2048_verify_hash();
		ran_verify = true;
	}

	/* RSA PSS 3072 with SHA-384 */
	if (IS_ENABLED_ALL(PSA_WANT_ALG_RSA_PSS, PSA_WANT_RSA_KEY_SIZE_3072,
			   PSA_WANT_ALG_SHA_384)) {
		test_rsa_pss_3072_verify_message();
		test_rsa_pss_3072_verify_hash();
		ran_verify = true;
	}

	/* RSA PKCS#1 v1.5 3072 with SHA-384 */
	if (IS_ENABLED_ALL(PSA_WANT_ALG_RSA_PKCS1V15_SIGN, PSA_WANT_RSA_KEY_SIZE_3072,
			   PSA_WANT_ALG_SHA_384)) {
		test_rsa_pkcs1v15_3072_verify_message();
		test_rsa_pkcs1v15_3072_verify_hash();
		ran_verify = true;
	}

	zassert_true(ran_verify, "Did not run RSA signature verify, check configs!");
}

static void test_decrypt_rsa_oaep(psa_key_attributes_t *attributes,
				 const uint8_t *priv_key, size_t priv_key_size,
				 const uint8_t *cipher, size_t cipher_size,
				 const uint8_t *expected_plain, size_t expected_plain_size,
				 psa_algorithm_t alg, const char *key_label)
{
	psa_status_t err;
	mbedtls_svc_key_id_t key_id = MBEDTLS_SVC_KEY_ID_INIT;
	size_t output_size;
	uint8_t plain[RSA_OAEP_MAX_OUTPUT_SIZE] = {0};

	zassert_true(expected_plain_size <= RSA_OAEP_MAX_OUTPUT_SIZE,
		     "Too large input for RSA decrypt for '%s' %d > %d", key_label,
		     expected_plain_size, RSA_OAEP_MAX_OUTPUT_SIZE);

	err = psa_import_key(attributes, priv_key, priv_key_size, &key_id);
	zassert_equal(err, PSA_SUCCESS,
		      "Failed to import key for '%s'. Err: %d", key_label, err);

	err = psa_asymmetric_decrypt(key_id, alg, cipher, cipher_size, "", 0,
				     plain, sizeof(plain), &output_size);
	zassert_equal(err, PSA_SUCCESS,
		      "Failed to decrypt for '%s'. Err: %d",
		      key_label, err);

	zassert_equal(expected_plain_size, output_size,
		      "Output size for decrypt mismatched. Expected: %d, got: %d",
		      expected_plain_size, output_size);

	if (constant_memcmp(plain, expected_plain, expected_plain_size) != 0) {
		zassert_false("Decrypted RSA OAEP did not match expected plaintext");
	}

	err = psa_destroy_key(key_id);
	zassert_equal(err, PSA_SUCCESS,
		      "Failed to destroy key for '%s' key. Err: %d",
		      key_label, err);
}

void test_decrypt_rsa_oaep_2048(void)
{
	psa_key_attributes_t attributes = {0};
	psa_algorithm_t alg = PSA_ALG_RSA_OAEP(PSA_ALG_SHA_256);
	static uint8_t key_label[] = "RSA OAEP decrypt 2048";

	init_rsa_key(&attributes, PSA_KEY_TYPE_RSA_KEY_PAIR, alg, PSA_KEY_USAGE_DECRYPT,
		     RSA_2048_KEY_BIT_SIZE);

	test_decrypt_rsa_oaep(
		&attributes, rsa_oaep_2048_private_key, sizeof(rsa_oaep_2048_private_key),
		rsa_oaep_2048_ciphertext, sizeof(rsa_oaep_2048_ciphertext),
		rsa_oaep_2048_plaintext, sizeof(rsa_oaep_2048_plaintext), alg, key_label);
}

void test_decrypt_rsa_oaep_3072(void)
{
	psa_key_attributes_t attributes = {0};
	psa_algorithm_t alg = PSA_ALG_RSA_OAEP(PSA_ALG_SHA_256);
	static uint8_t key_label[] = "RSA OAEP decrypt 3072";

	init_rsa_key(&attributes, PSA_KEY_TYPE_RSA_KEY_PAIR, alg, PSA_KEY_USAGE_DECRYPT,
		     RSA_3072_KEY_BIT_SIZE);

	test_decrypt_rsa_oaep(
		&attributes, rsa_oaep_3072_priv_key, sizeof(rsa_oaep_3072_priv_key),
		rsa_oaep_3072_ciphertext, sizeof(rsa_oaep_3072_ciphertext),
		rsa_oaep_3072_plaintext, sizeof(rsa_oaep_3072_plaintext), alg, key_label);
}

void test_decrypt_rsa(void)
{
	bool ran_decrypt = false;

	if (IS_ENABLED_ALL(PSA_WANT_ALG_RSA_OAEP, PSA_WANT_RSA_KEY_SIZE_2048,
			   PSA_WANT_ALG_SHA_256)) {
		test_decrypt_rsa_oaep_2048();
		ran_decrypt = true;
	}

	if (IS_ENABLED_ALL(PSA_WANT_ALG_RSA_OAEP, PSA_WANT_RSA_KEY_SIZE_3072,
			   PSA_WANT_ALG_SHA_256)) {
		test_decrypt_rsa_oaep_3072();
		ran_decrypt = true;
	}

	zassert_true(ran_decrypt, "Did not run RSA OAEP decrypt, check configs!");
}

void test_main(void)
{
	bool ran_tests = false;

	/* Test hashing */
	if (IS_ENABLED(PSA_CORE_LITE_HAS_HASH)) {
		test_hash();
		ran_tests = true;
	}


	/* Verify is required to be run in these tests */
	if (IS_ENABLED_ANY(PSA_WANT_ALG_RSA_PSS, PSA_WANT_ALG_RSA_PKCS1V15_SIGN)) {
		test_verify_rsa();
		ran_tests = true;
	}

	/* Test that RSA decrypt works for transport key wrapping */
	if (IS_ENABLED(PSA_WANT_ALG_RSA_OAEP)) {
		test_decrypt_rsa();
		ran_tests = true;
	}

	zassert_true(ran_tests, "psa_core_lite unit tests did not run (check config)");
}
```

## src/rsa_vectors.h
```c
/* Defines for RSA */
#define RSA_2048_KEY_BIT_SIZE		(2048)
#define RSA_3072_KEY_BIT_SIZE		(3072)


/* Test material for RSA with PSS from NIST CAVP 2048 SHA-256 #5 */
const uint8_t rsa_pss_2048_pubkey[270] = {
	0x30, 0x82, 0x01, 0x0a, 0x02, 0x82, 0x01, 0x01, 0x00, 0xa4, 0x7d, 0x04,
	0xe7, 0xca, 0xcd, 0xba, 0x4e, 0xa2, 0x6e, 0xca, 0x8a, 0x4c, 0x6e, 0x14,
	0x56, 0x3c, 0x2c, 0xe0, 0x3b, 0x62, 0x3b, 0x76, 0x8c, 0x0d, 0x49, 0x86,
	0x8a, 0x57, 0x12, 0x13, 0x01, 0xdb, 0xf7, 0x83, 0xd8, 0x2f, 0x4c, 0x05,
	0x5e, 0x73, 0x96, 0x0e, 0x70, 0x55, 0x01, 0x87, 0xd0, 0xaf, 0x62, 0xac,
	0x34, 0x96, 0xf0, 0xa3, 0xd9, 0x10, 0x3c, 0x2e, 0xb7, 0x91, 0x9a, 0x72,
	0x75, 0x2f, 0xa7, 0xce, 0x8c, 0x68, 0x8d, 0x81, 0xe3, 0xae, 0xe9, 0x94,
	0x68, 0x88, 0x7a, 0x15, 0x28, 0x8a, 0xfb, 0xb7, 0xac, 0xb8, 0x45, 0xb7,
	0xc5, 0x22, 0xb5, 0xc6, 0x4e, 0x67, 0x8f, 0xcd, 0x3d, 0x22, 0xfe, 0xb8,
	0x4b, 0x44, 0x27, 0x27, 0x00, 0xbe, 0x52, 0x7d, 0x2b, 0x20, 0x25, 0xa3,
	0xf8, 0x3c, 0x23, 0x83, 0xbf, 0x6a, 0x39, 0xcf, 0x5b, 0x4e, 0x48, 0xb3,
	0xcf, 0x2f, 0x56, 0xee, 0xf0, 0xdf, 0xff, 0x18, 0x55, 0x5e, 0x31, 0x03,
	0x7b, 0x91, 0x52, 0x48, 0x69, 0x48, 0x76, 0xf3, 0x04, 0x78, 0x14, 0x41,
	0x51, 0x64, 0xf2, 0xc6, 0x60, 0x88, 0x1e, 0x69, 0x4b, 0x58, 0xc2, 0x80,
	0x38, 0xa0, 0x32, 0xad, 0x25, 0x63, 0x4a, 0xad, 0x7b, 0x39, 0x17, 0x1d,
	0xee, 0x36, 0x8e, 0x3d, 0x59, 0xbf, 0xb7, 0x29, 0x9e, 0x46, 0x01, 0xd4,
	0x58, 0x7e, 0x68, 0xca, 0xaf, 0x8d, 0xb4, 0x57, 0xb7, 0x5a, 0xf4, 0x2f,
	0xc0, 0xcf, 0x1a, 0xe7, 0xca, 0xce, 0xd2, 0x86, 0xd7, 0x7f, 0xac, 0x6c,
	0xed, 0xb0, 0x3a, 0xd9, 0x4f, 0x14, 0x33, 0xd2, 0xc9, 0x4d, 0x08, 0xe6,
	0x0b, 0xc1, 0xfd, 0xef, 0x05, 0x43, 0xcd, 0x29, 0x51, 0xe7, 0x65, 0xb3,
	0x82, 0x30, 0xfd, 0xd1, 0x8d, 0xe5, 0xd2, 0xca, 0x62, 0x7d, 0xdc, 0x03,
	0x2f, 0xe0, 0x5b, 0xbd, 0x2f, 0xf2, 0x1e, 0x2d, 0xb1, 0xc2, 0xf9, 0x4d,
	0x8b, 0x02, 0x03, 0x10, 0xe4, 0x3f
};

const uint8_t rsa_pss_2048_msg[128] = {
	0xe0, 0x02, 0x37, 0x7a, 0xff, 0xb0, 0x4f, 0x0f, 0xe4, 0x59, 0x8d, 0xe9,
	0xd9, 0x2d, 0x31, 0xd6, 0xc7, 0x86, 0x04, 0x0d, 0x57, 0x76, 0x97, 0x65,
	0x56, 0xa2, 0xcf, 0xc5, 0x5e, 0x54, 0xa1, 0xdc, 0xb3, 0xcb, 0x1b, 0x12,
	0x6b, 0xd6, 0xa4, 0xbe, 0xd2, 0xa1, 0x84, 0x99, 0x0c, 0xce, 0xa7, 0x73,
	0xfc, 0xc7, 0x9d, 0x24, 0x65, 0x53, 0xe6, 0xc6, 0x4f, 0x68, 0x6d, 0x21,
	0xad, 0x41, 0x52, 0x67, 0x3c, 0xaf, 0xec, 0x22, 0xae, 0xb4, 0x0f, 0x6a,
	0x08, 0x4e, 0x8a, 0x5b, 0x49, 0x91, 0xf4, 0xc6, 0x4c, 0xf8, 0xa9, 0x27,
	0xef, 0xfd, 0x0f, 0xd7, 0x75, 0xe7, 0x1e, 0x83, 0x29, 0xe4, 0x1f, 0xdd,
	0x44, 0x57, 0xb3, 0x91, 0x11, 0x73, 0x18, 0x7b, 0x4f, 0x09, 0xa8, 0x17,
	0xd7, 0x9e, 0xa2, 0x39, 0x7f, 0xc1, 0x2d, 0xfe, 0x3d, 0x9c, 0x9a, 0x02,
	0x90, 0xc8, 0xea, 0xd3, 0x1b, 0x66, 0x90, 0xa6
};

const uint8_t rsa_pss_2048_hash[32] = {
	0x09, 0xe6, 0x05, 0xca, 0xce, 0xe4, 0x06, 0x3a, 0x2f, 0xa3, 0xb2, 0xbb,
	0x6b, 0x3c, 0x90, 0x1b, 0x81, 0xfb, 0x98, 0x78, 0xda, 0x41, 0x1f, 0xbb,
	0xff, 0x44, 0x26, 0x22, 0x10, 0xaa, 0xac, 0xe4
};

const uint8_t rsa_pss_2048_signature[256] = {
	0x4f, 0x9b, 0x42, 0x5c, 0x20, 0x58, 0x46, 0x0e, 0x4a, 0xb2, 0xf5, 0xc9,
	0x63, 0x84, 0xda, 0x23, 0x27, 0xfd, 0x29, 0x15, 0x0f, 0x01, 0x95, 0x5a,
	0x76, 0xb4, 0xef, 0xe9, 0x56, 0xaf, 0x06, 0xdc, 0x08, 0x77, 0x9a, 0x37,
	0x4e, 0xe4, 0x60, 0x7e, 0xab, 0x61, 0xa9, 0x3a, 0xdc, 0x56, 0x08, 0xf4,
	0xec, 0x36, 0xe4, 0x7f, 0x2a, 0x0f, 0x75, 0x4e, 0x8f, 0xf8, 0x39, 0xa8,
	0xa1, 0x9b, 0x1d, 0xb1, 0xe8, 0x84, 0xea, 0x4c, 0xf3, 0x48, 0xcd, 0x45,
	0x50, 0x69, 0xeb, 0x87, 0xaf, 0xd5, 0x36, 0x45, 0xb4, 0x4e, 0x28, 0xa0,
	0xa5, 0x68, 0x08, 0xf5, 0x03, 0x1d, 0xa5, 0xba, 0x91, 0x12, 0x76, 0x8d,
	0xfb, 0xfc, 0xa4, 0x4e, 0xbe, 0x63, 0xa0, 0xc0, 0x57, 0x2b, 0x73, 0x1d,
	0x66, 0x12, 0x2f, 0xb7, 0x16, 0x09, 0xbe, 0x14, 0x80, 0xfa, 0xa4, 0xe4,
	0xf7, 0x5e, 0x43, 0x95, 0x51, 0x59, 0xd7, 0x0f, 0x08, 0x1e, 0x2a, 0x32,
	0xfb, 0xb1, 0x9a, 0x48, 0xb9, 0xf1, 0x62, 0xcf, 0x6b, 0x2f, 0xb4, 0x45,
	0xd2, 0xd6, 0x99, 0x4b, 0xc5, 0x89, 0x10, 0xa2, 0x6b, 0x59, 0x43, 0x47,
	0x78, 0x03, 0xcd, 0xaa, 0xa1, 0xbd, 0x74, 0xb0, 0xda, 0x0a, 0x5d, 0x05,
	0x3d, 0x8b, 0x1d, 0xc5, 0x93, 0x09, 0x1d, 0xb5, 0x38, 0x83, 0x83, 0xc2,
	0x60, 0x79, 0xf3, 0x44, 0xe2, 0xae, 0xa6, 0x00, 0xd0, 0xe3, 0x24, 0x16,
	0x4b, 0x45, 0x0f, 0x7b, 0x9b, 0x46, 0x51, 0x11, 0xb7, 0x26, 0x5f, 0x3b,
	0x1b, 0x06, 0x30, 0x89, 0xae, 0x7e, 0x26, 0x23, 0xfc, 0x0f, 0xda, 0x80,
	0x52, 0xcf, 0x4b, 0xf3, 0x37, 0x91, 0x02, 0xfb, 0xf7, 0x1d, 0x7c, 0x98,
	0xe8, 0x25, 0x86, 0x64, 0xce, 0xed, 0x63, 0x7d, 0x20, 0xf9, 0x5f, 0xf0,
	0x11, 0x18, 0x81, 0xe6, 0x50, 0xce, 0x61, 0xf2, 0x51, 0xd9, 0xc3, 0xa6,
	0x29, 0xef, 0x22, 0x2d
};

/* Test material for RSA with PKCS#1 v1.5 From NIST CAVP 2048 SHA-256 (#32) */
const uint8_t rsa_pkcs1v15_2048_pubkey[270] = {
	0x30, 0x82, 0x01, 0x0a, 0x02, 0x82, 0x01, 0x01, 0x00, 0xa9, 0x11, 0x24,
	0x5a, 0x2c, 0xfb, 0x33, 0xd8, 0xee, 0x37, 0x5d, 0xf9, 0x43, 0x9f, 0x74,
	0xe6, 0x69, 0xc0, 0x3a, 0x8d, 0x9a, 0xca, 0xd2, 0x5b, 0xd2, 0x7a, 0xcf,
	0x3c, 0xd8, 0xbe, 0xa7, 0xeb, 0x9d, 0xbe, 0x47, 0x01, 0x55, 0xc7, 0xc7,
	0x27, 0x82, 0xc9, 0x48, 0x61, 0xf7, 0xb5, 0x73, 0xcd, 0x32, 0x56, 0x39,
	0xfb, 0x07, 0x0e, 0x9b, 0xa6, 0xe6, 0x21, 0x99, 0x1a, 0xef, 0xa4, 0x51,
	0x06, 0x18, 0x2e, 0x4d, 0x26, 0x4b, 0xe7, 0x06, 0x80, 0x35, 0x59, 0x5d,
	0x75, 0x49, 0x05, 0x29, 0x89, 0xb3, 0xe7, 0xfd, 0x04, 0xca, 0xbc, 0x94,
	0x01, 0x2c, 0x12, 0x78, 0xa0, 0xef, 0x86, 0x72, 0xb1, 0xa5, 0x1d, 0xd1,
	0xa9, 0xe2, 0x76, 0x81, 0x6b, 0xa4, 0x97, 0xde, 0xa2, 0x4b, 0x4f, 0xeb,
	0xe3, 0xdd, 0x8e, 0x97, 0x77, 0x07, 0xbc, 0xd2, 0x30, 0xca, 0x6f, 0xb6,
	0xf8, 0xa8, 0xbf, 0xf9, 0xe6, 0xba, 0x24, 0xfb, 0xad, 0xcd, 0x93, 0xf0,
	0x01, 0x26, 0xb1, 0x9b, 0x39, 0x6a, 0x38, 0xe6, 0xef, 0x86, 0xd1, 0x8f,
	0xef, 0x94, 0x5b, 0x91, 0x54, 0xc1, 0x96, 0x3f, 0xb4, 0x88, 0xc7, 0x02,
	0x59, 0x53, 0x51, 0x1f, 0x86, 0xd0, 0x56, 0x38, 0xbf, 0xe0, 0x56, 0x49,
	0x37, 0x30, 0xbc, 0x67, 0x78, 0x44, 0x6e, 0x59, 0xcd, 0x3c, 0x5c, 0x3a,
	0xcf, 0x07, 0xa0, 0xa3, 0xa6, 0x49, 0x43, 0x79, 0x36, 0x52, 0xf1, 0x0e,
	0x32, 0x92, 0xaa, 0x7a, 0x6d, 0x25, 0xa0, 0x31, 0x81, 0xcc, 0x6f, 0x6b,
	0xa0, 0x65, 0x8d, 0x90, 0x9e, 0x59, 0xce, 0x2a, 0x02, 0xba, 0xcc, 0x97,
	0x66, 0xfd, 0x8c, 0x4f, 0xbd, 0x4e, 0xd9, 0xc2, 0x3a, 0x86, 0x68, 0x44,
	0xb8, 0xa7, 0x94, 0xd4, 0x9e, 0x50, 0x5f, 0x9f, 0x94, 0x48, 0x70, 0xa7,
	0x1a, 0xad, 0xbe, 0x53, 0x38, 0x03, 0x98, 0x25, 0xc2, 0xdf, 0xf8, 0x1a,
	0xf3, 0x02, 0x03, 0x01, 0x00, 0x01
};

const uint8_t rsa_pkcs1v15_2048_msg[128] = {
	0x69, 0x18, 0xd6, 0x32, 0x8c, 0xa0, 0xa8, 0xb6, 0x4b, 0xbe, 0x81, 0xd9,
	0x1c, 0xde, 0xa5, 0x19, 0x91, 0x1b, 0x59, 0xfc, 0x2d, 0xbd, 0x53, 0xaf,
	0x76, 0x00, 0x6f, 0xec, 0x4b, 0x18, 0xa3, 0x20, 0x78, 0x71, 0x35, 0xce,
	0x88, 0x3b, 0x2b, 0x2e, 0xdb, 0x26, 0x04, 0x1b, 0xf8, 0x6a, 0xa5, 0x2c,
	0x23, 0x0b, 0x96, 0x20, 0x33, 0x5b, 0x6e, 0x7f, 0x9e, 0xc0, 0x8c, 0x7e,
	0xd6, 0xb7, 0x08, 0x23, 0xd8, 0x19, 0xe9, 0xab, 0x01, 0x9e, 0x99, 0x29,
	0x24, 0x9f, 0x96, 0x6f, 0xdb, 0x20, 0x69, 0x31, 0x1a, 0x0d, 0xdc, 0x68,
	0x0a, 0xc4, 0x68, 0xf5, 0x14, 0xd4, 0xed, 0x87, 0x3b, 0x04, 0xa6, 0xbe,
	0xb0, 0x98, 0x5b, 0x91, 0xa0, 0xcf, 0xd8, 0xed, 0x51, 0xb0, 0x9f, 0x9e,
	0x6d, 0x06, 0xda, 0x73, 0x9e, 0xaa, 0x93, 0x9d, 0x5a, 0x00, 0x27, 0x59,
	0x01, 0xc4, 0xf8, 0xcf, 0x25, 0x07, 0x63, 0x39
};

const uint8_t rsa_pkcs1v15_2048_hash[32] = {
	0x54, 0x47, 0x46, 0x49, 0x88, 0xbe, 0xdf, 0x5a, 0xb8, 0x06, 0x8e, 0x0c,
	0xfd, 0x0e, 0xa5, 0x3a, 0xe9, 0xf0, 0xec, 0x7a, 0x98, 0x2f, 0x57, 0xa5,
	0xe6, 0xca, 0xfd, 0x3b, 0xc1, 0xb5, 0xf5, 0x64
};

const uint8_t rsa_pkcs1v15_2048_signature[256] = {
	0x79, 0x4d, 0x0a, 0x45, 0xbc, 0x9f, 0xc6, 0xfe, 0xbb, 0x58, 0x6e, 0x31,
	0x9d, 0xfa, 0x69, 0x24, 0xc8, 0x88, 0x59, 0x48, 0x02, 0xb9, 0xde, 0xb9,
	0x66, 0x89, 0x63, 0xfd, 0xb3, 0x09, 0xbf, 0x02, 0x81, 0x79, 0x60, 0xa7,
	0x45, 0x71, 0x06, 0xfc, 0x47, 0x4f, 0x91, 0x60, 0x14, 0x36, 0xe8, 0x95,
	0x4c, 0xbb, 0x68, 0x15, 0x35, 0x0b, 0x2c, 0x51, 0xb5, 0x3c, 0x96, 0x8d,
	0x2c, 0x48, 0xcc, 0x17, 0x99, 0x55, 0x0d, 0x5d, 0x03, 0xb4, 0x1f, 0x6e,
	0x5a, 0x8c, 0x3c, 0x26, 0x4d, 0x2e, 0x2f, 0xe0, 0xb5, 0xb8, 0xff, 0x53,
	0xfd, 0xcb, 0x9d, 0xd1, 0x11, 0xc9, 0x85, 0xcb, 0x48, 0x8d, 0x70, 0x86,
	0xe6, 0x54, 0x8b, 0x40, 0x77, 0xec, 0x00, 0x72, 0x1c, 0x9c, 0xb5, 0x00,
	0xfe, 0x07, 0xa0, 0x31, 0xc2, 0x03, 0x0e, 0x8a, 0xd1, 0xdd, 0x01, 0x12,
	0xc3, 0x4f, 0xfd, 0x90, 0x91, 0xd7, 0x7a, 0x18, 0x7a, 0xac, 0x86, 0x61,
	0xb2, 0x98, 0xee, 0xe3, 0x9e, 0xb6, 0x15, 0xf9, 0x71, 0x5c, 0x4c, 0x48,
	0xa6, 0x76, 0x2e, 0xde, 0x55, 0xa4, 0x66, 0xec, 0x7f, 0x3c, 0xdb, 0x6a,
	0x93, 0x7c, 0xfc, 0x80, 0x18, 0x8a, 0x85, 0xd8, 0xf8, 0xd3, 0xa2, 0xa8,
	0x0b, 0x19, 0x9c, 0xe5, 0xe6, 0x37, 0x5a, 0xf8, 0xf0, 0x2f, 0x06, 0xd7,
	0x06, 0xa3, 0x4d, 0x9c, 0xf3, 0x83, 0x18, 0x90, 0x39, 0x65, 0xdb, 0x54,
	0xaa, 0xa7, 0xd3, 0xfa, 0x7a, 0x7e, 0xe5, 0x80, 0x34, 0xcd, 0x58, 0xc8,
	0x43, 0x57, 0x39, 0xc8, 0x90, 0x63, 0x66, 0xe2, 0xdd, 0xba, 0x29, 0x3f,
	0x2f, 0xb2, 0xc1, 0x5f, 0x07, 0xfa, 0x49, 0x51, 0x01, 0x44, 0x71, 0xe7,
	0xf6, 0x77, 0xd3, 0xbd, 0xac, 0xff, 0xc4, 0xc6, 0x8a, 0x90, 0x6e, 0x08,
	0xd6, 0x8b, 0x39, 0xf9, 0x01, 0x07, 0x46, 0xcb, 0xac, 0xd2, 0x29, 0x80,
	0xce, 0xe7, 0x3e, 0x8d
};


/* Test material for RSA with PSS using 3072 SHA-384 (custom) */
const uint8_t rsa_pss_3072_pubkey[398] = {
	0x30, 0x82, 0x01, 0x8a, 0x02, 0x82, 0x01, 0x81, 0x00, 0xba, 0x27, 0x5e,
	0x4f, 0x8e, 0x4a, 0x2d, 0x63, 0x21, 0x0b, 0xea, 0xc2, 0xba, 0x8c, 0x98,
	0x49, 0x56, 0x85, 0xae, 0x81, 0x8b, 0xd4, 0x40, 0x13, 0x6c, 0x62, 0x5e,
	0x1c, 0xd9, 0x60, 0x2d, 0xfd, 0x4f, 0x2e, 0x5a, 0x23, 0x2b, 0xc4, 0x05,
	0xa4, 0x67, 0x16, 0xee, 0x48, 0xfa, 0x90, 0x9c, 0x63, 0x3d, 0x84, 0xe8,
	0x53, 0xfa, 0x63, 0x6d, 0xf6, 0xfb, 0x6c, 0x90, 0x79, 0xba, 0xa0, 0xdd,
	0x49, 0x0e, 0xb7, 0xd4, 0x76, 0x72, 0x9b, 0x95, 0x37, 0xe1, 0x3e, 0x2e,
	0x0b, 0x24, 0x44, 0x6a, 0x0a, 0xae, 0x60, 0x4c, 0x24, 0x98, 0x62, 0x43,
	0x8d, 0x41, 0x9b, 0x20, 0xf5, 0xcc, 0x13, 0xc5, 0x2d, 0x97, 0x89, 0x5a,
	0x8e, 0xcc, 0xdf, 0x23, 0xc6, 0x15, 0xd9, 0xdb, 0x7a, 0xdd, 0x7a, 0xec,
	0xd4, 0xd1, 0x1f, 0x88, 0x58, 0xff, 0xe4, 0xc5, 0xe1, 0x12, 0x32, 0x2b,
	0xa8, 0xba, 0x1b, 0x6c, 0xe1, 0x1d, 0x03, 0x82, 0x3b, 0x66, 0x13, 0x37,
	0x0f, 0x5f, 0x9d, 0x2d, 0x1e, 0xc3, 0x53, 0x95, 0x31, 0xd7, 0x6d, 0xf0,
	0x3b, 0xfe, 0x4c, 0x5c, 0xcd, 0xf0, 0x89, 0xf1, 0x20, 0xd7, 0x23, 0x2c,
	0xa5, 0x44, 0xb1, 0x30, 0x5c, 0x55, 0xe5, 0x6d, 0xf3, 0xfa, 0x49, 0x27,
	0xfb, 0xe1, 0x65, 0x6b, 0xf9, 0xa4, 0x8c, 0x9e, 0xc0, 0x6a, 0xaa, 0xf1,
	0xbb, 0xb7, 0xe1, 0x1d, 0x4b, 0x7e, 0x35, 0xe4, 0xd8, 0xc0, 0xdc, 0x53,
	0x9c, 0xf7, 0xe4, 0xdd, 0xdb, 0x4a, 0x6a, 0xfe, 0x4d, 0xf9, 0x90, 0x34,
	0xdd, 0x92, 0x3e, 0xc9, 0x5c, 0x10, 0xc8, 0x4f, 0xc8, 0xb0, 0xf9, 0x32,
	0x3a, 0x06, 0xcb, 0x4d, 0x9b, 0xce, 0xd2, 0xda, 0x30, 0x99, 0x06, 0xb9,
	0x4f, 0x51, 0x4c, 0x05, 0xaa, 0x2e, 0xe2, 0x89, 0x3c, 0x22, 0x40, 0x29,
	0xc4, 0xf0, 0x5f, 0x0d, 0xca, 0xd3, 0x32, 0xe0, 0xca, 0x08, 0x44, 0x86,
	0xa2, 0xa6, 0x3a, 0x8d, 0x29, 0x02, 0x38, 0x40, 0x2e, 0x6f, 0x7f, 0x9c,
	0xc0, 0xc5, 0x49, 0x1c, 0xf1, 0x40, 0xe9, 0x6d, 0x32, 0x2a, 0x5f, 0x53,
	0xa7, 0x59, 0x81, 0xc7, 0x0c, 0x14, 0xec, 0x6f, 0x03, 0x36, 0x2d, 0xc6,
	0xcb, 0x44, 0xdc, 0xaa, 0x07, 0x45, 0xb0, 0x30, 0x7e, 0x13, 0xa5, 0x28,
	0xc4, 0x90, 0x90, 0x18, 0x92, 0x09, 0xd5, 0xca, 0x0f, 0xe3, 0x94, 0x2c,
	0xdb, 0x84, 0x53, 0x9b, 0x4b, 0x28, 0x11, 0xaf, 0x6d, 0xed, 0xd3, 0x7a,
	0x95, 0x4b, 0xa1, 0xc1, 0x17, 0x72, 0x2d, 0xf1, 0xe4, 0x84, 0xbd, 0x4b,
	0x25, 0x2d, 0x0a, 0x5f, 0xd0, 0x54, 0xc8, 0xcd, 0x99, 0xff, 0x5a, 0xc3,
	0xa8, 0x44, 0x64, 0x13, 0xb1, 0x21, 0xde, 0x82, 0xfb, 0x3d, 0x45, 0x88,
	0x93, 0xaa, 0x06, 0xca, 0x30, 0x61, 0x7c, 0xbe, 0x09, 0x42, 0xa3, 0x03,
	0x02, 0x31, 0x07, 0xc2, 0xf0, 0x68, 0xcf, 0x35, 0xdd, 0x02, 0x03, 0x01,
	0x00, 0x01
};
const uint8_t rsa_pss_3072_msg[257] = {
	0x40, 0xf6, 0x46, 0xc3, 0xa5, 0x57, 0x7a, 0x3b, 0x10, 0xe9, 0x56, 0x77,
	0x63, 0x62, 0xd5, 0x91, 0x95, 0x5f, 0x7e, 0x44, 0x58, 0x66, 0xe6, 0x14,
	0x51, 0x7b, 0x8e, 0x6e, 0x29, 0xb9, 0x3e, 0xb1, 0xc5, 0x81, 0x1d, 0xf7,
	0xb0, 0x4b, 0x10, 0x07, 0x24, 0x12, 0x8a, 0xe2, 0xfd, 0x7a, 0xa2, 0x39,
	0xed, 0x6b, 0x72, 0x48, 0x9f, 0x22, 0x66, 0x8b, 0x69, 0x3c, 0xd7, 0x41,
	0x27, 0xca, 0x86, 0x1d, 0xc4, 0xd5, 0x46, 0xa5, 0x38, 0xa9, 0x7c, 0xb3,
	0x8b, 0x14, 0x79, 0xa6, 0x49, 0x4d, 0x96, 0x70, 0xa0, 0x86, 0x9b, 0xea,
	0xa9, 0x50, 0x88, 0x39, 0x98, 0xa5, 0x74, 0x74, 0x84, 0xd0, 0x36, 0x56,
	0xf9, 0x0d, 0xed, 0x58, 0x1e, 0x54, 0x4f, 0x52, 0xe0, 0x34, 0x88, 0x72,
	0x3f, 0x73, 0x34, 0xd2, 0xae, 0x59, 0x3a, 0x64, 0x20, 0xa2, 0x5d, 0x3f,
	0x81, 0xb8, 0xf4, 0x2c, 0xeb, 0x0e, 0xf0, 0xcb, 0xdb, 0x8b, 0xf4, 0x65,
	0xb4, 0x0a, 0xd6, 0xf1, 0xef, 0x9e, 0x06, 0xb4, 0xe4, 0x8e, 0x59, 0xe0,
	0x2c, 0x07, 0x5e, 0x56, 0xfb, 0xbd, 0x68, 0x08, 0xc4, 0xfc, 0x56, 0xb5,
	0x29, 0x4f, 0xf9, 0x9d, 0xb7, 0x8f, 0xd4, 0x71, 0x50, 0x61, 0x89, 0xdb,
	0x50, 0xe0, 0x53, 0x20, 0x9b, 0x8c, 0x06, 0x54, 0x0e, 0xe4, 0x80, 0x47,
	0xb7, 0x0e, 0x72, 0x39, 0xf9, 0x20, 0x4a, 0x8f, 0x3a, 0x50, 0x54, 0x1c,
	0xd9, 0xbe, 0x78, 0xa0, 0xd1, 0x2f, 0x70, 0x51, 0xb7, 0x68, 0x2e, 0x09,
	0x0b, 0x88, 0x63, 0x93, 0xc6, 0x9a, 0xd3, 0xc3, 0x72, 0xf2, 0x68, 0xb6,
	0xe5, 0xae, 0x21, 0x86, 0x8f, 0xa8, 0xa5, 0x9f, 0xad, 0xfe, 0x08, 0x32,
	0xe5, 0x4c, 0x44, 0x7c, 0xc7, 0x6e, 0x16, 0xf4, 0x96, 0x77, 0x63, 0x17,
	0x04, 0x75, 0x8b, 0xe7, 0xe2, 0xce, 0x89, 0x73, 0x0a, 0x54, 0x6f, 0xc7,
	0x76, 0x65, 0xb3, 0x57, 0x33
};

const uint8_t rsa_pss_3072_hash[48] = {
	0xe2, 0x50, 0xe3, 0xfa, 0xf9, 0x8f, 0x99, 0xfd, 0xc0, 0xda, 0x3d, 0x60,
	0xce, 0xcb, 0x0e, 0xe1, 0xf3, 0xf2, 0xe5, 0x3f, 0x0e, 0x0b, 0xa5, 0x86,
	0x5a, 0x72, 0xce, 0x79, 0xb7, 0xfc, 0x8d, 0x48, 0xea, 0xc1, 0xbd, 0xe0,
	0x9b, 0x37, 0x10, 0x3a, 0x9c, 0xf3, 0x47, 0x15, 0x38, 0x23, 0x66, 0xd2
};

const uint8_t rsa_pss_3072_signature[384] = {
	0x1e, 0x1a, 0x96, 0x1a, 0xb8, 0xfd, 0x61, 0xdd, 0xba, 0x8e, 0xdc, 0x7f,
	0x16, 0xbb, 0xc8, 0x16, 0x56, 0xae, 0x89, 0xee, 0xa5, 0x90, 0x1e, 0xd0,
	0x69, 0x8b, 0x12, 0x09, 0xb9, 0x76, 0x93, 0x17, 0xc0, 0xca, 0xb0, 0xb3,
	0x46, 0xd4, 0xef, 0xf7, 0xbe, 0xbf, 0x0a, 0x34, 0x6f, 0xcf, 0xf7, 0x61,
	0xfd, 0x07, 0x05, 0x7d, 0xbd, 0x39, 0x4c, 0x84, 0xf3, 0xa0, 0x22, 0x10,
	0xfa, 0xea, 0x9e, 0x90, 0xe6, 0x91, 0x7c, 0xb5, 0x06, 0x60, 0xf4, 0x4c,
	0xef, 0xfc, 0xc2, 0xb1, 0xa0, 0x63, 0xda, 0xd2, 0x86, 0xad, 0x4c, 0x74,
	0x02, 0x09, 0x47, 0x68, 0xc1, 0x34, 0x36, 0x51, 0x19, 0xb0, 0x58, 0x0b,
	0xb3, 0x2c, 0xd2, 0xbe, 0x33, 0xd0, 0x4b, 0x65, 0x66, 0xcf, 0xfb, 0xea,
	0x4b, 0x61, 0xfa, 0xb4, 0x6b, 0xe3, 0x36, 0x53, 0xe9, 0x41, 0x6c, 0x79,
	0x6b, 0x94, 0x0c, 0x6c, 0xec, 0x96, 0x2f, 0xf8, 0x20, 0x92, 0x92, 0x2e,
	0xbc, 0xb4, 0xc1, 0x2e, 0xef, 0xa7, 0xde, 0xa7, 0xb3, 0x99, 0x75, 0x2e,
	0x4d, 0x05, 0xad, 0x82, 0xea, 0x97, 0x78, 0x7e, 0xb5, 0x4f, 0x27, 0xb1,
	0x46, 0xd9, 0xd6, 0x42, 0x32, 0xf1, 0xe9, 0x63, 0xab, 0xc2, 0x1a, 0x9c,
	0xaf, 0xfe, 0x18, 0x75, 0x01, 0xc4, 0xa0, 0x90, 0x30, 0xa9, 0x41, 0x96,
	0x35, 0x93, 0x9c, 0xae, 0x63, 0x0a, 0x82, 0xec, 0xf2, 0x16, 0xf0, 0xcb,
	0x26, 0x6d, 0x66, 0xc4, 0x26, 0x8c, 0x83, 0x2c, 0x7c, 0x4b, 0x4b, 0x43,
	0x78, 0x76, 0x88, 0x0d, 0x83, 0xfd, 0x8e, 0x57, 0xaf, 0x3b, 0x23, 0x13,
	0x39, 0x94, 0xcc, 0x68, 0xf0, 0xb1, 0x48, 0x6c, 0xc5, 0xab, 0xb0, 0x05,
	0xd1, 0x0d, 0x69, 0xe2, 0x8f, 0xf0, 0xb1, 0x9d, 0xc0, 0xb8, 0x83, 0x59,
	0xf8, 0x11, 0xe7, 0x2e, 0x2b, 0x2e, 0xf7, 0x9a, 0xf9, 0x67, 0xa2, 0xcf,
	0xe5, 0xbd, 0x06, 0xf3, 0x09, 0x29, 0xb3, 0xdf, 0x7a, 0xd4, 0x43, 0xc8,
	0x9d, 0xb8, 0x9e, 0x59, 0xbf, 0x5c, 0x2b, 0x35, 0xbf, 0x9a, 0x9a, 0xf1,
	0x00, 0x98, 0xfa, 0xee, 0xfd, 0x3e, 0x92, 0x26, 0x89, 0x7c, 0x29, 0x66,
	0xc4, 0x3c, 0xbf, 0x37, 0x98, 0xa2, 0xdc, 0x71, 0x5f, 0x9b, 0x07, 0x09,
	0x9b, 0xa4, 0xaa, 0xfa, 0xea, 0x00, 0x9d, 0x67, 0xfe, 0x79, 0x62, 0x65,
	0xef, 0x7b, 0xe3, 0xb4, 0x20, 0xe9, 0xe1, 0x35, 0xb7, 0xbb, 0x90, 0x6e,
	0x63, 0xda, 0x40, 0xe5, 0x8c, 0x9a, 0xe0, 0xbe, 0x60, 0xe9, 0xad, 0x6e,
	0xb7, 0xed, 0x44, 0xa1, 0xfb, 0x67, 0x92, 0x5c, 0xf7, 0xba, 0xd3, 0x16,
	0xb3, 0xcc, 0x92, 0x55, 0xc6, 0x56, 0xea, 0x10, 0xa6, 0x4f, 0x1d, 0x2c,
	0xd0, 0xbd, 0x94, 0xc9, 0xd3, 0xa7, 0x32, 0x78, 0x9b, 0x14, 0x0e, 0x52,
	0x21, 0x87, 0x59, 0xd1, 0x8e, 0x72, 0x1b, 0x70, 0xa5, 0x20, 0x05, 0x04
};

/* Test material for RSA with PKCS#1 v1.5 from NIST CAVP 3072 SHA-384 (#180) */
uint8_t rsa_pkcs1v15_3072_pubkey[397] = {
	0x30, 0x82, 0x01, 0x89, 0x02, 0x82, 0x01, 0x81, 0x00, 0xcd, 0x28, 0x4b,
	0x76, 0xdb, 0xc0, 0x96, 0xeb, 0x9a, 0xa7, 0x98, 0x79, 0xbf, 0xfb, 0x3e,
	0xb6, 0xa0, 0x28, 0x0c, 0x39, 0x45, 0x9b, 0x54, 0xe6, 0xc3, 0xee, 0xd1,
	0xcf, 0x31, 0x2a, 0x07, 0xff, 0xa5, 0x46, 0x45, 0xc4, 0xbd, 0xac, 0x49,
	0x84, 0xe1, 0x20, 0x91, 0xac, 0xae, 0xd0, 0xbf, 0xd1, 0x03, 0x9a, 0x54,
	0x45, 0x22, 0xb9, 0xc3, 0x4f, 0xd6, 0x90, 0xc6, 0x27, 0x80, 0x92, 0xa0,
	0x88, 0x19, 0xd3, 0x80, 0xc9, 0x62, 0x42, 0x1a, 0x48, 0xaf, 0xd8, 0x97,
	0xc0, 0x41, 0x86, 0x04, 0x25, 0xcd, 0x66, 0x69, 0xac, 0x80, 0x37, 0xd7,
	0x03, 0xdf, 0x79, 0x3c, 0xd7, 0x77, 0xc0, 0xd5, 0x62, 0xee, 0x93, 0x20,
	0x4b, 0x2c, 0x59, 0x99, 0x42, 0xaa, 0x6d, 0x96, 0x60, 0x68, 0xca, 0x99,
	0xf3, 0x8a, 0xd1, 0x06, 0x29, 0x18, 0xf3, 0x41, 0xf6, 0x61, 0x22, 0x0f,
	0xd8, 0xe3, 0x33, 0x28, 0xef, 0x81, 0x9e, 0x52, 0xee, 0x9a, 0xf4, 0x0f,
	0x60, 0x77, 0x4d, 0xee, 0x2d, 0x62, 0xd2, 0x11, 0xfb, 0x92, 0x62, 0xdb,
	0xa1, 0x7e, 0x8c, 0x5d, 0xcc, 0xf1, 0xe8, 0x8e, 0x2b, 0xbd, 0xc8, 0xa8,
	0xba, 0x70, 0x89, 0x84, 0x04, 0x2f, 0x96, 0xd0, 0x0f, 0x48, 0x55, 0x08,
	0x1f, 0x71, 0xb1, 0xab, 0x27, 0xf3, 0xeb, 0x35, 0xfb, 0xf4, 0x1e, 0xbe,
	0x8f, 0x9b, 0x22, 0x0f, 0x1d, 0x69, 0xe2, 0xa5, 0x3a, 0x99, 0xf7, 0xe3,
	0x0a, 0x6a, 0xac, 0x17, 0x2c, 0x7a, 0x5a, 0xe7, 0x96, 0x9a, 0xf9, 0x34,
	0xf4, 0x57, 0x3c, 0x80, 0x45, 0x34, 0xc9, 0xfe, 0xb5, 0xc8, 0x40, 0xa5,
	0x06, 0x4d, 0xed, 0x43, 0x73, 0x18, 0x27, 0xb1, 0xf0, 0xec, 0x81, 0xae,
	0x4f, 0x49, 0x4f, 0x84, 0x60, 0xfa, 0x70, 0xd4, 0xf0, 0xac, 0x45, 0xf5,
	0x0a, 0x23, 0xf9, 0x93, 0x40, 0xbe, 0x77, 0x09, 0x9d, 0x4b, 0xe8, 0xa9,
	0xae, 0x00, 0x07, 0x0b, 0xf2, 0xb3, 0x57, 0x4a, 0x42, 0xd5, 0xa1, 0xc1,
	0x94, 0x46, 0x80, 0x95, 0x0f, 0x6a, 0x4a, 0x98, 0xde, 0x65, 0xce, 0x97,
	0x31, 0x7c, 0xfb, 0xfe, 0x34, 0xfc, 0xa6, 0x1e, 0xd3, 0x6c, 0x1e, 0xe7,
	0xb2, 0xf7, 0x88, 0xab, 0x14, 0xf8, 0xa4, 0x09, 0xaa, 0x33, 0xaf, 0x73,
	0xf2, 0xe3, 0xae, 0x3f, 0xb0, 0xee, 0x94, 0x59, 0x9e, 0x03, 0x1e, 0xab,
	0x08, 0x25, 0x15, 0xa7, 0x49, 0x09, 0x41, 0x10, 0xff, 0x17, 0xa0, 0x52,
	0xce, 0x53, 0x56, 0x92, 0x5c, 0x34, 0xec, 0xbb, 0xee, 0x94, 0x08, 0x26,
	0xfc, 0xb6, 0xa7, 0x7e, 0xeb, 0x8e, 0xbb, 0xc1, 0x43, 0x45, 0xd5, 0xb3,
	0xaa, 0x1b, 0xa2, 0xab, 0x43, 0x6c, 0x45, 0x9f, 0xae, 0x5d, 0xf3, 0x3d,
	0x4d, 0xb8, 0x91, 0x65, 0xe7, 0xd6, 0xc9, 0xe0, 0x9b, 0x68, 0xed, 0xd7,
	0x20, 0x46, 0x54, 0x51, 0x03, 0x27, 0x64, 0x8d, 0x63, 0x02, 0x02, 0x10,
	0x01
};

const uint8_t rsa_pkcs1v15_3072_msg[128] = {
	0xe3, 0x75, 0xbd, 0x5e, 0xbb, 0xd8, 0x1a, 0xf8, 0x1f, 0x53, 0xea, 0x01,
	0xdc, 0xd7, 0x6e, 0x84, 0x5f, 0x6b, 0x9e, 0x70, 0x6a, 0x17, 0x75, 0x9d,
	0x0c, 0x00, 0x90, 0x0a, 0xcf, 0xd4, 0xf7, 0x69, 0x33, 0x68, 0x3b, 0xdd,
	0x5b, 0xa0, 0xc1, 0x02, 0x07, 0x90, 0x5d, 0x2e, 0xc2, 0xe0, 0x22, 0xf6,
	0x5d, 0x75, 0x79, 0xf4, 0x9b, 0x4d, 0x71, 0xc8, 0x2e, 0xab, 0x56, 0x5d,
	0xe2, 0x75, 0x85, 0x6e, 0x19, 0xda, 0x7e, 0x48, 0x77, 0x37, 0x3b, 0xd1,
	0xde, 0x3c, 0xc1, 0xc9, 0x9d, 0x4b, 0xf4, 0x50, 0xe4, 0x20, 0xaf, 0xa8,
	0x7c, 0xb7, 0x14, 0x3d, 0xb4, 0x6a, 0x21, 0xe2, 0x9f, 0x5b, 0x84, 0x5e,
	0x7c, 0x11, 0xb1, 0x27, 0x76, 0x66, 0x31, 0x6d, 0x8e, 0xa0, 0x3d, 0x5a,
	0xd5, 0xde, 0x8b, 0x99, 0xde, 0xb6, 0x68, 0x15, 0x73, 0x1c, 0x07, 0x03,
	0x87, 0x85, 0x19, 0x22, 0x6c, 0x4d, 0x9d, 0x41
};

const uint8_t rsa_pkcs1v15_3072_hash[48] = {
	0x81, 0x7a, 0x52, 0x4b, 0xfe, 0xd5, 0x7a, 0x7b, 0x15, 0x43, 0x66, 0xa7,
	0x0c, 0x41, 0xf9, 0xff, 0xe7, 0x77, 0x7a, 0xea, 0x73, 0xfc, 0xb7, 0x38,
	0x09, 0x6a, 0xa0, 0xfb, 0xc8, 0xab, 0x9f, 0xec, 0x6a, 0xfa, 0x2a, 0x4b,
	0x0f, 0x5c, 0xa2, 0x6f, 0xde, 0xd3, 0x68, 0x22, 0xdf, 0x7a, 0x5f, 0xec
};

const uint8_t rsa_pkcs1v15_3072_signature[384] = {
	0x9b, 0x77, 0x29, 0x35, 0x8f, 0x87, 0x47, 0xfa, 0xab, 0x09, 0x74, 0x89,
	0x75, 0xa7, 0x0f, 0x13, 0x25, 0xe8, 0xe8, 0x02, 0x23, 0x2e, 0xaa, 0x58,
	0x95, 0x23, 0x6d, 0xad, 0xef, 0x49, 0x89, 0x88, 0x7f, 0xbc, 0x8f, 0xa3,
	0x7b, 0x4e, 0x0d, 0xc8, 0xb2, 0xe2, 0x70, 0xc5, 0x64, 0x22, 0x8c, 0x10,
	0xaa, 0x27, 0xd9, 0xa0, 0x72, 0x11, 0x22, 0xc1, 0x6c, 0x37, 0xea, 0x8e,
	0xd6, 0x07, 0x69, 0xf1, 0x5c, 0xb4, 0xad, 0x79, 0x97, 0xa0, 0x64, 0x93,
	0xf6, 0x5d, 0x88, 0x97, 0x1e, 0x9d, 0xb5, 0x90, 0x79, 0xd0, 0xc7, 0x30,
	0x8c, 0x73, 0xd1, 0x0c, 0x55, 0x75, 0xf9, 0x59, 0x05, 0xe1, 0x8a, 0xae,
	0xf2, 0x2d, 0x49, 0xf0, 0xf7, 0xc4, 0x7b, 0x45, 0x3e, 0x1b, 0xbf, 0x00,
	0x02, 0x00, 0xc4, 0xd3, 0xc9, 0x96, 0x97, 0x9b, 0x6e, 0xc7, 0xae, 0x66,
	0x0f, 0x15, 0x63, 0xa6, 0xdf, 0xe7, 0xaa, 0xac, 0x89, 0x07, 0x87, 0x69,
	0x49, 0x1e, 0x4c, 0x03, 0x65, 0x5f, 0x40, 0xaf, 0x52, 0x17, 0xb2, 0x2e,
	0xb1, 0xa0, 0x0d, 0xc5, 0x53, 0xc9, 0xfa, 0xcf, 0x1b, 0xe4, 0x9a, 0x7a,
	0x53, 0xd6, 0x93, 0x57, 0x2a, 0xce, 0x3b, 0xfb, 0x95, 0x70, 0xa2, 0x5f,
	0x33, 0xa6, 0x2e, 0x07, 0xb0, 0x1b, 0x2a, 0xf5, 0x94, 0x86, 0x4c, 0x28,
	0x20, 0x83, 0xd4, 0x3a, 0xc4, 0x37, 0xf9, 0x9c, 0xe6, 0x12, 0x2f, 0x72,
	0xef, 0x08, 0x96, 0xda, 0xb7, 0xb3, 0x0d, 0xe3, 0x85, 0x44, 0x6b, 0xfc,
	0x0a, 0x7b, 0xe2, 0x40, 0x8c, 0x7d, 0xf8, 0x5e, 0x39, 0x15, 0x82, 0x87,
	0x79, 0x4f, 0x4e, 0xdc, 0x39, 0xdf, 0xd1, 0xf6, 0x65, 0x7e, 0x75, 0x85,
	0x57, 0x12, 0x9b, 0xef, 0xe9, 0x6d, 0xa4, 0x7e, 0x90, 0x52, 0x85, 0x6d,
	0x01, 0x54, 0x8f, 0x0f, 0xd8, 0x29, 0x3c, 0xf7, 0x4d, 0xb8, 0xd7, 0x82,
	0xd9, 0x6e, 0x07, 0xbd, 0x3f, 0x7e, 0x69, 0x73, 0x4d, 0xdd, 0xec, 0x47,
	0x2c, 0x0f, 0x4b, 0xf9, 0xfe, 0xf6, 0xf9, 0xb4, 0x36, 0x67, 0xb8, 0x6c,
	0xa5, 0x1a, 0x26, 0xab, 0xf5, 0x66, 0xd3, 0x79, 0xab, 0x18, 0x8f, 0x48,
	0x9e, 0x06, 0x65, 0xfc, 0xa8, 0x09, 0xd9, 0xdf, 0xbc, 0xe7, 0x25, 0xab,
	0xf4, 0x47, 0xdb, 0x62, 0xc5, 0x02, 0x84, 0x21, 0x68, 0x02, 0xcb, 0xec,
	0x55, 0x09, 0x74, 0x7a, 0xa6, 0x66, 0x14, 0x35, 0x85, 0x89, 0x9a, 0x56,
	0x25, 0x56, 0x53, 0xcd, 0xb4, 0x3b, 0xff, 0xfe, 0xf4, 0x5e, 0x6a, 0xef,
	0x2d, 0x30, 0x21, 0x00, 0x70, 0xed, 0x6b, 0x22, 0x1f, 0xb9, 0xa7, 0x90,
	0xa5, 0xbf, 0x9d, 0x57, 0x0e, 0x20, 0xdd, 0xa7, 0xf7, 0x53, 0x3b, 0x81,
	0x0d, 0x02, 0x29, 0x73, 0x8d, 0x83, 0x5c, 0x34, 0x59, 0xe3, 0x2e, 0xae,
	0x23, 0xd2, 0x49, 0x2d, 0x92, 0x56, 0x30, 0x5b, 0x78, 0x32, 0x2d, 0xc8
};
```
