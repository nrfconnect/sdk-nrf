## tests/subsys/app_event_manager/Kconfig.sysbuild
```kconfig
#
# Copyright (c) 2025 Nordic Semiconductor
#
# SPDX-License-Identifier: LicenseRef-Nordic-5-Clause
#

config PARTITION_MANAGER
	default n if !BOARD_IS_NON_SECURE

source "share/sysbuild/Kconfig"
```

## tests/subsys/app_event_manager/testcase.yaml
```yaml
tests:
  app_event_manager.core:
    sysbuild: true
    platform_allow:
      - nrf52dk/nrf52832
      - nrf52840dk/nrf52840
      - nrf9160dk/nrf9160/ns
      - qemu_cortex_m3
    integration_platforms:
      - nrf52dk/nrf52832
      - nrf52840dk/nrf52840
      - nrf9160dk/nrf9160/ns
      - qemu_cortex_m3
    tags: app_event_manager sysbuild
  app_event_manager.size_enabled:
    sysbuild: true
    extra_args: OVERLAY_CONFIG=overlay-event_size.conf
    platform_allow:
      - nrf52dk/nrf52832
      - nrf52840dk/nrf52840
      - nrf9160dk/nrf9160/ns
      - qemu_cortex_m3
    integration_platforms:
      - nrf52dk/nrf52832
      - nrf52840dk/nrf52840
      - nrf9160dk/nrf9160/ns
      - qemu_cortex_m3
    tags: app_event_manager sysbuild
```

## tests/subsys/app_protect/testcase.yaml
```yaml
common:
  tags: ci_tests_subsys_app_protect
  harness: pytest
  harness_config:
    pytest_root:
      - "pytest/test_app_protect.py"
  platform_allow:
    - nrf52840dk/nrf52840
    - nrf5340dk/nrf5340/cpuapp
    - nrf54h20dk/nrf54h20/cpuapp
    - nrf54l15dk/nrf54l05/cpuapp
    - nrf54l15dk/nrf54l10/cpuapp
    - nrf54l15dk/nrf54l15/cpuapp
    - nrf54lm20dk/nrf54lm20a/cpuapp
    - nrf54ls05dk/nrf54ls05b/cpuapp
    - nrf54lv10dk/nrf54lv10a/cpuapp
    - nrf7120dk/nrf7120/cpuapp
  integration_platforms:
    - nrf54lm20dk/nrf54lm20a/cpuapp

tests:
  subsys.app_protect: {}
```

## tests/subsys/audio/audio_module_template/testcase.yaml
```yaml
tests:
  nrf5340_audio.audio_module_template:
    sysbuild: true
    platform_allow: qemu_cortex_m3
    integration_platforms:
      - qemu_cortex_m3
    tags:
      - audio_module
      - audio_module_template
      - nrf5340_audio_unit_tests
      - sysbuild
      - ci_tests_subsys_audio_module
```

## tests/subsys/audio_module/testcase.yaml
```yaml
tests:
  nrf5340_audio.audio_module_test:
    sysbuild: true
    platform_allow: qemu_cortex_m3
    integration_platforms:
      - qemu_cortex_m3
    tags: audio_module nrf5340_audio_unit_tests sysbuild ci_tests_subsys_audio_module
```

## tests/subsys/audio_modules/lc3_module/testcase.yaml
```yaml
tests:
  nrf5340_audio.lc3_module_test:
    sysbuild: true
    platform_allow: qemu_cortex_m3
    integration_platforms:
      - qemu_cortex_m3
    tags: lc3_module audio_module nrf5340_audio_unit_tests sysbuild
```

## tests/subsys/bluetooth/controller/testcase.yaml
```yaml
tests:
  bluetooth.controller:
    platform_allow:
      - native_sim
    integration_platforms:
      - native_sim
    tags:
      - unittest
      - ci_tests_subsys_bluetooth_controller
      - bluetooth
```

## tests/subsys/bluetooth/cs_de/testcase.yaml
```yaml
tests:
  subsys.bluetooth.cs_de:
    platform_allow:
      - native_sim
    integration_platforms:
      - native_sim
    tags:
      - unittest
      - ci_tests_subsys_bluetooth_cs_de
```

## tests/subsys/bluetooth/enocean/testcase.yaml
```yaml
tests:
  bluetooth.enocean:
    platform_allow:
      - native_sim
      - qemu_cortex_m3
    tags:
      - bluetooth
      - ci_build
      - ci_tests_subsys_bluetooth_enocean
    integration_platforms:
      - native_sim
      - qemu_cortex_m3
```

## tests/subsys/bluetooth/fast_pair/crypto/Kconfig
```kconfig
#
# Copyright (c) 2022 Nordic Semiconductor
#
# SPDX-License-Identifier: LicenseRef-Nordic-5-Clause
#

config TEST_BT_FAST_PAIR_CRYPTO_PSA
	bool "Enable PSA backend and dependencies"
	help
	  The helper Kconfig option is used by the test to enable PSA backend
	  and set proper TFM build profile. Used to avoid board-specific Kconfig
	  overlays.

if TEST_BT_FAST_PAIR_CRYPTO_PSA

choice BT_FAST_PAIR_CRYPTO_BACKEND
	default BT_FAST_PAIR_CRYPTO_PSA
endchoice

if BUILD_WITH_TFM

choice TFM_PROFILE_TYPE
	default TFM_PROFILE_TYPE_NOT_SET
	help
	  The minimal TFM build profile is not configurable and cannot be used.
endchoice

endif # BUILD_WITH_TFM

endif # TEST_BT_FAST_PAIR_CRYPTO_PSA

menu "Test configuration"
source "$(ZEPHYR_NRF_MODULE_DIR)/subsys/bluetooth/services/fast_pair/fp_crypto/Kconfig.fp_crypto"
endmenu

menu "Zephyr"
source "Kconfig.zephyr"
endmenu
```

## tests/subsys/bluetooth/fast_pair/crypto/testcase.yaml
```yaml
common:
  tags:
    - sysbuild
    - bluetooth
    - ci_tests_subsys_bluetooth_fast_pair
tests:
  fast_pair.crypto.oberon:
    sysbuild: true
    platform_allow:
      - nrf52dk/nrf52832
      - nrf52840dk/nrf52840
      - nrf5340dk/nrf5340/cpuapp
      - nrf5340dk/nrf5340/cpuapp/ns
      - nrf54l15dk/nrf54l05/cpuapp
      - nrf54l15dk/nrf54l10/cpuapp
      - nrf54l15dk/nrf54l15/cpuapp
      - nrf54lm20dk/nrf54lm20a/cpuapp
    integration_platforms:
      - nrf52dk/nrf52832
      - nrf52840dk/nrf52840
      - nrf5340dk/nrf5340/cpuapp
      - nrf5340dk/nrf5340/cpuapp/ns
      - nrf54l15dk/nrf54l05/cpuapp
      - nrf54l15dk/nrf54l10/cpuapp
      - nrf54l15dk/nrf54l15/cpuapp
      - nrf54lm20dk/nrf54lm20a/cpuapp
  fast_pair.crypto.psa:
    sysbuild: true
    platform_allow:
      - nrf52dk/nrf52832
      - nrf52840dk/nrf52840
      - nrf5340dk/nrf5340/cpuapp
      - nrf5340dk/nrf5340/cpuapp/ns
      - nrf54h20dk/nrf54h20/cpuapp
      - nrf54l15dk/nrf54l05/cpuapp
      - nrf54l15dk/nrf54l10/cpuapp
      - nrf54l15dk/nrf54l15/cpuapp
      - nrf54l15dk/nrf54l15/cpuapp/ns
      - nrf54lm20dk/nrf54lm20a/cpuapp
    integration_platforms:
      - nrf52dk/nrf52832
      - nrf52840dk/nrf52840
      - nrf5340dk/nrf5340/cpuapp
      - nrf5340dk/nrf5340/cpuapp/ns
      - nrf54h20dk/nrf54h20/cpuapp
      - nrf54l15dk/nrf54l05/cpuapp
      - nrf54l15dk/nrf54l10/cpuapp
      - nrf54l15dk/nrf54l15/cpuapp
      - nrf54l15dk/nrf54l15/cpuapp/ns
      - nrf54lm20dk/nrf54lm20a/cpuapp
    extra_args: FILE_SUFFIX=psa
```

## tests/subsys/bluetooth/fast_pair/locator_tag_legacy/Kconfig
```kconfig
#
# Copyright (c) 2026 Nordic Semiconductor
#
# SPDX-License-Identifier: LicenseRef-Nordic-5-Clause
#

menu "Nordic Fast Pair Locator tag sample"

rsource "Kconfig.dfu"
rsource "Kconfig.battery"

config SETTINGS
	default y

config ZMS
	default y if (SOC_FLASH_NRF_RRAM || SOC_FLASH_NRF_MRAM)

config NVS
	default y if !(SOC_FLASH_NRF_RRAM || SOC_FLASH_NRF_MRAM)

endmenu

source "Kconfig.zephyr"
```

## tests/subsys/bluetooth/fast_pair/locator_tag_legacy/Kconfig.battery
```kconfig
#
# Copyright (c) 2026 Nordic Semiconductor
#
# SPDX-License-Identifier: LicenseRef-Nordic-5-Clause
#

config APP_BATTERY_LEVEL_DECREMENT
	int "Battery level decrement [%] used to simulate battery level on the DK"
	range 0 100
	default 10
```

## tests/subsys/bluetooth/fast_pair/locator_tag_legacy/testcase.yaml
```yaml
common:
  tags:
    - sysbuild
    - bluetooth
    - ci_tests_subsys_bluetooth_fast_pair
tests:
  test.bluetooth.fast_pair.locator_tag_legacy.fast_pair_api_legacy.pm_legacy:
    sysbuild: true
    build_only: true
    platform_allow:
      - nrf54l15dk/nrf54l15/cpuapp
    integration_platforms:
      - nrf54l15dk/nrf54l15/cpuapp
    extra_args:
      - CONFIG_DEPRECATION_TEST=y
      - SB_CONFIG_COMPILER_WARNINGS_AS_ERRORS=n
```

## tests/subsys/bluetooth/fast_pair/storage/Kconfig
```kconfig
#
# Copyright (c) 2022 Nordic Semiconductor
#
# SPDX-License-Identifier: LicenseRef-Nordic-5-Clause
#

source "Kconfig.zephyr"

config BT_FAST_PAIR_STORAGE_ACCOUNT_KEY_MAX
	int "Maximum number of stored Account Keys"
	range 5 10
	default 5
	help
	  Maximum number of stored account keys. According to Fast Pair specification, it should be
	  at least equal to 5. It can not be larger than 10, because then Account Key Filter length
	  would not fit in the "field length and type" data field specified in the non-discoverable
	  advertising packet.

module = BT_FAST_PAIR
module-str = Fast Pair Service
source "${ZEPHYR_BASE}/subsys/logging/Kconfig.template.log_config"
```

## tests/subsys/bluetooth/fast_pair/storage/account_key_storage/Kconfig
```kconfig
#
# Copyright (c) 2022 Nordic Semiconductor
#
# SPDX-License-Identifier: LicenseRef-Nordic-5-Clause
#

config TEST_BT_FAST_PAIR_STORAGE_OWNER_ACCOUNT_KEY
	bool "Enable support for the Owner Account Key in the Storage module to be able to test it"
	select BT_FAST_PAIR_STORAGE_OWNER_ACCOUNT_KEY
	help
	  Enable support for the Owner Account Key in the Storage module to be able to test it.

menu "Test configuration"
source "$(ZEPHYR_NRF_MODULE_DIR)/subsys/bluetooth/services/fast_pair/fp_storage/Kconfig.fp_storage"
endmenu

menu "Zephyr"
source "Kconfig.zephyr"
endmenu
```

## tests/subsys/bluetooth/fast_pair/storage/account_key_storage/testcase.yaml
```yaml
tests:
  fast_pair.storage.account_key_storage.default:
    sysbuild: true
    platform_allow:
      - nrf52dk/nrf52832
      - nrf52840dk/nrf52840
      - nrf5340dk/nrf5340/cpuapp
      - nrf5340dk/nrf5340/cpuapp/ns
      - nrf54l15pdk/nrf54l15/cpuapp
      - qemu_cortex_m3
    integration_platforms:
      - nrf52dk/nrf52832
      - nrf52840dk/nrf52840
      - nrf5340dk/nrf5340/cpuapp
      - nrf5340dk/nrf5340/cpuapp/ns
      - nrf54l15pdk/nrf54l15/cpuapp
      - qemu_cortex_m3
    tags: sysbuild
  fast_pair.storage.account_key_storage.6keys:
    sysbuild: true
    platform_allow:
      - qemu_cortex_m3
    integration_platforms:
      - qemu_cortex_m3
    extra_args: CONFIG_BT_FAST_PAIR_STORAGE_ACCOUNT_KEY_MAX=6
    tags: sysbuild
  fast_pair.storage.account_key_storage.7keys:
    sysbuild: true
    platform_allow:
      - qemu_cortex_m3
    integration_platforms:
      - qemu_cortex_m3
    extra_args: CONFIG_BT_FAST_PAIR_STORAGE_ACCOUNT_KEY_MAX=7
    tags: sysbuild
  fast_pair.storage.account_key_storage.8keys:
    sysbuild: true
    platform_allow:
      - qemu_cortex_m3
    integration_platforms:
      - qemu_cortex_m3
    extra_args: CONFIG_BT_FAST_PAIR_STORAGE_ACCOUNT_KEY_MAX=8
    tags: sysbuild
  fast_pair.storage.account_key_storage.9keys:
    sysbuild: true
    platform_allow:
      - qemu_cortex_m3
    integration_platforms:
      - qemu_cortex_m3
    extra_args: CONFIG_BT_FAST_PAIR_STORAGE_ACCOUNT_KEY_MAX=9
    tags: sysbuild
  fast_pair.storage.account_key_storage.10keys:
    sysbuild: true
    platform_allow:
      - qemu_cortex_m3
    integration_platforms:
      - qemu_cortex_m3
    extra_args: CONFIG_BT_FAST_PAIR_STORAGE_ACCOUNT_KEY_MAX=10
    tags: sysbuild
  fast_pair.storage.account_key_storage.minimal:
    sysbuild: true
    platform_allow:
      - nrf52dk/nrf52832
      - nrf52840dk/nrf52840
      - nrf5340dk/nrf5340/cpuapp
      - nrf5340dk/nrf5340/cpuapp/ns
      - nrf54l15pdk/nrf54l15/cpuapp
      - qemu_cortex_m3
    integration_platforms:
      - nrf52dk/nrf52832
      - nrf52840dk/nrf52840
      - nrf5340dk/nrf5340/cpuapp
      - nrf5340dk/nrf5340/cpuapp/ns
      - nrf54l15pdk/nrf54l15/cpuapp
      - qemu_cortex_m3
    extra_args: CONFIG_TEST_BT_FAST_PAIR_STORAGE_OWNER_ACCOUNT_KEY=y
    tags: sysbuild
```

## tests/subsys/bluetooth/fast_pair/storage/factory_reset/Kconfig
```kconfig
#
# Copyright (c) 2023 Nordic Semiconductor
#
# SPDX-License-Identifier: LicenseRef-Nordic-5-Clause
#

config BT_FAST_PAIR_STORAGE_FMDN_CLOCK
	default y
	help
	  Unit test enables this option to be able to use API of the Beacon Clock used in the FMDN
	  extension.

config BT_FAST_PAIR_STORAGE_FMDN_EIK
	default y
	help
	  Unit test enables this option to be able to use API of the Ephemeral Identity Key (EIK)
	  used in the FMDN extension.

config BT_FAST_PAIR_STORAGE_PN
	default y
	help
	  Unit test enables this option to be able to use API of Personalized Name extension.

config TEST_BT_FAST_PAIR_STORAGE_OWNER_ACCOUNT_KEY
	bool "Enable support for the Owner Account Key in the Storage module to be able to test it."
	select BT_FAST_PAIR_STORAGE_OWNER_ACCOUNT_KEY
	help
	  Enable support for the Owner Account Key in the Storage module to be able to test it.

menu "Test configuration"
source "$(ZEPHYR_NRF_MODULE_DIR)/subsys/bluetooth/services/fast_pair/fp_storage/Kconfig.fp_storage"
endmenu

menu "Zephyr"
source "Kconfig.zephyr"
endmenu
```

## tests/subsys/bluetooth/fast_pair/storage/factory_reset/testcase.yaml
```yaml
tests:
  fast_pair.storage.factory_reset.default:
    sysbuild: true
    platform_exclude: native_sim
    platform_allow:
      - nrf52dk/nrf52832
      - nrf52840dk/nrf52840
      - nrf5340dk/nrf5340/cpuapp
      - nrf5340dk/nrf5340/cpuapp/ns
      - nrf54h20dk/nrf54h20/cpuapp
      - nrf54l15dk/nrf54l05/cpuapp
      - nrf54l15dk/nrf54l10/cpuapp
      - nrf54l15dk/nrf54l15/cpuapp
      - nrf54lm20dk/nrf54lm20a/cpuapp
    integration_platforms:
      - nrf52dk/nrf52832
      - nrf5340dk/nrf5340/cpuapp
      - nrf5340dk/nrf5340/cpuapp/ns
      - nrf54h20dk/nrf54h20/cpuapp
      - nrf54l15dk/nrf54l05/cpuapp
      - nrf54lm20dk/nrf54lm20a/cpuapp
    tags:
      - sysbuild
      - bluetooth
  fast_pair.storage.factory_reset.no_reboot:
    sysbuild: true
    platform_allow:
      - native_sim
      - nrf52840dk/nrf52840
    integration_platforms:
      - native_sim
      - nrf52840dk/nrf52840
    extra_args: CONFIG_REBOOT=n
    tags:
      - sysbuild
      - bluetooth
  fast_pair.storage.factory_reset.6keys:
    sysbuild: true
    platform_exclude: native_sim
    platform_allow:
      - nrf52840dk/nrf52840
    integration_platforms:
      - nrf52840dk/nrf52840
    extra_args: CONFIG_BT_FAST_PAIR_STORAGE_ACCOUNT_KEY_MAX=6
    tags:
      - sysbuild
      - bluetooth
  fast_pair.storage.factory_reset.7keys:
    sysbuild: true
    platform_exclude: native_sim
    platform_allow:
      - nrf52840dk/nrf52840
    integration_platforms:
      - nrf52840dk/nrf52840
    extra_args: CONFIG_BT_FAST_PAIR_STORAGE_ACCOUNT_KEY_MAX=7
    tags:
      - sysbuild
      - bluetooth
  fast_pair.storage.factory_reset.8keys:
    sysbuild: true
    platform_exclude: native_sim
    platform_allow:
      - nrf52840dk/nrf52840
    integration_platforms:
      - nrf52840dk/nrf52840
    extra_args: CONFIG_BT_FAST_PAIR_STORAGE_ACCOUNT_KEY_MAX=8
    tags:
      - sysbuild
      - bluetooth
  fast_pair.storage.factory_reset.9keys:
    sysbuild: true
    platform_exclude: native_sim
    platform_allow:
      - nrf52840dk/nrf52840
    integration_platforms:
      - nrf52840dk/nrf52840
    extra_args: CONFIG_BT_FAST_PAIR_STORAGE_ACCOUNT_KEY_MAX=9
    tags:
      - sysbuild
      - bluetooth
  fast_pair.storage.factory_reset.10keys:
    sysbuild: true
    platform_exclude: native_sim
    platform_allow:
      - nrf52840dk/nrf52840
    integration_platforms:
      - nrf52840dk/nrf52840
    extra_args: CONFIG_BT_FAST_PAIR_STORAGE_ACCOUNT_KEY_MAX=10
    tags:
      - sysbuild
      - bluetooth
  fast_pair.storage.factory_reset.ak_minimal_backend:
    sysbuild: true
    platform_exclude: native_sim
    platform_allow:
      - nrf52dk/nrf52832
      - nrf52840dk/nrf52840
      - nrf5340dk/nrf5340/cpuapp
      - nrf5340dk/nrf5340/cpuapp/ns
      - nrf54h20dk/nrf54h20/cpuapp
      - nrf54l15dk/nrf54l05/cpuapp
      - nrf54l15dk/nrf54l10/cpuapp
      - nrf54l15dk/nrf54l15/cpuapp
      - nrf54lm20dk/nrf54lm20a/cpuapp
    integration_platforms:
      - nrf52dk/nrf52832
      - nrf5340dk/nrf5340/cpuapp
      - nrf5340dk/nrf5340/cpuapp/ns
      - nrf54h20dk/nrf54h20/cpuapp
      - nrf54l15dk/nrf54l05/cpuapp
      - nrf54lm20dk/nrf54lm20a/cpuapp
    extra_args: CONFIG_TEST_BT_FAST_PAIR_STORAGE_OWNER_ACCOUNT_KEY=y
    tags:
      - sysbuild
      - bluetooth
  fast_pair.storage.factory_reset.ak_minimal_backend_no_reboot:
    sysbuild: true
    platform_allow:
      - native_sim
      - nrf52840dk/nrf52840
    integration_platforms:
      - native_sim
      - nrf52840dk/nrf52840
    extra_args:
      - CONFIG_TEST_BT_FAST_PAIR_STORAGE_OWNER_ACCOUNT_KEY=y
      - CONFIG_REBOOT=n
    tags:
      - sysbuild
      - bluetooth
```
