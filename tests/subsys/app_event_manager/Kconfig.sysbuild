## tests/subsys/bluetooth/mesh/light_ctrl/testcase.yaml
```yaml
tests:
  bluetooth.mesh.nlc_lightness_controller:
    sysbuild: true
    platform_allow:
      - native_sim
    tags:
      - bluetooth
      - ci_build
      - sysbuild
    integration_platforms:
      - native_sim
```

## tests/subsys/bluetooth/mesh/light_hue/boards/native_sim.conf
```kconfig
# nrf_security only supports Cortex-M via PSA crypto libraries.
# Enable Mbed TLS for native simulator.
CONFIG_MBEDTLS=y
```

## tests/subsys/bluetooth/mesh/light_hue/testcase.yaml
```yaml
tests:
  bluetooth.mesh.light_hue:
    sysbuild: true
    platform_allow:
      - native_sim
    tags:
      - bluetooth
      - ci_build
      - sysbuild
    integration_platforms:
      - native_sim
```

## tests/subsys/bluetooth/mesh/metadata_extraction/Kconfig
```kconfig
choice COMP_DATA_LAYOUT
	prompt "Composition data layout"
	default COMP_DATA_LAYOUT_SINGLE

config COMP_DATA_LAYOUT_SINGLE
	bool "Single composition data"

config COMP_DATA_LAYOUT_MULTIPLE
	bool "Multiple composition data as separate variables"

config COMP_DATA_LAYOUT_ARRAY
	bool "Multiple composition data as an array"

endchoice

source "Kconfig.zephyr"
```

## tests/subsys/bluetooth/mesh/metadata_extraction/Kconfig.sysbuild
```kconfig
choice COMP_DATA_LAYOUT
	prompt "Composition data layout"
	default COMP_DATA_LAYOUT_SINGLE

config COMP_DATA_LAYOUT_SINGLE
	bool "Single composition data"

config COMP_DATA_LAYOUT_MULTIPLE
	bool "Multiple composition data as separate variables"

config COMP_DATA_LAYOUT_ARRAY
	bool "Multiple composition data as an array"

endchoice

source "${ZEPHYR_BASE}/share/sysbuild/Kconfig"
```

## tests/subsys/bluetooth/mesh/metadata_extraction/testcase.yaml
```yaml
common:
  build_only: true
  platform_allow: nrf52840dk/nrf52840
  tags: bluetooth ci_build
  integration_platforms:
    - nrf52840dk/nrf52840
tests:
  bluetooth.mesh.metadata_extraction_single:
    sysbuild: true
    tags: sysbuild
    extra_args:
      - SB_CONFIG_COMP_DATA_LAYOUT_SINGLE=y
  bluetooth.mesh.metadata_extraction_multiple:
    sysbuild: true
    tags: sysbuild
    extra_args:
      - SB_CONFIG_COMP_DATA_LAYOUT_MULTIPLE=y
  bluetooth.mesh.metadata_extraction_array:
    sysbuild: true
    tags: sysbuild
    extra_args:
      - SB_CONFIG_COMP_DATA_LAYOUT_ARRAY=y
  bluetooth.mesh.metadata_extraction_single_lto:
    sysbuild: true
    tags: sysbuild
    extra_args:
      - SB_CONFIG_COMP_DATA_LAYOUT_SINGLE=y
    extra_configs:
      - CONFIG_ISR_TABLES_LOCAL_DECLARATION=y
      - CONFIG_LTO=y
```
