## tests/subsys/net/lib/lwm2m_client_utils/testcase.yaml
```yaml
tests:
  subsys.net.lib.lwm2m_client_utils.unittest:
    sysbuild: true
    tags: unittest sysbuild ci_tests_subsys_net
    platform_allow: native_sim
    integration_platforms:
      - native_sim
```

## tests/subsys/net/lib/lwm2m_fota_utils/testcase.yaml
```yaml
tests:
  subsys.net.lib.lwm2m_fota_utils.unittest_adv:
    sysbuild: true
    tags: unittest sysbuild
    platform_allow: native_sim
    integration_platforms:
      - native_sim
  subsys.net.lib.lwm2m_fota_utils.unittest_obj5:
    sysbuild: true
    extra_args: FILE_SUFFIX=obj5
    tags: unittest sysbuild
    platform_allow: native_sim
    integration_platforms:
      - native_sim
```

## tests/subsys/net/lib/mcumgr_smp_client/testcase.yaml
```yaml
tests:
  subsys.net.lib.mcumgr_smp_client.unittest:
    sysbuild: true
    platform_allow: native_sim
    integration_platforms:
      - native_sim
    tags:
      - unittest
      - sysbuild
      - ci_tests_subsys_net
```

## tests/subsys/net/lib/nrf_cloud/client_id/testcase.yaml
```yaml
common:
  platform_allow: nrf9160dk/nrf9160/ns
  integration_platforms:
    - nrf9160dk/nrf9160/ns
  tags:
    - ci_build
    - nrf_cloud_test
    - nrf_cloud_lib
    - ci_tests_subsys_net
tests:
  net.lib.nrf_cloud.client_id.imei:
    sysbuild: true
    timeout: 60
    extra_args:
      - CONFIG_NRF_CLOUD_CLIENT_ID_SRC_IMEI=y
    tags:
      - sysbuild
      - ci_tests_subsys_net
  net.lib.nrf_cloud.client_id.runtime:
    sysbuild: true
    timeout: 60
    extra_args:
      - CONFIG_NRF_CLOUD_CLIENT_ID_SRC_IMEI=n
      - CONFIG_NRF_CLOUD_CLIENT_ID_SRC_RUNTIME=y
    tags:
      - sysbuild
      - ci_tests_subsys_net
  net.lib.nrf_cloud.client_id.uuid:
    sysbuild: true
    timeout: 60
    extra_args:
      - CONFIG_NRF_CLOUD_CLIENT_ID_SRC_IMEI=n
      - CONFIG_NRF_CLOUD_CLIENT_ID_SRC_INTERNAL_UUID=y
      - CONFIG_MODEM_JWT=y
    tags:
      - sysbuild
      - ci_tests_subsys_net
  net.lib.nrf_cloud.client_id.hwid:
    sysbuild: true
    timeout: 60
    extra_args:
      - CONFIG_NRF_CLOUD_CLIENT_ID_SRC_IMEI=n
      - CONFIG_NRF_CLOUD_CLIENT_ID_SRC_HW_ID=y
      - CONFIG_HW_ID_LIBRARY=y
    tags:
      - sysbuild
      - ci_tests_subsys_net
  net.lib.nrf_cloud.client_id.comptime:
    sysbuild: true
    timeout: 60
    extra_args:
      - CONFIG_NRF_CLOUD_CLIENT_ID_SRC_IMEI=n
      - CONFIG_NRF_CLOUD_CLIENT_ID_SRC_COMPILE_TIME=y
    tags:
      - sysbuild
      - ci_tests_subsys_net
```

## tests/subsys/net/lib/nrf_cloud/cloud/boards/qemu_cortex_m3.conf
```kconfig
#
# Copyright (c) 2023 Nordic Semiconductor
#
# SPDX-License-Identifier: LicenseRef-Nordic-5-Clause
#

# Disable networking
CONFIG_NETWORKING=n

# For the unit test to run in qemu_cortex_m3,
# we need the following KConfig values to be set.
# See https://github.com/zephyrproject-rtos/zephyr/issues/15565
CONFIG_ENTROPY_GENERATOR=y
CONFIG_TEST_RANDOM_GENERATOR=y
```

## tests/subsys/net/lib/nrf_cloud/cloud/testcase.yaml
```yaml
tests:
  net.lib.nrf_cloud.cloud:
    sysbuild: true
    platform_allow: nrf9160dk/nrf9160/ns native_posix qemu_cortex_m3
    integration_platforms:
      - nrf9160dk/nrf9160/ns
      - native_posix
      - qemu_cortex_m3
    tags: nrf_cloud_test nrf_cloud_lib sysbuild
    timeout: 90
```

## tests/subsys/net/lib/nrf_cloud/codec/cbor/Kconfig
```kconfig
#
# Copyright (c) 2026 Nordic Semiconductor ASA
#
# SPDX-License-Identifier: LicenseRef-Nordic-5-Clause
#

# NRF_CLOUD_LOG_LEVEL and NRF_CLOUD_COAP_LOG_LEVEL are generated by
# Kconfig.template.log_config inside "if NRF_CLOUD" / "if NRF_CLOUD_COAP"
# blocks, so they do not exist in the Kconfig tree on native_sim.
# Defining them here makes them available without conflict.

config NRF_CLOUD_LOG_LEVEL
	default 0

config NRF_CLOUD_COAP_LOG_LEVEL
	default 0

# Enable AGNSS and PGPS so the corresponding code paths in
# nrf_cloud_coap_codec.c (guarded by these CONFIG_* symbols) are
# compiled into the test binary.  The actual library .c files that
# would be pulled in by these symbols are excluded from the build via
# HEADER_FILE_ONLY in CMakeLists.txt; the codec sources are added
# explicitly there.
config NRF_CLOUD_AGNSS
	default y

config NRF_CLOUD_PGPS
	default y

source "Kconfig.zephyr"
```

## tests/subsys/net/lib/nrf_cloud/codec/cbor/boards/qemu_cortex_m3.conf
```kconfig
#
# Copyright (c) 2026 Nordic Semiconductor
#
# SPDX-License-Identifier: LicenseRef-Nordic-5-Clause
#

# qemu_cortex_m3 does not support the networking stack
CONFIG_NETWORKING=n

# coap_codec_ground_fix_req_encode() allocates a ~2.4 kB struct ground_fix_req
# on the stack.  The default ZTEST_STACK_SIZE on ARM (1024 B) is too small and
# causes a stack overflow leading to a kernel panic.
CONFIG_ZTEST_STACK_SIZE=4096

# Required for the test to run in qemu_cortex_m3
# See https://github.com/zephyrproject-rtos/zephyr/issues/15565
CONFIG_ENTROPY_GENERATOR=y
CONFIG_TEST_RANDOM_GENERATOR=y
```

## tests/subsys/net/lib/nrf_cloud/codec/json/Kconfig
```kconfig
#
# Copyright (c) 2026 Nordic Semiconductor ASA
#
# SPDX-License-Identifier: LicenseRef-Nordic-5-Clause
#

# NRF_CLOUD_LOG_LEVEL is normally generated by the Kconfig log_config template
# and depends on LOG being enabled. In this minimal test config LOG is not
# enabled, so the symbol is invisible.
config NRF_CLOUD_LOG_LEVEL
	default 4

source "Kconfig.zephyr"
```

## tests/subsys/net/lib/nrf_cloud/codec/shadow/boards/qemu_cortex_m3.conf
```kconfig
#
# Copyright (c) 2026 Nordic Semiconductor
#
# SPDX-License-Identifier: LicenseRef-Nordic-5-Clause
#

# qemu_cortex_m3 does not support the networking stack
CONFIG_NETWORKING=n

# Required for the test to run in qemu_cortex_m3
# See https://github.com/zephyrproject-rtos/zephyr/issues/15565
CONFIG_ENTROPY_GENERATOR=y
CONFIG_TEST_RANDOM_GENERATOR=y
```

## tests/subsys/net/lib/nrf_cloud/fota_common/testcase.yaml
```yaml
common:
  platform_allow: nrf9160dk/nrf9160/ns
  integration_platforms:
    - nrf9160dk/nrf9160/ns
  tags: ci_build nrf_cloud_test nrf_cloud_lib
tests:
  net.lib.nrf_cloud.fota_common:
    sysbuild: true
    timeout: 60
    extra_args:
      # CONFIG_NRF_CLOUD_FOTA and CONFIG_FOTA_DOWNLOAD are implicitly enabled
      # in the prj.conf with CONFIG_NRF_CLOUD_MQTT=y
      - CONFIG_MCUBOOT_IMG_MANAGER=y
      - CONFIG_BOOTLOADER_MCUBOOT=y
      - CONFIG_IMG_MANAGER=y
      - CONFIG_STREAM_FLASH_ERASE=y
      - CONFIG_NRF_CLOUD_FOTA_FULL_MODEM_UPDATE=y
      - SB_CONFIG_BOOTLOADER_MCUBOOT=y
    tags: sysbuild
  net.lib.nrf_cloud.fota_common.no_img_mngr:
    sysbuild: true
    timeout: 60
    extra_configs:
      - CONFIG_NRF_CLOUD_FOTA=n
      - CONFIG_FOTA_DOWNLOAD=n
      - CONFIG_NRF_CLOUD_REST=n
      - CONFIG_MCUBOOT_IMG_MANAGER=n
      - CONFIG_IMG_MANAGER=n
      - CONFIG_STREAM_FLASH_ERASE=n
    tags: sysbuild
```

## tests/subsys/net/lib/nrf_cloud/nrf_cloud_init_uninit/testcase.yaml
```yaml
tests:
  net.lib.nrf_cloud.nrf_cloud_init_uninit:
    platform_allow: nrf9160dk_nrf9160_ns
    integration_platforms:
      - nrf9160dk_nrf9160_ns
    tags: nrf_cloud_test nrf_cloud_lib
```

## tests/subsys/net/lib/nrf_cloud/testcase.yaml
```yaml
tests:
  nrf_cloud.nrf_cloud_init:
    platform_allow: nrf9160dk_nrf9160_ns
    integration_platforms:
      - nrf9160dk_nrf9160_ns
    tags: cia_nightly nrf_cloud_test_init
```

## tests/subsys/net/lib/nrf_provisioning/Kconfig
```kconfig
#
# Copyright (c) 2025 Nordic Semiconductor ASA
#
# SPDX-License-Identifier: LicenseRef-Nordic-5-Clause
#

menuconfig NRF_PROVISIONING
	bool "nRF Provisioning"
	select EXPERIMENTAL
	#depends on NRF_MODEM_LIB
	depends on SETTINGS
	imply FCB
	help
	  Redefinition to disable modemlib requirement from the tests as we want to mock it.

menuconfig NRF_PROVISIONING_CODEC
	bool "nRF Provisioning codec"
	select EXPERIMENTAL
	#depends on NRF_MODEM_LIB
	help
	  Redefinition to disable modemlib requirement from the tests as we want to mock it.

menu "Zephyr Kernel"
source "Kconfig.zephyr"
endmenu
```

## tests/subsys/net/lib/nrf_provisioning/testcase.yaml
```yaml
tests:
  nrf_provisioning.unittest_jwt:
    sysbuild: true
    extra_args: FILE_SUFFIX=jwt
    platform_allow: native_posix native_sim
    integration_platforms:
      - native_sim
    tags: unittest sysbuild ci_tests_subsys_net
  nrf_provisioning.unittest_http:
    sysbuild: true
    platform_allow: native_posix native_sim
    integration_platforms:
      - native_sim
    tags: unittest sysbuild ci_tests_subsys_net
  nrf_provisioning.unittest_coap:
    sysbuild: true
    extra_args: FILE_SUFFIX=coap
    platform_allow: native_posix native_sim
    integration_platforms:
      - native_sim
    tags: unittest sysbuild ci_tests_subsys_net
```

## tests/subsys/net/lib/tls_credentials_nrf_modem/testcase.yaml
```yaml
tests:
  net.lib.tls_credentials:
    platform_allow: native_sim
    integration_platforms:
      - native_sim
    tags:
      - ci_tests_subsys_net
```

## tests/subsys/net/lib/wifi_credentials/testcase.yaml
```yaml
tests:
  net.lib.wifi_credentials:
    sysbuild: true
    platform_allow: native_posix
    integration_platforms:
      - native_posix
    tags: sysbuild
```

## tests/subsys/net/lib/wifi_credentials_backend_psa/testcase.yaml
```yaml
tests:
  net.lib.wifi_credentials_backend_psa:
    sysbuild: true
    platform_allow: native_sim
    integration_platforms:
      - native_sim
    tags:
      - sysbuild
      - ci_tests_subsys_net
```

## tests/subsys/net/lib/wifi_credentials_backend_settings/testcase.yaml
```yaml
tests:
  net.lib.wifi_credentials_backend_settings:
    sysbuild: true
    platform_allow: native_sim
    integration_platforms:
      - native_sim
    tags:
      - sysbuild
      - ci_tests_subsys_net
```

## tests/subsys/net/openthread/rpc/client/ctrl/testcase.yaml
```yaml
tests:
  net.openthread.rpc.client.ctrl:
    sysbuild: true
    platform_allow: native_sim
    tags: openthread ci_build sysbuild ci_tests_subsys_net_openthread
    integration_platforms:
      - native_sim
```

## tests/subsys/net/openthread/rpc/client/testcase.yaml
```yaml
tests:
  net.openthread.rpc.client:
    sysbuild: true
    platform_allow: native_sim
    tags: openthread ci_build sysbuild ci_tests_subsys_net_openthread
    integration_platforms:
      - native_sim
```

## tests/subsys/net/openthread/rpc/server/Kconfig
```kconfig
menu "Zephyr Kernel"
source "Kconfig.zephyr"
endmenu

config OPENTHREAD_MESH_DIAG
	bool "Mesh diagnostics"
	default y
```

## tests/subsys/net/openthread/rpc/server/commissioning/testcase.yaml
```yaml
tests:
  net.openthread.rpc.server.commissioning:
    sysbuild: true
    platform_allow: native_sim
    tags: openthread ci_build sysbuild
    integration_platforms:
      - native_sim
```

## tests/subsys/net/openthread/rpc/server/ctrl/testcase.yaml
```yaml
tests:
  net.openthread.rpc.server.ctrl:
    sysbuild: true
    platform_allow: native_sim
    tags: openthread ci_build sysbuild
    integration_platforms:
      - native_sim
```

## tests/subsys/net/openthread/rpc/server/testcase.yaml
```yaml
tests:
  net.openthread.rpc.server:
    sysbuild: true
    platform_allow: native_sim
    tags: openthread ci_build sysbuild ci_tests_subsys_net_openthread
    integration_platforms:
      - native_sim
```
