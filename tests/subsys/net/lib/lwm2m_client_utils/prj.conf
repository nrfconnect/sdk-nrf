## CMakeLists.txt
```
#
# Copyright (c) 2022 Nordic Semiconductor ASA
#
# SPDX-License-Identifier: LicenseRef-Nordic-5-Clause
#

cmake_minimum_required(VERSION 3.20.0)
find_package(Zephyr REQUIRED HINTS $ENV{ZEPHYR_BASE})
project(lwm2m_client_unittest)

FILE(GLOB app_sources src/*.c)
target_sources(app
  PRIVATE
    ${app_sources}
    ${ZEPHYR_BASE}/subsys/net/lib/lwm2m/lwm2m_util.c
)
zephyr_linker_sources(SECTIONS src/iterables.ld)

set(options
  -DCONFIG_LWM2M_ENGINE_MAX_PENDING=5
  -DCONFIG_LWM2M_ENGINE_MAX_REPLIES=5
  -DCONFIG_LWM2M_ENGINE_VALIDATION_BUFFER_SIZE=100
  -DCONFIG_LWM2M_DTLS_SUPPORT
  -DCONFIG_LWM2M_COAP_BLOCK_SIZE=512
  -DCONFIG_LWM2M_COAP_MAX_MSG_SIZE=512
  -DCONFIG_LWM2M_ENGINE_MESSAGE_HEADER_SIZE=10
  -DCONFIG_LWM2M_RD_CLIENT_SUPPORT_BOOTSTRAP
  -DCONFIG_LWM2M_CLIENT_UTILS_NEIGHBOUR_CELL_LISTENER
  -DCONFIG_LWM2M_CLIENT_UTILS_CONN_MON_OBJ_SUPPORT
  -DCONFIG_LWM2M_CLIENT_UTILS_SIGNAL_MEAS_INFO_OBJ_SUPPORT
  -DCONFIG_LTE_LC_TAU_PRE_WARNING_NOTIFICATIONS
  -DCONFIG_LTE_PSM_REQ_RPTAU="10101010"
  -DCONFIG_LTE_PSM_REQ_RAT="00001111"
  -DCONFIG_LTE_EDRX_REQ_VALUE_LTE_M="0001"
  -DCONFIG_LTE_PTW_VALUE_LTE_M="0000"
  -DCONFIG_DOWNLOADER_STACK_SIZE=4096
  -DCONFIG_DOWNLOADER_MAX_HOSTNAME_SIZE=128
  -DCONFIG_DOWNLOADER_MAX_FILENAME_SIZE=128
  -DCONFIG_DOWNLOADER_TRANSPORT_PARAMS_SIZE=256
  -DCONFIG_LWM2M_FIRMWARE_UPDATE_OBJ_SUPPORT
  -DCONFIG_LWM2M_FIRMWARE_UPDATE_PULL_SUPPORT
  -DCONFIG_DFU_TARGET_MCUBOOT
  -DCONFIG_FOTA_DOWNLOAD_MCUBOOT_FLASH_BUF_SZ=512
  -DCONFIG_LTE_PTW_VALUE_NBIOT="0000"
  -DCONFIG_LTE_EDRX_REQ_VALUE_NBIOT="0010"
  -DCONFIG_NET_MGMT_EVENT_INFO
  -DCONFIG_NET_MGMT_EVENT
  -DCONFIG_LWM2M_CLIENT_UTILS_RAI
  -DCONFIG_LWM2M_ENGINE_DEFAULT_LIFETIME=43200
  -DCONFIG_LWM2M_CLIENT_UTILS_DTLS_CON_MANAGEMENT
  -DCONFIG_LTE_LC_EDRX_MODULE=1
  -DCONFIG_LTE_LC_NEIGHBOR_CELL_MEAS_MODULE=1
  -DCONFIG_LTE_LC_PSM_MODULE=1
  -DCONFIG_LTE_LC_TAU_PRE_WARNING_MODULE=1
  -DCONFIG_LTE_LC_NETWORK_REGISTRATION_MODULE=1
)

target_compile_options(app
  PRIVATE
  ${options}
)
target_compile_options(..__nrf__subsys__net__lib__lwm2m_client_utils
  PRIVATE
  ${options}
)

set(includes
"${ZEPHYR_BASE}/subsys/net/lib/lwm2m/"
"${ZEPHYR_BASE}/../nrfxlib/nrf_modem/include/"
"${ZEPHYR_BASE}/../modules/lib/cjson/"
"${ZEPHYR_BASE}/../nrf/subsys/net/lib/nrf_cloud/common/include/"
"${ZEPHYR_BASE}/../nrf/subsys/net/lib/fota_download/include/"
"src/"
)

target_include_directories(..__nrf__subsys__net__lib__lwm2m_client_utils
  PRIVATE
  ${includes}
)

target_include_directories(app
  PRIVATE
  ${includes}
)
```

## prj.conf
```kconfig
#
# Copyright (c) 2022-2023 Nordic Semiconductor ASA
#
# SPDX-License-Identifier: LicenseRef-Nordic-5-Clause
#

CONFIG_ZTEST=y
# Ineffective here: EXTERNAL_LIBC wins this choice, so NEWLIB_LIBC cannot be selected.
# CONFIG_NEWLIB_LIBC=y
CONFIG_HEAP_MEM_POOL_SIZE=16384
CONFIG_LWM2M_CLIENT_UTILS=y
CONFIG_LWM2M_CLIENT_UTILS_FIRMWARE_UPDATE_OBJ_SUPPORT=y
CONFIG_LWM2M_CLIENT_UTILS_CONN_MON_OBJ_SUPPORT=y
CONFIG_LWM2M_CLIENT_UTILS_LOCATION_OBJ_SUPPORT=n
CONFIG_LWM2M_CLIENT_UTILS_CELL_CONN_OBJ_SUPPORT=y
CONFIG_LWM2M_CLIENT_UTILS_SIGNAL_MEAS_INFO_OBJ_SUPPORT=y
CONFIG_LWM2M_CLIENT_UTILS_GROUND_FIX_OBJ_SUPPORT=y
CONFIG_LWM2M_CLIENT_UTILS_GNSS_ASSIST_OBJ_SUPPORT=y
CONFIG_LWM2M_CLIENT_UTILS_LOCATION_ASSIST_CELL=y
CONFIG_LWM2M_CLIENT_UTILS_LOCATION_ASSIST_AGNSS=y
CONFIG_LWM2M_CLIENT_UTILS_LOCATION_ASSIST_PGPS=y
CONFIG_LWM2M_CELL_CONN_OBJ_VERSION_1_1=y
CONFIG_LWM2M_CLIENT_UTILS_BOOTSTRAP_TLS_TAG=100
CONFIG_LWM2M_CLIENT_UTILS_SERVER_TLS_TAG=200
CONFIG_LWM2M_CLIENT_UTILS_SERVER="coaps://server.example.com:5684"
CONFIG_LWM2M_CONN_HOLD_TIME_RSRP=5
CONFIG_LWM2M_CLIENT_UTILS_WIFI_AP_SCANNER=y
CONFIG_LWM2M_CLIENT_UTILS_VISIBLE_WIFI_AP_OBJ_SUPPORT=y
CONFIG_LWM2M_CLIENT_UTILS_LTE_CONNEVAL=y
```

## boards/native_sim.overlay
```dts
/* Copyright (c) 2024 Nordic Semiconductor ASA
 *
 * SPDX-License-Identifier: LicenseRef-Nordic-5-Clause
 */

/ {
    nordic_wlan0: nordic_wlan0 {
        compatible = "nordic,wlan0";
        status = "okay";
    };

    chosen {
        zephyr,wifi = &nordic_wlan0;
    };
};
```

## src/cellconn.c
```c
/*
 * Copyright (c) 2022 Nordic Semiconductor ASA
 *
 * SPDX-License-Identifier: LicenseRef-Nordic-5-Clause
 */

#include <zephyr/ztest.h>
#include <zephyr/fff.h>

#include <net/lwm2m_client_utils.h>
#include <modem/lte_lc.h>
#include "stubs.h"
#include "lwm2m_object.h"
#include "lwm2m_engine.h"

static int copy_uri_write_cb(const struct lwm2m_obj_path *path, lwm2m_engine_set_data_cb_t cb);

static lwm2m_engine_set_data_cb_t set_uri_cb;
static lwm2m_engine_set_data_cb_t set_uri_cb_psm;
static lwm2m_engine_set_data_cb_t set_uri_cb_active_time;
static lwm2m_engine_set_data_cb_t set_uri_cb_edrx;
static lwm2m_engine_set_data_cb_t set_uri_cb_psm_update;
static lwm2m_engine_set_data_cb_t set_uri_cb_rai;

static void setup(void)
{
	/* Register resets */
	DO_FOREACH_FAKE(RESET_FAKE);

	/* reset common FFF internal structures */
	FFF_RESET_HISTORY();

	lwm2m_register_post_write_callback_fake.custom_fake = copy_uri_write_cb;
	call_lwm2m_init_callbacks();
}

static int copy_uri_write_cb(const struct lwm2m_obj_path *path, lwm2m_engine_set_data_cb_t cb)
{
	if (path->obj_id == 10 && path->obj_inst_id == 0 && path->res_id == 1) {
		set_uri_cb = cb;
	} else if (path->obj_id == 10 && path->obj_inst_id == 0 && path->res_id == 4) {
		set_uri_cb_psm = cb;
	} else if (path->obj_id == 10 && path->obj_inst_id == 0 && path->res_id == 5) {
		set_uri_cb_active_time = cb;
	} else if (path->obj_id == 10 && path->obj_inst_id == 0 && path->res_id == 8) {
		set_uri_cb_edrx = cb;
	} else if (path->obj_id == 10 && path->obj_inst_id == 0 && path->res_id == 13) {
		set_uri_cb_psm_update = cb;
	} else if (path->obj_id == 10 && path->obj_inst_id == 0 && path->res_id == 14) {
		set_uri_cb_rai = cb;
	}

	return 0;
}

ZTEST_SUITE(lwm2m_client_utils_cellconn, NULL, NULL, NULL, NULL, NULL);

ZTEST(lwm2m_client_utils_cellconn, test_disable_radio_period_cb)
{
	int rc;
	uint16_t period = 1;

	setup();

	rc = set_uri_cb(10, 0, 1, (uint8_t *)&period, sizeof(period), true, sizeof(period), 0);
	zassert_equal(rc, 0, "Wrong return value");
	k_sleep(K_SECONDS(70)); /* Wait for timer */
}

ZTEST(lwm2m_client_utils_cellconn, test_psm_time_cb)
{
	int rc;
	int32_t time = 1115999;

	setup();

	rc = set_uri_cb_psm(10, 0, 4, (uint8_t *)&time, sizeof(time), true, sizeof(time), 0);
	zassert_equal(rc, 0, "Wrong return value");
}

ZTEST(lwm2m_client_utils_cellconn, test_active_time_cb)
{
	int rc;
	int32_t time = 30;

	setup();

	rc = set_uri_cb_active_time(10, 0, 5, (uint8_t *)&time, sizeof(time),
				    true, sizeof(time), 0);
	zassert_equal(rc, 0, "Wrong return value");
}

ZTEST(lwm2m_client_utils_cellconn, test_edrx_update_cb)
{
	int rc;
	uint8_t data = 0x32;

	setup();

	rc = set_uri_cb_edrx(10, 0, 8, &data, sizeof(data), true, sizeof(data), 0);
	zassert_equal(rc, 0, "Wrong return value");
}

ZTEST(lwm2m_client_utils_cellconn, test_active_psm_update_cb)
{
	int rc;
	uint8_t psm = 3;

	setup();

	rc = set_uri_cb_psm_update(10, 0, 13, &psm, sizeof(psm), true, sizeof(psm), 0);
	zassert_equal(rc, 0, "Wrong return value");
}

ZTEST(lwm2m_client_utils_cellconn, test_rai_update_cb)
{
	int rc;
	uint8_t rai = 2;

	setup();

	rc = set_uri_cb_rai(10, 0, 14, &rai, sizeof(rai), true, sizeof(rai), 0);
	zassert_equal(rc, 0, "Wrong return value");
	rai = 6;
	rc = set_uri_cb_rai(10, 0, 14, &rai, sizeof(rai), true, sizeof(rai), 0);
	zassert_equal(rc, -ENOTSUP, "Wrong return value");
	rai = 7;
	rc = set_uri_cb_rai(10, 0, 14, &rai, sizeof(rai), true, sizeof(rai), 0);
	zassert_equal(rc, -EINVAL, "Wrong return value");
}

ZTEST(lwm2m_client_utils_cellconn, test_psm_update)
{
	struct lte_lc_evt evt = {0};

	setup();

	evt.type = LTE_LC_EVT_PSM_UPDATE;
	evt.psm_cfg.tau = 600;
	evt.psm_cfg.active_time = 30;
	call_lte_handlers(&evt);
	zassert_equal(lwm2m_notify_observer_fake.call_count, 3,
		      "Incorrect number of lwm2m_notify_observer() calls");
}

ZTEST(lwm2m_client_utils_cellconn, test_edrx_update)
{
	struct lte_lc_evt evt = {0};

	setup();

	evt.type = LTE_LC_EVT_LTE_MODE_UPDATE;
	evt.lte_mode = LTE_LC_LTE_MODE_LTEM;
	call_lte_handlers(&evt);

	evt.type = LTE_LC_EVT_EDRX_UPDATE;
	evt.edrx_cfg.edrx = 20;
	evt.edrx_cfg.mode = LTE_LC_LTE_MODE_LTEM;
	call_lte_handlers(&evt);
	evt.edrx_cfg.mode = LTE_LC_LTE_MODE_NBIOT;
	call_lte_handlers(&evt);
	zassert_equal(lwm2m_notify_observer_fake.call_count, 3,
		      "Incorrect number of lwm2m_notify_observer() calls");
}
```

## src/common.c
```c
/*
 * Copyright (c) 2022 Nordic Semiconductor ASA
 *
 * SPDX-License-Identifier: LicenseRef-Nordic-5-Clause
 */

#include <zephyr/ztest.h>
#include <zephyr/fff.h>

#include <net/lwm2m_client_utils.h>
#include <modem/modem_key_mgmt.h>
#include <modem/lte_lc.h>
#include <modem/modem_info.h>
#include <zephyr/settings/settings.h>
#include <modem/modem_info.h>

#include "stubs.h"
#include "lwm2m_object.h"

static rsrp_cb_t modem_info_rsrp_cb;

static uint8_t con_mon_mode;

static int8_t modem_rsp_resource;

static enum lte_lc_lte_mode lte_mode;

ZTEST_SUITE(lwm2m_client_utils_common, NULL, NULL, NULL, NULL, NULL);

static int modem_info_rsrp_register_copy(rsrp_cb_t cb)
{
	modem_info_rsrp_cb = cb;
	return 0;
}

static int lwm2m_engine_set_s8_copy(const char *pathstr, int8_t value)
{
	if (strcmp(pathstr, "4/0/2") == 0) {
		modem_rsp_resource = value;
	}
	return 0;
}

static int lwm2m_engine_set_u8_copy(const char *pathstr, uint8_t value)
{
	if (strcmp(pathstr, "4/0/0") == 0) {
		con_mon_mode = value;
	}
	return 0;
}

static int lte_lc_lte_mode_get_copy(enum lte_lc_lte_mode *mode)
{
	*mode = lte_mode;
	return 0;
}

static void test_common_update(uint8_t test_con_mon_mode)
{
	int rc;

	rc = lwm2m_update_connmon();
	zassert_equal(rc, modem_info_rsrp_register_fake.return_val, "wrong return value");
	k_sleep(K_MSEC(100));
	zassert_equal(con_mon_mode, test_con_mon_mode, "wrong con mode value");
}

static void test_signal_update_feed(char rsrp_value)
{
	modem_info_rsrp_cb(rsrp_value);
	k_sleep(K_MSEC(100));
}

static void setup(void)
{
	/* Register resets */
	DO_FOREACH_FAKE(RESET_FAKE);

	/* reset common FFF internal structures */
	FFF_RESET_HISTORY();
	/* Clear Custom fake functions */
	lte_lc_lte_mode_get_fake.custom_fake = NULL;
	lwm2m_engine_set_s8_fake.custom_fake = NULL;
	lwm2m_engine_set_u8_fake.custom_fake = NULL;
	modem_info_rsrp_register_fake.custom_fake = NULL;
	/* Clear Custom fake states */
	modem_info_rsrp_cb = NULL;
	con_mon_mode = 0;
	modem_rsp_resource = 0;
	lte_mode = LTE_LC_LTE_MODE_NONE;
}

/*
 * Tests for initializing the module and setting the credentials
 */

ZTEST(lwm2m_client_utils_common, test_init_conmon_fails)
{
	int rc;

	setup();
	/* First, test if settings fail */
	modem_info_init_fake.return_val = -1;
	rc = lwm2m_init_connmon();
	zassert_equal(rc, modem_info_init_fake.return_val, "wrong return value");
	modem_info_init_fake.return_val = 0;
	rc = lwm2m_init_connmon();
	zassert_equal(rc, modem_info_init_fake.return_val, "wrong return value");
}

/*
 * Tests for initializing the module and setting the credentials
 */

ZTEST(lwm2m_client_utils_common, test_update_commands)
{
	setup();
	/* First, test if settings fail */
	modem_info_rsrp_register_fake.return_val = -1;

	modem_info_params_get_fake.return_val = -1;
	lte_lc_lte_mode_get_fake.return_val = -1;
	test_common_update(0);
	modem_info_params_get_fake.return_val = 0;
	test_common_update(0);
	/* All return OK but no update */
	lte_lc_lte_mode_get_fake.return_val = 0;
	lte_lc_lte_mode_get_fake.custom_fake = lte_lc_lte_mode_get_copy;
	lwm2m_engine_set_u8_fake.custom_fake = lwm2m_engine_set_u8_copy;
	modem_info_rsrp_register_fake.return_val = 0;
	test_common_update(0);
	/* Test detetct mode LTE_LC_LTE_MODE_LTEM */
	lte_mode = LTE_LC_LTE_MODE_LTEM;
	test_common_update(6);
	/* Test detetct mode LTE_LC_LTE_MODE_NBIOT */
	lte_mode = LTE_LC_LTE_MODE_NBIOT;
	test_common_update(7);
}

/*
 * Tests for initializing the module and setting the credentials
 */

ZTEST(lwm2m_client_utils_common, test_signal_update)
{
	int rc;
	int8_t modem_test_val;

	setup();
	/* First, test if settings fail */
	modem_info_rsrp_register_fake.custom_fake = modem_info_rsrp_register_copy;
	lwm2m_engine_set_s8_fake.custom_fake = lwm2m_engine_set_s8_copy;

	modem_test_val = modem_rsp_resource;
	k_sleep(K_SECONDS(2));
	rc = lwm2m_update_connmon();
	zassert_equal(rc, 0, "wrong return value");
	zassert_not_null(modem_info_rsrp_cb, "NULL");

	/* Test too big number that it not change value */
	test_signal_update_feed(98);
	zassert_equal(modem_test_val, modem_rsp_resource, "wrong RSP value");
	/* Test that init value is updated */
	test_signal_update_feed(97);
	zassert_not_equal(modem_test_val, modem_rsp_resource, "wrong RSP value");
	modem_test_val = modem_rsp_resource;
	/* Test that init value is updated is not updated before CONFIG_LWM2M_CONN_HOLD_TIME_RSRP */
	k_sleep(K_SECONDS(2));
	test_signal_update_feed(96);
	zassert_equal(modem_test_val, modem_rsp_resource, "wrong RSP value");
	k_sleep(K_SECONDS(CONFIG_LWM2M_CONN_HOLD_TIME_RSRP));
	/* Test that init value is updated after CONFIG_LWM2M_CONN_HOLD_TIME_RSRP */
	test_signal_update_feed(96);
	zassert_not_equal(modem_test_val, modem_rsp_resource, "wrong RSP value");
}
```

## src/con_management.c
```c
/*
 * Copyright (c) 2024 Nordic Semiconductor ASA
 *
 * SPDX-License-Identifier: LicenseRef-Nordic-5-Clause
 */

#include <zephyr/ztest.h>
#include <zephyr/fff.h>
#include <zephyr/net/socket_ncs.h>

#include <net/lwm2m_client_utils.h>
#include "stubs.h"

#define LIFETIME 120
#define TAU 60

static void setup(void *data)
{
	/* Register resets */
	DO_FOREACH_FAKE(RESET_FAKE);

	/* reset common FFF internal structures */
	FFF_RESET_HISTORY();
}

static int lte_lc_psm_disabled(int *tau, int *active_time)
{
	*tau = TAU;
	*active_time = -1;

	return 0;
}

static int lte_lc_psm_ok(int *tau, int *active_time)
{
	*tau = TAU;
	*active_time = 30;

	return 0;
}

static int get_lifetime(const struct lwm2m_obj_path *path, uint32_t *value)
{
	*value = LIFETIME;

	return 0;
}

static int get_lifetime_and_tau_match(const struct lwm2m_obj_path *path, uint32_t *value)
{
	*value = TAU;

	return 0;
}

static int setsockopt_save(int sock, int level, int optname, const void *optval,
			   net_socklen_t optlen)
{
	zassert_equal(optname, TLS_DTLS_CONN_SAVE, "Incorrect socket option");

	return 0;
}

static int setsockopt_load(int sock, int level, int optname, const void *optval,
			   net_socklen_t optlen)
{
	zassert_equal(optname, TLS_DTLS_CONN_LOAD, "Incorrect socket option");

	return 0;
}

ZTEST_SUITE(lwm2m_client_utils_con_management, NULL, NULL, setup, NULL, NULL);

ZTEST(lwm2m_client_utils_con_management, test_dtls_save_load)
{
	struct lwm2m_ctx ctx;
	enum lwm2m_rd_client_event event = LWM2M_RD_CLIENT_EVENT_QUEUE_MODE_RX_OFF;

	z_impl_zsock_setsockopt_fake.custom_fake = setsockopt_save;
	lwm2m_utils_connection_manage(&ctx, &event);

	event = LWM2M_RD_CLIENT_EVENT_REG_UPDATE;
	z_impl_zsock_setsockopt_fake.custom_fake = setsockopt_load;
	lwm2m_utils_connection_manage(&ctx, &event);

	event = LWM2M_RD_CLIENT_EVENT_DISCONNECT;
	lwm2m_utils_connection_manage(&ctx, &event);
}

ZTEST(lwm2m_client_utils_con_management, test_psm_disabled)
{
	struct lwm2m_ctx ctx;
	enum lwm2m_rd_client_event event = LWM2M_RD_CLIENT_EVENT_REGISTRATION_COMPLETE;

	lte_lc_psm_get_fake.custom_fake = lte_lc_psm_disabled;
	lwm2m_utils_connection_manage(&ctx, &event);

	zassert_equal(lwm2m_get_u32_fake.call_count, 0,
		      "Incorrect number of lwm2m_get_u32() calls");
}

ZTEST(lwm2m_client_utils_con_management, test_request_tau)
{
	struct lwm2m_ctx ctx;
	enum lwm2m_rd_client_event event = LWM2M_RD_CLIENT_EVENT_REGISTRATION_COMPLETE;

	lte_lc_psm_get_fake.custom_fake = lte_lc_psm_ok;
	lwm2m_get_u32_fake.custom_fake = get_lifetime;
	lwm2m_utils_connection_manage(&ctx, &event);

	zassert_equal(lte_lc_psm_param_set_seconds_fake.call_count, 1,
		      "Incorrect number of lte_lc_psm_param_set_seconds() calls");
	zassert_equal(lte_lc_psm_param_set_seconds_fake.arg0_val, LIFETIME, "Incorrect lifetime");
}

ZTEST(lwm2m_client_utils_con_management, test_tau_and_lifetime_match)
{
	struct lwm2m_ctx ctx;
	enum lwm2m_rd_client_event event = LWM2M_RD_CLIENT_EVENT_REGISTRATION_COMPLETE;

	lte_lc_psm_get_fake.custom_fake = lte_lc_psm_ok;
	lwm2m_get_u32_fake.custom_fake = get_lifetime_and_tau_match;
	lwm2m_utils_connection_manage(&ctx, &event);

	zassert_equal(lte_lc_psm_param_set_seconds_fake.call_count, 0,
		      "Incorrect number of lte_lc_psm_param_set_seconds() calls");
}
```

## src/conneval.c
```c
/*
 * Copyright (c) 2023 Nordic Semiconductor ASA
 *
 * SPDX-License-Identifier: LicenseRef-Nordic-5-Clause
 */

#include <zephyr/ztest.h>
#include <zephyr/fff.h>

#include <net/lwm2m_client_utils.h>
#include "stubs.h"

static int counter_int;
static int counter_short;

static int resp_cb(nrf_modem_at_resp_handler_t cb, const char *fmt, char *p)
{
	cb("my_resp");

	return 0;
}

static void setup(void *data)
{
	/* Register resets */
	DO_FOREACH_FAKE(RESET_FAKE);

	/* reset common FFF internal structures */
	FFF_RESET_HISTORY();

	counter_int = 0;
	counter_short = 0;
	nrf_modem_at_cmd_async_fake.custom_fake = resp_cb;
}

static int energy_normal(struct lte_lc_conn_eval_params *params)
{
	params->energy_estimate = LTE_LC_ENERGY_CONSUMPTION_NORMAL;

	return 0;
}

static int energy_increased(struct lte_lc_conn_eval_params *params)
{
	params->energy_estimate = LTE_LC_ENERGY_CONSUMPTION_INCREASED;

	return 0;
}

static int at_parser_int32_get_custom_fake_error(struct at_parser *parser, size_t index,
						 int32_t *value)
{
	if (counter_int <= 1) {
		*value = 1;
	} else {
		*value = 0;
	}
	counter_int++;

	return 0;
}

static int at_parser_int32_get_custom_fake_ok(struct at_parser *parser, size_t index,
					      int32_t *value)
{
	*value = 0;

	return 0;
}

int at_parser_uint16_get_changing_energy(struct at_parser *parser, size_t index, uint16_t *value)
{
	if (counter_short > 2) {
		*value = LTE_LC_ENERGY_CONSUMPTION_NORMAL;
	} else {
		*value = LTE_LC_ENERGY_CONSUMPTION_INCREASED;
	}
	counter_short++;

	return 0;
}

int at_parser_uint16_get_normal_energy(struct at_parser *parser, size_t index, uint16_t *value)
{
	*value = LTE_LC_ENERGY_CONSUMPTION_NORMAL;

	return 0;
}

int at_parser_uint16_get_increased_energy(struct at_parser *parser, size_t index, uint16_t *value)
{
	*value = LTE_LC_ENERGY_CONSUMPTION_INCREASED;

	return 0;
}

ZTEST_SUITE(lwm2m_client_utils_conneval, NULL, NULL, setup, NULL, NULL);


ZTEST(lwm2m_client_utils_conneval, test_enable)
{
	int rc;

	rc = lwm2m_utils_enable_conneval(LTE_LC_ENERGY_CONSUMPTION_NORMAL, 60, 50);
	zassert_equal(rc, -EINVAL, "Wrong return value");

	rc = lwm2m_utils_enable_conneval(LTE_LC_ENERGY_CONSUMPTION_NORMAL, 60, 5000);
	zassert_equal(rc, 0, "Wrong return value");
}

ZTEST(lwm2m_client_utils_conneval, test_disable)
{
	int rc;
	struct lwm2m_ctx ctx;
	enum lwm2m_rd_client_event client_event;

	rc = lwm2m_utils_enable_conneval(LTE_LC_ENERGY_CONSUMPTION_NORMAL, 60, 5000);
	zassert_equal(rc, 0, "Wrong return value");

	lwm2m_utils_disable_conneval();

	client_event = LWM2M_RD_CLIENT_EVENT_REG_UPDATE;
	rc = lwm2m_utils_conneval(&ctx, &client_event);
	zassert_equal(rc, 0, "Wrong return value");

	zassert_equal(lte_lc_conn_eval_params_get_fake.call_count, 0,
		      "Incorrect number of lte_lc_conn_eval_params_get() calls");
}

ZTEST(lwm2m_client_utils_conneval, test_normal)
{
	int rc;
	struct lwm2m_ctx ctx;
	enum lwm2m_rd_client_event client_event;

	rc = lwm2m_utils_enable_conneval(LTE_LC_ENERGY_CONSUMPTION_NORMAL, 60, 5000);
	zassert_equal(rc, 0, "Wrong return value");

	lte_lc_conn_eval_params_get_fake.custom_fake = energy_normal;
	client_event = LWM2M_RD_CLIENT_EVENT_REG_UPDATE;

	rc = lwm2m_utils_conneval(&ctx, &client_event);
	zassert_equal(rc, 0, "Wrong return value");
	zassert_equal(lte_lc_conn_eval_params_get_fake.call_count, 1,
		      "Incorrect number of lte_lc_conn_eval_params_get() calls");
}

ZTEST(lwm2m_client_utils_conneval, test_max_delay)
{
	int rc;
	struct lwm2m_ctx ctx;
	enum lwm2m_rd_client_event client_event;

	rc = lwm2m_utils_enable_conneval(LTE_LC_ENERGY_CONSUMPTION_NORMAL, 20, 2000);
	zassert_equal(rc, 0, "Wrong return value");

	lte_lc_conn_eval_params_get_fake.custom_fake = energy_increased;
	at_parser_int32_get_fake.custom_fake = at_parser_int32_get_custom_fake_ok;
	at_parser_uint16_get_fake.custom_fake = at_parser_uint16_get_increased_energy;
	client_event = LWM2M_RD_CLIENT_EVENT_REG_UPDATE;

	rc = lwm2m_utils_conneval(&ctx, &client_event);
	zassert_equal(rc, 0, "Wrong return value");
	k_sleep(K_SECONDS(21)); /* Wait for timer */
	zassert_equal(lwm2m_engine_pause_fake.call_count, 1,
		      "Incorrect number of lte_lc_conn_eval_params_get() calls");
	zassert_equal(lte_lc_conn_eval_params_get_fake.call_count, 1,
		      "Incorrect number of lte_lc_conn_eval_params_get() calls");
	zassert_equal(lwm2m_engine_resume_fake.call_count, 1,
		      "Incorrect number of lte_lc_conn_eval_params_get() calls");
	zassert_equal(nrf_modem_at_cmd_async_fake.call_count, 9,
		      "Incorrect number of nrf_modem_at_cmd_async() calls");

	rc = lwm2m_utils_conneval(&ctx, &client_event);
	zassert_equal(rc, 0, "Wrong return value");
}

ZTEST(lwm2m_client_utils_conneval, test_energy_change)
{
	int rc;
	struct lwm2m_ctx ctx;
	enum lwm2m_rd_client_event client_event;

	rc = lwm2m_utils_enable_conneval(LTE_LC_ENERGY_CONSUMPTION_NORMAL, 20, 2000);
	zassert_equal(rc, 0, "Wrong return value");

	lte_lc_conn_eval_params_get_fake.custom_fake = energy_increased;
	at_parser_int32_get_fake.custom_fake = at_parser_int32_get_custom_fake_ok;
	at_parser_uint16_get_fake.custom_fake = at_parser_uint16_get_changing_energy;
	client_event = LWM2M_RD_CLIENT_EVENT_REG_UPDATE;

	rc = lwm2m_utils_conneval(&ctx, &client_event);
	zassert_equal(rc, 0, "Wrong return value");

	k_sleep(K_SECONDS(21)); /* Wait for timer */
	zassert_equal(lwm2m_engine_pause_fake.call_count, 1,
		      "Incorrect number of lte_lc_conn_eval_params_get() calls");
	zassert_equal(lte_lc_conn_eval_params_get_fake.call_count, 1,
		      "Incorrect number of lte_lc_conn_eval_params_get() calls");
	zassert_equal(lwm2m_engine_resume_fake.call_count, 1,
		      "Incorrect number of lte_lc_conn_eval_params_get() calls");
	zassert_equal(nrf_modem_at_cmd_async_fake.call_count, 4,
		      "Incorrect number of nrf_modem_at_cmd_async() calls");

	rc = lwm2m_utils_conneval(&ctx, &client_event);
	zassert_equal(rc, 0, "Wrong return value");
}

ZTEST(lwm2m_client_utils_conneval, test_evaluation_failed)
{
	int rc;
	struct lwm2m_ctx ctx;
	enum lwm2m_rd_client_event client_event;

	rc = lwm2m_utils_enable_conneval(LTE_LC_ENERGY_CONSUMPTION_NORMAL, 20, 2000);
	zassert_equal(rc, 0, "Wrong return value");

	lte_lc_conn_eval_params_get_fake.custom_fake = energy_increased;
	at_parser_int32_get_fake.custom_fake = at_parser_int32_get_custom_fake_error;
	at_parser_uint16_get_fake.custom_fake = at_parser_uint16_get_normal_energy;
	client_event = LWM2M_RD_CLIENT_EVENT_REG_UPDATE;

	rc = lwm2m_utils_conneval(&ctx, &client_event);
	zassert_equal(rc, 0, "Wrong return value");

	k_sleep(K_SECONDS(21)); /* Wait for timer */
	zassert_equal(lwm2m_engine_pause_fake.call_count, 1,
		      "Incorrect number of lte_lc_conn_eval_params_get() calls");
	zassert_equal(lte_lc_conn_eval_params_get_fake.call_count, 1,
		      "Incorrect number of lte_lc_conn_eval_params_get() calls");
	zassert_equal(lwm2m_engine_resume_fake.call_count, 1,
		      "Incorrect number of lte_lc_conn_eval_params_get() calls");
	zassert_equal(nrf_modem_at_cmd_async_fake.call_count, 3,
		      "Incorrect number of nrf_modem_at_cmd_async() calls");
	zassert_equal(at_parser_uint16_get_fake.call_count, 1,
		      "Incorrect number of at_parser_uint16_get() calls");
}

ZTEST(lwm2m_client_utils_conneval, test_incorrect_event)
{
	int rc;
	struct lwm2m_ctx ctx;
	enum lwm2m_rd_client_event client_event;

	rc = lwm2m_utils_enable_conneval(LTE_LC_ENERGY_CONSUMPTION_NORMAL, 60, 5000);
	zassert_equal(rc, 0, "Wrong return value");

	lte_lc_conn_eval_params_get_fake.custom_fake = energy_normal;
	client_event = LWM2M_RD_CLIENT_EVENT_REGISTRATION_COMPLETE;

	rc = lwm2m_utils_conneval(&ctx, &client_event);
	zassert_equal(rc, 0, "Wrong return value");
	zassert_equal(lte_lc_conn_eval_params_get_fake.call_count, 0,
		      "Incorrect number of lte_lc_conn_eval_params_get() calls");
}

ZTEST(lwm2m_client_utils_conneval, test_conn_eval_params_get_fail)
{
	int rc;
	struct lwm2m_ctx ctx;
	enum lwm2m_rd_client_event client_event;

	rc = lwm2m_utils_enable_conneval(LTE_LC_ENERGY_CONSUMPTION_NORMAL, 60, 5000);
	zassert_equal(rc, 0, "Wrong return value");

	lte_lc_conn_eval_params_get_fake.return_val = -1;
	client_event = LWM2M_RD_CLIENT_EVENT_REG_UPDATE;

	rc = lwm2m_utils_conneval(&ctx, &client_event);
	zassert_equal(rc, -1, "Wrong return value");
}
```

## src/connmon.c
```c
/*
 * Copyright (c) 2022 Nordic Semiconductor ASA
 *
 * SPDX-License-Identifier: LicenseRef-Nordic-5-Clause
 */

#include <zephyr/ztest.h>
#include <zephyr/fff.h>

#include <net/lwm2m_client_utils.h>
#include <modem/modem_key_mgmt.h>
#include <modem/lte_lc.h>
#include <modem/modem_info.h>
#include <zephyr/settings/settings.h>

#include "stubs.h"

/* LTE-FDD bearer & NB-IoT bearer */
#define LTE_FDD_BEARER 6U
#define NB_IOT_BEARER 7U

static rsrp_cb_t modem_info_rsrp_cb;

static uint8_t connmon_mode;

static int16_t modem_rsrp_resource;

static enum lte_lc_lte_mode lte_mode;

static struct modem_param_info modem_param = {
		.network.ip_address.value_string = "192.168.0.2",
		.network.apn.value_string = "nat.iot.no",
		.device.modem_fw.value_string = "mfw_nrf9160_1.3.1",
		.network.cellid_dec = 1234567,
		.network.mnc.value = 10,
		.network.mcc.value = 200,
		.network.area_code.value = 12345,
};

ZTEST_SUITE(lwm2m_client_utils_connmon, NULL, NULL, NULL, NULL, NULL);

static int set_string_custom_fake(const struct lwm2m_obj_path *path, const char *data)
{
	if (path->obj_id == 3 && path->obj_inst_id == 0 && path->res_id == 3) {
		zassert_mem_equal(modem_param.device.modem_fw.value_string, data, strlen(data),
				  "Wrong FW version");
	} else if (path->obj_id == 4 && path->obj_inst_id == 0 && path->res_id == 4 &&
		   path->res_inst_id == 0) {
		zassert_mem_equal(modem_param.network.ip_address.value_string, data, strlen(data),
				  "Wrong IP Address");
	} else if (path->obj_id == 4 && path->obj_inst_id == 0 && path->res_id == 7 &&
		   path->res_inst_id == 0){
		zassert_mem_equal(modem_param.network.apn.value_string, data, strlen(data),
				  "Wrong APN");
	} else {
		zassert(0, "Invalid path");
		return -EINVAL;
	}
	return 0;
}

static int set_s16_custom_fake(const struct lwm2m_obj_path *path, int16_t value)
{
	if (path->obj_id == 4 && path->obj_inst_id == 0 && path->res_id == 2) {
		zassert_equal((int16_t)RSRP_IDX_TO_DBM(modem_rsrp_resource), value);
	} else {
		zassert(0, "Invalid path");
		return -EINVAL;
	}
	return 0;
}

static int set_u8_custom_fake(const struct lwm2m_obj_path *path, uint8_t value)
{
	if (path->obj_id == 4 && path->obj_inst_id == 0 && path->res_id == 0) {
		if (lte_mode == LTE_LC_LTE_MODE_LTEM) {
			zassert_equal(LTE_FDD_BEARER, value);
		} else if (lte_mode == LTE_LC_LTE_MODE_NBIOT) {
			zassert_equal(NB_IOT_BEARER, value);
		} else {
			zassert(0, "Invalid mode");
		}
	} else {
		zassert(0, "Invalid path");
		return -EINVAL;
	}
	return 0;
}

static int copy_modem_info(struct modem_param_info *params)
{
	params = &modem_param;
	return 0;
}
static int copy_rsrp_handler(rsrp_cb_t cb)
{
	modem_info_rsrp_cb = cb;
	return 0;
}

static void setup(void)
{
	/* Register resets */
	DO_FOREACH_FAKE(RESET_FAKE);

	/* reset common FFF internal structures */
	FFF_RESET_HISTORY();
	modem_info_rsrp_cb = NULL;
	connmon_mode = 0;
	modem_rsrp_resource = 0;
	lte_mode = LTE_LC_LTE_MODE_NONE;
}

/*
 * Tests for initializing the module
 */
ZTEST(lwm2m_client_utils_connmon, test_modem_info_init_fail)
{
	setup();

	modem_info_init_fake.return_val = -1;
	call_lwm2m_init_callbacks();
	zassert_equal(modem_info_init_fake.call_count, 1, "Modem info init not called");
}

ZTEST(lwm2m_client_utils_connmon, test_modem_info_params_init_fail)
{
	setup();

	modem_info_params_init_fake.return_val = -2;
	call_lwm2m_init_callbacks();
	zassert_equal(modem_info_params_init_fake.call_count, 1, "Info params init not called");
}

ZTEST(lwm2m_client_utils_connmon, test_connected)
{
	struct lte_lc_evt evt = {0};

	setup();

	modem_rsrp_resource = 50;
	lwm2m_set_string_fake.custom_fake = set_string_custom_fake;
	lwm2m_set_s16_fake.custom_fake = set_s16_custom_fake;
	modem_info_params_get_fake.custom_fake = copy_modem_info;
	modem_info_rsrp_register_fake.custom_fake = copy_rsrp_handler;
	call_lwm2m_init_callbacks();
	evt.type = LTE_LC_EVT_NW_REG_STATUS;
	evt.nw_reg_status = LTE_LC_NW_REG_REGISTERED_HOME;
	call_lte_handlers(&evt);
	k_sleep(K_MSEC(100));
	zassert_equal(modem_info_params_get_fake.call_count, 1, "Info params get not called");
	zassert_equal(lwm2m_set_string_fake.call_count, 3, "Strings not set");
	modem_info_rsrp_cb(modem_rsrp_resource);
	k_sleep(K_MSEC(100));
	zassert_equal(lwm2m_set_s16_fake.call_count, 1, "RSRP not set");
	evt.nw_reg_status = LTE_LC_NW_REG_NOT_REGISTERED;
	call_lte_handlers(&evt);
	k_sleep(K_MSEC(100));
	zassert_equal(modem_info_params_get_fake.call_count, 1, "Info params called");
	zassert_equal(lwm2m_set_string_fake.call_count, 3, "Strings set");
}

ZTEST(lwm2m_client_utils_connmon, test_update_disconnected)
{
	struct lte_lc_evt evt = {0};

	setup();

	lwm2m_set_string_fake.custom_fake = set_string_custom_fake;
	modem_info_params_get_fake.custom_fake = copy_modem_info;
	evt.type = LTE_LC_EVT_CELL_UPDATE;
	call_lte_handlers(&evt);
	k_sleep(K_MSEC(100));
	zassert_equal(modem_info_params_get_fake.call_count, 0, "Info params called");
	zassert_equal(lwm2m_set_string_fake.call_count, 0, "Strings set");
}

ZTEST(lwm2m_client_utils_connmon, test_update)
{
	struct lte_lc_evt evt = {0};

	setup();

	lwm2m_set_string_fake.custom_fake = set_string_custom_fake;
	modem_info_params_get_fake.custom_fake = copy_modem_info;
	evt.type = LTE_LC_EVT_NW_REG_STATUS;
	evt.nw_reg_status = LTE_LC_NW_REG_REGISTERED_HOME;
	call_lte_handlers(&evt);
	k_sleep(K_MSEC(100));
	zassert_equal(modem_info_params_get_fake.call_count, 1, "Info params get not called");
	zassert_equal(lwm2m_set_string_fake.call_count, 3, "Strings not set");
	evt.type = LTE_LC_EVT_CELL_UPDATE;
	call_lte_handlers(&evt);
	k_sleep(K_MSEC(100));
	zassert_equal(modem_info_params_get_fake.call_count, 2, "Info params called");
	zassert_equal(lwm2m_set_string_fake.call_count, 6, "Strings set");
	evt.type = LTE_LC_EVT_NW_REG_STATUS;
	evt.nw_reg_status = LTE_LC_NW_REG_NOT_REGISTERED;
	call_lte_handlers(&evt);
	k_sleep(K_MSEC(100));
	zassert_equal(modem_info_params_get_fake.call_count, 2, "Info params called");
	zassert_equal(lwm2m_set_string_fake.call_count, 6, "Strings set");
}

ZTEST(lwm2m_client_utils_connmon, test_lte_mode_update)
{
	struct lte_lc_evt evt = {0};

	setup();
	lte_mode = LTE_LC_LTE_MODE_LTEM;

	lwm2m_set_u8_fake.custom_fake = set_u8_custom_fake;
	evt.type = LTE_LC_EVT_LTE_MODE_UPDATE;
	evt.lte_mode = lte_mode;
	call_lte_handlers(&evt);
	zassert_equal(lwm2m_set_u8_fake.call_count, 1, "LTE mode not set");
}
```

## src/device.c
```c
/*
 * Copyright (c) 2022 Nordic Semiconductor ASA
 *
 * SPDX-License-Identifier: LicenseRef-Nordic-5-Clause
 */
#include <zephyr/ztest.h>
#include <zephyr/fff.h>

#include <zephyr/kernel.h>
#include <zephyr/logging/log_ctrl.h>
#include <zephyr/sys/reboot.h>
#include <zephyr/net/lwm2m.h>
#include <net/lwm2m_client_utils.h>

#include "stubs.h"

ZTEST_SUITE(lwm2m_client_utils_device, NULL, NULL, NULL, NULL, NULL);

static lwm2m_engine_execute_cb_t reboot_cb;
static int reboot_type;

static int lwm2m_register_exec_callback_copy(const struct lwm2m_obj_path *path,
						    lwm2m_engine_execute_cb_t cb)
{
	reboot_cb = cb;
	reboot_type = -1;
	return 0;
}

/* Stubbed */
FUNC_NORETURN void sys_reboot(int types)
{
	reboot_type = types;

	while (1) {
		k_sleep(K_SECONDS(1));
	}
}

static void setup(void)
{
	/* Register resets */
	DO_FOREACH_FAKE(RESET_FAKE);

	/* reset common FFF internal structures */
	FFF_RESET_HISTORY();

	reboot_cb = NULL;
	lwm2m_register_exec_callback_fake.custom_fake = NULL;
}

/*
 * Tests for initializing the module and test reboot funtionality
 */

ZTEST(lwm2m_client_utils_device, test_init_device)
{
	setup();
	lwm2m_register_exec_callback_fake.custom_fake =
		lwm2m_register_exec_callback_copy;

	call_lwm2m_init_callbacks();
	zassert_not_null(reboot_cb, "NULL");
}
```

## src/dummy_wlan.c
```c
/*
 * Copyright (c) 2022 Nordic Semiconductor ASA
 *
 * SPDX-License-Identifier: LicenseRef-Nordic-5-Clause
 */
#include <zephyr/device.h>

/* Define a dummy driver just that the linker finds it. Otherwise we get a complaint like:
 *     undefined reference to `__device_dts_ord_12'
 */
#define DT_DRV_COMPAT nordic_wlan0
DEVICE_DT_INST_DEFINE(0, NULL, NULL, NULL, NULL, POST_KERNEL, 0, NULL);
```

## src/firmware.c
```c
/*
 * Copyright (c) 2022 grandcentrix GmbH
 *
 * SPDX-License-Identifier: LicenseRef-Nordic-5-Clause
 */

#include <zephyr/ztest.h>
#include <zephyr/fff.h>

#include "stubs.h"
#include <net/lwm2m_client_utils.h>

static const struct lwm2m_obj_path FIRMWARE_UPDATE_URI =
	LWM2M_OBJ(LWM2M_OBJECT_FIRMWARE_ID, 0, LWM2M_FOTA_PACKAGE_URI_ID);
static const struct lwm2m_obj_path FIRMWARE_UPDATE_STATE =
	LWM2M_OBJ(LWM2M_OBJECT_FIRMWARE_ID, 0, LWM2M_FOTA_STATE_ID);

void client_acknowledge(void)
{
}

bool check_set_update_result(uint8_t expected_val, uint8_t arg_index)
{
	if (lwm2m_firmware_set_update_result_inst_fake.call_count > arg_index) {
		return lwm2m_firmware_set_update_result_inst_fake.arg1_history[arg_index] ==
		       expected_val;
	}

	return false;
}

bool check_set_update_state(uint8_t expected_val, uint8_t arg_index)
{
	if (lwm2m_firmware_set_update_state_inst_fake.call_count > arg_index) {
		return lwm2m_firmware_set_update_state_inst_fake.arg1_history[arg_index] ==
		       expected_val;
	}

	return false;
}

bool is_last_update_state(uint8_t expected)
{
	if (lwm2m_firmware_set_update_state_inst_fake.call_count > 0) {
		return lwm2m_firmware_set_update_state_inst_fake
			       .arg1_history[lwm2m_firmware_set_update_state_inst_fake.call_count -
					     1] == expected;
	}

	return true;
}

static void my_suite_before(void *f)
{
	/* Register resets */
	DO_FOREACH_FAKE(RESET_FAKE);

	/* reset common FFF internal structures */
	FFF_RESET_HISTORY();

	test_stubs_teardown();
}

ZTEST_SUITE(lwm2m_firmware, NULL, NULL, my_suite_before, NULL, NULL);

ZTEST(lwm2m_firmware, test_on_init_downloading)
{
	lwm2m_firmware_get_update_state_inst_fake.return_val = STATE_DOWNLOADING;
	lwm2m_init_firmware();

	zassert_true(check_set_update_result(RESULT_DEFAULT, 0), NULL);
}

ZTEST(lwm2m_firmware, test_on_init_image_updating_confirmed)
{
	lwm2m_firmware_get_update_state_inst_fake.return_val = STATE_UPDATING;
	boot_is_img_confirmed_fake.return_val = false;
	lwm2m_init_image();

	zassert_true(check_set_update_result(RESULT_SUCCESS, 0), NULL);
}

ZTEST(lwm2m_firmware, test_on_init_image_updating_not_confirmed)
{
	lwm2m_firmware_get_update_state_inst_fake.return_val = STATE_UPDATING;
	boot_is_img_confirmed_fake.return_val = true;
	lwm2m_init_image();

	zassert_true(check_set_update_result(RESULT_UPDATE_FAILED, 0), NULL);
}

ZTEST(lwm2m_firmware, test_on_init_image_downloading)
{
	lwm2m_firmware_get_update_state_inst_fake.return_val = STATE_DOWNLOADING;
	boot_is_img_confirmed_fake.return_val = true;
	lwm2m_init_image();

	zassert_equal(lwm2m_firmware_set_update_result_inst_fake.call_count, 0, NULL);
}

ZTEST(lwm2m_firmware, test_write_coap_uri_start_download)
{
	char test_uri[] = "coap://10.1.0.10:5683/tmp/test.tmp";

	lwm2m_register_post_write_callback_fake.custom_fake =
		lwm2m_register_post_write_callback_fake1;
	lwm2m_firmware_get_update_state_inst_fake.return_val = STATE_IDLE;
	lwm2m_init_firmware();

	test_lwm2m_engine_call_post_write_cb(&FIRMWARE_UPDATE_URI, 0, 0, 0, test_uri,
					     strlen(test_uri), 1, strlen(test_uri));
	k_sleep(K_MSEC(20));
	zassert_equal(lwm2m_firmware_set_update_result_inst_fake.call_count, 0, NULL);
	zassert_true(check_set_update_state(STATE_DOWNLOADING, 0), NULL);
}

ZTEST(lwm2m_firmware, test_write_coap_sec_uri_start_download)
{
	char test_uri[] = "coaps://10.1.0.10:5684/tmp/test.tmp";

	lwm2m_register_post_write_callback_fake.custom_fake =
		lwm2m_register_post_write_callback_fake1;
	lwm2m_firmware_get_update_state_inst_fake.return_val = STATE_IDLE;
	lwm2m_init_firmware();

	test_lwm2m_engine_call_post_write_cb(&FIRMWARE_UPDATE_URI, 0, 0, 0, test_uri,
					     strlen(test_uri), 1, strlen(test_uri));
	k_sleep(K_MSEC(20));
	zassert_equal(lwm2m_firmware_set_update_result_inst_fake.call_count, 0, NULL);
	zassert_true(check_set_update_state(STATE_DOWNLOADING, 0), NULL);
}

ZTEST(lwm2m_firmware, test_write_http_uri_start_download)
{
	char test_uri[] = "http://10.1.0.10:80/tmp/test.tmp";

	lwm2m_register_post_write_callback_fake.custom_fake =
		lwm2m_register_post_write_callback_fake1;
	lwm2m_firmware_get_update_state_inst_fake.return_val = STATE_IDLE;
	lwm2m_init_firmware();

	test_lwm2m_engine_call_post_write_cb(&FIRMWARE_UPDATE_URI, 0, 0, 0, test_uri,
					     strlen(test_uri), 1, strlen(test_uri));
	k_sleep(K_MSEC(20));
	zassert_equal(lwm2m_firmware_set_update_result_inst_fake.call_count, 0, NULL);
	zassert_true(check_set_update_state(STATE_DOWNLOADING, 0), NULL);
}

ZTEST(lwm2m_firmware, test_write_http_sec_uri_start_download)
{
	char test_uri[] = "https://10.1.0.10:443/tmp/test.tmp";

	lwm2m_register_post_write_callback_fake.custom_fake =
		lwm2m_register_post_write_callback_fake1;
	lwm2m_firmware_get_update_state_inst_fake.return_val = STATE_IDLE;
	lwm2m_init_firmware();

	test_lwm2m_engine_call_post_write_cb(&FIRMWARE_UPDATE_URI, 0, 0, 0, test_uri,
					     strlen(test_uri), 1, strlen(test_uri));
	k_sleep(K_MSEC(20));
	zassert_equal(lwm2m_firmware_set_update_result_inst_fake.call_count, 0, NULL);
	zassert_true(check_set_update_state(STATE_DOWNLOADING, 0), NULL);
}

ZTEST(lwm2m_firmware, test_write_uri_twice)
{
	char test_uri[] = "coap://10.1.0.10:5683/tmp/test.tmp";

	lwm2m_register_post_write_callback_fake.custom_fake =
		lwm2m_register_post_write_callback_fake1;
	lwm2m_firmware_get_update_state_inst_fake.return_val = STATE_IDLE;
	lwm2m_init_firmware();

	lwm2m_firmware_get_update_state_inst_fake.return_val = STATE_DOWNLOADING;
	test_lwm2m_engine_call_post_write_cb(&FIRMWARE_UPDATE_URI, 0, 0, 0, test_uri,
					     strlen(test_uri), 1, strlen(test_uri));
	k_sleep(K_MSEC(20));
	zassert_equal(lwm2m_firmware_set_update_result_inst_fake.call_count, 0, NULL);
	zassert_equal(lwm2m_firmware_set_update_state_inst_fake.call_count, 0, NULL);
}

ZTEST(lwm2m_firmware, test_write_invalid_uri_no_path)
{
	char test_uri[] = "coap://10.1.0.10:5683";

	lwm2m_register_post_write_callback_fake.custom_fake =
		lwm2m_register_post_write_callback_fake1;
	lwm2m_firmware_get_update_state_inst_fake.return_val = STATE_IDLE;
	lwm2m_init_firmware();

	test_lwm2m_engine_call_post_write_cb(&FIRMWARE_UPDATE_URI, 0, 0, 0, test_uri,
					     strlen(test_uri), 1, strlen(test_uri));
	k_sleep(K_MSEC(20));
	zassert_true(check_set_update_result(RESULT_INVALID_URI, 0), NULL);
}

ZTEST(lwm2m_firmware, test_write_invalid_uri_invalid_host)
{
	char test_uri[] = "10.1.0.10:5683/tmp/test.tmp";

	lwm2m_register_post_write_callback_fake.custom_fake =
		lwm2m_register_post_write_callback_fake1;
	lwm2m_firmware_get_update_state_inst_fake.return_val = STATE_IDLE;
	lwm2m_init_firmware();

	test_lwm2m_engine_call_post_write_cb(&FIRMWARE_UPDATE_URI, 0, 0, 0, test_uri,
					     strlen(test_uri), 1, strlen(test_uri));
	k_sleep(K_MSEC(20));
	zassert_true(check_set_update_result(RESULT_INVALID_URI, 0), NULL);
}

ZTEST(lwm2m_firmware, test_write_uri_reset_download)
{
	char test_uri[] = "10.1.0.10:5683/tmp/test.tmp";

	lwm2m_register_post_write_callback_fake.custom_fake =
		lwm2m_register_post_write_callback_fake1;
	lwm2m_firmware_get_update_state_inst_fake.return_val = STATE_IDLE;
	lwm2m_init_firmware();

	lwm2m_firmware_get_update_state_inst_fake.return_val = STATE_DOWNLOADED;
	test_lwm2m_engine_call_post_write_cb(&FIRMWARE_UPDATE_URI, 0, 0, 0, test_uri, 0, 1,
					     strlen(test_uri));
	k_sleep(K_MSEC(20));
	zassert_true(check_set_update_result(RESULT_DEFAULT, 0), NULL);
}

ZTEST(lwm2m_firmware, test_download_evt_progres)
{
	char test_uri[] = "coap://10.1.0.10:5683/tmp/test.tmp";

	lwm2m_register_post_write_callback_fake.custom_fake =
		lwm2m_register_post_write_callback_fake1;
	lwm2m_firmware_get_update_state_inst_fake.return_val = STATE_IDLE;
	lwm2m_init_firmware();

	fota_download_init_fake.custom_fake = fota_download_init_fake1;
	test_lwm2m_engine_call_post_write_cb(&FIRMWARE_UPDATE_URI, 0, 0, 0, test_uri,
					     strlen(test_uri), 1, strlen(test_uri));
	k_sleep(K_MSEC(20));

	test_fota_download_throw_evt(FOTA_DOWNLOAD_EVT_PROGRESS);
	zassert_true(check_set_update_state(STATE_DOWNLOADING, 0), NULL);
}

ZTEST(lwm2m_firmware, test_download_evt_cancelled)
{
	char test_uri[] = "coap://10.1.0.10:5683/tmp/test.tmp";

	lwm2m_register_post_write_callback_fake.custom_fake =
		lwm2m_register_post_write_callback_fake1;
	lwm2m_firmware_get_update_state_inst_fake.return_val = STATE_IDLE;
	lwm2m_init_firmware();

	fota_download_init_fake.custom_fake = fota_download_init_fake1;
	test_lwm2m_engine_call_post_write_cb(&FIRMWARE_UPDATE_URI, 0, 0, 0, test_uri,
					     strlen(test_uri), 1, strlen(test_uri));
	k_sleep(K_MSEC(20));
	zassert_true(check_set_update_state(STATE_DOWNLOADING, 0), NULL);

	test_fota_download_throw_evt(FOTA_DOWNLOAD_EVT_CANCELLED);
	zassert_true(check_set_update_result(RESULT_CONNECTION_LOST, 0), NULL);
}

ZTEST(lwm2m_firmware, test_download_evt_finished)
{
	char test_uri[] = "coap://10.1.0.10:5683/tmp/test.tmp";

	lwm2m_register_post_write_callback_fake.custom_fake =
		lwm2m_register_post_write_callback_fake1;
	lwm2m_firmware_get_update_state_inst_fake.return_val = STATE_IDLE;
	lwm2m_init_firmware();

	fota_download_init_fake.custom_fake = fota_download_init_fake1;
	test_lwm2m_engine_call_post_write_cb(&FIRMWARE_UPDATE_URI, 0, 0, 0, test_uri,
					     strlen(test_uri), 1, strlen(test_uri));
	k_sleep(K_MSEC(20));
	zassert_true(check_set_update_state(STATE_DOWNLOADING, 0), NULL);

	test_fota_download_throw_evt(FOTA_DOWNLOAD_EVT_FINISHED);
	zassert_true(check_set_update_state(STATE_DOWNLOADED, 1), NULL);
}

ZTEST(lwm2m_firmware, test_download_evt_download_failed)
{
	char test_uri[] = "coap://10.1.0.10:5683/tmp/test.tmp";

	lwm2m_register_post_write_callback_fake.custom_fake =
		lwm2m_register_post_write_callback_fake1;
	lwm2m_firmware_get_update_state_inst_fake.return_val = STATE_IDLE;
	lwm2m_init_firmware();

	fota_download_init_fake.custom_fake = fota_download_init_fake1;
	test_lwm2m_engine_call_post_write_cb(&FIRMWARE_UPDATE_URI, 0, 0, 0, test_uri,
					     strlen(test_uri), 1, strlen(test_uri));
	k_sleep(K_MSEC(20));
	zassert_true(check_set_update_state(STATE_DOWNLOADING, 0), NULL);

	test_fota_download_throw_evt_error(FOTA_DOWNLOAD_ERROR_CAUSE_DOWNLOAD_FAILED);
	zassert_true(check_set_update_result(RESULT_CONNECTION_LOST, 0), NULL);
}

ZTEST(lwm2m_firmware, test_download_evt_download_invalid_update)
{
	char test_uri[] = "coap://10.1.0.10:5683/tmp/test.tmp";

	lwm2m_register_post_write_callback_fake.custom_fake =
		lwm2m_register_post_write_callback_fake1;
	lwm2m_firmware_get_update_state_inst_fake.return_val = STATE_IDLE;
	lwm2m_init_firmware();

	fota_download_init_fake.custom_fake = fota_download_init_fake1;
	test_lwm2m_engine_call_post_write_cb(&FIRMWARE_UPDATE_URI, 0, 0, 0, test_uri,
					     strlen(test_uri), 1, strlen(test_uri));
	k_sleep(K_MSEC(20));
	zassert_true(check_set_update_state(STATE_DOWNLOADING, 0), NULL);

	test_fota_download_throw_evt_error(FOTA_DOWNLOAD_ERROR_CAUSE_INVALID_UPDATE);
	zassert_true(check_set_update_result(RESULT_UNSUP_FW, 0), NULL);
}

ZTEST(lwm2m_firmware, test_download_evt_download_type_mismatch)
{
	char test_uri[] = "coap://10.1.0.10:5683/tmp/test.tmp";

	lwm2m_register_post_write_callback_fake.custom_fake =
		lwm2m_register_post_write_callback_fake1;
	lwm2m_firmware_get_update_state_inst_fake.return_val = STATE_IDLE;
	lwm2m_init_firmware();

	fota_download_init_fake.custom_fake = fota_download_init_fake1;
	test_lwm2m_engine_call_post_write_cb(&FIRMWARE_UPDATE_URI, 0, 0, 0, test_uri,
					     strlen(test_uri), 1, strlen(test_uri));
	k_sleep(K_MSEC(20));
	zassert_true(check_set_update_state(STATE_DOWNLOADING, 0), NULL);

	test_fota_download_throw_evt_error(FOTA_DOWNLOAD_ERROR_CAUSE_TYPE_MISMATCH);
	zassert_true(check_set_update_result(RESULT_UNSUP_FW, 0), NULL);
}

ZTEST(lwm2m_firmware, test_write_update_state_reset_download)
{
	uint8_t idle_state = STATE_IDLE;
	uint8_t dl_data[4];

	lwm2m_firmware_set_write_cb_fake.custom_fake = lwm2m_firmware_set_write_cb_fake1;
	lwm2m_register_post_write_callback_fake.custom_fake =
		lwm2m_register_post_write_callback_fake1;
	lwm2m_firmware_get_update_state_inst_fake.return_val = STATE_IDLE;
	lwm2m_init_firmware();

	dfu_target_img_type_fake.custom_fake = dfu_target_img_type_fake_return_mcuboot;
	test_call_lwm2m_firmware_set_write_cb(0, 0, 0, dl_data, 2, 0, sizeof(dl_data));

	test_lwm2m_engine_call_post_write_cb(&FIRMWARE_UPDATE_STATE, 0, 0, 0, &idle_state, 0, 0, 0);
	k_sleep(K_MSEC(20));
	zassert_equal(fota_download_cancel_fake.call_count, 1, NULL);
	zassert_equal(dfu_target_reset_fake.call_count, 1, NULL);
}
```

## src/fota_settings.c
```c
/*
 * Copyright (c) 2022 Nordic Semiconductor ASA
 *
 * SPDX-License-Identifier: LicenseRef-Nordic-5-Clause
 */

#include <zephyr/ztest.h>
#include <zephyr/fff.h>

#include <net/lwm2m_client_utils_fota.h>

#include "stubs.h"

#define MY_KEY "counter"

static void setup(void)
{
	/* Register resets */
	DO_FOREACH_FAKE(RESET_FAKE);

	/* reset common FFF internal structures */
	FFF_RESET_HISTORY();
	settings_register_fake.custom_fake = NULL;
}

static struct settings_handler *handler;
static struct update_counter uc;

static int copy_settings_handler(struct settings_handler *cf)
{
	handler = cf;
	return 0;
}

static ssize_t read_cb(void *cb_arg, void *data, size_t len)
{
	memcpy(data, cb_arg, len);
	return len;
}

ZTEST_SUITE(lwm2m_client_utils_fota_settings, NULL, NULL, NULL, NULL, NULL);

ZTEST(lwm2m_client_utils_fota_settings, test_init)
{
	int rc;
	struct update_counter uc_tmp;

	setup();

	/* test subsys_init() fail */
	settings_subsys_init_fake.return_val = -1;
	rc = fota_settings_init();
	zassert_equal(rc, -1, "wrong return value");

	/* test settings_register() fail */
	settings_subsys_init_fake.return_val = 0;
	settings_register_fake.return_val = -EEXIST;
	rc = fota_settings_init();
	zassert_equal(rc, -EEXIST, "wrong return value");

	/* test settings_load_subtree() fail */
	settings_register_fake.return_val = 0;
	settings_load_subtree_fake.return_val = -3;
	rc = fota_settings_init();
	zassert_equal(rc, -3, "wrong return value");

	/* test fota_update_counter_read() and settings handler */
	settings_register_fake.custom_fake = copy_settings_handler;
	settings_name_next_fake.return_val = sizeof(MY_KEY);
	rc = fota_settings_init();
	uc.current = 1;
	uc.update = 2;
	handler->h_set(MY_KEY, sizeof(MY_KEY), read_cb, &uc);
	fota_update_counter_read(&uc_tmp);
	zassert_mem_equal(&uc, &uc_tmp, sizeof(uc), "Incorrect update_counter");

	/* test settings_register() fail */
	settings_register_fake.custom_fake = NULL;
	settings_register_fake.return_val = 0;
	settings_load_subtree_fake.return_val = -1;
	rc = fota_settings_init();
	zassert_equal(rc, -1, "wrong return value");

	/* test init OK */
	settings_load_subtree_fake.return_val = 0;
	rc = fota_settings_init();
	zassert_equal(rc, 0, "wrong return value");

	/* test that init fails if called twice */
	rc = fota_settings_init();
	zassert_equal(rc, -EALREADY, "wrong return value");
}

ZTEST(lwm2m_client_utils_fota_settings, test_update_counter)
{
	int rc;

	setup();

	rc = fota_update_counter_update(COUNTER_CURRENT, 1);
	zassert_equal(rc, 0, "wrong return value");

	rc = fota_update_counter_update(COUNTER_UPDATE, 2);
	zassert_equal(rc, 0, "wrong return value");
}

ZTEST(lwm2m_client_utils_fota_settings, test_update_counter_fail)
{
	int rc;

	setup();

	settings_save_one_fake.return_val = -ENOENT;
	rc = fota_update_counter_update(COUNTER_CURRENT, 1);
	zassert_equal(rc, -ENOENT, "wrong return value");
}
```

## src/pm_config.h
```c
/*
 * Copyright (c) 2022 Nordic Semiconductor ASA
 *
 * SPDX-License-Identifier: LicenseRef-Nordic-5-Clause
 */

/* DUMMY FILE ONLY TO BE USED FOR TESTING */
#ifndef PM_CONFIG_H__
#define PM_CONFIG_H__
#define PM_MCUBOOT_PRIMARY_ID 3
#endif /* PM_CONFIG_H__ */
```
