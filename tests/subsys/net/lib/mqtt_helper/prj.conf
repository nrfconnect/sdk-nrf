## CMakeLists.txt
```
#
# Copyright (c) 2023 Nordic Semiconductor
#
# SPDX-License-Identifier: LicenseRef-Nordic-5-Clause
#

cmake_minimum_required(VERSION 3.20.0)

find_package(Zephyr REQUIRED HINTS $ENV{ZEPHYR_BASE})
project(mqtt_helper_test)

# Generate runner for the test
test_runner_generate(src/mqtt_helper_test.c)

# Create mock
cmock_handle(${ZEPHYR_BASE}/include/zephyr/net/mqtt.h)
cmock_handle(${ZEPHYR_BASE}/include/zephyr/net/socket.h zephyr/net)
cmock_handle(${ZEPHYR_BASE}/include/zephyr/net/net_if.h zephyr/net
  FUNC_EXCLUDE ".*net_if_send_data"
  FUNC_EXCLUDE ".*net_if_try_send_data"
  FUNC_EXCLUDE ".*net_if_recv_data"
  FUNC_EXCLUDE ".*net_if_queue_tx"
  FUNC_EXCLUDE ".*net_if_try_queue_tx"
  FUNC_EXCLUDE ".*net_if_register_timestamp_cb"
  FUNC_EXCLUDE ".*net_if_unregister_timestamp_cb"
  FUNC_EXCLUDE ".*net_if_call_timestamp_cb"
  FUNC_EXCLUDE ".*net_if_add_tx_timestamp"
  FUNC_EXCLUDE ".*net_if_set_link_addr_locked"
  FUNC_EXCLUDE ".*net_if_is_wifi"
  FUNC_EXCLUDE ".*net_if_set_name"
  FUNC_EXCLUDE ".*net_if_ipv6_calc_reachable_time"
  FUNC_EXCLUDE ".*net_if_ipv4_get_netmask"
  FUNC_EXCLUDE ".*net_if_ipv4_set_netmask"
  FUNC_EXCLUDE ".*net_if_offload_set"
  WORD_EXCLUDE ".*deprecated.*"
  WORD_EXCLUDE ".*net_if_send_data.*"
  WORD_EXCLUDE ".*net_if_try_send_data.*"
  WORD_EXCLUDE ".*net_if_try_queue_tx.*"
  WORD_EXCLUDE ".*net_if_register_timestamp_cb.*"
  WORD_EXCLUDE ".*net_if_set_link_addr_locked.*"
  WORD_EXCLUDE ".*net_if_is_wifi.*"
  WORD_EXCLUDE ".*net_if_set_name.*"
  WORD_EXCLUDE ".*net_if_ipv6_calc_reachable_time.*"
)
cmock_handle(${ZEPHYR_BASE}/include/zephyr/net/conn_mgr_monitor.h zephyr/net
  FUNC_EXCLUDE ".*_iface"
  FUNC_EXCLUDE ".*_iface_ignored"
  FUNC_EXCLUDE ".*_l2"
)

# Add Unit Under Test source files
target_sources(app PRIVATE
        ${ZEPHYR_NRF_MODULE_DIR}/subsys/net/lib/mqtt_helper/mqtt_helper.c
)

# Add test source file
target_sources(app PRIVATE src/mqtt_helper_test.c)

# Include paths
target_include_directories(app PRIVATE ${ZEPHYR_NRF_MODULE_DIR}/include/zephyr/net/)

# Options that cannot be passed through Kconfig fragments.
target_compile_options(app PRIVATE
  -DCONFIG_MQTT_LIB_TLS=1
  -DCONFIG_POSIX_API=1
  -DCONFIG_MQTT_HELPER_HOSTNAME="test-some-hostname.com"
  -DCONFIG_MQTT_HELPER_STATIC_IP_ADDRESS=""
  -DCONFIG_MQTT_HELPER_PORT=8883
  -DCONFIG_MQTT_HELPER_TIMEOUT_SEC=60
  -DCONFIG_MQTT_HELPER_RX_TX_BUFFER_SIZE=256
  -DCONFIG_MQTT_HELPER_PAYLOAD_BUFFER_LEN=2304
  -DCONFIG_MQTT_HELPER_STACK_SIZE=2560
  -DCONFIG_MQTT_HELPER_SEC_TAG=1
  -DCONFIG_MQTT_HELPER_SECONDARY_SEC_TAG=-1
  -DCONFIG_MQTT_HELPER_SEND_TIMEOUT_SEC=60
  -DCONFIG_MQTT_HELPER_LAST_WILL=y
  -DCONFIG_MQTT_HELPER_LAST_WILL_MESSAGE="lastwillmessage"
  -DCONFIG_MQTT_HELPER_LAST_WILL_TOPIC="lastwilltopic"
  # Declare the Connection Manager functions, so they are mocked instead of inline stubs
  -DCONFIG_NET_CONNECTION_MANAGER=1
)
```

## prj.conf
```kconfig
#
# Copyright (c) 2023 Nordic Semiconductor ASA
#
# SPDX-License-Identifier: LicenseRef-Nordic-5-Clause
#
CONFIG_UNITY=y
CONFIG_TEST_RANDOM_GENERATOR=y
CONFIG_ASSERT=y
CONFIG_NETWORKING=y
CONFIG_NET_IPV4=y
CONFIG_NET_IPV6=y
# Needed to disable Ethernet auto-start at boot through net_if_up(), which
# triggers CMock and causes unexpected calls.
# The dummy network interface does not expose Ethernet auto-start control.
# CONFIG_ETH_NET_IF_NO_AUTO_START=y

# Every socket and net_if call is mocked, so no network device is needed. This
# keeps out the QEMU SLIP driver and the Ethernet-sized packet pools, which do
# not fit in the 64 kB RAM of qemu_cortex_m3 next to CMock's 32 kB arena.
CONFIG_NET_TEST=y
CONFIG_NET_PKT_RX_COUNT=1
CONFIG_NET_PKT_TX_COUNT=1
CONFIG_NET_BUF_RX_COUNT=1
CONFIG_NET_BUF_TX_COUNT=1
CONFIG_NET_TC_RX_COUNT=0
```

## src/ready_resolve_fake.c
```c
/*
 * Copyright (c) 2026 Nordic Semiconductor ASA
 *
 * SPDX-License-Identifier: LicenseRef-Nordic-5-Clause
 */

/* Minimal ready_resolve: always ready, resolves through the mocked getaddrinfo() */

#include <errno.h>
#include <zephyr/net/socket.h>
#include <net/ready_resolve.h>

#define FAMILY_V4 BIT(0)
#define FAMILY_V6 BIT(1)

static uint8_t family_bit(int family)
{
	return family == NET_AF_INET ? FAMILY_V4 : family == NET_AF_INET6 ? FAMILY_V6 : 0;
}

int ready_resolve(struct ready_resolve *ctx, const char *host, const char *service,
		  const struct zsock_addrinfo *hints, uint16_t port)
{
	ready_resolve_free(ctx);

	if (zsock_getaddrinfo(host, service, hints, &ctx->res)) {
		ctx->res = NULL;
		return -EHOSTUNREACH;
	}

	ctx->next = ctx->res;
	ctx->port = port;
	/* Wanted families that are enabled */
	ctx->mask = (IS_ENABLED(CONFIG_NET_IPV4) ? FAMILY_V4 : 0) |
		    (IS_ENABLED(CONFIG_NET_IPV6) ? FAMILY_V6 : 0);
	if (hints != NULL && hints->ai_family != NET_AF_UNSPEC) {
		ctx->mask &= family_bit(hints->ai_family);
	}

	return 0;
}

int ready_resolve_next(struct ready_resolve *ctx, const struct net_sockaddr **addr,
		       net_socklen_t *addrlen)
{
	struct zsock_addrinfo *ai = ctx->next;

	while (ai != NULL && !(ctx->mask & family_bit(ai->ai_family))) {
		ai = ai->ai_next;
	}

	if (ai == NULL) {
		ctx->next = NULL;
		return -ENOENT;
	}

	ctx->next = ai->ai_next;
	if (ai->ai_family == NET_AF_INET6) {
		net_sin6(ai->ai_addr)->sin6_port = net_htons(ctx->port);
	} else {
		net_sin(ai->ai_addr)->sin_port = net_htons(ctx->port);
	}

	*addr = ai->ai_addr;
	*addrlen = ai->ai_addrlen;

	return 0;
}

void ready_resolve_free(struct ready_resolve *ctx)
{
	if (ctx->res != NULL) {
		zsock_freeaddrinfo(ctx->res);
	}

	ctx->res = NULL;
	ctx->next = NULL;
}

int ready_resolve_wait_change(const struct ready_resolve *ctx, k_timeout_t timeout)
{
	k_sleep(timeout);

	return -EAGAIN;
}
```
