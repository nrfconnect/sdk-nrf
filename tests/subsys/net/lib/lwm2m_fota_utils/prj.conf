## CMakeLists.txt
```
#
# Copyright (c) 2022 Nordic Semiconductor ASA
#
# SPDX-License-Identifier: LicenseRef-Nordic-5-Clause
#

cmake_minimum_required(VERSION 3.20.0)
find_package(Zephyr REQUIRED HINTS $ENV{ZEPHYR_BASE})
project(lwm2m_client_fota_unittest)



FILE(GLOB app_sources src/*.c )
target_sources(app
  PRIVATE
    ${app_sources}
    ${ZEPHYR_BASE}/subsys/net/lib/lwm2m/lwm2m_registry.c
    ${ZEPHYR_BASE}/subsys/net/lib/lwm2m/lwm2m_obj_firmware.c
    ${ZEPHYR_BASE}/subsys/net/lib/lwm2m/lwm2m_util.c
)


set(options
  -DCONFIG_LWM2M_ENGINE_MAX_PENDING=5
  -DCONFIG_LWM2M_ENGINE_MAX_REPLIES=5
  -DCONFIG_LWM2M_ENGINE_VALIDATION_BUFFER_SIZE=100
  -DCONFIG_LWM2M_DTLS_SUPPORT
  -DCONFIG_LWM2M_COAP_BLOCK_SIZE=512
  -DCONFIG_LWM2M_COAP_MAX_MSG_SIZE=512
  -DCONFIG_LWM2M_ENGINE_MESSAGE_HEADER_SIZE=10
  -DCONFIG_LWM2M_RD_CLIENT_SUPPORT_BOOTSTRAP
  -DCONFIG_LWM2M_CLIENT_UTILS_NEIGHBOUR_CELL_LISTENER
  -DCONFIG_LWM2M_CLIENT_UTILS_CONN_MON_OBJ_SUPPORT
  -DCONFIG_LTE_LC_TAU_PRE_WARNING_NOTIFICATIONS
  -DCONFIG_DOWNLOADER_STACK_SIZE=4096
  -DCONFIG_DOWNLOADER_MAX_HOSTNAME_SIZE=128
  -DCONFIG_DOWNLOADER_MAX_FILENAME_SIZE=128
  -DCONFIG_DOWNLOADER_TRANSPORT_PARAMS_SIZE=256
  -DCONFIG_LWM2M_FIRMWARE_UPDATE_OBJ_SUPPORT
  -DCONFIG_LWM2M_FIRMWARE_UPDATE_PULL_SUPPORT
  -DCONFIG_LWM2M_FIRMWARE_UPDATE_PUSH_TIMEOUT=180
  -DCONFIG_LWM2M_SWMGMT_PACKAGE_URI_LEN=128
  -DCONFIG_DFU_TARGET_MCUBOOT=y
  -DCONFIG_DFU_TARGET_MODEM_DELTA=y
  -DCONFIG_FOTA_DOWNLOAD_MCUBOOT_FLASH_BUF_SZ=512
  -DCONFIG_LWM2M_VERSION_1_0=y
  -DCONFIG_LWM2M_ENGINE_DEFAULT_LIFETIME=43200
  -D_POSIX_C_SOURCE=200809L
  -DCONFIG_LTE_LC_CONN_EVAL_MODULE=1
  -DCONFIG_LTE_LC_EDRX_MODULE=1
  -DCONFIG_LTE_LC_NEIGHBOR_CELL_MEAS_MODULE=1
  -DCONFIG_LTE_LC_PERIODIC_SEARCH_MODULE=1
  -DCONFIG_LTE_LC_PSM_MODULE=1
  -DCONFIG_LTE_LC_RAI_MODULE=1
  -DCONFIG_LTE_LC_MODEM_SLEEP_MODULE=1
  -DCONFIG_LTE_LC_TAU_PRE_WARNING_MODULE=1
  -DCONFIG_LTE_LC_NETWORK_REGISTRATION_MODULE=1
)

target_compile_options(app
  PRIVATE
  ${options}
)
target_compile_options(..__nrf__subsys__net__lib__lwm2m_client_utils
  PRIVATE
  ${options}
)

target_compile_options(..__nrf__subsys__dfu__dfu_target
  PRIVATE
  ${options}
)

set(includes
"${ZEPHYR_BASE}/subsys/net/lib/lwm2m/"
"${ZEPHYR_BASE}/../nrfxlib/nrf_modem/include/"
"${ZEPHYR_BASE}/../nrf/subsys/net/lib/fota_download/include/"
"src/"
)

target_include_directories(..__nrf__subsys__net__lib__lwm2m_client_utils
  PRIVATE
  ${includes}
)

target_include_directories(app
  PRIVATE
  ${includes}
)

zephyr_linker_sources(SECTIONS src/iterables.ld)
```

## prj.conf
```kconfig
#
# Copyright (c) 2022-2023 Nordic Semiconductor ASA
#
# SPDX-License-Identifier: LicenseRef-Nordic-5-Clause
#

CONFIG_ZTEST=y
CONFIG_LWM2M_CLIENT_UTILS=y
CONFIG_LWM2M_CLIENT_UTILS_FIRMWARE_UPDATE_OBJ_SUPPORT=y
CONFIG_LWM2M_CLIENT_UTILS_ADV_FIRMWARE_UPDATE_OBJ_SUPPORT=y
CONFIG_LWM2M_CLIENT_UTILS_LOCATION_OBJ_SUPPORT=n
CONFIG_HEAP_MEM_POOL_SIZE=1024
```

## prj_obj5.conf
```kconfig
#
# Copyright (c) 2022-2023 Nordic Semiconductor ASA
#
# SPDX-License-Identifier: LicenseRef-Nordic-5-Clause
#

CONFIG_ZTEST=y
CONFIG_LWM2M_CLIENT_UTILS=y
CONFIG_LWM2M_CLIENT_UTILS_FIRMWARE_UPDATE_OBJ_SUPPORT=y
CONFIG_LWM2M_CLIENT_UTILS_LOCATION_OBJ_SUPPORT=n
CONFIG_HEAP_MEM_POOL_SIZE=1024
```

## src/stubs.c
```c
/*
 * Copyright (c) 2022 Nordic Semiconductor ASA
 *
 * SPDX-License-Identifier: LicenseRef-Nordic-5-Clause
 */

#include <zephyr/ztest.h>
#include <zephyr/fff.h>

#include <net/lwm2m_client_utils.h>
#include <modem/nrf_modem_lib.h>
#include <modem/modem_key_mgmt.h>
#include <modem/lte_lc.h>
#include <modem/modem_info.h>
#include <zephyr/settings/settings.h>
#include <zephyr/sys/reboot.h>
#include <net/fota_download.h>
#include "stubs.h"

/*
 * Stubs are defined here, so that multiple .C files can share them
 * without having linker issues.
 */

DEFINE_FFF_GLOBALS;

DEFINE_FAKE_VALUE_FUNC(int, lwm2m_notify_observer, uint16_t, uint16_t, uint16_t);
DEFINE_FAKE_VALUE_FUNC(int, lwm2m_update_signal_meas_objects,
		       const struct lte_lc_cells_info *const);
DEFINE_FAKE_VALUE_FUNC(struct lwm2m_ctx *, lwm2m_rd_client_ctx);
DEFINE_FAKE_VOID_FUNC(lwm2m_rd_client_update);
DEFINE_FAKE_VALUE_FUNC(int, modem_key_mgmt_exists, nrf_sec_tag_t, enum modem_key_mgmt_cred_type,
		       bool *);
DEFINE_FAKE_VALUE_FUNC(int, modem_key_mgmt_write, nrf_sec_tag_t, enum modem_key_mgmt_cred_type,
		       const void *, size_t);
DEFINE_FAKE_VALUE_FUNC(int, lte_lc_func_mode_set, enum lte_lc_func_mode);
DEFINE_FAKE_VALUE_FUNC(int, lte_lc_connect);
DEFINE_FAKE_VALUE_FUNC(int, lte_lc_offline);
DEFINE_FAKE_VALUE_FUNC(int, lte_lc_func_mode_get, enum lte_lc_func_mode *);
DEFINE_FAKE_VALUE_FUNC(int, lte_lc_lte_mode_get, enum lte_lc_lte_mode *);
DEFINE_FAKE_VALUE_FUNC(int, lte_lc_ptw_set, enum lte_lc_lte_mode, const char *);
DEFINE_FAKE_VALUE_FUNC(int, lte_lc_psm_param_set, const char *, const char *);
DEFINE_FAKE_VALUE_FUNC(int, lte_lc_psm_req, bool);
DEFINE_FAKE_VALUE_FUNC(int, lte_lc_edrx_param_set, enum lte_lc_lte_mode, const char *);
DEFINE_FAKE_VALUE_FUNC(int, lte_lc_edrx_req, bool);
DEFINE_FAKE_VALUE_FUNC(int, lte_lc_neighbor_cell_measurement, struct lte_lc_ncellmeas_params *);
DEFINE_FAKE_VOID_FUNC(lte_lc_register_handler, lte_lc_evt_handler_t);
DEFINE_FAKE_VALUE_FUNC(int, settings_load_subtree, const char *);
DEFINE_FAKE_VALUE_FUNC(int, settings_register, struct settings_handler *);
DEFINE_FAKE_VALUE_FUNC(int, settings_subsys_init);
DEFINE_FAKE_VALUE_FUNC(int, settings_save_one, const char *, const void *, size_t);
DEFINE_FAKE_VALUE_FUNC(int, settings_delete, const char *);
DEFINE_FAKE_VALUE_FUNC(int, settings_name_next, const char *, const char **);
DEFINE_FAKE_VALUE_FUNC(int, modem_info_init);
DEFINE_FAKE_VALUE_FUNC(int, modem_info_params_init, struct modem_param_info *);
DEFINE_FAKE_VALUE_FUNC(int, modem_info_params_get, struct modem_param_info *);
DEFINE_FAKE_VALUE_FUNC(int, modem_info_rsrp_register, rsrp_cb_t);
DEFINE_FAKE_VALUE_FUNC(int, modem_info_get_hw_version, char *, uint8_t);
DEFINE_FAKE_VOID_FUNC(engine_trigger_update, bool);
DEFINE_FAKE_VALUE_FUNC(int, dfu_target_mcuboot_set_buf, uint8_t *, size_t);
DEFINE_FAKE_VALUE_FUNC(int, nrf_modem_lib_shutdown);
DEFINE_FAKE_VALUE_FUNC(int, nrf_modem_lib_init);
DEFINE_FAKE_VALUE_FUNC(int, fota_download_init, fota_download_callback_t);
DEFINE_FAKE_VALUE_FUNC(int, fota_download_start_with_image_type, const char *, const char *, int,
		       uint8_t, size_t, const enum dfu_target_image_type);
DEFINE_FAKE_VALUE_FUNC(int, fota_download_cancel);
DEFINE_FAKE_VALUE_FUNC(int, fota_download_target);
DEFINE_FAKE_VOID_FUNC(client_acknowledge);
DEFINE_FAKE_VALUE_FUNC(bool, boot_is_img_confirmed);
DEFINE_FAKE_VALUE_FUNC(int, boot_write_img_confirmed);
DEFINE_FAKE_VALUE_FUNC(int, dfu_target_mcuboot_init, size_t, int, dfu_target_callback_t);
DEFINE_FAKE_VALUE_FUNC(int, dfu_target_mcuboot_offset_get, size_t *);
DEFINE_FAKE_VALUE_FUNC(int, dfu_target_mcuboot_write, const void *const, size_t);
DEFINE_FAKE_VALUE_FUNC(int, dfu_target_mcuboot_done, bool);
DEFINE_FAKE_VALUE_FUNC(int, dfu_target_mcuboot_schedule_update, int);
DEFINE_FAKE_VALUE_FUNC(int, dfu_target_mcuboot_reset);
DEFINE_FAKE_VALUE_FUNC(bool, dfu_target_mcuboot_identify, const void *const);
DEFINE_FAKE_VALUE_FUNC(int, dfu_target_modem_delta_init, size_t, int, dfu_target_callback_t);
DEFINE_FAKE_VALUE_FUNC(int, dfu_target_modem_delta_offset_get, size_t *);
DEFINE_FAKE_VALUE_FUNC(int, dfu_target_modem_delta_write, const void *const, size_t);
DEFINE_FAKE_VALUE_FUNC(int, dfu_target_modem_delta_done, bool);
DEFINE_FAKE_VALUE_FUNC(int, dfu_target_modem_delta_schedule_update, int);
DEFINE_FAKE_VALUE_FUNC(int, dfu_target_modem_delta_reset);
DEFINE_FAKE_VALUE_FUNC(bool, dfu_target_modem_delta_identify, const void *const);
DEFINE_FAKE_VALUE_FUNC(int, modem_info_string_get, enum modem_info, char *, const size_t);
DEFINE_FAKE_VALUE_FUNC(int, boot_read_bank_header, uint8_t, struct mcuboot_img_header *, size_t);
DEFINE_FAKE_VOID_FUNC(clear_attrs, uint8_t, void *);
DEFINE_FAKE_VALUE_FUNC(int, lwm2m_notify_observer_path, const struct lwm2m_obj_path *);
DEFINE_FAKE_VOID_FUNC(engine_remove_observer_by_id, uint16_t, int32_t);
DEFINE_FAKE_VALUE_FUNC(int, lwm2m_engine_update_service_period, k_work_handler_t, uint32_t);
DEFINE_FAKE_VALUE_FUNC(int, lwm2m_engine_call_at, k_work_handler_t, int64_t);
DEFINE_FAKE_VALUE_FUNC(int, lwm2m_firmware_start_transfer, uint16_t, char *);
DEFINE_FAKE_VALUE_FUNC(int, fota_download_util_stream_init);
DEFINE_FAKE_VALUE_FUNC(int, fota_download_util_dfu_target_init, enum dfu_target_image_type);
DEFINE_FAKE_VALUE_FUNC(int, fota_download_util_download_start, const char *,
		       enum dfu_target_image_type, int, fota_download_callback_t);
DEFINE_FAKE_VALUE_FUNC(int, fota_download_util_download_cancel);
DEFINE_FAKE_VALUE_FUNC(int, fota_download_util_image_schedule, enum dfu_target_image_type);
DEFINE_FAKE_VALUE_FUNC(int, fota_download_util_image_reset, enum dfu_target_image_type);
DEFINE_FAKE_VALUE_FUNC(int, fota_download_util_apply_update, enum dfu_target_image_type);

static int lwm2m_engine_init(void)
{
	STRUCT_SECTION_FOREACH(lwm2m_init_func, init) {
		int ret = init->f();

		if (ret) {
			printf("Init function %p returned %d\n", init, ret);
		}
	}
	return 0;
}

SYS_INIT(lwm2m_engine_init, APPLICATION, CONFIG_KERNEL_INIT_PRIORITY_DEFAULT);

FUNC_NORETURN void sys_reboot(int types)
{
	while (1) {
		k_sleep(K_SECONDS(1));
	}
}
```

## src/stubs.h
```c
/*
 * Copyright (c) 2022 Nordic Semiconductor ASA
 *
 * SPDX-License-Identifier: LicenseRef-Nordic-5-Clause
 */

#ifndef STUBS_H_
#define STUBS_H_

#include <zephyr/ztest.h>
#include <zephyr/fff.h>
#include <nrf_modem.h>
#include <modem/nrf_modem_lib.h>
#include <net/lwm2m_client_utils.h>
#include <modem/modem_key_mgmt.h>
#include <modem/modem_info.h>
#include <modem/lte_lc.h>
#include <dfu/dfu_target_mcuboot.h>
#include <zephyr/settings/settings.h>
#include <zephyr/sys/reboot.h>
#include "lwm2m_engine.h"
#include <net/fota_download.h>

DECLARE_FAKE_VALUE_FUNC(int, lwm2m_notify_observer, uint16_t, uint16_t, uint16_t);
DECLARE_FAKE_VALUE_FUNC(int, lwm2m_update_signal_meas_objects,
			const struct lte_lc_cells_info *const);
DECLARE_FAKE_VALUE_FUNC(struct lwm2m_ctx *, lwm2m_rd_client_ctx);
DECLARE_FAKE_VOID_FUNC(lwm2m_rd_client_update);
DECLARE_FAKE_VALUE_FUNC(int, modem_key_mgmt_exists, nrf_sec_tag_t, enum modem_key_mgmt_cred_type,
			bool *);
DECLARE_FAKE_VALUE_FUNC(int, modem_key_mgmt_write, nrf_sec_tag_t, enum modem_key_mgmt_cred_type,
			const void *, size_t);
DECLARE_FAKE_VALUE_FUNC(int, lte_lc_func_mode_set, enum lte_lc_func_mode);
DECLARE_FAKE_VALUE_FUNC(int, lte_lc_connect);
DECLARE_FAKE_VALUE_FUNC(int, lte_lc_offline);
DECLARE_FAKE_VALUE_FUNC(int, lte_lc_func_mode_get, enum lte_lc_func_mode *);
DECLARE_FAKE_VALUE_FUNC(int, lte_lc_ptw_set, enum lte_lc_lte_mode, const char *);
DECLARE_FAKE_VALUE_FUNC(int, lte_lc_psm_param_set, const char *, const char *);
DECLARE_FAKE_VALUE_FUNC(int, lte_lc_psm_req, bool);
DECLARE_FAKE_VALUE_FUNC(int, lte_lc_edrx_param_set, enum lte_lc_lte_mode, const char *);
DECLARE_FAKE_VALUE_FUNC(int, lte_lc_edrx_req, bool);
DECLARE_FAKE_VALUE_FUNC(int, lte_lc_neighbor_cell_measurement, struct lte_lc_ncellmeas_params *);
DECLARE_FAKE_VOID_FUNC(lte_lc_register_handler, lte_lc_evt_handler_t);
DECLARE_FAKE_VALUE_FUNC(int, settings_load_subtree, const char *);
DECLARE_FAKE_VALUE_FUNC(int, settings_register, struct settings_handler *);
DECLARE_FAKE_VALUE_FUNC(int, settings_subsys_init);
DECLARE_FAKE_VALUE_FUNC(int, settings_save_one, const char *, const void *, size_t);
DECLARE_FAKE_VALUE_FUNC(int, settings_delete, const char *);
DECLARE_FAKE_VALUE_FUNC(int, settings_name_next, const char *, const char **);
DECLARE_FAKE_VOID_FUNC(engine_trigger_update, bool);
DECLARE_FAKE_VALUE_FUNC(int, modem_info_init);
DECLARE_FAKE_VALUE_FUNC(int, modem_info_params_init, struct modem_param_info *);
DECLARE_FAKE_VALUE_FUNC(int, modem_info_params_get, struct modem_param_info *);
DECLARE_FAKE_VALUE_FUNC(int, modem_info_get_hw_version, char *, uint8_t);
DECLARE_FAKE_VALUE_FUNC(int, lte_lc_lte_mode_get, enum lte_lc_lte_mode *);
DECLARE_FAKE_VALUE_FUNC(int, modem_info_rsrp_register, rsrp_cb_t);
DECLARE_FAKE_VALUE_FUNC(int, dfu_target_mcuboot_set_buf, uint8_t *, size_t);
DECLARE_FAKE_VALUE_FUNC(int, nrf_modem_lib_shutdown);
DECLARE_FAKE_VALUE_FUNC(int, nrf_modem_lib_init);
DECLARE_FAKE_VALUE_FUNC(int, fota_download_init, fota_download_callback_t);
DECLARE_FAKE_VALUE_FUNC(int, fota_download_start_with_image_type, const char *, const char *, int,
			uint8_t, size_t, const enum dfu_target_image_type);
DECLARE_FAKE_VALUE_FUNC(int, fota_download_cancel);
DECLARE_FAKE_VALUE_FUNC(int, fota_download_target);
DECLARE_FAKE_VOID_FUNC(client_acknowledge);
DECLARE_FAKE_VALUE_FUNC(bool, boot_is_img_confirmed);
DECLARE_FAKE_VALUE_FUNC(int, boot_write_img_confirmed);
DECLARE_FAKE_VALUE_FUNC(int, dfu_target_mcuboot_init, size_t, int, dfu_target_callback_t);
DECLARE_FAKE_VALUE_FUNC(int, dfu_target_mcuboot_offset_get, size_t *);
DECLARE_FAKE_VALUE_FUNC(int, dfu_target_mcuboot_write, const void *const, size_t);
DECLARE_FAKE_VALUE_FUNC(int, dfu_target_mcuboot_done, bool);
DECLARE_FAKE_VALUE_FUNC(int, dfu_target_mcuboot_schedule_update, int);
DECLARE_FAKE_VALUE_FUNC(int, dfu_target_mcuboot_reset);
DECLARE_FAKE_VALUE_FUNC(bool, dfu_target_mcuboot_identify, const void *const);
DECLARE_FAKE_VALUE_FUNC(int, dfu_target_modem_delta_init, size_t, int, dfu_target_callback_t);
DECLARE_FAKE_VALUE_FUNC(int, dfu_target_modem_delta_offset_get, size_t *);
DECLARE_FAKE_VALUE_FUNC(int, dfu_target_modem_delta_write, const void *const, size_t);
DECLARE_FAKE_VALUE_FUNC(int, dfu_target_modem_delta_done, bool);
DECLARE_FAKE_VALUE_FUNC(int, dfu_target_modem_delta_schedule_update, int);
DECLARE_FAKE_VALUE_FUNC(int, dfu_target_modem_delta_reset);
DECLARE_FAKE_VALUE_FUNC(bool, dfu_target_modem_delta_identify, const void *const);
DECLARE_FAKE_VALUE_FUNC(int, modem_info_string_get, enum modem_info, char *, const size_t);
DECLARE_FAKE_VALUE_FUNC(int, boot_read_bank_header, uint8_t, struct mcuboot_img_header *, size_t);
DECLARE_FAKE_VOID_FUNC(clear_attrs, uint8_t, void *);
DECLARE_FAKE_VALUE_FUNC(int, lwm2m_notify_observer_path, const struct lwm2m_obj_path *);
DECLARE_FAKE_VOID_FUNC(engine_remove_observer_by_id, uint16_t, int32_t);
DECLARE_FAKE_VALUE_FUNC(int, lwm2m_engine_update_service_period, k_work_handler_t, uint32_t);
DECLARE_FAKE_VALUE_FUNC(int, lwm2m_engine_call_at, k_work_handler_t, int64_t);
DECLARE_FAKE_VALUE_FUNC(int, lwm2m_firmware_start_transfer, uint16_t, char *);
DECLARE_FAKE_VALUE_FUNC(int, fota_download_util_stream_init);
DECLARE_FAKE_VALUE_FUNC(int, fota_download_util_dfu_target_init, enum dfu_target_image_type);
DECLARE_FAKE_VALUE_FUNC(int, fota_download_util_download_start, const char *,
		       enum dfu_target_image_type, int, fota_download_callback_t);
DECLARE_FAKE_VALUE_FUNC(int, fota_download_util_download_cancel);
DECLARE_FAKE_VALUE_FUNC(int, fota_download_util_image_schedule, enum dfu_target_image_type);
DECLARE_FAKE_VALUE_FUNC(int, fota_download_util_image_reset, enum dfu_target_image_type);
DECLARE_FAKE_VALUE_FUNC(int, fota_download_util_apply_update, enum dfu_target_image_type);


/* List of fakes used by this unit tester */
#define DO_FOREACH_FAKE(FUNC)                                                                      \
	do {                                                                                       \
		FUNC(lwm2m_notify_observer)                                                        \
		FUNC(lwm2m_update_signal_meas_objects)                                             \
		FUNC(lwm2m_rd_client_ctx)                                                          \
		FUNC(lwm2m_rd_client_update)                                                       \
		FUNC(modem_key_mgmt_exists)                                                        \
		FUNC(modem_key_mgmt_write)                                                         \
		FUNC(modem_info_init)                                                              \
		FUNC(modem_info_params_init)                                                       \
		FUNC(modem_info_params_get)                                                        \
		FUNC(modem_info_rsrp_register)                                                     \
		FUNC(lte_lc_func_mode_set)                                                         \
		FUNC(lte_lc_connect)                                                               \
		FUNC(lte_lc_offline)                                                               \
		FUNC(lte_lc_func_mode_get)                                                         \
		FUNC(lte_lc_lte_mode_get)                                                          \
		FUNC(lte_lc_ptw_set)                                                               \
		FUNC(lte_lc_psm_param_set)                                                         \
		FUNC(lte_lc_psm_req)                                                               \
		FUNC(lte_lc_edrx_param_set)                                                        \
		FUNC(lte_lc_edrx_req)                                                              \
		FUNC(lte_lc_neighbor_cell_measurement)                                             \
		FUNC(lte_lc_register_handler)                                                      \
		FUNC(settings_load_subtree)                                                        \
		FUNC(settings_register)                                                            \
		FUNC(settings_subsys_init)                                                         \
		FUNC(settings_save_one)                                                            \
		FUNC(settings_delete)                                                              \
		FUNC(settings_name_next)                                                           \
		FUNC(engine_trigger_update)                                                        \
		FUNC(dfu_target_mcuboot_set_buf)                                                   \
		FUNC(nrf_modem_lib_shutdown)                                                       \
		FUNC(nrf_modem_lib_init)                                                           \
		FUNC(fota_download_init)                                                           \
		FUNC(fota_download_start_with_image_type)                                          \
		FUNC(fota_download_cancel)                                                         \
		FUNC(fota_download_target)                                                         \
		FUNC(client_acknowledge)                                                           \
		FUNC(boot_is_img_confirmed)                                                        \
		FUNC(boot_write_img_confirmed)                                                     \
		FUNC(dfu_target_mcuboot_init)                                                      \
		FUNC(dfu_target_mcuboot_offset_get)                                                \
		FUNC(dfu_target_mcuboot_write)                                                     \
		FUNC(dfu_target_mcuboot_done)                                                      \
		FUNC(dfu_target_mcuboot_schedule_update)                                           \
		FUNC(dfu_target_mcuboot_reset)                                                     \
		FUNC(dfu_target_mcuboot_identify)                                                  \
		FUNC(dfu_target_modem_delta_init)                                                  \
		FUNC(dfu_target_modem_delta_offset_get)                                            \
		FUNC(dfu_target_modem_delta_write)                                                 \
		FUNC(dfu_target_modem_delta_done)                                                  \
		FUNC(dfu_target_modem_delta_schedule_update)                                       \
		FUNC(dfu_target_modem_delta_reset)                                                 \
		FUNC(dfu_target_modem_delta_identify)                                              \
		FUNC(modem_info_string_get)                                                        \
		FUNC(boot_read_bank_header)                                                        \
		FUNC(clear_attrs)                                                                  \
		FUNC(lwm2m_notify_observer_path)                                                   \
		FUNC(engine_remove_observer_by_id)                                                 \
		FUNC(lwm2m_engine_update_service_period)                                           \
		FUNC(lwm2m_engine_call_at)                                                         \
		FUNC(lwm2m_firmware_start_transfer)                                                \
		FUNC(fota_download_util_stream_init)                                               \
		FUNC(fota_download_util_dfu_target_init)                                           \
		FUNC(fota_download_util_download_start)                                            \
		FUNC(fota_download_util_download_cancel)                                           \
		FUNC(fota_download_util_image_schedule)                                            \
		FUNC(fota_download_util_image_reset)                                               \
		FUNC(fota_download_util_apply_update)                                              \
		FUNC(modem_info_get_hw_version)                                                    \
	} while (0)

#endif
```
