## CMakeLists.txt
```
#
# Copyright (c) 2023 Nordic Semiconductor ASA
#
# SPDX-License-Identifier: LicenseRef-Nordic-5-Clause
#

cmake_minimum_required(VERSION 3.20.0)
find_package(Zephyr REQUIRED HINTS $ENV{ZEPHYR_BASE})

project(nrf_provisioning_unittest)

set(app_sources)

set(options
  -DCONFIG_NRF_MODEM_LIB_MEM_DIAG=y
  -DCONFIG_NRF_PROVISIONING_JWT_MAX_VALID_TIME_S=300
  -DCONFIG_MODEM_JWT_MAX_LEN=850
)

cmock_handle(${ZEPHYR_NRF_MODULE_DIR}/include/modem/lte_lc.h
  FUNC_EXCLUDE ".*(lte_lc_rai_req|lte_lc_rai_param_set)"
  WORD_EXCLUDE "__deprecated"
)
cmock_handle(${ZEPHYR_NRF_MODULE_DIR}/include/modem/modem_key_mgmt.h)
cmock_handle(${ZEPHYR_NRF_MODULE_DIR}/include/attest_token.h)
cmock_handle(${ZEPHYR_NRF_MODULE_DIR}/include/modem/modem_info.h
  WORD_EXCLUDE "__deprecated"
)
cmock_handle(${ZEPHYR_NRF_MODULE_DIR}/include/modem/nrf_modem_lib.h)
cmock_handle(${ZEPHYR_BASE}/include/zephyr/settings/settings.h)
cmock_handle(${ZEPHYR_NRF_MODULE_DIR}/subsys/net/lib/nrf_provisioning/include/nrf_provisioning_at.h)
cmock_handle(${ZEPHYR_NRF_MODULE_DIR}/include/net/rest_client.h)
cmock_handle(include/nrf_modem_at.h)

if(CONFIG_SETTINGS_CUSTOM)
  test_runner_generate(src/http_jwt.c)
  list(APPEND app_sources src/http_jwt.c)
  cmock_handle(${ZEPHYR_NRF_MODULE_DIR}/include/modem/modem_jwt.h)
elseif(CONFIG_NRF_PROVISIONING_COAP)
  test_runner_generate(src/coap.c)
  list(APPEND app_sources src/coap.c)
  list (APPEND options
    -DCONFIG_COAP_CLIENT_MESSAGE_HEADER_SIZE=48
    -DCONFIG_COAP_CLIENT_MESSAGE_SIZE=512
    -DCONFIG_COAP_CLIENT_STACK_SIZE=1024
    -DCONFIG_MODEM_INFO_BUFFER_SIZE=128
    -DCONFIG_COAP_CLIENT_MAX_REQUESTS=2
    -DCONFIG_COAP_CLIENT_BLOCK_SIZE=256
    -DCONFIG_COAP_CLIENT_MAX_PATH_LENGTH=96
    -DCONFIG_COAP_CLIENT_MAX_EXTRA_OPTIONS=2
  )
  cmock_handle(${ZEPHYR_BASE}/include/zephyr/net/coap_client.h)
  cmock_handle(${ZEPHYR_NRF_MODULE_DIR}/subsys/net/lib/nrf_provisioning/include/nrf_provisioning_jwt.h)
  cmock_handle(${ZEPHYR_NRF_MODULE_DIR}/subsys/net/lib/nrf_provisioning/include/nrf_provisioning_internal.h)
elseif(CONFIG_NRF_PROVISIONING_HTTP AND NOT CONFIG_NRF_PROVISIONING_SCHEDULED)
  test_runner_generate(src/main.c)
  list(APPEND app_sources src/main.c)
  cmock_handle(${ZEPHYR_NRF_MODULE_DIR}/subsys/net/lib/nrf_provisioning/include/nrf_provisioning_jwt.h)
  cmock_handle(${ZEPHYR_NRF_MODULE_DIR}/subsys/net/lib/nrf_provisioning/include/nrf_provisioning_internal.h)
elseif(CONFIG_NRF_PROVISIONING_HTTP AND CONFIG_NRF_PROVISIONING_SCHEDULED)
  test_runner_generate(src/scheduled.c)
  list(APPEND app_sources src/scheduled.c)
  cmock_handle(${ZEPHYR_NRF_MODULE_DIR}/subsys/net/lib/nrf_provisioning/include/nrf_provisioning_jwt.h)
  cmock_handle(${ZEPHYR_NRF_MODULE_DIR}/subsys/net/lib/nrf_provisioning/include/nrf_provisioning_internal.h FUNC_EXCLUDE ".*(nrf_provisioning_schedule)")
endif()

target_sources(app PRIVATE ${app_sources})

target_compile_options(app
  PRIVATE
  ${options}
)

target_compile_options(..__nrf__subsys__net__lib__nrf_provisioning
  PRIVATE
  ${options}
)

set(includes
  "include/" # Must be included first to redefine functions as non-static-inline
  "${ZEPHYR_NRF_MODULE_DIR}/include/"
  "${ZEPHYR_NRF_MODULE_DIR}/subsys/net/lib/nrf_provisioning/include/"
  "${ZEPHYR_NRFXLIB_MODULE_DIR}/nrf_modem/include/"
  "${ZEPHYR_BASE}/include/"
  "src/"
)

target_include_directories(app
  PRIVATE
  ${includes}
)

target_include_directories(..__nrf__subsys__net__lib__nrf_provisioning
  PRIVATE
  ${includes}
)

target_link_libraries(..__nrf__subsys__net__lib__nrf_provisioning
  PRIVATE
  "-Wl,--wrap=k_malloc,--wrap=k_free"
)
```

## Kconfig
```
#
# Copyright (c) 2025 Nordic Semiconductor ASA
#
# SPDX-License-Identifier: LicenseRef-Nordic-5-Clause
#

menuconfig NRF_PROVISIONING
	bool "nRF Provisioning"
	select EXPERIMENTAL
	#depends on NRF_MODEM_LIB
	depends on SETTINGS
	imply FCB
	help
	  Redefinition to disable modemlib requirement from the tests as we want to mock it.

menuconfig NRF_PROVISIONING_CODEC
	bool "nRF Provisioning codec"
	select EXPERIMENTAL
	#depends on NRF_MODEM_LIB
	help
	  Redefinition to disable modemlib requirement from the tests as we want to mock it.

menu "Zephyr Kernel"
source "Kconfig.zephyr"
endmenu
```

## prj.conf
```kconfig
#
# Copyright (c) 2023 Nordic Semiconductor ASA
#
# SPDX-License-Identifier: LicenseRef-Nordic-5-Clause
#

CONFIG_UNITY=y
CONFIG_ASSERT=n

CONFIG_ASAN=y

CONFIG_DEBUG=y
CONFIG_NO_OPTIMIZATIONS=y

CONFIG_FCB=n
CONFIG_REST_CLIENT=n
CONFIG_MODEM_JWT=n

CONFIG_NRF_PROVISIONING=y
CONFIG_NRF_PROVISIONING_HTTP=y
CONFIG_NRF_PROVISIONING_ROOT_CA_SEC_TAG=-1
CONFIG_NRF_PROVISIONING_CODEC=y
CONFIG_NRF_PROVISIONING_CBOR=y
CONFIG_NRF_PROVISIONING_SPREAD_S=2
CONFIG_NRF_PROVISIONING_SCHEDULED=n
CONFIG_NRF_PROVISIONING_AUTO_START_ON_INIT=n

CONFIG_ZCBOR=y
CONFIG_ZCBOR_CANONICAL=y

CONFIG_SETTINGS=y
CONFIG_SETTINGS_NONE=y

CONFIG_LOG=y
CONFIG_LOG_MODE_IMMEDIATE=y
CONFIG_LOG_BACKEND_SHOW_COLOR=n
CONFIG_LOG_BACKEND_FORMAT_TIMESTAMP=n
CONFIG_LOG_PRINTK=y

CONFIG_NRF_PROVISIONING_INTERVAL_S=5
CONFIG_NRF_PROVISIONING_INITIAL_BACKOFF=1
CONFIG_NATIVE_SIM_SLOWDOWN_TO_REAL_TIME=n
```

## prj_coap.conf
```kconfig
#
# Copyright (c) 2023 Nordic Semiconductor ASA
#
# SPDX-License-Identifier: LicenseRef-Nordic-5-Clause
#

CONFIG_UNITY=y
CONFIG_ASSERT=y

CONFIG_ASAN=y

CONFIG_DEBUG=y
CONFIG_NO_OPTIMIZATIONS=y

CONFIG_FCB=n
CONFIG_REST_CLIENT=n
CONFIG_MODEM_JWT=n

CONFIG_NRF_PROVISIONING=y
CONFIG_NRF_PROVISIONING_COAP=y
CONFIG_NRF_PROVISIONING_ROOT_CA_SEC_TAG=-1
CONFIG_NRF_PROVISIONING_CODEC=y
CONFIG_NRF_PROVISIONING_CBOR=y
CONFIG_NRF_PROVISIONING_SPREAD_S=2
CONFIG_NRF_PROVISIONING_SAVE_CMD_ID=y

CONFIG_ZCBOR=y
CONFIG_ZCBOR_CANONICAL=y

CONFIG_SETTINGS=y
CONFIG_SETTINGS_NONE=y

CONFIG_LOG=y
CONFIG_LOG_MODE_IMMEDIATE=y
CONFIG_LOG_BACKEND_SHOW_COLOR=n
CONFIG_LOG_BACKEND_FORMAT_TIMESTAMP=n
CONFIG_LOG_PRINTK=y
CONFIG_NRF_PROVISIONING_LOG_LEVEL_DBG=y

CONFIG_NRF_PROVISIONING_INTERVAL_S=5
CONFIG_NRF_PROVISIONING_INITIAL_BACKOFF=1
CONFIG_NATIVE_SIM_SLOWDOWN_TO_REAL_TIME=n
```

## prj_jwt.conf
```kconfig
#
# Copyright (c) 2023 Nordic Semiconductor ASA
#
# SPDX-License-Identifier: LicenseRef-Nordic-5-Clause
#

CONFIG_UNITY=y
CONFIG_ASSERT=y

CONFIG_ASAN=y

CONFIG_DEBUG=y
CONFIG_NO_OPTIMIZATIONS=y

CONFIG_FCB=n
CONFIG_REST_CLIENT=n
CONFIG_MODEM_JWT=n

CONFIG_NRF_PROVISIONING=y
CONFIG_NRF_PROVISIONING_HTTP=y
CONFIG_NRF_PROVISIONING_COAP=n
CONFIG_NRF_PROVISIONING_ROOT_CA_SEC_TAG=-1
CONFIG_NRF_PROVISIONING_CODEC=y
CONFIG_NRF_PROVISIONING_CBOR=y

CONFIG_SETTINGS=y
CONFIG_SETTINGS_CUSTOM=y

CONFIG_ZCBOR=y
CONFIG_ZCBOR_CANONICAL=y

CONFIG_LOG=y
CONFIG_LOG_MODE_IMMEDIATE=y
CONFIG_LOG_BACKEND_SHOW_COLOR=n
CONFIG_LOG_BACKEND_FORMAT_TIMESTAMP=n
CONFIG_LOG_PRINTK=y

CONFIG_NRF_PROVISIONING_INTERVAL_S=5
CONFIG_NRF_PROVISIONING_INITIAL_BACKOFF=1
CONFIG_NATIVE_SIM_SLOWDOWN_TO_REAL_TIME=n
```

## prj_scheduled.conf
```kconfig
#
# Copyright (c) 2023 Nordic Semiconductor ASA
#
# SPDX-License-Identifier: LicenseRef-Nordic-5-Clause
#

CONFIG_UNITY=y
CONFIG_ASSERT=y

# CONFIG_ASAN=y

CONFIG_DEBUG=y
CONFIG_NO_OPTIMIZATIONS=y

CONFIG_FCB=n
CONFIG_REST_CLIENT=n
CONFIG_MODEM_JWT=n

CONFIG_NRF_PROVISIONING=y
CONFIG_NRF_PROVISIONING_LOG_LEVEL_DBG=y
CONFIG_NRF_PROVISIONING_HTTP=y
CONFIG_NRF_PROVISIONING_ROOT_CA_SEC_TAG=-1
CONFIG_NRF_PROVISIONING_CODEC=y
CONFIG_NRF_PROVISIONING_CBOR=y
CONFIG_NRF_PROVISIONING_SPREAD_S=2
CONFIG_NRF_PROVISIONING_SCHEDULED=y
CONFIG_NRF_PROVISIONING_AUTO_START_ON_INIT=y

CONFIG_ZCBOR=y
CONFIG_ZCBOR_CANONICAL=y

CONFIG_SETTINGS=y
CONFIG_SETTINGS_NONE=y

CONFIG_LOG=y
CONFIG_LOG_MODE_IMMEDIATE=y
CONFIG_LOG_BACKEND_SHOW_COLOR=n
CONFIG_LOG_BACKEND_FORMAT_TIMESTAMP=n
CONFIG_LOG_PRINTK=y

CONFIG_NRF_PROVISIONING_INTERVAL_S=120
CONFIG_NRF_PROVISIONING_INITIAL_BACKOFF=10
CONFIG_NATIVE_SIM_SLOWDOWN_TO_REAL_TIME=n
```

## include/coap_client.h
```c
/*
 * Copyright (c) 2023 Nordic Semiconductor ASA
 *
 * SPDX-License-Identifier: LicenseRef-Nordic-5-Clause
 */

#ifndef ZEPHYR_INCLUDE_NET_COAP_CLIENT_H_
#define ZEPHYR_INCLUDE_NET_COAP_CLIENT_H_

/** @file
 * @brief CoAP client API
 *
 * An API for applications to do CoAP requests
 */

/**
 * @brief CoAP client API
 * @defgroup coap_client CoAP client API
 * @ingroup networking
 * @{
 */

#include <zephyr/net/coap.h>


#define MAX_COAP_MSG_LEN (CONFIG_COAP_CLIENT_MESSAGE_HEADER_SIZE + \
			  CONFIG_COAP_CLIENT_MESSAGE_SIZE)

/**
 * @typedef coap_client_response_cb_t
 * @brief Callback for CoAP request.
 *
 * This callback is called for responses to CoAP client requests.
 * It is used to indicate errors, response codes from server or to deliver payload.
 * Blockwise transfers cause this callback to be called sequentially with increasing payload offset
 * and only partial content in buffer pointed by payload parameter.
 *
 * @param result_code Result code of the response. Negative if there was a failure in send.
 *                    @ref coap_response_code for positive.
 * @param offset Payload offset from the beginning of a blockwise transfer.
 * @param payload Buffer containing the payload from the response. NULL for empty payload.
 * @param len Size of the payload.
 * @param last_block Indicates the last block of the response.
 * @param user_data User provided context.
 */
typedef void (*coap_client_response_cb_t)(int16_t result_code,
					  size_t offset, const uint8_t *payload, size_t len,
					  bool last_block, void *user_data);

/**
 * @brief Representation of a CoAP client request.
 */
struct coap_client_request {
	enum coap_method method;            /**< Method of the request */
	bool confirmable;	            /**< CoAP Confirmable/Non-confirmable message */
	const char *path;	            /**< Path of the requested resource */
	enum coap_content_format fmt;       /**< Content format to be used */
	uint8_t *payload;	            /**< User allocated buffer for send request */
	size_t len;		            /**< Length of the payload */
	coap_client_response_cb_t cb;       /**< Callback when response received */
	struct coap_client_option *options; /**< Extra options to be added to request */
	uint8_t num_options;                /**< Number of extra options */
	void *user_data;	            /**< User provided context */
};

/**
 * @brief Representation of extra options for the CoAP client request
 */
struct coap_client_option {
	uint16_t code;
#if defined(CONFIG_COAP_EXTENDED_OPTIONS_LEN)
	uint16_t len;
	uint8_t value[CONFIG_COAP_EXTENDED_OPTIONS_LEN_VALUE];
#else
	uint8_t len;
	uint8_t value[12];
#endif
};

/** @cond INTERNAL_HIDDEN */
struct coap_client {
	int fd;
	struct sockaddr address;
	socklen_t socklen;
	uint8_t send_buf[MAX_COAP_MSG_LEN];
	uint8_t recv_buf[MAX_COAP_MSG_LEN];
	uint8_t request_token[COAP_TOKEN_MAX_LEN];
	int request_tkl;
	int offset;
	int retry_count;
	struct coap_block_context recv_blk_ctx;
	struct coap_block_context send_blk_ctx;
	struct coap_pending pending;
	struct coap_client_request *coap_request;
	struct coap_packet request;
};
/** @endcond */

/**
 * @brief Initialize the CoAP client.
 *
 * @param[in] client Client instance.
 * @param[in] info Name for the receiving thread of the client. Setting this NULL will result as
 *                 default name of "coap_client".
 *
 * @return int Zero on success, otherwise a negative error code.
 */
int coap_client_init(struct coap_client *client, const char *info);

/**
 * @brief Send CoAP request
 *
 * Operation is handled asynchronously using a background thread.
 * If the socket isn't connected to a destination address, user must provide a destination address,
 * otherwise the address should be set as NULL.
 * Once the callback is called with last block set as true, socket can be closed or
 * used for another query.
 *
 * @param client Client instance.
 * @param sock Open socket file descriptor.
 * @param addr the destination address of the request.
 * @param req CoAP request structure
 * @param retries How many times to retry or -1 to use default.
 * @return zero when operation started successfully or negative error code otherwise.
 */

int coap_client_req(struct coap_client *client, int sock, const struct sockaddr *addr,
		    struct coap_client_request *req, int retries);

/**
 * @}
 */

#endif /* ZEPHYR_INCLUDE_NET_COAP_CLIENT_H_ */
```

## include/nrf_modem_at.h
```c
/*
 * Copyright (c) 2021 Nordic Semiconductor ASA
 *
 * SPDX-License-Identifier: LicenseRef-Nordic-5-Clause
 */

/**
 * @file nrf_modem_at.h
 *
 * @defgroup nrf_modem_at AT commands interface
 * @{
 * @brief Modem library AT commands interface.
 */
#ifndef NRF_MODEM_AT_H__
#define NRF_MODEM_AT_H__

#include <stddef.h>
#include <stdbool.h>

#ifdef __cplusplus
extern "C" {
#endif

/** @brief Modem response type for 'ERROR' responses. */
#define NRF_MODEM_AT_ERROR 1
/** @brief Modem response type for '+CME ERROR' responses. */
#define NRF_MODEM_AT_CME_ERROR 2
/** @brief Modem response type for '+CMS ERROR' responses. */
#define NRF_MODEM_AT_CMS_ERROR 3

/**
 * @brief AT Notification handler prototype.
 *
 * @note This handler is executed in an interrupt service routine.
 * Offload any intensive operation as necessary.
 *
 * @param notif The AT notification.
 */
typedef void (*nrf_modem_at_notif_handler_t)(const char *notif);

/**
 * @brief Set a handler function for AT notifications.
 *
 * @note The callback is executed in an interrupt service routine.
 *	 Take care to offload any processing as appropriate.
 *
 * @param callback The AT notification callback. Use @c NULL to unset handler.
 *
 * @retval 0 On success.
 */
int nrf_modem_at_notif_handler_set(nrf_modem_at_notif_handler_t callback);

/**
 * @brief Send a formatted AT command to the modem.
 *
 * Supports all format specifiers of printf() as implemented by the selected C library.
 * This function can return a negative value, zero or a positive value.
 *
 * @param fmt Command format.
 * @param ... Format arguments.
 *
 * @retval  0 On "OK" responses.
 * @returns A positive value On "ERROR", "+CME ERROR", and "+CMS ERROR" responses.
 *	    The type of error can be distinguished using @c nrf_modem_at_err_type.
 *	    The error value can be retrieved using @c nrf_modem_at_err.
 * @retval -NRF_EPERM The Modem library is not initialized.
 * @retval -NRF_EFAULT @c fmt is @c NULL.
 * @retval -NRF_EINVAL Bad format @c fmt.
 * @retval -NRF_EAGAIN Timed out while waiting for another AT command to complete.
 * @retval -NRF_ENOMEM Not enough shared memory for this request.
 * @retval -NRF_ESHUTDOWN If modem was shut down.
 */
int nrf_modem_at_printf(const char *fmt, ...);

/**
 * @brief Send an AT command to the modem and read the formatted response
 *	  into the supplied argument list.
 *
 * Supports all the format specifiers of scanf() as implemented by the selected C library.
 * This function does not support retrieving the modem response beyond reading
 * the formatted response into the argument list.
 *
 * @param cmd AT command.
 * @param fmt Response format.
 * @param ... Variable argument list.
 *
 * @returns The number of arguments matched.
 * @retval -NRF_EPERM The Modem library is not initialized.
 * @retval -NRF_EFAULT @c cmd or @c fmt are @c NULL.
 * @retval -NRF_EBADMSG No arguments were matched.
 * @retval -NRF_EAGAIN Timed out while waiting for another AT command to complete.
 * @retval -NRF_ENOMEM Not enough shared memory for this request.
 * @retval -NRF_ESHUTDOWN If the modem was shut down.
 */
int nrf_modem_at_scanf(const char *cmd, const char *fmt, ...);

/**
 * @brief Send a formatted AT command to the modem
 *	  and receive the response into the supplied buffer.
 *
 * @param buf Buffer to receive the response into.
 * @param len Buffer length.
 * @param fmt Command format.
 * @param ... Format arguments.
 *
 * @retval  0 On "OK" responses.
 * @returns A positive value On "ERROR", "+CME ERROR", and "+CMS ERROR" responses.
 *	    The type of error can be distinguished using @c nrf_modem_at_err_type.
 *	    The error value can be retrieved using @c nrf_modem_at_err.
 * @retval -NRF_EPERM The Modem library is not initialized.
 * @retval -NRF_EFAULT @c buf or @c fmt are @c NULL.
 * @retval -NRF_EINVAL Bad format @c fmt, or @c len is zero.
 * @retval -NRF_EAGAIN Timed out while waiting for another AT command to complete.
 * @retval -NRF_ENOMEM Not enough shared memory for this request.
 * @retval -NRF_E2BIG The response is larger than the supplied buffer @c buf.
 * @retval -NRF_ESHUTDOWN If the modem was shut down.
 */
int nrf_modem_at_cmd(void *buf, size_t len, const char *fmt, ...);

/**
 * @brief AT response handler prototype.
 *
 * @note This handler is executed in an interrupt service routine.
 * Offload any intensive operations as necessary.
 *
 * @param resp The AT command response.
 */
typedef void (*nrf_modem_at_resp_handler_t)(const char *resp);

/**
 * @brief Send a formatted AT command to the modem
 *	  and receive the response asynchronously via a callback.
 *
 * This function waits for the Modem to acknowledge the AT command
 * but will return without waiting for the command execution.
 *
 * @note The callback is executed in an interrupt context.
 *	 Take care to offload any processing as appropriate.
 *
 * @param callback Callback to receive the response.
 * @param fmt Command format.
 * @param ... Format arguments.
 *
 * @retval  0 On "OK" responses.
 * @retval -NRF_EPERM The Modem library is not initialized.
 * @retval -NRF_EFAULT @c callback or @c fmt are @c NULL.
 * @retval -NRF_EINVAL Bad format @c fmt.
 * @retval -NRF_EINPROGRESS Another AT command is executing.
 * @retval -NRF_ENOMEM Not enough shared memory for this request.
 * @retval -NRF_ESHUTDOWN If the modem was shut down.
 */
int nrf_modem_at_cmd_async(nrf_modem_at_resp_handler_t callback, const char *fmt, ...);

/** @brief AT command handler prototype.
 *
 * Implements a custom AT command in the application.
 *
 * @param buf Buffer to receive the response into.
 * @param len Buffer length.
 * @param at_cmd AT command.
 *
 * @retval  0 On "OK" responses.
 * @returns A positive value On "ERROR", "+CME ERROR", and "+CMS ERROR" responses.
 *	    The type of error can be distinguished using @c nrf_modem_at_err_type.
 *	    The error value can be retrieved using @c nrf_modem_at_err.
 * @retval -NRF_EPERM The Modem library is not initialized.
 * @retval -NRF_EFAULT @c buf or @c fmt are @c NULL.
 * @retval -NRF_ENOMEM Not enough shared memory for this request.
 * @retval -NRF_E2BIG The response is larger than the supplied buffer @c buf.
 */
typedef int (*nrf_modem_at_cmd_custom_handler_t)(char *buf, size_t len, char *at_cmd);

/**
 * @brief Custom AT command.
 *
 * Application-defined AT command implementation.
 */
struct nrf_modem_at_cmd_custom {
	/** The AT command to implement. */
	const char * const cmd;
	/** The function implementing the AT command. */
	const nrf_modem_at_cmd_custom_handler_t callback;
};

/**
 * @brief Set a list of custom AT commands that are implemented in the application.
 *
 * When a custom AT command list is set, AT commands sent via @c nrf_modem_at_cmd that match any
 * AT command in the list, will be redirected to the custom callback function instead
 * of being sent to the modem.
 *
 * @note The custom commands are disabled by passing NULL to the @c custom_commands and
 * 0 to the @c len.
 *
 * @param custom_commands List of custom AT commands.
 * @param len Custom AT command list size.
 *
 * @retval  0 On success.
 * @retval -NRF_EINVAL On invalid parameters.
 */
int nrf_modem_at_cmd_custom_set(struct nrf_modem_at_cmd_custom *custom_commands, size_t len);

/**
 * @brief Configure how long to wait for ongoing AT commands to complete when sending AT commands.
 *
 * AT commands are executed one at a time. While one AT command is being executed, the other
 * AT commands wait on a semaphore for the ongoing AT command to complete.
 *
 * This function configures how long @c nrf_modem_at_printf, @c nrf_modem_at_scanf and
 * @c nrf_modem_at_cmd shall wait for ongoing AT commands to complete.
 *
 * By default, the timeout is infinite.
 *
 * @param timeout_ms Timeout in milliseconds. Use NRF_MODEM_OS_FOREVER for infinite timeout
 *		     or NRF_MODEM_OS_NO_WAIT for no timeout.
 *
 * @return int Zero on success, a negative errno otherwise.
 */
int nrf_modem_at_sem_timeout_set(int timeout_ms);

/**
 * @brief Return the error type represented by the return value of
 *	  @c nrf_modem_at_printf and @c nrf_modem_at_cmd.
 *
 * @param error The return value of @c nrf_modem_at_printf or @c nrf_modem_at_cmd.
 *
 * @retval NRF_MODEM_AT_ERROR If the modem response was 'ERROR'.
 * @retval NRF_MODEM_AT_CME_ERROR If the modem response was '+CME ERROR'.
 * @retval NRF_MODEM_AT_CMS_ERROR If the modem response was '+CMS ERROR'.
 */
int nrf_modem_at_err_type(int error);

/**
 * @brief Retrieve the specific CME or CMS error from the return value of
 *	  a @c nrf_modem_at_printf or @c nrf_modem_at_cmd call.
 *
 * @param error The return value of a @c nrf_modem_at_printf or @c nrf_modem_at_cmd call.
 *
 * @returns int The CME or CMS error code.
 */
int nrf_modem_at_err(int error);

#ifdef __cplusplus
}
#endif

#endif /* NRF_MODEM_AT_H__ */
/** @} */
```

## src/http_jwt.c
```c
/*
 * Copyright (c) 2023 Nordic Semiconductor ASA
 *
 * SPDX-License-Identifier: LicenseRef-Nordic-5-Clause
 */

#include "unity.h"
#include <zephyr/kernel.h>
#include <stdio.h>
#include <stdlib.h>

#include "nrf_provisioning_http.h"

#include "cmock_rest_client.h"
#include "cmock_modem_info.h"
#include "cmock_nrf_provisioning_at.h"
#include "cmock_modem_jwt.h"

#define AUTH_HDR_BEARER_PREFIX_JWT "Authorization: Bearer "
#define AUTH_HDR_BEARER_JWT_DUMMY "dummy_json_web_token"
#define CRLF "\r\n"

static char ok_jwt_fake[] = AUTH_HDR_BEARER_JWT_DUMMY;
static char ok_jwt_http_hdr_fake[] = AUTH_HDR_BEARER_PREFIX_JWT AUTH_HDR_BEARER_JWT_DUMMY CRLF;

void *__wrap_k_malloc(size_t size)
{
	return malloc(size);
}

void __wrap_k_free(void *ptr)
{
	free(ptr);
}

int custom_nrf_modem_at_cmd(void *buf, size_t len, const char *fmt, va_list argp)
{
	return 0;
}

static int modem_jwt_generate_fake(struct jwt_data *const jwt, int cmock_num_calls)
{
	memcpy(jwt->jwt_buf, ok_jwt_fake, strlen(ok_jwt_fake) + 1);

	return 0;
}

static int rest_client_request_auth_hdr_valid(struct rest_client_req_context *req_ctx,
				    struct rest_client_resp_context *resp_ctx, int cmock_num_calls)
{
	int cnt = 0;

	(void)cmock_num_calls;

	for (int i = 0; req_ctx->header_fields && req_ctx->header_fields[i]; i++) {
		if (strcmp(ok_jwt_http_hdr_fake, req_ctx->header_fields[i]) == 0) {
			cnt++;
		}
	}

	resp_ctx->http_status_code = NRF_PROVISIONING_HTTP_STATUS_NO_CONTENT;

	TEST_ASSERT_EQUAL_INT(1, cnt);

	return 0;
}

void setUp(void)
{
}

void tearDown(void)
{
}

/*
 * - JWT is generated and placed as one of the HTTP headers
 * - To have a valid token for authentication
 * - Retrieves a dummy token and writes an authentication header based on it
 */
void test_http_commands_auth_hdr_valid(void)
{
	int ret;
	char mfw_version[] = "mfw_nrf9160_99.99.99-DUMMY";

	struct nrf_provisioning_http_context rest_ctx = {
		.connect_socket = REST_CLIENT_SCKT_CONNECT,
	};

	__cmock_rest_client_request_defaults_set_Ignore();
	__cmock_modem_info_get_fw_version_ExpectAnyArgsAndReturn(0);
	__cmock_modem_info_get_fw_version_ReturnArrayThruPtr_buf(mfw_version, sizeof(mfw_version));

	__cmock_modem_jwt_generate_Stub(modem_jwt_generate_fake);

	__cmock_nrf_provisioning_at_time_get_ExpectAnyArgsAndReturn(0);

	__cmock_rest_client_request_Stub(rest_client_request_auth_hdr_valid);

	ret = nrf_provisioning_http_req(&rest_ctx);
}

extern int unity_main(void);

int main(void)
{
	(void)unity_main();

	return 0;
}
```

## src/net_mgmt_mock.c
```c
/*
 * Copyright (c) 2023 Nordic Semiconductor ASA
 *
 * SPDX-License-Identifier: LicenseRef-Nordic-5-Clause
 */

#include <zephyr/net/net_mgmt.h>

/* Simple stub implementations for the net_mgmt functions we need to mock */

void net_mgmt_init_event_callback(struct net_mgmt_event_callback *cb,
				  net_mgmt_event_handler_t handler,
				  uint64_t mgmt_event_mask)
{
	/* Mock implementation - do nothing */
	(void)cb;
	(void)handler;
	(void)mgmt_event_mask;
}

void net_mgmt_add_event_callback(struct net_mgmt_event_callback *cb)
{
	/* Mock implementation - do nothing */
	(void)cb;
}
```

## src/scheduled.c
```c
/*
 * Copyright (c) 2025 Nordic Semiconductor ASA
 *
 * SPDX-License-Identifier: LicenseRef-Nordic-5-Clause
 */

#ifdef _POSIX_C_SOURCE
#undef _POSIX_C_SOURCE
#endif
/* Define _POSIX_C_SOURCE before including <string.h> in order to use `strtok_r`. */
#define _POSIX_C_SOURCE 200809L

#include <zephyr/kernel.h>
#include <zephyr/sys/reboot.h>
#include <zephyr/sys/util.h>
#include "unity.h"
#include <stdlib.h>
#include <string.h>
#include <time.h>
#include <ncs_version.h>

#include "cmock_lte_lc.h"
#include "cmock_attest_token.h"
#include "cmock_modem_key_mgmt.h"
#include "cmock_modem_info.h"
#include "cmock_nrf_modem_lib.h"
#include "cmock_nrf_modem_at.h"
#include "cmock_nrf_provisioning_at.h"
#include "cmock_rest_client.h"
#include "cmock_settings.h"
#include "cmock_nrf_provisioning_jwt.h"
#include "cmock_nrf_provisioning_internal.h"

#include "nrf_provisioning_codec.h"
#include "nrf_provisioning_http.h"
#include "nrf_provisioning_internal.h"
#include "net/nrf_provisioning.h"

#define AUTH_HDR_BEARER "Authorization: Bearer "
#define AUTH_HDR_BEARER_JWT_DUMMY "dummy_json_web_token"

#define CRLF "\r\n"

#define EXPECT_NO_EVENTS_TIMEOUT_SECONDS 10000

char tok_jwt_plain[] = AUTH_HDR_BEARER_JWT_DUMMY;
char http_auth_hdr[] = AUTH_HDR_BEARER AUTH_HDR_BEARER_JWT_DUMMY CRLF;
char MFW_VER[] = "mfw_nrf9161_99.99.99-DUMMY";

/* [["9685ef84-8cac-4257-b5cc-94bc416a1c1d.d", 2]] */
static unsigned char cbor_cmds1_valid[] = {
	0x81, 0x82, 0x78, 0x26, 0x39, 0x36, 0x38, 0x35, 0x65,
	0x66, 0x38, 0x34, 0x2d, 0x38, 0x63, 0x61, 0x63, 0x2d,
	0x34, 0x32, 0x35, 0x37, 0x2d, 0x62, 0x35, 0x63, 0x63,
	0x2d, 0x39, 0x34, 0x62, 0x63, 0x34, 0x31, 0x36, 0x61,
	0x31, 0x63, 0x31, 0x64, 0x2e, 0x64, 0x02
};

K_SEM_DEFINE(event_received_sem, 0, 1);

static struct nrf_provisioning_callback_data event_data = { 0 };

static void nrf_provisioning_event_cb(const struct nrf_provisioning_callback_data *event)
{
	switch (event->type) {
	case NRF_PROVISIONING_EVENT_START:
		printk("Provisioning started\n");
		break;
	case NRF_PROVISIONING_EVENT_STOP:
		printk("Provisioning stopped\n");
		break;
	case NRF_PROVISIONING_EVENT_DONE:
		printk("Provisioning done\n");
		break;
	case NRF_PROVISIONING_EVENT_FAILED:
		printk("Provisioning failed\n");
		break;
	case NRF_PROVISIONING_EVENT_NO_COMMANDS:
		printk("No commands from server\n");
		break;
	case NRF_PROVISIONING_EVENT_FAILED_TOO_MANY_COMMANDS:
		printk("Too many commands\n");
		break;
	case NRF_PROVISIONING_EVENT_FAILED_DEVICE_NOT_CLAIMED:
		printk("Device not claimed\n");
		break;
	case NRF_PROVISIONING_EVENT_FAILED_WRONG_ROOT_CA:
		printk("Wrong root CA\n");
		break;
	case NRF_PROVISIONING_EVENT_FAILED_NO_VALID_DATETIME:
		printk("No valid datetime\n");
		break;
	case NRF_PROVISIONING_EVENT_NEED_LTE_DEACTIVATED:
		printk("Need LTE deactivated\n");
		break;
	case NRF_PROVISIONING_EVENT_NEED_LTE_ACTIVATED:
		printk("Need LTE activated\n");
		break;
	case NRF_PROVISIONING_EVENT_SCHEDULED_PROVISIONING:
		printk("Scheduled provisioning\n");
		break;
	case NRF_PROVISIONING_EVENT_FATAL_ERROR:
		printk("Fatal error\n");
		break;
	}

	event_data = *event;

	k_sem_give(&event_received_sem);
}

static void wait_for_provisioning_event(enum nrf_provisioning_event event)
{
	k_sem_take(&event_received_sem, K_FOREVER);

	if (event_data.type != event) {
		printk("Expected event: %d, received event: %d\n", event, event_data.type);
		TEST_FAIL_MESSAGE("Unexpected provisioning event received");
	}
}

static void wait_for_no_provisioning_event(int timeout_seconds)
{
	int ret;

	ret = k_sem_take(&event_received_sem, K_SECONDS(timeout_seconds));
	if (ret == 0) {
		printk("Unexpected provisioning event received, event: %d\n", event_data.type);
		TEST_FAIL_MESSAGE("Unexpected provisioning event received");
	}
}

/* Malloc and free are to be used in native_sim environment */
void *__wrap_k_malloc(size_t size)
{
	return malloc(size);
}

void __wrap_k_free(void *ptr)
{
	free(ptr);
}

static int rest_client_request_no_commands_cb(struct rest_client_req_context *req_ctx,
					       struct rest_client_resp_context *resp_ctx,
					       int cmock_num_calls)
{
	resp_ctx->http_status_code = NRF_PROVISIONING_HTTP_STATUS_NO_CONTENT;
	return 0;
}

static int rest_client_request_too_many_commands_cb(struct rest_client_req_context *req_ctx,
						 struct rest_client_resp_context *resp_ctx,
						 int cmock_num_calls)
{
	return -ENOMEM;
}

static int rest_client_request_server_error_cb(struct rest_client_req_context *req_ctx,
						struct rest_client_resp_context *resp_ctx,
						int cmock_num_calls)
{
	resp_ctx->http_status_code = NRF_PROVISIONING_HTTP_STATUS_INTERNAL_SERVER_ERR;
	return 0;
}

static int rest_client_request_not_found_cb(struct rest_client_req_context *req_ctx,
					     struct rest_client_resp_context *resp_ctx,
					     int cmock_num_calls)
{
	resp_ctx->http_status_code = NRF_PROVISIONING_HTTP_STATUS_UNAUTH;
	return 0;
}

static int rest_client_request_timeout_cb(struct rest_client_req_context *req_ctx,
					   struct rest_client_resp_context *resp_ctx,
					   int cmock_num_calls)
{
	return -ETIMEDOUT;
}

static int rest_client_request_wrong_root_ca_cb(struct rest_client_req_context *req_ctx,
					     struct rest_client_resp_context *resp_ctx,
					     int cmock_num_calls)
{
	return -ECONNREFUSED;
}

static int rest_client_request_with_commands_cb(struct rest_client_req_context *req_ctx,
						struct rest_client_resp_context *resp_ctx,
						int cmock_num_calls)
{
	static int scenario_call_count;

	/* For scenario 3, we expect exactly 2 calls in sequence:
	 * First call: Get commands - should return CBOR data and return 1
	 * Second call: Upload responses - should return success and return 0
	 */
	if (scenario_call_count % 2 == 0) {
		/* First call of the pair - return commands */
		resp_ctx->response = req_ctx->resp_buff;
		memcpy(resp_ctx->response, cbor_cmds1_valid, sizeof(cbor_cmds1_valid));
		resp_ctx->response_len = sizeof(cbor_cmds1_valid);
		resp_ctx->http_status_code = NRF_PROVISIONING_HTTP_STATUS_OK;
		scenario_call_count++;
		return 1; /* Positive return indicates commands processed */
	}

	/* Second call of the pair - upload responses, just return success */
	resp_ctx->http_status_code = NRF_PROVISIONING_HTTP_STATUS_OK;
	resp_ctx->response_len = 0; /* No response body needed */
	scenario_call_count++;
	return 0; /* Success */
}

void setUp(void)
{
	k_sem_reset(&event_received_sem);
}

void test_provisioning_init_should_start_provisioning(void)
{
	__cmock_modem_key_mgmt_exists_IgnoreAndReturn(0);
	__cmock_modem_info_init_IgnoreAndReturn(0);
	__cmock_nrf_modem_lib_init_IgnoreAndReturn(0);
	__cmock_settings_subsys_init_IgnoreAndReturn(0);
	__cmock_settings_register_IgnoreAndReturn(0);
	__cmock_settings_load_subtree_IgnoreAndReturn(0);
	__cmock_lte_lc_register_handler_Ignore();
	__cmock_nrf_provisioning_at_time_get_IgnoreAndReturn(0);
	__cmock_nrf_provisioning_notify_event_and_wait_for_modem_state_IgnoreAndReturn(0);
	__cmock_rest_client_request_defaults_set_Ignore();
	__cmock_modem_info_get_fw_version_IgnoreAndReturn(0);
	__cmock_modem_info_get_fw_version_ReturnArrayThruPtr_buf(MFW_VER, sizeof(MFW_VER));

	__cmock_nrf_provisioning_jwt_generate_IgnoreAndReturn(0);
	__cmock_nrf_provisioning_jwt_generate_CMockReturnMemThruPtr_jwt_buf(
		CONFIG_NRF_PROVISIONING_JWT_MAX_VALID_TIME_S, tok_jwt_plain,
		strlen(tok_jwt_plain) + 1);

	int ret = nrf_provisioning_init(nrf_provisioning_event_cb);

	TEST_ASSERT_EQUAL_INT(0, ret);

	for (int i = 0; i < 100; i++) {
		/* Wait for scheduled provisioning event */
		wait_for_provisioning_event(NRF_PROVISIONING_EVENT_SCHEDULED_PROVISIONING);

		/* Verify next attempt time is within expected range */
		TEST_ASSERT_LESS_OR_EQUAL_INT(
			(CONFIG_NRF_PROVISIONING_INTERVAL_S + CONFIG_NRF_PROVISIONING_SPREAD_S),
			event_data.next_attempt_time_seconds);

		/* Wait for the scheduled time (no events should occur during this period) */
		wait_for_no_provisioning_event(event_data.next_attempt_time_seconds);

		/* Provisioning should start */
		wait_for_provisioning_event(NRF_PROVISIONING_EVENT_START);

		/* Test different scenarios in rotation */
		int scenario = i % 7;

		switch (scenario) {
		case 0: /* No commands from server */
			__cmock_rest_client_request_ExpectAnyArgsAndReturn(0);
			__cmock_rest_client_request_AddCallback(
				rest_client_request_no_commands_cb);
			wait_for_provisioning_event(NRF_PROVISIONING_EVENT_NO_COMMANDS);
			break;

		case 1: /* Device not found/claimed */
			__cmock_rest_client_request_ExpectAnyArgsAndReturn(0);
			__cmock_attest_token_get_ExpectAnyArgsAndReturn(0);
			__cmock_attest_token_free_ExpectAnyArgs();
			__cmock_rest_client_request_AddCallback(
				rest_client_request_not_found_cb);
			wait_for_provisioning_event(
				NRF_PROVISIONING_EVENT_FAILED_DEVICE_NOT_CLAIMED);
			break;

		case 2: /* Too many commands */
			__cmock_rest_client_request_ExpectAnyArgsAndReturn(0);
			__cmock_rest_client_request_AddCallback(
				rest_client_request_too_many_commands_cb);
			wait_for_provisioning_event(
				NRF_PROVISIONING_EVENT_FAILED_TOO_MANY_COMMANDS);
			break;

		case 3: /* Successful provisioning with commands */
			__cmock_rest_client_request_ExpectAnyArgsAndReturn(1);
			__cmock_rest_client_request_ExpectAnyArgsAndReturn(0);
			__cmock_rest_client_request_AddCallback(
				rest_client_request_with_commands_cb);

			__cmock_nrf_provisioning_at_cmee_enable_ExpectAndReturn(true);
			__cmock_nrf_provisioning_at_cmee_control_ExpectAnyArgsAndReturn(0);

			wait_for_provisioning_event(NRF_PROVISIONING_EVENT_DONE);
			break;

		case 4: /* Wrong root CA */
			__cmock_rest_client_request_ExpectAnyArgsAndReturn(0);
			__cmock_rest_client_request_AddCallback(
				rest_client_request_wrong_root_ca_cb);
			wait_for_provisioning_event(NRF_PROVISIONING_EVENT_FAILED_WRONG_ROOT_CA);
			break;

		case 5: /* Timeout */
			__cmock_rest_client_request_ExpectAnyArgsAndReturn(-ETIMEDOUT);
			__cmock_rest_client_request_AddCallback(rest_client_request_timeout_cb);

			wait_for_provisioning_event(NRF_PROVISIONING_EVENT_FAILED);
			wait_for_provisioning_event(NRF_PROVISIONING_EVENT_STOP);

			/* Retry provisioning after timeout */
			wait_for_provisioning_event(NRF_PROVISIONING_EVENT_START);

			__cmock_rest_client_request_ExpectAnyArgsAndReturn(0);
			__cmock_rest_client_request_AddCallback(
				rest_client_request_too_many_commands_cb);
			wait_for_provisioning_event(
				NRF_PROVISIONING_EVENT_FAILED_TOO_MANY_COMMANDS);
			break;

		case 6: /* Server error busy */
			__cmock_rest_client_request_ExpectAnyArgsAndReturn(-EBUSY);
			__cmock_rest_client_request_AddCallback(
				rest_client_request_server_error_cb);

			wait_for_provisioning_event(NRF_PROVISIONING_EVENT_FAILED);
			wait_for_provisioning_event(NRF_PROVISIONING_EVENT_STOP);

			/* Retry provisioning after server error */
			wait_for_provisioning_event(NRF_PROVISIONING_EVENT_START);
			__cmock_rest_client_request_ExpectAnyArgsAndReturn(0);
			__cmock_rest_client_request_AddCallback(rest_client_request_no_commands_cb);
			wait_for_provisioning_event(NRF_PROVISIONING_EVENT_NO_COMMANDS);
			break;
		}

		/* If adding more cases here, increase the scenario count, 'scenario' */

		/* Provisioning should stop after each attempt */
		wait_for_provisioning_event(NRF_PROVISIONING_EVENT_STOP);
	}
}

/*
 * - Get when next provisioning should be executed
 * - The client should follow the interval configured at compile time
 * - Call the function and check that the returned interval is within the expected range.
 *   The compile time configuration is used as we are not reading the value from flash
 *   storage
 */
void test_provisioning_schedule_valid(void)
{
	/* To avoid being entangled to other tests let's assume that the function has
	 * never been called earlier. If that's not the case let's just ignore the first invocation.
	 */
	(void)nrf_provisioning_schedule();

	int ret = nrf_provisioning_schedule();

	/* Can't have exact match due to the spread factor */
	TEST_ASSERT_GREATER_OR_EQUAL(0, ret);
	TEST_ASSERT_LESS_OR_EQUAL_INT(
		CONFIG_NRF_PROVISIONING_INTERVAL_S + CONFIG_NRF_PROVISIONING_SPREAD_S, ret);
}

extern int unity_main(void);

int main(void)
{
	(void)unity_main();

	return 0;
}
```
