/*
 * Copyright (c) 2026 Nordic Semiconductor ASA
 *
 * SPDX-License-Identifier: LicenseRef-Nordic-5-Clause
 */

#include <samples/cellular/nrf91_crypto_partitions.dtsi>

s0_partition: &slot0_s_partition {};

s1_partition: &slot0_ns_partition {};
