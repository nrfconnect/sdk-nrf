## CMakeLists.txt
```
#
# Copyright (c) 2022 Nordic Semiconductor
#
# SPDX-License-Identifier: LicenseRef-Nordic-5-Clause
#
#

cmake_minimum_required(VERSION 3.20.0)

find_package(Zephyr REQUIRED HINTS $ENV{ZEPHYR_BASE})
project(fota_download)

FILE(GLOB app_sources src/*.c)
target_sources(app PRIVATE ${app_sources})

target_sources(app
  PRIVATE
  ${ZEPHYR_NRF_MODULE_DIR}/subsys/net/lib/fota_download/src/fota_download.c
  ${ZEPHYR_NRF_MODULE_DIR}/subsys/net/lib/fota_download/src/util/fota_download_util.c
  )

target_include_directories(app
  PRIVATE
  src
  ${ZEPHYR_NRF_MODULE_DIR}/subsys/net/lib/fota_download/include
  ${ZEPHYR_NRF_MODULE_DIR}/include/net/
  ${ZEPHYR_NRF_MODULE_DIR}/subsys/dfu/include
  ${ZEPHYR_NRF_MODULE_DIR}/subsys/net/lib/downloader/include
  )

target_compile_options(app
  PRIVATE
  -DCONFIG_DOWNLOADER_STACK_SIZE=500
  -DCONFIG_DOWNLOADER_MAX_FILENAME_SIZE=192
  -DCONFIG_DOWNLOADER_MAX_HOSTNAME_SIZE=128
  -DCONFIG_DOWNLOADER_TRANSPORT_PARAMS_SIZE=256
  -DCONFIG_FW_MAGIC_LEN=32
  -DABI_INFO_MAGIC=0xdededede
  -DCONFIG_FW_FIRMWARE_INFO_OFFSET=0x200
  -DCONFIG_FOTA_DOWNLOAD_LOG_LEVEL=2
  -DCONFIG_FOTA_SOCKET_RETRIES=2
  -DCONFIG_FW_INFO_MAGIC_LEN=12
  -DCONFIG_FOTA_DOWNLOAD_RESOURCE_LOCATOR_LENGTH=512
  -DCONFIG_FOTA_DOWNLOAD_FILE_NAME_LENGTH=128
  -DCONFIG_FOTA_DOWNLOAD_HOST_NAME_LENGTH=128
  -DCONFIG_FOTA_DOWNLOAD_SEC_TAG_LIST_SIZE_MAX=5
  -DCONFIG_FOTA_DOWNLOAD_BUF_SZ=2048
  )
```

## Kconfig
```
#
# Copyright (c) 2024 Nordic Semiconductor
#
# SPDX-License-Identifier: LicenseRef-Nordic-5-Clause
#

source "Kconfig.zephyr"

# Needed to allow mocking of tfm functions
config MOCK_TFM_PLATFORM_S0_FUNCTIONS
	bool
	default y
	depends on BUILD_WITH_TFM
```

## prj.conf
```kconfig
#
# Copyright (c) 2022-2023 Nordic Semiconductor ASA
#
# SPDX-License-Identifier: LicenseRef-Nordic-5-Clause
#
CONFIG_ZTEST=y
CONFIG_FLASH=y
CONFIG_FW_INFO=y
CONFIG_SYS_HASH_FUNC32=y

# In order to mock tfm_platform_s0_active
CONFIG_TFM_ALLOW_NON_SECURE_FAULT_HANDLING=n
CONFIG_BUILD_WITH_TFM=n
```

## boards/nrf9160dk_nrf9160.conf
```kconfig
#
# Copyright (c) 2021 Nordic Semiconductor ASA
#
# SPDX-License-Identifier: LicenseRef-Nordic-5-Clause
#

CONFIG_MPU_ALLOW_FLASH_WRITE=y
```

## boards/nrf9160dk_nrf9160_ns.conf
```kconfig
#
# Copyright (c) 2021 Nordic Semiconductor ASA
#
# SPDX-License-Identifier: LicenseRef-Nordic-5-Clause
#

# Disable this since we write our own mock for 'spm_s0_active()'
CONFIG_SPM_SERVICE_S0_ACTIVE=n
CONFIG_SPM_SERVICE_BUSY_WAIT=n
```

## boards/nrf9160dk_nrf9160ns.conf
```kconfig
#
# Copyright (c) 2021 Nordic Semiconductor ASA
#
# SPDX-License-Identifier: LicenseRef-BSD-5-Clause-Nordic
#

# Disable this since we write our own mock for 'spm_s0_active()'
CONFIG_SPM_SECURE_SERVICES=n
```

## boards/qemu_x86.conf
```kconfig
#
# Copyright (c) 2021 Nordic Semiconductor ASA
#
# SPDX-License-Identifier: LicenseRef-Nordic-5-Clause
#

CONFIG_FLASH_SIMULATOR=y
CONFIG_FLASH_SIMULATOR_DOUBLE_WRITES=y
```

## boards/nrf9160dk_nrf9160.overlay
```dts
/*
 * Copyright (c) 2026 Nordic Semiconductor ASA
 *
 * SPDX-License-Identifier: LicenseRef-Nordic-5-Clause
 */

s0_partition: &slot0_partition {};

s1_partition: &slot1_partition {};
```

## boards/nrf9160dk_nrf9160_ns.overlay
```dts
/*
 * Copyright (c) 2026 Nordic Semiconductor ASA
 *
 * SPDX-License-Identifier: LicenseRef-Nordic-5-Clause
 */

#include <samples/cellular/nrf91_crypto_partitions.dtsi>

s0_partition: &slot0_s_partition {};

s1_partition: &slot0_ns_partition {};
```

## src/main.c
```c
/*
 * Copyright (c) 2019 Nordic Semiconductor ASA
 *
 * SPDX-License-Identifier: LicenseRef-Nordic-5-Clause
 */
#include <string.h>
#include <zephyr/types.h>
#include <stdbool.h>
#include <ztest.h>
#include <download_client.h>
#include <fw_info.h>
#include <pm_config.h>
#include <fota_download.h>

/* Create buffer which we will fill with strings to test with.
 * This is needed since 'dfu_ctx_Mcuboot_set_b1_file` will modify its
 * 'file' parameter, hence we can not provide it raw c strings as they
 * are stored in read-only memory
 */
char buf[1024];

#define S0_S1 "s0 s1"
#define S0 "s0"
#define S1 "s1"
#define NO_SPACE "s0s1"
#define NO_TLS -1

#define ARBITRARY_IMAGE_OFFSET 512

/* Stubs and mocks */
bool dfu_ctx_mcuboot_set_b1_file__s0_active;
const char *download_client_start_file;
char *dfu_ctx_mcuboot_set_b1_file__update;
static bool spm_s0_active_retval;

K_SEM_DEFINE(download_with_offset_sem, 0, 1);
static bool start_with_offset;
static bool fail_on_offset_get;
static bool fail_on_connect;
static bool fail_on_start;
static bool download_with_offset_success;
static download_client_callback_t download_client_event_handler;

int dfu_target_init(int img_type, int img_num, size_t file_size, dfu_target_callback_t cb)
{
	return 0;
}

int dfu_target_img_type(const void *const buf, size_t len)
{
	return 0;
}

int dfu_target_offset_get(size_t *offset)
{
	if (fail_on_offset_get == true) {
		return -1;
	}

	if (start_with_offset == true) {
		*offset = ARBITRARY_IMAGE_OFFSET;
	} else {
		*offset = 0;
	}

	return 0;
}

int dfu_target_write(const void *const buf, size_t len)
{
	return 0;
}

int dfu_target_done(bool successful)
{
	return 0;
}

int download_client_disconnect(struct download_client *client)
{
	return 0;
}

int dfu_target_reset(void)
{
	return 0;
}

int dfu_target_schedule_update(int img_num)
{
	return 0;
}

int download_client_start(struct download_client *client, const char *file,
			  size_t from)
{
	download_client_start_file = file;

	if (fail_on_start == true) {
		return -1;
	}

	if (from == ARBITRARY_IMAGE_OFFSET) {
		download_with_offset_success = true;
		k_sem_give(&download_with_offset_sem);
	}

	return 0;
}

int download_client_file_size_get(struct download_client *client, size_t *size)
{
	return 0;
}

int download_client_init(struct download_client *client,
			 download_client_callback_t callback)
{
	download_client_event_handler = callback;
	return 0;
}

int download_client_connect(struct download_client *client, const char *host,
			    const struct download_client_cfg *config)
{
	if (fail_on_connect == true) {
		return -1;
	}

	return 0;
}

int dfu_ctx_mcuboot_set_b1_file(char * const file, bool s0_active,
				const char **selected_path)
{
	dfu_ctx_mcuboot_set_b1_file__s0_active = s0_active;
	*selected_path = dfu_ctx_mcuboot_set_b1_file__update;
	return 0;
}

int z_impl_zsock_inet_pton(sa_family_t family, const char *src, void *dst)
{
	return 0;
}

/* END stubs and mocks */

#ifdef CONFIG_TRUSTED_EXECUTION_NONSECURE

#include "tfm_platform_api.h"
enum tfm_platform_err_t tfm_platform_ioctl(tfm_platform_ioctl_req_t request,
					   psa_invec *input,
					   psa_outvec *output)
{
	return PSA_SUCCESS;
}

int spm_s0_active(uint32_t s0_address, uint32_t s1_address, bool *s0_active)
{
	*s0_active = spm_s0_active_retval;

	return 0;
}

int tfm_platform_s0_active(uint32_t s0_address, uint32_t s1_address, bool *s0_active)
{
	*s0_active = spm_s0_active_retval;

	return 0;
}

void set_s0_active(bool s0_active)
{
	spm_s0_active_retval = s0_active;
}
#else /* ! CONFIG_TRUSTED_EXECUTION_NONSECURE */

/* The test is _NOT_ executed as non-secure. Hence 'spm_s0_active' will not
 * be called. This means that we cannot create a mock of that function to
 * modify whether or not S0 should be considered the active B1 slot.
 *
 * To solve this issue, we perform flash write operations to the locations
 * where 'fw_info.h' will look for the S0 and S1 metadata. This allows
 * us to dictate what B1 slot should be considered active
 */
#include <zephyr/kernel.h>
#include <zephyr/drivers/flash.h>
#include <nrfx_nvmc.h>
#include <zephyr/device.h>

void set_s0_active(bool s0_active)
{
	int err;
	const struct device *fdev = DEVICE_DT_GET(DT_CHOSEN(zephyr_flash_controller));
	struct fw_info s0_info = { .magic = { FIRMWARE_INFO_MAGIC } };
	struct fw_info s1_info = { .magic = { FIRMWARE_INFO_MAGIC } };

	spm_s0_active_retval = s0_active;

	s1_info.version = 1;
	if (s0_active) {
		s0_info.version = s1_info.version + 1;
	} else {
		s0_info.version = s1_info.version - 1;
	}

	zassert_true(device_is_ready(fdev), "Flash device not ready");

	err = flash_erase(fdev, PM_S0_ADDRESS, nrfx_nvmc_flash_page_size_get());
	zassert_equal(err, 0, "flash_erase failed");

	err = flash_erase(fdev, PM_S1_ADDRESS, nrfx_nvmc_flash_page_size_get());
	zassert_equal(err, 0, "flash_erase failed");

	err = flash_write(fdev, PM_S0_ADDRESS, (void *)&s0_info,
			  sizeof(s0_info));
	zassert_equal(err, 0, "Unable to write to flash");

	err = flash_write(fdev, PM_S1_ADDRESS, (void *)&s1_info,
			  sizeof(s1_info));
	zassert_equal(err, 0, "Unable to write to flash");
}
#endif

void client_callback(const struct fota_download_evt *evt)
{
	switch (evt->id) {
	case FOTA_DOWNLOAD_EVT_ERROR:
		if (fail_on_offset_get == true) {
			zassert_equal(evt->cause, FOTA_DOWNLOAD_ERROR_CAUSE_DOWNLOAD_FAILED, NULL);
			fail_on_offset_get = false;
			k_sem_give(&download_with_offset_sem);
		}
		if (fail_on_connect == true) {
			zassert_equal(evt->cause, FOTA_DOWNLOAD_ERROR_CAUSE_DOWNLOAD_FAILED, NULL);
			fail_on_connect = false;
			k_sem_give(&download_with_offset_sem);
		}
		if (fail_on_start == true) {
			zassert_equal(evt->cause, FOTA_DOWNLOAD_ERROR_CAUSE_DOWNLOAD_FAILED, NULL);
			fail_on_start = false;
			k_sem_give(&download_with_offset_sem);
		}
		break;

	default:
		break;
	}
}

static void init(void)
{
	int err;

	k_sem_init(&download_with_offset_sem, 0, 1);
	start_with_offset = false;
	fail_on_offset_get = false;
	fail_on_connect = false;
	fail_on_start = false;

	err = fota_download_init(client_callback);
	zassert_equal(err, 0, NULL);
}

static void test_fota_download_start(void)
{
	int err;

	init();

	/* Verify that correct argument for s0_active is given */
	set_s0_active(false);
	strcpy(buf, S0_S1);
	err = fota_download_start("something.com", buf, NO_TLS, 0, 0);
	zassert_equal(err, 0, NULL);
	zassert_equal(dfu_ctx_mcuboot_set_b1_file__s0_active,
		      spm_s0_active_retval, "Incorrect param for s0_active");

	err = fota_download_cancel();
	zassert_equal(err, 0, NULL);
	set_s0_active(true);
	err = fota_download_start("something.com", buf, NO_TLS, 0, 0);
	zassert_equal(err, 0, NULL);
	zassert_equal(dfu_ctx_mcuboot_set_b1_file__s0_active,
		      spm_s0_active_retval, "Incorrect param for s0_active");
	err = fota_download_cancel();
	zassert_equal(err, 0, NULL);

	/* Next, verify that the update path given by mcuboot_set_b1_file
	 * is used correctly.
	 */

	/* update set to null indicates to use original file param */
	dfu_ctx_mcuboot_set_b1_file__update = NULL;
	strcpy(buf, S0_S1);
	err = fota_download_start("something.com", buf, NO_TLS, 0, 0);
	zassert_equal(err, 0, NULL);
	zassert_true(strcmp(download_client_start_file, S0_S1) == 0, NULL);
	err = fota_download_cancel();
	zassert_equal(err, 0, NULL);

	/* update set to not null indicates to use update for file param */
	dfu_ctx_mcuboot_set_b1_file__update = S1;
	strcpy(buf, S0_S1);
	err = fota_download_start("something.com", buf, NO_TLS, 0, 0);
	zassert_equal(err, 0, NULL);
	zassert_true(strcmp(download_client_start_file, S1) == 0, NULL);

	/* Check if double call returns EALREADY */
	err = fota_download_start("something.com", buf, NO_TLS, 0, 0);
	zassert_equal(err, -EALREADY, "No failure for double call");

	err = fota_download_cancel();
	zassert_equal(err, 0, NULL);
}

static void test_download_with_offset(void)
{
	int err;

	uint8_t fragment_buf[1] = {0};
	size_t  fragment_len = 1;
	const struct download_client_evt evt = {
		.id = DOWNLOAD_CLIENT_EVT_FRAGMENT,
		.fragment = {
			.buf = fragment_buf,
			.len = fragment_len,
		}
	};

	start_with_offset = true;


	/* Check that application is being notified when
	 * download_with_offset fails to get fw image offset
	 */
	err = fota_download_start("something.com", buf, NO_TLS, 0, 0);
	zassert_ok(err, NULL);

	err = download_client_event_handler(&evt);
	zassert_equal(err, -1, NULL);

	fail_on_offset_get = true;
	k_sem_take(&download_with_offset_sem, K_SECONDS(2));
	zassert_false(fail_on_offset_get, NULL);

	err = fota_download_cancel();
	zassert_ok(err, NULL);


	/* Check that application is being notified when
	 * download_with_offset fails to connect
	 */
	err = fota_download_start("something.com", buf, NO_TLS, 0, 0);
	zassert_ok(err, NULL);

	err = download_client_event_handler(&evt);
	zassert_equal(err, -1, NULL);

	fail_on_connect = true;
	k_sem_take(&download_with_offset_sem, K_SECONDS(2));
	zassert_false(fail_on_connect, NULL);

	err = fota_download_cancel();
	zassert_ok(err, NULL);


	/* Check that application is being notified when
	 * download_with_offset fails to start download
	 */
	err = fota_download_start("something.com", buf, NO_TLS, 0, 0);
	zassert_ok(err, NULL);

	err = download_client_event_handler(&evt);
	zassert_equal(err, -1, NULL);

	fail_on_start = true;
	k_sem_take(&download_with_offset_sem, K_SECONDS(2));
	zassert_false(fail_on_start, NULL);

	err = fota_download_cancel();
	zassert_ok(err, NULL);


	/* Successfully restart download with offset */
	err = fota_download_start("something.com", buf, NO_TLS, 0, 0);
	zassert_ok(err, NULL);

	err = download_client_event_handler(&evt);
	zassert_equal(err, -1, NULL);

	download_with_offset_success = false;
	k_sem_take(&download_with_offset_sem, K_SECONDS(2));
	zassert_true(download_with_offset_success, NULL);

	err = fota_download_cancel();
	zassert_ok(err, NULL);


	start_with_offset = false;
}

void test_main(void)
{
	ztest_test_suite(lib_fota_download_test,
			 ztest_unit_test(test_fota_download_start),
			 ztest_unit_test(test_download_with_offset));

	ztest_run_test_suite(lib_fota_download_test);
}
```

## src/test_fota_download.c
```c
/*
 * Copyright (c) 2022 Nordic Semiconductor ASA
 *
 * SPDX-License-Identifier: LicenseRef-Nordic-5-Clause
 */

#include <string.h>
#include <zephyr/types.h>
#include <stdbool.h>
#include <errno.h>
#include <zephyr/ztest.h>
#include <zephyr/storage/flash_map.h>
#include <downloader.h>
#include <fw_info.h>
#include <fota_download.h>
#include "test_fota_download_common.h"
#include <fota_download_util.h>

/* fota_download_start may modify the resource locator passed to it, so we cannot directly pass
 * test constants. Instead, we copy them to a modifiable buffer first.
 */
static char buf[1024];

#define BASE_DOMAIN "something.com"
#define NO_TLS NULL
#define ARBITRARY_IMAGE_OFFSET 512

#define S0_ADDRESS PARTITION_ADDRESS(s0_partition)
#define S1_ADDRESS PARTITION_ADDRESS(s1_partition)

#if defined(CONFIG_DFU_TARGET_MCUBOOT) && defined(CONFIG_UPDATEABLE_IMAGE_NUMBER)
#define IMG_NUM_MAX (CONFIG_UPDATEABLE_IMAGE_NUMBER - 1)
#else
#define IMG_NUM_MAX 1
#endif

/* Stubs and mocks */
static const char *downloader_get_file;
static bool spm_s0_active_retval;

K_SEM_DEFINE(download_with_offset_sem, 0, 1);
static bool start_with_offset;
static bool fail_on_offset_get;
static bool fail_on_connect;
static bool fail_on_start;
static bool fail_on_proto;
static bool download_with_offset_success;
static downloader_callback_t downloader_event_handler;
K_SEM_DEFINE(stop_sem, 0, 1);

static int dfu_target_init_img_num;
static int dfu_target_schedule_img_num;

int dfu_target_init(int img_type, int img_num, size_t file_size, dfu_target_callback_t cb)
{
	dfu_target_init_img_num = img_num;
	return 0;
}

enum dfu_target_image_type dfu_target_img_type(const void *const buf, size_t len)
{
	return DFU_TARGET_IMAGE_TYPE_MCUBOOT;
}

int dfu_target_offset_get(size_t *offset)
{
	if (fail_on_offset_get == true) {
		return -1;
	}

	if (start_with_offset == true) {
		*offset = ARBITRARY_IMAGE_OFFSET;
	} else {
		*offset = 0;
	}

	return 0;
}

int dfu_target_write(const void *const buf, size_t len)
{
	return 0;
}

int dfu_target_done(bool successful)
{
	return 0;
}

int dfu_target_reset(void)
{
	return 0;
}

int dfu_target_schedule_update(int img_num)
{
	dfu_target_schedule_img_num = img_num;
	return 0;
}

int downloader_file_size_get(struct downloader *client, size_t *size)
{
	*size = 4096;
	return 0;
}

int downloader_init(struct downloader *client, struct downloader_cfg *dl_cfg)
{
	downloader_event_handler = dl_cfg->callback;
	return 0;
}

enum dfu_target_image_type dfu_target_smp_img_type_check(const void *const buf, size_t len)
{
	return DFU_TARGET_IMAGE_TYPE_SMP;
}

int downloader_get_with_host_and_file(struct downloader *dl,
				      const struct downloader_host_cfg *dl_host_cfg,
				      const char *host, const char *file, size_t from)
{
	if (fail_on_proto == true) {
		return -EPROTONOSUPPORT;
	}
	if (fail_on_connect == true) {
		return -1;
	}

	downloader_get_file = file;

	if (fail_on_start == true) {
		return -1;
	}

	if (from == ARBITRARY_IMAGE_OFFSET) {
		download_with_offset_success = true;
		k_sem_give(&download_with_offset_sem);
	}

	return 0;
}

int downloader_cancel(struct downloader *client)
{
	const struct downloader_evt evt = {
		.id = DOWNLOADER_EVT_STOPPED,
	};

	downloader_event_handler(&evt);
	return 0;
}


int z_impl_zsock_inet_pton(net_sa_family_t family, const char *src, void *dst)
{
	return 0;
}

/* END stubs and mocks */


#ifdef CONFIG_TRUSTED_EXECUTION_NONSECURE

int spm_s0_active(uint32_t s0_address, uint32_t s1_address, bool *s0_active)
{
	*s0_active = spm_s0_active_retval;

	return 0;
}

int tfm_platform_s0_active(uint32_t s0_address, uint32_t s1_address, bool *s0_active)
{
	*s0_active = spm_s0_active_retval;

	return 0;
}

void set_s0_active(bool s0_active)
{
	spm_s0_active_retval = s0_active;
}
#else /* ! CONFIG_TRUSTED_EXECUTION_NONSECURE */

/* The test is _NOT_ executed as non-secure. Hence 'spm_s0_active' will not
 * be called. This means that we cannot create a mock of that function to
 * modify whether or not S0 should be considered the active B1 slot.
 *
 * To solve this issue, we perform flash write operations to the locations
 * where 'fw_info.h' will look for the S0 and S1 metadata. This allows
 * us to dictate what B1 slot should be considered active
 */
#include <zephyr/kernel.h>
#include <zephyr/drivers/flash.h>
#include <nrfx_nvmc.h>
#include <zephyr/device.h>

void set_s0_active(bool s0_active)
{
	int err;
	const struct device *fdev = DEVICE_DT_GET(DT_CHOSEN(zephyr_flash_controller));
	struct fw_info s0_info = { .magic = { FIRMWARE_INFO_MAGIC } };
	struct fw_info s1_info = { .magic = { FIRMWARE_INFO_MAGIC } };

	spm_s0_active_retval = s0_active;

	s1_info.version = 1;
	if (s0_active) {
		s0_info.version = s1_info.version + 1;
	} else {
		s0_info.version = s1_info.version - 1;
	}

	zassert_true(device_is_ready(fdev), "Flash device not ready");

	err = flash_erase(fdev, S0_ADDRESS, nrfx_nvmc_flash_page_size_get());
	zassert_equal(err, 0, "flash_erase failed");

	err = flash_erase(fdev, S1_ADDRESS, nrfx_nvmc_flash_page_size_get());
	zassert_equal(err, 0, "flash_erase failed");

	err = flash_write(fdev, S0_ADDRESS, (void *)&s0_info,
			  sizeof(s0_info));
	zassert_equal(err, 0, "Unable to write to flash");

	err = flash_write(fdev, S1_ADDRESS, (void *)&s1_info,
			  sizeof(s1_info));
	zassert_equal(err, 0, "Unable to write to flash");
}
#endif

void client_callback(const struct fota_download_evt *evt)
{
	printk("Event: %d\n", evt->id);
	switch (evt->id) {
	case FOTA_DOWNLOAD_EVT_ERROR:
		if (fail_on_proto) {
			zassert_equal(evt->cause, FOTA_DOWNLOAD_ERROR_CAUSE_PROTO_NOT_SUPPORTED);
			fail_on_proto = false;
			k_sem_give(&download_with_offset_sem);
		}
		if (fail_on_offset_get == true) {
			zassert_equal(evt->cause, FOTA_DOWNLOAD_ERROR_CAUSE_INTERNAL, NULL);
			fail_on_offset_get = false;
			k_sem_give(&download_with_offset_sem);
		}
		if (fail_on_connect == true) {
			zassert_equal(evt->cause, FOTA_DOWNLOAD_ERROR_CAUSE_DOWNLOAD_FAILED, NULL);
			fail_on_connect = false;
			k_sem_give(&download_with_offset_sem);
		}
		if (fail_on_start == true) {
			zassert_equal(evt->cause, FOTA_DOWNLOAD_ERROR_CAUSE_DOWNLOAD_FAILED, NULL);
			fail_on_start = false;
			k_sem_give(&download_with_offset_sem);
		}
		k_sem_give(&stop_sem);
		break;

	case FOTA_DOWNLOAD_EVT_CANCELLED:
	case FOTA_DOWNLOAD_EVT_FINISHED:
		k_sem_give(&stop_sem);
		break;

	default:
		break;
	}
}


/**
 * @brief Reset mocks and initialize the fota_download library
 *
 * Call this before every test
 */
static void init(void)
{
	int err;

	start_with_offset = false;
	fail_on_offset_get = false;
	fail_on_connect = false;
	fail_on_start = false;
	fail_on_proto = false;
	downloader_get_file = NULL;
	spm_s0_active_retval = false;
	dfu_target_init_img_num = -1;
	dfu_target_schedule_img_num = -1;

	k_sem_reset(&stop_sem);
	k_sem_reset(&download_with_offset_sem);

	err = fota_download_init(client_callback);
	zassert_equal(err, 0, NULL);
}


/**
 * @brief Generic test of fota_download
 * Not to be called directly by the test suite. Performs a parameterized test of fota_download_start
 *
 * @param resource_locator - The resource locator to be fed to fota_download_start
 * @param expected_selection - The resource locator that fota_download_start is expected to select
 * @param s0_active - If true, pretend that s0 is active. Otherwise, pretend that s1 is active.
 */
static void test_fota_download_any_generic(const char * const resource_locator,
					     const char * const expected_selection, bool s0_active)
{
	int err;
	/* Init */
	init();

	/* Set the active slot */
	set_s0_active(s0_active);

	/* Start the download, check that it succeeds */
	strcpy(buf, resource_locator);
	err = fota_download_any(BASE_DOMAIN, buf, NO_TLS, 0, 0, 0);
	zassert_equal(err, 0, NULL);

	/* Verify that the correct resource was selected */
	zassert_true(strcmp(downloader_get_file, expected_selection) == 0, NULL);

	/* Verify that the download can be canceled with no isse */
	err = fota_download_cancel();
	zassert_equal(err, 0, NULL);

	k_sem_take(&stop_sem, K_FOREVER);
}


ZTEST_SUITE(fota_download_tests, NULL, NULL, NULL, NULL, NULL);

ZTEST(fota_download_tests, test_fota_download_cancel_before_init)
{
	/* Verify that calling fota_download_cancel without initializing results in an error. */
	int err = fota_download_cancel();

	zassert_equal(err, -EAGAIN);
}

ZTEST(fota_download_tests, test_download_single)
{
	test_fota_download_any_generic(S0_A, S0_A, S1_ACTIVE);
}

/**
 * @brief Test the MCUboot image pair index plumbing.
 *
 * Start a download with the given image pair index, deliver the first
 * fragment (which triggers dfu_target_init()) and the DONE event (which
 * triggers dfu_target_schedule_update() when autoscheduling is enabled), and
 * verify that both dfu_target calls received the requested index.
 */
static void test_fota_download_img_num_generic(int img_num)
{
	int err;
	static uint8_t fragment_data[32];
	struct downloader_evt evt = {
		.id = DOWNLOADER_EVT_FRAGMENT,
		.fragment = {
			.buf = fragment_data,
			.len = sizeof(fragment_data),
		},
	};

	strcpy(buf, S0_A);
	const struct fota_download_params params = {
		.host = BASE_DOMAIN,
		.file = buf,
		.img_num = img_num,
	};

	err = fota_download_start_params(&params);
	zassert_equal(err, 0, "start failed: %d", err);

	err = downloader_event_handler(&evt);
	zassert_equal(err, 0, NULL);
	zassert_equal(dfu_target_init_img_num, img_num,
		      "dfu_target_init() got img_num %d, expected %d",
		      dfu_target_init_img_num, img_num);

	evt.id = DOWNLOADER_EVT_DONE;
	err = downloader_event_handler(&evt);
	zassert_equal(err, 0, NULL);
	if (IS_ENABLED(CONFIG_FOTA_CLIENT_AUTOSCHEDULE_UPDATE)) {
		zassert_equal(dfu_target_schedule_img_num, img_num,
			      "dfu_target_schedule_update() got img_num %d, expected %d",
			      dfu_target_schedule_img_num, img_num);
	} else {
		zassert_equal(dfu_target_schedule_img_num, -1,
			      "dfu_target_schedule_update() called without autoschedule");
	}
}

ZTEST(fota_download_tests, test_download_img_num_default)
{
	init();

	/* A zero-initialized params struct selects image pair 0 */
	test_fota_download_img_num_generic(0);
}

ZTEST(fota_download_tests, test_download_img_num_secondary)
{
	if (IMG_NUM_MAX < 1) {
		ztest_test_skip();
	}

	init();

	test_fota_download_img_num_generic(1);
}

ZTEST(fota_download_tests, test_download_img_num_not_sticky)
{
	int err;
	static uint8_t fragment_data[32];
	const struct downloader_evt evt = {
		.id = DOWNLOADER_EVT_FRAGMENT,
		.fragment = {
			.buf = fragment_data,
			.len = sizeof(fragment_data),
		},
	};

	if (IMG_NUM_MAX < 1) {
		ztest_test_skip();
	}

	init();

	/* A download for image pair 1 must not leak into the next download,
	 * which uses a legacy entry point and therefore expects image pair 0.
	 */
	test_fota_download_img_num_generic(1);

	init();
	strcpy(buf, S0_A);
	err = fota_download_any(BASE_DOMAIN, buf, NO_TLS, 0, 0, 0);
	zassert_equal(err, 0, NULL);

	err = downloader_event_handler(&evt);
	zassert_equal(err, 0, NULL);
	zassert_equal(dfu_target_init_img_num, 0,
		      "legacy entry point inherited img_num %d from previous download",
		      dfu_target_init_img_num);

	err = fota_download_cancel();
	zassert_equal(err, 0, NULL);
	k_sem_take(&stop_sem, K_FOREVER);
}

ZTEST(fota_download_tests, test_download_img_num_negative)
{
	int err;

	init();

	strcpy(buf, S0_A);
	const struct fota_download_params params = {
		.host = BASE_DOMAIN,
		.file = buf,
		.img_num = -1,
	};

	err = fota_download_start_params(&params);
	zassert_equal(err, -EINVAL, "negative img_num accepted: %d", err);

	/* The rejected call must not leave the library in the downloading state */
	err = fota_download_cancel();
	zassert_equal(err, -EAGAIN, NULL);
}

#if defined(CONFIG_DFU_TARGET_MCUBOOT) && defined(CONFIG_UPDATEABLE_IMAGE_NUMBER)
ZTEST(fota_download_tests, test_download_img_num_out_of_range)
{
	int err;

	init();

	strcpy(buf, S0_A);
	const struct fota_download_params params = {
		.host = BASE_DOMAIN,
		.file = buf,
		.img_num = CONFIG_UPDATEABLE_IMAGE_NUMBER,
	};

	err = fota_download_start_params(&params);
	zassert_equal(err, -EINVAL, "img_num %d accepted with %d image pairs: %d",
		      CONFIG_UPDATEABLE_IMAGE_NUMBER, CONFIG_UPDATEABLE_IMAGE_NUMBER, err);

	err = fota_download_cancel();
	zassert_equal(err, -EAGAIN, NULL);
}
#endif

ZTEST(fota_download_tests, test_download_params_null)
{
	int err;

	init();

	err = fota_download_start_params(NULL);
	zassert_equal(err, -EINVAL, NULL);

	const struct fota_download_params params = {
		.host = BASE_DOMAIN,
		.file = NULL,
	};

	err = fota_download_start_params(&params);
	zassert_equal(err, -EINVAL, NULL);
}

ZTEST(fota_download_tests, test_download_dual_s0_active)
{
	test_fota_download_any_generic(S0_B " " S1_B, S1_B, S0_ACTIVE);
}

ZTEST(fota_download_tests, test_download_dual_s1_active)
{
	test_fota_download_any_generic(S0_C " " S1_C, S0_C, S1_ACTIVE);
}

ZTEST(fota_download_tests, test_download_with_offset)
{
	int err;

	/* Init */
	init();

	/* Cause subsequent downloads to start with an offset */
	start_with_offset = true;

	uint8_t fragment_buf[1] = {0};
	size_t  fragment_len = 1;
	const struct downloader_evt evt = {
		.id = DOWNLOADER_EVT_FRAGMENT,
		.fragment = {
			.buf = fragment_buf,
			.len = fragment_len,
		}
	};

	/* Check that application is being notified when
	 * download_with_offset fails to get fw image offset
	 */
	err = fota_download_any(BASE_DOMAIN, buf, NO_TLS, 0, 0, 0);
	zassert_ok(err, NULL);

	err = downloader_event_handler(&evt);
	zassert_equal(err, -1, NULL);

	fail_on_offset_get = true;
	k_sem_take(&download_with_offset_sem, K_SECONDS(2));
	zassert_false(fail_on_offset_get, NULL);
	k_sem_take(&stop_sem, K_FOREVER);

	/* Expect the fota_download_cancel to fail as the download_with_offset() failed. */
	err = fota_download_cancel();
	zassert_equal(err, -EAGAIN);


	/* Check that application is being notified when
	 * download_with_offset fails to connect
	 */
	err = fota_download_any(BASE_DOMAIN, buf, NO_TLS, 0, 0, 0);
	zassert_ok(err, NULL);

	err = downloader_event_handler(&evt);
	zassert_equal(err, -1, NULL);

	fail_on_connect = true;
	k_sem_take(&download_with_offset_sem, K_SECONDS(2));
	zassert_false(fail_on_connect, NULL);

	/* Expect the fota_download_cancel to fail as the download_with_offset() failed. */
	err = fota_download_cancel();
	zassert_equal(err, -EAGAIN);


	/* Check that application is being notified when
	 * download_with_offset fails to start download
	 */
	err = fota_download_any(BASE_DOMAIN, buf, NO_TLS, 0, 0, 0);
	zassert_ok(err, NULL);

	err = downloader_event_handler(&evt);
	zassert_equal(err, -1, NULL);

	fail_on_start = true;
	k_sem_take(&download_with_offset_sem, K_SECONDS(2));
	zassert_false(fail_on_start, NULL);

	/* Expect the fota_download_cancel to fail as the download_with_offset() failed. */
	err = fota_download_cancel();
	zassert_equal(err, -EAGAIN);


	/* Successfully restart download with offset */
	err = fota_download_any(BASE_DOMAIN, buf, NO_TLS, 0, 0, 0);
	zassert_ok(err, NULL);

	err = downloader_event_handler(&evt);
	zassert_equal(err, -1, NULL);

	download_with_offset_success = false;
	k_sem_take(&download_with_offset_sem, K_SECONDS(2));
	zassert_true(download_with_offset_success, NULL);

	err = fota_download_cancel();
	zassert_ok(err, NULL);

	/* Try cancelling again and expect error. */
	err = fota_download_cancel();
	zassert_equal(err, -EAGAIN);
}

ZTEST(fota_download_tests, test_socket_retries)
{
	int err;
	int retryable_errors[] = {-ECONNRESET, -EAGAIN, -ENETDOWN, -EHOSTUNREACH, -ENETUNREACH};

	for (int i = 0; i < ARRAY_SIZE(retryable_errors); i++) {
		/* Init */
		init();

		uint8_t fragment_buf[1] = {0};
		size_t  fragment_len = 1;
		const struct downloader_evt fragment_evt = {
			.id = DOWNLOADER_EVT_FRAGMENT,
			.fragment = {
				.buf = fragment_buf,
				.len = fragment_len,
			}
		};
		const struct downloader_evt error_evt = {
			.id = DOWNLOADER_EVT_ERROR,
			.error = retryable_errors[i],
		};
		const struct downloader_evt stopped_evt = {
			.id = DOWNLOADER_EVT_STOPPED,
		};

		/* Start download */
		err = fota_download_any(BASE_DOMAIN, buf, NO_TLS, 0, 0, 0);
		zassert_ok(err, NULL);

		/* Send first fragment to initialize DFU target */
		err = downloader_event_handler(&fragment_evt);
		zassert_ok(err, NULL);

		/* Verify that error triggers retry (returns 0) when retries are left.
		 * CONFIG_FOTA_SOCKET_RETRIES is set to 2 in test configuration.
		 */
		err = downloader_event_handler(&error_evt);
		zassert_equal(err, 0, "Expected retry on first error %d", retryable_errors[i]);

		err = downloader_event_handler(&error_evt);
		zassert_equal(err, 0, "Expected retry on second error %d", retryable_errors[i]);

		/* Third error should fail as retries are exhausted */
		err = downloader_event_handler(&error_evt);
		zassert_equal(err, -1, "Expected failure when retries exhausted for error %d",
			      retryable_errors[i]);

		/* Simulate the DOWNLOADER_EVT_STOPPED that the real downloader
		 * would send after callback returns -1
		 */
		err = downloader_event_handler(&stopped_evt);
		zassert_ok(err, NULL);

		k_sem_take(&stop_sem, K_FOREVER);
	}
}

ZTEST(fota_download_tests, test_download_invalid_protocol)
{
	init();

	fail_on_proto = true;
	int err = fota_download_any("ftp://" BASE_DOMAIN, buf, NO_TLS, 0, 0, 0);

	zassert_equal(err, -EPROTONOSUPPORT, "%d", err);
	fota_download_cancel();

}

ZTEST_SUITE(fota_download_util, NULL, NULL, NULL, NULL, NULL);

ZTEST(fota_download_util, test_download_util_invalid_protocol)
{
	init();

	fail_on_proto = true;
	int err = fota_download_util_download_start("ftp://host.com/file.bin",
				      DFU_TARGET_IMAGE_TYPE_ANY, 0,
				      client_callback);

	zassert_ok(err, NULL);
	k_sem_take(&download_with_offset_sem, K_SECONDS(2));
	k_sem_take(&stop_sem, K_FOREVER);
}

ZTEST(fota_download_util, test_download_util_start)
{
	init();

	uint8_t fragment_buf[1] = {0};
	size_t  fragment_len = 1;
	struct downloader_evt evt = {
		.id = DOWNLOADER_EVT_FRAGMENT,
		.fragment = {
			.buf = fragment_buf,
			.len = fragment_len,
		}
	};

	start_with_offset = true;
	int err = fota_download_util_download_start("http://host.com/file.bin",
				      DFU_TARGET_IMAGE_TYPE_ANY, 0,
				      client_callback);

	zassert_ok(err);

	err = downloader_event_handler(&evt);
	zassert_ok(err);

	evt.id = DOWNLOADER_EVT_DONE;
	err = downloader_event_handler(&evt);
	zassert_ok(err);

	k_sem_take(&stop_sem, K_FOREVER);
}
```

## src/test_fota_download_common.h
```c
/*
 * Copyright (c) 2022 Nordic Semiconductor ASA
 *
 * SPDX-License-Identifier: LicenseRef-Nordic-5-Clause
 */

#ifndef TEST_FOTA_DOWNLOAD_COMMON_H__
#define TEST_FOTA_DOWNLOAD_COMMON_H__
#define S0_A "s0"
#define S1_A "s1"
#define S0_B "adf31d21-a51c-419d-b332-841def20b01f/BOOT*e05130b7*9.9.9/"\
	     "signed_by_mcuboot_and_b0_s0_image_update.bin"
#define S1_B "adf31d21-a51c-419d-b332-841def20b01f/BOOT*e05130b7*9.9.9/"\
	     "signed_by_mcuboot_and_b0_s1_image_update.bin"
#define S0_C "signed_by_mcuboot_and_b0_s0_image_update.bin"
#define S1_C "signed_by_mcuboot_and_b0_s1_image_update.bin"
#define S1_ACTIVE false
#define S0_ACTIVE true
#endif /* TEST_FOTA_DOWNLOAD_COMMON_H__ */
```

## src/test_parse_dual_resource_locator.c
```c
/*
 * Copyright (c) 2022 Nordic Semiconductor ASA
 *
 * SPDX-License-Identifier: LicenseRef-Nordic-5-Clause
 */

#include <zephyr/types.h>
#include <zephyr/ztest.h>
#include <fota_download_util.h>
#include "test_fota_download_common.h"

/* fota_download_parse_dual_resource_locator may modify the resource locator passed to it, so we
 * cannot directly pass test constants. Instead, we copy them to a modifiable buffer first.
 */
static char buf[1024];

char *const flash_ptr = S0_A " " S1_A;

ZTEST_SUITE(fota_download_parse_dual_resource_locator_tests, NULL, NULL, NULL, NULL, NULL);


/**
 * @brief Generic test of parse_dual_resource_locator
 * Not to be called directly by the test suite. Performs a parameterized test of
 * parse_dual_resource_locator
 *
 * @param resource_locator - The resource locator to be fed to parse_dual_resource_locator
 * @param expected_selection - The resource locator that parse_dual_resource_locator is expected to
 *			       select
 * @param s0_active - The slot activity state to be fed to parse_dual_resource_locator
 */
void test_fota_download_parse_dual_resource_locator_generic(const char * const resource_locator,
						    const char * const expected_selection,
						    const bool s0_active)
{
	int err;
	const char *update;

	strcpy(buf, resource_locator);
	err = fota_download_parse_dual_resource_locator(buf, s0_active, &update);

	zassert_equal(err, 0, "Selection of resource locator from valid dual resource locator "
			      " should not fail.");
	if (expected_selection == NULL) {
		zassert_is_null(update, "fota_download_parse_dual_resource_locator was expected to "
					"select NULL, and did not.");
	} else {
		zassert_not_null(update, "fota_download_parse_dual_resource_locator did not select "
					 "a resource locator");
		zassert_true(strcmp(expected_selection, update) == 0,
		     "fota_download_parse_dual_resource_locator did not select the expected "
		     "resource locator.");
	}

}

ZTEST(fota_download_parse_dual_resource_locator_tests, test_dual_A_s0_active)
{
	test_fota_download_parse_dual_resource_locator_generic(S0_A " " S1_A, S1_A, S0_ACTIVE);
}

ZTEST(fota_download_parse_dual_resource_locator_tests, test_dual_A_s1_active)
{
	test_fota_download_parse_dual_resource_locator_generic(S0_A " " S1_A, S0_A, S1_ACTIVE);
}

ZTEST(fota_download_parse_dual_resource_locator_tests, test_dual_B_s0_active)
{
	test_fota_download_parse_dual_resource_locator_generic(S0_B " " S1_B, S1_B, S0_ACTIVE);
}

ZTEST(fota_download_parse_dual_resource_locator_tests, test_dual_B_s1_active)
{
	test_fota_download_parse_dual_resource_locator_generic(S0_B " " S1_B, S0_B, S1_ACTIVE);
}

ZTEST(fota_download_parse_dual_resource_locator_tests, test_dual_C_s0_active)
{
	test_fota_download_parse_dual_resource_locator_generic(S0_C " " S1_C, S1_C, S0_ACTIVE);
}

ZTEST(fota_download_parse_dual_resource_locator_tests, test_dual_C_s1_active)
{
	test_fota_download_parse_dual_resource_locator_generic(S0_C " " S1_C, S0_C, S1_ACTIVE);
}

ZTEST(fota_download_parse_dual_resource_locator_tests, test_single_A)
{
	test_fota_download_parse_dual_resource_locator_generic(S0_A, NULL, S1_ACTIVE);
}

ZTEST(fota_download_parse_dual_resource_locator_tests, test_single_B)
{
	test_fota_download_parse_dual_resource_locator_generic(S1_B, NULL, S1_ACTIVE);
}

ZTEST(fota_download_parse_dual_resource_locator_tests, test_single_C)
{
	test_fota_download_parse_dual_resource_locator_generic(S0_C, NULL, S0_ACTIVE);
}

ZTEST(fota_download_parse_dual_resource_locator_tests, test_ptr_placement)
{
	/* This test cannot be executed on native sim as there is
	 * no mechanism in place do deduce if an address maps to non-volatile
	 * storage or RAM
	 *
	 * Recently, this test case was moved to a test suite without native sim support, so
	 * this skip condition is technically no longer necessary. It remains active in case native
	 * sim support is ever re-added.
	 */

	Z_TEST_SKIP_IFDEF(CONFIG_BOARD_NATIVE_SIM);

	int err;
	const char *update;
	bool s0_active = true;

	err = fota_download_parse_dual_resource_locator(flash_ptr, s0_active, &update);
	zassert_true(err != 0, "Did not fail when given flash pointer");
}

ZTEST(fota_download_parse_dual_resource_locator_tests, test_no_separator)
{
	int err;
	const char *update;
	bool s0_active = true;

	strcpy(buf, S0_B S1_B);
	err = fota_download_parse_dual_resource_locator(buf, s0_active, &update);

	zassert_equal(err, 0, "Should not get error when missing separator");
	zassert_equal(update, NULL, "update should be NULL when no separator");
}

ZTEST(fota_download_parse_dual_resource_locator_tests, test_null)
{
	int err;
	const char *update;
	bool s0_active = true;

	err = fota_download_parse_dual_resource_locator(NULL, s0_active, &update);
	zassert_true(err < 0, NULL);

	err = fota_download_parse_dual_resource_locator(buf, s0_active, NULL);
	zassert_true(err < 0, NULL);
}

ZTEST(fota_download_parse_dual_resource_locator_tests, test_not_terminated)
{
	int err;
	const char *update;
	bool s0_active = true;

	/* Remove any null terminator */
	for (int i = 0; i < sizeof(buf); ++i) {
		buf[i] = 'a';
	}
	err = fota_download_parse_dual_resource_locator(buf, s0_active, &update);
	zassert_true(err < 0, NULL);
}

ZTEST(fota_download_parse_dual_resource_locator_tests, test_empty)
{
	int err;
	const char *update;
	bool s0_active = true;
	char empty[] = "";

	err = fota_download_parse_dual_resource_locator(empty, s0_active, &update);
	zassert_true(update == NULL, "update should not be set");
}
```
