## CMakeLists.txt
```
#
# Copyright (c) 2026 Nordic Semiconductor ASA
#
# SPDX-License-Identifier: LicenseRef-Nordic-5-Clause
#

cmake_minimum_required(VERSION 3.20.0)

find_package(Zephyr REQUIRED HINTS $ENV{ZEPHYR_BASE})
project(dect_tether_ipv6_integration_test)

set(dect_int_test_dir ${ZEPHYR_NRF_MODULE_DIR}/tests/drivers/dect/dect_mdm/integration)

target_sources(app PRIVATE
  src/main.c
  src/tether_dect_events.c
  src/tether_test_eth.c
  src/tether_net_fixture.c
  src/tether_host_sim.c
  ${dect_int_test_dir}/src/mocks/mock_nrf_modem_dect_mac.c
  ${dect_int_test_dir}/src/test_dect_utils.c
)

target_include_directories(app PRIVATE
  src
  ${dect_int_test_dir}/src
  ${dect_int_test_dir}/src/mocks
  ${ZEPHYR_NRFXLIB_MODULE_DIR}/nrf_modem/include
  ${ZEPHYR_NRF_MODULE_DIR}/drivers/dect/dect_mdm
  ${ZEPHYR_NRF_MODULE_DIR}/include/net/dect
  ${ZEPHYR_NRF_MODULE_DIR}/include/net
  ${ZEPHYR_NRF_MODULE_DIR}/subsys/net/lib/dect/tether_ipv6
  ${ZEPHYR_BASE}/include/zephyr/net
  ${ZEPHYR_BASE}/subsys/net/ip
)

target_include_directories(zephyr_interface INTERFACE
  ${ZEPHYR_NRFXLIB_MODULE_DIR}/nrf_modem/include
)
```

## Kconfig
```
#
# Copyright (c) 2026 Nordic Semiconductor ASA
#
# SPDX-License-Identifier: LicenseRef-Nordic-5-Clause
#
# Kconfig for dect_tether_ipv6 integration tests (mock modem shmem size).

module = TEST_DECT_TETHER
module-str = DECT tether test
source "subsys/logging/Kconfig.template.log_config"

source "Kconfig.zephyr"
```

## prj.conf
```kconfig
#
# Copyright (c) 2026 Nordic Semiconductor ASA
#
# SPDX-License-Identifier: LicenseRef-Nordic-5-Clause
#
# DECT IPv6 tether integration test (native_sim + mocked modem)

CONFIG_ZTEST=y
CONFIG_TEST=y

CONFIG_MAIN_STACK_SIZE=8192
CONFIG_SYSTEM_WORKQUEUE_STACK_SIZE=4096

CONFIG_NETWORKING=y
CONFIG_NET_NATIVE=y
CONFIG_NET_IPV4=n
CONFIG_NET_IPV6=y
CONFIG_NET_UDP=y
CONFIG_NET_MGMT=y
CONFIG_NET_MGMT_EVENT=y
CONFIG_NET_MGMT_EVENT_INFO=y
CONFIG_NET_MGMT_EVENT_INFO_DEFAULT_DATA_SIZE=224

CONFIG_NET_L2_DECT=y
CONFIG_NET_L2_DECT_MGMT=y
CONFIG_NET_L2_DECT_BR=n
CONFIG_NET_CONNECTION_MANAGER=y

CONFIG_NET_L2_ETHERNET=y
CONFIG_NET_L2_ETHERNET_MGMT=y
CONFIG_ETH_DRIVER=n

CONFIG_NET_SOCKETS=y
CONFIG_NET_SOCKETS_PACKET=y

CONFIG_NET_IPV6_FORWARDING=y
CONFIG_NET_IPV6_NBR_CACHE=y
CONFIG_NET_IPV6_MLD=y

CONFIG_DECT=y
CONFIG_DECT_MDM=y
CONFIG_DECT_MDM_DRIVER_NRF=y
CONFIG_DECT_CLUSTER_MAX_CHILD_ASSOCIATION_COUNT=8
CONFIG_DECT_MDM_DEVICE_NAME="dect_test"
CONFIG_DECT_MDM_NET_IF_NO_AUTO_START=n

CONFIG_NET_L2_DECT_ULA=y
CONFIG_NET_L2_DECT_ULA_PREFIX="fdde:ad00:0000::"

CONFIG_DECT_TETHER_IPV6_LIB=y
CONFIG_DECT_TETHER_IPV6_RA=y
CONFIG_DECT_TETHER_IPV6_DHCPV6_SERVER=y
CONFIG_DECT_TETHER_IPV6_RA_PREFIX_INFO=y
CONFIG_DECT_TETHER_IPV6_RA_RDNSS=y
CONFIG_DECT_TETHER_IPV6_RA_MANAGED=y
CONFIG_DECT_TETHER_IPV6_RA_UNSOLICIT_MS=0
CONFIG_DECT_TETHER_IPV6_MDNS_FORWARD=n

CONFIG_NET_INTERFACE_NAME=y
CONFIG_NET_INTERFACE_NAME_LEN=15
CONFIG_DECT_TETHER_IPV6_HOST_ETH_IFACE="eth0"

CONFIG_NET_IF_MAX_IPV6_COUNT=4
CONFIG_NET_IF_UNICAST_IPV6_ADDR_COUNT=6
CONFIG_NET_IF_MCAST_IPV6_ADDR_COUNT=10
CONFIG_NET_IF_IPV6_PREFIX_COUNT=4
CONFIG_NET_IPV6_MAX_NEIGHBORS=12

CONFIG_NET_BUF=y
CONFIG_NET_BUF_DATA_SIZE=128
CONFIG_NET_PKT_RX_COUNT=24
CONFIG_NET_BUF_RX_COUNT=48
CONFIG_NET_PKT_TX_COUNT=24
CONFIG_NET_BUF_TX_COUNT=48
CONFIG_NET_TX_STACK_SIZE=4096
CONFIG_NET_RX_STACK_SIZE=4096
CONFIG_NET_MGMT_EVENT_STACK_SIZE=2048
CONFIG_NET_MGMT_EVENT_QUEUE_SIZE=24

CONFIG_HEAP_MEM_POOL_SIZE=32768
CONFIG_ENTROPY_GENERATOR=y
CONFIG_NEWLIB_LIBC=y

CONFIG_LOG=y
CONFIG_LOG_MODE_DEFERRED=y
CONFIG_ASSERT=y
CONFIG_RESET_ON_FATAL_ERROR=n
CONFIG_THREAD_NAME=y

CONFIG_FLASH=y
CONFIG_FLASH_MAP=y
CONFIG_MPU_ALLOW_FLASH_WRITE=y
CONFIG_NVS=y
CONFIG_SETTINGS=y
CONFIG_SETTINGS_NVS=y

CONFIG_MODEM_CELLULAR=n
CONFIG_MODEM_ANTENNA=n
CONFIG_MODEM_INFO=n
CONFIG_MBEDTLS=n
```

## tether_ipv6_test.conf
```kconfig
#
# Copyright (c) 2026 Nordic Semiconductor ASA
#
# SPDX-License-Identifier: LicenseRef-Nordic-5-Clause
#
# Fast, deterministic options for CI integration tests.

CONFIG_DECT_TETHER_IPV6_LOG_LEVEL_DBG=y
CONFIG_DECT_TETHER_IPV6_DHCPV6_TRACE=y
CONFIG_DECT_TETHER_IPV6_DHCPV6_RX_LOG=y
CONFIG_TEST_DECT_TETHER_LOG_LEVEL_INF=y
CONFIG_DECT_TETHER_IPV6_DHCPV6_REVOKE_DEBOUNCE_SEC=0
CONFIG_DECT_TETHER_IPV6_RA_RS_UNICAST=n
CONFIG_DECT_TETHER_IPV6_ETH_UNSOLICITED_NA=n
```

## src/main.c
```c
/*
 * Copyright (c) 2026 Nordic Semiconductor ASA
 *
 * SPDX-License-Identifier: LicenseRef-Nordic-5-Clause
 */

#include <errno.h>

#include <zephyr/ztest.h>
#include <zephyr/kernel.h>
#include <zephyr/net/net_ip.h>
#include <zephyr/sys/byteorder.h>

#include "tether_host_sim.h"
#include "tether_net_fixture.h"
#include "tether_test_eth.h"

#include "dect_tether_ipv6_int.h"

static struct tether_net_fixture fx;
static struct tether_host_ctx host;
static struct tether_host_ctx host_other;
static bool tether_skip_next_tx_reset = true;

/* Bootstraps a bound lease for `host` if one isn't already active, reusing
 * the Solicit/Request exchange verified by test_dhcp_solicit_request_bind.
 */
static void tether_ensure_lease_bound(void)
{
	struct tether_dhcp_parse dhcp;
	int baseline;

	if (dect_tether_ipv6_dhcpv6_srv_lease_bound()) {
		return;
	}

	/* Ztest runs test cases in alphabetical, not declaration, order, so this
	 * bootstrap cannot assume test_dhcp_solicit_request_bind already ran and
	 * populated host.server_duid: capture it from the Advertise here too.
	 */
	baseline = tether_tx_capture_count;
	zassert_ok(tether_host_send_solicit_to(fx.eth, &host, &fx.server_ll));
	(void)tether_host_wait_tx_growth(baseline, 5000);
	zassert_true(tether_host_find_dhcp(baseline, DHCPV6_MSG_ADVERTISE, &dhcp, &host),
		     "Advertise not captured while bootstrapping a lease");

	baseline = tether_tx_capture_count;
	zassert_ok(tether_host_send_request(fx.eth, &host, &fx.server_ll));
	(void)tether_host_wait_tx_growth(baseline, 5000);
	zassert_true(dect_tether_ipv6_dhcpv6_srv_lease_bound());
}

/* Waits until the server-side lease becomes unbound, polling like the
 * dhcp_thread() itself does. Used to deterministically reach the
 * "no active binding" code paths regardless of prior test ordering.
 */
static bool tether_wait_lease_unbound(int timeout_ms)
{
	int64_t end = k_uptime_get() + timeout_ms;

	while (k_uptime_get() < end) {
		if (!dect_tether_ipv6_dhcpv6_srv_lease_bound()) {
			return true;
		}
		k_msleep(20);
	}

	return false;
}

static void *tether_suite_setup(void)
{
	int err = tether_net_fixture_setup(&fx);

	zassert_equal(err, 0, "network fixture setup failed: %d", err);
	tether_host_ctx_init(&host);
	tether_host_ctx_init_other(&host_other, 0x66);
	return NULL;
}

static void tether_suite_teardown(void *unused)
{
	ARG_UNUSED(unused);
	tether_net_fixture_teardown(&fx);
}

static void tether_before(void *unused)
{
	ARG_UNUSED(unused);

	if (!tether_skip_next_tx_reset) {
		tether_test_eth_tx_reset();
	}
	tether_skip_next_tx_reset = false;
}

ZTEST_SUITE(dect_tether_ipv6_integration, NULL, tether_suite_setup, tether_before, NULL,
	    tether_suite_teardown);

ZTEST(dect_tether_ipv6_integration, test_bootstrap_init)
{
	struct tether_ra_parse ra;

	zassert_true(fx.tether_started, "tether should be started in suite setup");
	zassert_not_null(fx.dect, "dect iface");
	zassert_not_null(fx.eth, "eth iface");
	zassert_true(tether_host_find_ra(0, &ra), "init-time RA should be captured during setup");
	zassert_equal(ra.router_lifetime, 0, "router lifetime 0 before DECT parent");
	zassert_false(ra.managed, "Managed flag clear before DECT parent");
}

ZTEST(dect_tether_ipv6_integration, test_rs_to_ra)
{
	struct tether_ra_parse ra;
	int baseline = tether_tx_capture_count;
	int tx_end;

	zassert_ok(tether_host_send_rs(fx.eth, &host), "RS inject failed");
	tx_end = tether_host_wait_tx_growth(baseline, 3000);
	zassert_true(tx_end > baseline, "expected RA TX after RS");

	zassert_true(tether_host_find_ra(baseline, &ra), "RA not found in TX capture");
	zassert_true(ra.router_lifetime > 0, "router lifetime should be non-zero");
	zassert_true(ra.managed, "Managed (M) flag should be set");
#if defined(CONFIG_DECT_TETHER_IPV6_RA_RDNSS)
	zassert_true(ra.has_rdnss, "RDNSS option expected");
#endif
#if defined(CONFIG_DECT_TETHER_IPV6_RA_PREFIX_INFO)
	zassert_true(ra.has_pio, "PIO expected when uplink + DECT addresses present");
#endif
}

ZTEST(dect_tether_ipv6_integration, test_dhcp_solicit_request_bind)
{
	struct tether_dhcp_parse dhcp;
	int baseline;
	int tx_end;

	/* Optional RS (matches typical host ordering). */
	zassert_ok(tether_host_send_rs(fx.eth, &host));
	(void)tether_host_wait_tx_growth(tether_tx_capture_count, 2000);
	tether_test_eth_tx_reset();

	baseline = tether_tx_capture_count;
	zassert_ok(tether_host_send_solicit_to(fx.eth, &host, &fx.server_ll),
		   "Solicit inject failed");
	tx_end = tether_host_wait_tx_growth(baseline, 5000);
	zassert_true(tx_end > baseline, "expected Advertise after Solicit");
	zassert_true(tether_host_find_dhcp(baseline, DHCPV6_MSG_ADVERTISE, &dhcp, &host),
		     "Advertise not captured");
	zassert_true(dhcp.has_iaaddr && (dhcp.have_ula || dhcp.have_gua),
		     "Advertise should carry IAADDR");

	tether_test_eth_tx_reset();
	baseline = tether_tx_capture_count;
	zassert_ok(tether_host_send_request(fx.eth, &host, &fx.server_ll), "Request inject failed");
	tx_end = tether_host_wait_tx_growth(baseline, 5000);
	zassert_true(tx_end > baseline, "expected Reply after Request");
	zassert_true(tether_host_find_dhcp(baseline, DHCPV6_MSG_REPLY, &dhcp, NULL),
		     "Reply not captured");
	zassert_true(dhcp.has_iaaddr && (dhcp.have_ula || dhcp.have_gua),
		     "Reply should carry IAADDR");

	zassert_true(dect_tether_ipv6_dhcpv6_srv_lease_bound(), "lease should be bound");
}

ZTEST(dect_tether_ipv6_integration, test_uplink_loss_ra_withdraw)
{
	struct tether_ra_parse ra;
	int baseline;

	/* Ensure lease exists for realistic disconnect scenario. */
	tether_ensure_lease_bound();

	tether_test_eth_tx_reset();
	zassert_ok(tether_net_fixture_parent_release(&fx), "parent release failed");

	baseline = tether_tx_capture_count;
	zassert_ok(tether_host_send_rs(fx.eth, &host), "RS inject after uplink loss");
	(void)tether_host_wait_tx_growth(baseline, 3000);

	zassert_true(tether_host_find_ra(baseline, &ra), "RA after uplink loss not seen");
	zassert_equal(ra.router_lifetime, 0, "router lifetime should be 0 on uplink loss");
	zassert_false(ra.managed, "Managed flag should be cleared on uplink loss");

	/* Restore the parent association: this suite's default (non-shuffled) test
	 * order happens to run this test last, but nothing guarantees that stays
	 * true, so leave the fixture as it was found rather than relying on it.
	 */
	zassert_ok(tether_net_fixture_parent_restore(&fx), "parent restore failed");
}

ZTEST(dect_tether_ipv6_integration, test_renew_rebind_address_change_revoke)
{
	struct tether_dhcp_parse dhcp;
	int baseline;
	int tx_end;

	tether_ensure_lease_bound();

	zassert_ok(tether_net_fixture_change_gua_prefix(&fx), "GUA prefix change failed");
	k_msleep(100);

	tether_test_eth_tx_reset();
	baseline = tether_tx_capture_count;
	zassert_ok(tether_host_send_renew(fx.eth, &host, &fx.server_ll), "Renew inject failed");
	tx_end = tether_host_wait_tx_growth(baseline, 5000);
	zassert_true(tx_end > baseline, "expected Reply after Renew");
	zassert_true(tether_host_find_dhcp(baseline, DHCPV6_MSG_REPLY, &dhcp, NULL),
		     "Renew Reply not captured");
	zassert_true(tether_host_dhcp_has_revoked_iaaddr(baseline, DHCPV6_MSG_REPLY),
		     "Renew Reply should include revoked IAADDR (lifetime 0) after GUA change");

	/* Same check for dhcp_reply_revoke_plan()'s Rebind branch: change the
	 * prefix again (back to the original) so the lease cached from the
	 * Renew above is guaranteed stale, regardless of what other tests in
	 * this suite (which run in alphabetical, not declaration, order) may
	 * have done to the prefix.
	 */
	zassert_ok(tether_net_fixture_revert_gua_prefix(&fx), "GUA prefix revert failed");
	k_msleep(100);

	tether_test_eth_tx_reset();
	baseline = tether_tx_capture_count;
	zassert_ok(tether_host_send_rebind(fx.eth, &host, &fx.server_ll), "Rebind inject failed");
	tx_end = tether_host_wait_tx_growth(baseline, 5000);
	zassert_true(tx_end > baseline, "expected Reply after Rebind");
	zassert_true(tether_host_find_dhcp(baseline, DHCPV6_MSG_REPLY, &dhcp, NULL),
		     "Rebind Reply not captured");
	zassert_true(tether_host_dhcp_has_revoked_iaaddr(baseline, DHCPV6_MSG_REPLY),
		     "Rebind Reply should include revoked IAADDR (lifetime 0) after GUA change");
}

ZTEST(dect_tether_ipv6_integration, test_dhcp_rebind_after_bind)
{
	struct tether_dhcp_parse dhcp;
	int baseline;
	int tx_end;

	tether_ensure_lease_bound();

	tether_test_eth_tx_reset();
	baseline = tether_tx_capture_count;
	zassert_ok(tether_host_send_rebind(fx.eth, &host, &fx.server_ll), "Rebind inject failed");
	tx_end = tether_host_wait_tx_growth(baseline, 5000);
	zassert_true(tx_end > baseline, "expected Reply after Rebind");
	zassert_true(tether_host_find_dhcp(baseline, DHCPV6_MSG_REPLY, &dhcp, NULL),
		     "Rebind Reply not captured");
	zassert_true(dhcp.has_iaaddr && (dhcp.have_ula || dhcp.have_gua),
		     "Rebind Reply should carry IAADDR");
}

ZTEST(dect_tether_ipv6_integration, test_dhcp_confirm_after_bind)
{
	struct tether_dhcp_parse dhcp;
	int baseline;
	int tx_end;

	tether_ensure_lease_bound();

	tether_test_eth_tx_reset();
	baseline = tether_tx_capture_count;
	zassert_ok(tether_host_send_confirm(fx.eth, &host, &fx.server_ll), "Confirm inject failed");
	tx_end = tether_host_wait_tx_growth(baseline, 5000);
	zassert_true(tx_end > baseline, "expected Reply after Confirm");
	zassert_true(tether_host_find_dhcp(baseline, DHCPV6_MSG_REPLY, &dhcp, NULL),
		     "Confirm Reply not captured");
	zassert_false(dhcp.has_iaaddr,
		     "Confirm Reply should carry Status=Success only, no IA_NA/IAADDR");
}

ZTEST(dect_tether_ipv6_integration, test_dhcp_info_request_no_addrs)
{
	struct tether_dhcp_parse dhcp;
	int baseline;
	int tx_end;

	/* Common case: Info-Request with a Client ID. */
	tether_test_eth_tx_reset();
	baseline = tether_tx_capture_count;
	zassert_ok(tether_host_send_info_request(fx.eth, &host, &fx.server_ll, true),
		   "Info-Request inject failed");
	tx_end = tether_host_wait_tx_growth(baseline, 5000);
	zassert_true(tx_end > baseline, "expected Reply after Info-Request");
	zassert_true(tether_host_find_dhcp(baseline, DHCPV6_MSG_REPLY, &dhcp, NULL),
		     "Info-Request Reply not captured");
	zassert_false(dhcp.has_iaaddr, "Info-Request Reply should not carry IA_NA/IAADDR");

	/* RFC 8415 §18.2.6: Client ID is only RECOMMENDED for Info-Request, and
	 * it is the only message type the server accepts without one.
	 */
	tether_test_eth_tx_reset();
	baseline = tether_tx_capture_count;
	zassert_ok(tether_host_send_info_request(fx.eth, &host, &fx.server_ll, false),
		   "Info-Request (no Client ID) inject failed");
	tx_end = tether_host_wait_tx_growth(baseline, 5000);
	zassert_true(tx_end > baseline, "expected Reply after Info-Request without Client ID");
	zassert_true(tether_host_find_dhcp(baseline, DHCPV6_MSG_REPLY, &dhcp, NULL),
		     "Info-Request (no Client ID) Reply not captured");
}

ZTEST(dect_tether_ipv6_integration, test_dhcp_rebind_confirm_without_lease_silent)
{
	int baseline;

	tether_ensure_lease_bound();

	/* Force the lease into the unbound state deterministically, mirroring
	 * test_uplink_loss_ra_withdraw, instead of relying on suite ordering.
	 */
	zassert_ok(tether_net_fixture_parent_release(&fx), "parent release failed");
	zassert_true(tether_wait_lease_unbound(3000),
		     "lease should become unbound after uplink loss");

	tether_test_eth_tx_reset();
	baseline = tether_tx_capture_count;
	zassert_ok(tether_host_send_rebind(fx.eth, &host, &fx.server_ll), "Rebind inject failed");
	zassert_equal(tether_host_wait_tx_growth(baseline, 1000), -ETIMEDOUT,
		     "Rebind without a bound lease must be silently dropped");

	tether_test_eth_tx_reset();
	baseline = tether_tx_capture_count;
	zassert_ok(tether_host_send_confirm(fx.eth, &host, &fx.server_ll), "Confirm inject failed");
	zassert_equal(tether_host_wait_tx_growth(baseline, 1000), -ETIMEDOUT,
		     "Confirm without a bound lease must be silently dropped");

	zassert_ok(tether_net_fixture_parent_restore(&fx), "parent restore failed");
}

ZTEST(dect_tether_ipv6_integration, test_dhcp_other_client_solicit_no_addrs_when_bound)
{
	struct tether_dhcp_parse dhcp;
	int baseline;
	int tx_end;

	tether_ensure_lease_bound();

	/* NoAddrsAvail replies skip the production neighbor-install step (only
	 * granted addresses get one), so the fake Ethernet driver's lack of a
	 * real ND responder would otherwise strand the reply. Pre-seed it.
	 */
	zassert_ok(tether_host_install_neighbor(fx.eth, &host_other),
		   "failed to pre-seed neighbor cache for other client");

	tether_test_eth_tx_reset();
	baseline = tether_tx_capture_count;
	zassert_ok(tether_host_send_solicit_to(fx.eth, &host_other, &fx.server_ll),
		   "Other-client Solicit inject failed");
	tx_end = tether_host_wait_tx_growth(baseline, 5000);
	zassert_true(tx_end > baseline, "expected Advertise for other client");
	zassert_true(tether_host_find_dhcp(baseline, DHCPV6_MSG_ADVERTISE, &dhcp, &host_other),
		     "Advertise for other client not captured");
	zassert_false(dhcp.has_iaaddr,
		     "Other client should get NoAddrsAvail (no IAADDR) while a lease is bound");

	zassert_true(dect_tether_ipv6_dhcpv6_srv_lease_bound(),
		     "existing lease should remain bound after other-client Solicit");
}

ZTEST(dect_tether_ipv6_integration, test_dhcp_other_client_request_silent_when_bound)
{
	int baseline;

	tether_ensure_lease_bound();

	tether_test_eth_tx_reset();
	baseline = tether_tx_capture_count;
	zassert_ok(tether_host_send_request(fx.eth, &host_other, &fx.server_ll),
		   "Other-client Request inject failed");
	zassert_equal(tether_host_wait_tx_growth(baseline, 1000), -ETIMEDOUT,
		     "Request from a different client while another lease is bound must be "
		     "dropped");

	zassert_true(dect_tether_ipv6_dhcpv6_srv_lease_bound(),
		     "existing lease should remain bound after other-client Request");
}

ZTEST(dect_tether_ipv6_integration, test_dhcp_missing_clientid_silent)
{
	int baseline;

	tether_test_eth_tx_reset();
	baseline = tether_tx_capture_count;
	zassert_ok(tether_host_send_solicit_no_clientid(fx.eth, &host, &fx.server_ll),
		   "Solicit (no Client ID) inject failed");
	zassert_equal(tether_host_wait_tx_growth(baseline, 1000), -ETIMEDOUT,
		     "a non-Info-Request message without a Client ID must be silently dropped");
}

ZTEST(dect_tether_ipv6_integration, test_dhcp_serverid_mismatch_silent)
{
	int baseline;

	tether_ensure_lease_bound();

	tether_test_eth_tx_reset();
	baseline = tether_tx_capture_count;
	zassert_ok(tether_host_send_request_bad_serverid(fx.eth, &host, &fx.server_ll),
		   "Request (bad Server ID) inject failed");
	zassert_equal(tether_host_wait_tx_growth(baseline, 1000), -ETIMEDOUT,
		     "a Request/Renew with a mismatching Server ID must be silently dropped");

	zassert_true(dect_tether_ipv6_dhcpv6_srv_lease_bound(),
		     "existing lease should remain bound after a Server ID mismatch");
}

ZTEST(dect_tether_ipv6_integration, test_dhcp_unknown_msgtype_silent)
{
	int baseline;

	tether_test_eth_tx_reset();
	baseline = tether_tx_capture_count;
	zassert_ok(tether_host_send_unknown_type(fx.eth, &host, &fx.server_ll),
		   "unknown-type message inject failed");
	zassert_equal(tether_host_wait_tx_growth(baseline, 1000), -ETIMEDOUT,
		     "an unhandled DHCPv6 message type must be silently ignored");
}
```

## src/tether_dect_events.c
```c
/*
 * Copyright (c) 2026 Nordic Semiconductor ASA
 *
 * SPDX-License-Identifier: LicenseRef-Nordic-5-Clause
 *
 * Minimal DECT net_mgmt event state for tether integration tests (feeds test_dect_utils).
 */

#include <string.h>

#include <zephyr/kernel.h>
#include <zephyr/logging/log.h>
#include <zephyr/net/net_if.h>
#include <zephyr/net/net_mgmt.h>

#include <net/dect/dect_net_l2_mgmt.h>

LOG_MODULE_REGISTER(tether_dect_events, LOG_LEVEL_INF);

K_SEM_DEFINE(tether_activation_done_sem, 0, 1);

bool dect_scan_result_received;
bool dect_scan_done_received;
enum dect_status_values dect_scan_done_status;
struct dect_scan_result_evt received_beacon_data;
bool beacon_data_valid;

bool dect_association_changed_received;
bool dect_association_created_received;
bool dect_association_failed_received;
bool dect_association_released_received;
int dect_association_released_count;
struct dect_association_changed_evt received_association_data;

bool dect_network_status_received;
struct dect_network_status_evt received_network_status_data;

bool dect_activate_done_received;
enum dect_status_values dect_activate_done_status;
bool dect_deactivate_done_received;
enum dect_status_values dect_deactivate_done_status;

bool dect_rssi_scan_result_received;
struct dect_rssi_scan_result_evt received_rssi_scan_result_data;
bool dect_rssi_scan_done_received;
enum dect_status_values dect_rssi_scan_done_status;

static struct net_mgmt_event_callback tether_dect_mgmt_cb;

static void tether_dect_mgmt_handler(struct net_mgmt_event_callback *cb, uint64_t mgmt_event,
				       struct net_if *iface)
{
	ARG_UNUSED(iface);

	switch (mgmt_event) {
	case NET_EVENT_DECT_ACTIVATE_DONE:
		if (cb->info != NULL) {
			const struct dect_common_resp_evt *evt = cb->info;

			dect_activate_done_status = evt->status;
		}
		dect_activate_done_received = true;
		k_sem_give(&tether_activation_done_sem);
		break;
	case NET_EVENT_DECT_DEACTIVATE_DONE:
		if (cb->info != NULL) {
			const struct dect_common_resp_evt *evt = cb->info;

			dect_deactivate_done_status = evt->status;
		}
		dect_deactivate_done_received = true;
		break;
	case NET_EVENT_DECT_SCAN_RESULT:
		if (cb->info != NULL) {
			memcpy(&received_beacon_data, cb->info, sizeof(received_beacon_data));
			beacon_data_valid = true;
		}
		dect_scan_result_received = true;
		break;
	case NET_EVENT_DECT_SCAN_DONE:
		if (cb->info != NULL) {
			const struct dect_common_resp_evt *evt = cb->info;

			dect_scan_done_status = evt->status;
		}
		dect_scan_done_received = true;
		break;
	case NET_EVENT_DECT_RSSI_SCAN_RESULT:
		if (cb->info != NULL) {
			memcpy(&received_rssi_scan_result_data, cb->info,
			       sizeof(received_rssi_scan_result_data));
		}
		dect_rssi_scan_result_received = true;
		break;
	case NET_EVENT_DECT_RSSI_SCAN_DONE:
		if (cb->info != NULL) {
			const struct dect_common_resp_evt *evt = cb->info;

			dect_rssi_scan_done_status = evt->status;
		}
		dect_rssi_scan_done_received = true;
		break;
	case NET_EVENT_DECT_ASSOCIATION_CHANGED:
		if (cb->info != NULL) {
			const struct dect_association_changed_evt *evt = cb->info;

			memcpy(&received_association_data, evt, sizeof(received_association_data));
			if (evt->association_change_type == DECT_ASSOCIATION_CREATED) {
				dect_association_created_received = true;
			} else if (evt->association_change_type == DECT_ASSOCIATION_RELEASED) {
				dect_association_released_received = true;
				dect_association_released_count++;
			} else if (evt->association_change_type ==
				   DECT_ASSOCIATION_REQ_FAILED_MDM) {
				dect_association_failed_received = true;
			}
		}
		dect_association_changed_received = true;
		break;
	case NET_EVENT_DECT_NETWORK_STATUS:
		if (cb->info != NULL) {
			memcpy(&received_network_status_data, cb->info,
			       sizeof(received_network_status_data));
		}
		dect_network_status_received = true;
		break;
	default:
		break;
	}
}

void tether_dect_events_reset_flags(void)
{
	dect_scan_result_received = false;
	dect_scan_done_received = false;
	beacon_data_valid = false;

	dect_association_changed_received = false;
	dect_association_created_received = false;
	dect_association_failed_received = false;
	dect_association_released_received = false;

	dect_network_status_received = false;

	dect_activate_done_received = false;
	dect_deactivate_done_received = false;

	dect_rssi_scan_result_received = false;
	dect_rssi_scan_done_received = false;
}

int tether_dect_events_init(void)
{
	net_mgmt_init_event_callback(
		&tether_dect_mgmt_cb, tether_dect_mgmt_handler,
		NET_EVENT_DECT_ACTIVATE_DONE | NET_EVENT_DECT_DEACTIVATE_DONE |
			NET_EVENT_DECT_SCAN_RESULT | NET_EVENT_DECT_SCAN_DONE |
			NET_EVENT_DECT_RSSI_SCAN_RESULT | NET_EVENT_DECT_RSSI_SCAN_DONE |
			NET_EVENT_DECT_ASSOCIATION_CHANGED | NET_EVENT_DECT_NETWORK_STATUS);
	net_mgmt_add_event_callback(&tether_dect_mgmt_cb);
	return 0;
}

void tether_dect_events_deinit(void)
{
	net_mgmt_del_event_callback(&tether_dect_mgmt_cb);
}
```

## src/tether_dect_events.h
```c
/*
 * Copyright (c) 2026 Nordic Semiconductor ASA
 *
 * SPDX-License-Identifier: LicenseRef-Nordic-5-Clause
 */

#ifndef TETHER_DECT_EVENTS_H_
#define TETHER_DECT_EVENTS_H_

#include <net/dect/dect_net_l2_mgmt.h>

#ifdef __cplusplus
extern "C" {
#endif

extern bool dect_scan_result_received;
extern bool dect_scan_done_received;
extern enum dect_status_values dect_scan_done_status;
extern struct dect_scan_result_evt received_beacon_data;
extern bool beacon_data_valid;

extern bool dect_association_changed_received;
extern bool dect_association_created_received;
extern bool dect_association_failed_received;
extern bool dect_association_released_received;
extern int dect_association_released_count;
extern struct dect_association_changed_evt received_association_data;

extern bool dect_network_status_received;
extern struct dect_network_status_evt received_network_status_data;

extern bool dect_activate_done_received;
extern enum dect_status_values dect_activate_done_status;
extern bool dect_deactivate_done_received;
extern enum dect_status_values dect_deactivate_done_status;

extern bool dect_rssi_scan_result_received;
extern struct dect_rssi_scan_result_evt received_rssi_scan_result_data;
extern bool dect_rssi_scan_done_received;
extern enum dect_status_values dect_rssi_scan_done_status;

void tether_dect_events_reset_flags(void);
int tether_dect_events_init(void);
void tether_dect_events_deinit(void);

extern struct k_sem tether_activation_done_sem;

#ifdef __cplusplus
}
#endif

#endif /* TETHER_DECT_EVENTS_H_ */
```

## src/tether_host_sim.c
```c
/*
 * Copyright (c) 2026 Nordic Semiconductor ASA
 *
 * SPDX-License-Identifier: LicenseRef-Nordic-5-Clause
 */

#include <errno.h>
#include <string.h>

#include <zephyr/kernel.h>
#include <zephyr/net/net_ip.h>
#include <zephyr/sys/byteorder.h>

#include "tether_host_sim.h"
#include "tether_test_eth.h"

#include <ipv6.h>


static const struct in6_addr dhcp_all_servers = {
	.s6_addr = { 0xff, 0x02, 0, 0, 0, 0, 0, 0, 0, 0, 0, 0, 0, 0x01, 0, 0x02 }
};

static void host_ll_from_mac(const uint8_t mac[6], struct in6_addr *ll)
{
	ll->s6_addr[0] = 0xfe;
	ll->s6_addr[1] = 0x80;
	memset(&ll->s6_addr[2], 0, 6);
	ll->s6_addr[8] = mac[0];
	ll->s6_addr[9] = mac[1];
	ll->s6_addr[10] = mac[2];
	ll->s6_addr[11] = 0xff;
	ll->s6_addr[12] = 0xfe;
	ll->s6_addr[13] = mac[3];
	ll->s6_addr[14] = mac[4];
	ll->s6_addr[15] = mac[5];
}

static size_t append_opt(uint8_t *wp, uint16_t code, const void *data, uint16_t dlen)
{
	sys_put_be16(code, wp);
	sys_put_be16(dlen, wp + 2);
	if (dlen > 0U && data != NULL) {
		memcpy(wp + 4, data, dlen);
	}
	return 4U + dlen;
}

static size_t append_client_duid(uint8_t *wp, const uint8_t mac[6])
{
	uint8_t duid[10];
	uint16_t t = sys_cpu_to_be16(DHCPV6_DUID_LL);

	memcpy(duid, &t, 2);
	t = sys_cpu_to_be16(1);
	memcpy(duid + 2, &t, 2);
	memcpy(duid + 4, mac, 6);
	return append_opt(wp, DHCPV6_OPT_CLIENTID, duid, sizeof(duid));
}

static size_t append_ia_na(uint8_t *wp, uint32_t iaid)
{
	uint8_t inner[12];

	sys_put_be32(iaid, inner);
	sys_put_be32(0, inner + 4);
	sys_put_be32(0, inner + 8);
	return append_opt(wp, DHCPV6_OPT_IA_NA, inner, sizeof(inner));
}

static int send_dhcp(struct net_if *eth, struct tether_host_ctx *host, const struct in6_addr *dst,
		     uint8_t mtype, const uint8_t *extra, size_t extra_len)
{
	uint8_t msg[256];
	size_t len = 4U + extra_len;

	msg[0] = mtype;
	memcpy(msg + 1, host->tid, 3);
	if (extra != NULL && extra_len > 0U) {
		memcpy(msg + 4, extra, extra_len);
	}

	return tether_test_eth_inject_udp(eth, &host->ll, dst, htons(DHCPV6_CLIENT_PORT),
					  htons(DHCPV6_SERVER_PORT), msg, len, host->mac);
}

static void host_ctx_init_common(struct tether_host_ctx *host, uint8_t mac_last_octet,
				 uint32_t iaid, const uint8_t tid[3])
{
	static const uint8_t def_mac[6] = { 0x02, 0x11, 0x22, 0x33, 0x44, 0x55 };

	memcpy(host->mac, def_mac, sizeof(def_mac));
	host->mac[5] = mac_last_octet;
	host_ll_from_mac(host->mac, &host->ll);
	host->iaid = iaid;
	memcpy(host->tid, tid, 3U);
	host->server_duid_len = 0U;
}

void tether_host_ctx_init(struct tether_host_ctx *host)
{
	static const uint8_t tid[3] = { 0x12, 0x34, 0x56 };

	host_ctx_init_common(host, 0x55, 1U, tid);
}

/* Second, independent client identity (distinct DUID-LL and link-local
 * address) used to exercise the DHCPv6 server's single-lease-slot
 * "other client" policy while a lease is bound to the primary host.
 */
void tether_host_ctx_init_other(struct tether_host_ctx *host, uint8_t mac_last_octet)
{
	static const uint8_t tid[3] = { 0x22, 0x33, 0x44 };

	host_ctx_init_common(host, mac_last_octet, 2U, tid);
}

int tether_host_install_neighbor(struct net_if *eth, struct tether_host_ctx *host)
{
	struct net_linkaddr lla = {
		.len = TETHER_HOST_MAC_LEN,
		.type = NET_LINK_ETHERNET,
	};
	struct net_nbr *nbr;

	memcpy(lla.addr, host->mac, TETHER_HOST_MAC_LEN);

	/* The fake Ethernet driver never answers real Neighbor Discovery, so
	 * unlike the production code path (which installs a neighbor entry
	 * itself once it grants an address, see dect_tether_ipv6_fwd.c),
	 * tests that expect a reply routed back to a client that was NOT
	 * granted an address (e.g. NoAddrsAvail) must pre-seed the neighbor
	 * cache themselves, or the reply gets stuck waiting on ND forever.
	 */
	(void)net_ipv6_nbr_rm(eth, &host->ll);
	nbr = net_ipv6_nbr_add(eth, &host->ll, &lla, false, NET_IPV6_NBR_STATE_STATIC);
	return (nbr != NULL) ? 0 : -EIO;
}

int tether_host_send_rs(struct net_if *eth, struct tether_host_ctx *host)
{
	return tether_test_eth_inject_rs(eth, &host->ll, host->mac);
}

int tether_host_send_solicit(struct net_if *eth, struct tether_host_ctx *host)
{
	return tether_host_send_solicit_to(eth, host, &dhcp_all_servers);
}

int tether_host_send_solicit_to(struct net_if *eth, struct tether_host_ctx *host,
				const struct in6_addr *server_ll)
{
	uint8_t opts[64];
	size_t olen = 0U;

	olen += append_client_duid(opts + olen, host->mac);
	olen += append_ia_na(opts + olen, host->iaid);
	return send_dhcp(eth, host, server_ll, DHCPV6_MSG_SOLICIT, opts, olen);
}

int tether_host_send_request(struct net_if *eth, struct tether_host_ctx *host,
			     const struct in6_addr *server_ll)
{
	uint8_t opts[96];
	size_t olen = 0U;

	olen += append_client_duid(opts + olen, host->mac);
	if (host->server_duid_len > 0U) {
		olen += append_opt(opts + olen, DHCPV6_OPT_SERVERID, host->server_duid,
				   host->server_duid_len);
	}
	olen += append_ia_na(opts + olen, host->iaid);
	return send_dhcp(eth, host, server_ll, DHCPV6_MSG_REQUEST, opts, olen);
}

int tether_host_send_renew(struct net_if *eth, struct tether_host_ctx *host,
			   const struct in6_addr *server_ll)
{
	uint8_t opts[96];
	size_t olen = 0U;

	olen += append_client_duid(opts + olen, host->mac);
	if (host->server_duid_len > 0U) {
		olen += append_opt(opts + olen, DHCPV6_OPT_SERVERID, host->server_duid,
				   host->server_duid_len);
	}
	olen += append_ia_na(opts + olen, host->iaid);
	return send_dhcp(eth, host, server_ll, DHCPV6_MSG_RENEW, opts, olen);
}

int tether_host_send_rebind(struct net_if *eth, struct tether_host_ctx *host,
			    const struct in6_addr *server_ll)
{
	uint8_t opts[96];
	size_t olen = 0U;

	/* RFC 8415 §18.3.5: Rebind MUST NOT include a Server ID option. */
	olen += append_client_duid(opts + olen, host->mac);
	olen += append_ia_na(opts + olen, host->iaid);
	return send_dhcp(eth, host, server_ll, DHCPV6_MSG_REBIND, opts, olen);
}

int tether_host_send_confirm(struct net_if *eth, struct tether_host_ctx *host,
			     const struct in6_addr *server_ll)
{
	uint8_t opts[96];
	size_t olen = 0U;

	/* RFC 8415 §18.3.3: Confirm MUST NOT include a Server ID option. */
	olen += append_client_duid(opts + olen, host->mac);
	olen += append_ia_na(opts + olen, host->iaid);
	return send_dhcp(eth, host, server_ll, DHCPV6_MSG_CONFIRM, opts, olen);
}

int tether_host_send_info_request(struct net_if *eth, struct tether_host_ctx *host,
				  const struct in6_addr *server_ll, bool with_clientid)
{
	uint8_t opts[32];
	size_t olen = 0U;

	/* RFC 8415 §18.2.6: Info-Request carries no IA_NA; Client ID is only
	 * RECOMMENDED, not required, so callers can test either variant.
	 */
	if (with_clientid) {
		olen += append_client_duid(opts + olen, host->mac);
	}
	return send_dhcp(eth, host, server_ll, DHCPV6_MSG_INFO_REQUEST, opts, olen);
}

int tether_host_send_solicit_no_clientid(struct net_if *eth, struct tether_host_ctx *host,
					 const struct in6_addr *server_ll)
{
	uint8_t opts[32];
	size_t olen = 0U;

	/* Deliberately omit the Client ID: the server must silently drop any
	 * non-Info-Request message that lacks one.
	 */
	olen += append_ia_na(opts + olen, host->iaid);
	return send_dhcp(eth, host, server_ll, DHCPV6_MSG_SOLICIT, opts, olen);
}

int tether_host_send_request_bad_serverid(struct net_if *eth, struct tether_host_ctx *host,
					  const struct in6_addr *server_ll)
{
	static const uint8_t bogus_duid[10] = { 0xff, 0xff, 0xff, 0xff, 0xff,
						 0xff, 0xff, 0xff, 0xff, 0xff };
	uint8_t opts[96];
	size_t olen = 0U;

	/* Server ID deliberately does not match the server's own DUID: the
	 * server must silently drop the Request.
	 */
	olen += append_client_duid(opts + olen, host->mac);
	olen += append_opt(opts + olen, DHCPV6_OPT_SERVERID, bogus_duid, sizeof(bogus_duid));
	olen += append_ia_na(opts + olen, host->iaid);
	return send_dhcp(eth, host, server_ll, DHCPV6_MSG_REQUEST, opts, olen);
}

int tether_host_send_unknown_type(struct net_if *eth, struct tether_host_ctx *host,
				  const struct in6_addr *server_ll)
{
	/* RFC 8415 §7.3: message type 9 is Decline, which this server does not
	 * implement/handle; it must be silently ignored.
	 */
	const uint8_t unhandled_msg_type = 9U;
	uint8_t opts[96];
	size_t olen = 0U;

	olen += append_client_duid(opts + olen, host->mac);
	olen += append_ia_na(opts + olen, host->iaid);
	return send_dhcp(eth, host, server_ll, unhandled_msg_type, opts, olen);
}

int tether_host_wait_tx_growth(int baseline, int timeout_ms)
{
	int64_t end = k_uptime_get() + timeout_ms;

	while (k_uptime_get() < end) {
		if (tether_tx_capture_count > baseline) {
			return tether_tx_capture_count;
		}
		k_msleep(20);
	}

	return -ETIMEDOUT;
}

static bool parse_frame_ipv6(const struct tether_tx_frame *f, const uint8_t **l3, size_t *l3_len,
			     uint8_t *nexthdr)
{
	if (f->len < 14U + 40U) {
		return false;
	}

	if (f->data[12] != 0x86 || f->data[13] != 0xdd) {
		return false;
	}

	*l3 = f->data + 14U;
	*l3_len = f->len - 14U;
	*nexthdr = (*l3)[6];
	return true;
}

bool tether_host_find_ra(int baseline, struct tether_ra_parse *out)
{
	for (int i = baseline; i < tether_tx_capture_count; i++) {
		const uint8_t *l3;
		size_t l3_len;
		uint8_t nh;

		if (!parse_frame_ipv6(&tether_tx_frames[i], &l3, &l3_len, &nh)) {
			continue;
		}
		if (nh != IPPROTO_ICMPV6 || l3_len < 48U) {
			continue;
		}
		if (l3[40] != ICMPV6_RA_TYPE) {
			continue;
		}

		out->flags = l3[45];
		out->router_lifetime = sys_get_be16(l3 + 46);
		out->managed = (out->flags & RA_FLAG_MANAGED) != 0U;
		out->has_pio = false;
		out->has_rdnss = false;

		size_t off = 56U;

		while (off + 2U <= l3_len) {
			uint8_t otype = l3[off];
			uint8_t olen = l3[off + 1];

			if (olen == 0U) {
				break;
			}
			if (off + (size_t)olen * 8U > l3_len) {
				break;
			}
			if (otype == RA_OPT_PREFIX_INFO) {
				out->has_pio = true;
			} else if (otype == RA_OPT_RDNSS) {
				out->has_rdnss = true;
			}
			off += (size_t)olen * 8U;
		}
		return true;
	}

	return false;
}

static bool dhcp_opt_find(const uint8_t *opts, size_t opts_len, uint16_t code,
			  const uint8_t **val, uint16_t *vlen)
{
	size_t off = 0U;

	while (off + 4U <= opts_len) {
		uint16_t oc = sys_get_be16(opts + off);
		uint16_t ol = sys_get_be16(opts + off + 2);

		off += 4U;
		if (off + ol > opts_len) {
			break;
		}
		if (oc == code) {
			*val = opts + off;
			*vlen = ol;
			return true;
		}
		off += ol;
	}

	return false;
}

static void dhcp_parse_iaaddr(const uint8_t *ia_na, uint16_t ia_len, struct tether_dhcp_parse *out)
{
	size_t off = 12U;

	while (off + 4U <= ia_len) {
		uint16_t oc = sys_get_be16(ia_na + off);
		uint16_t ol = sys_get_be16(ia_na + off + 2);
		const uint8_t *val;

		off += 4U;
		if (off + ol > ia_len) {
			break;
		}
		val = ia_na + off;
		if (oc == DHCPV6_OPT_IAADDR && ol >= 24U) {
			struct in6_addr a;

			memcpy(a.s6_addr, val, 16);
			if (net_ipv6_is_ula_addr(&a)) {
				out->ula = a;
				out->have_ula = true;
			} else if (net_ipv6_is_global_addr(&a)) {
				out->gua = a;
				out->have_gua = true;
			}
			out->has_iaaddr = true;
		}
		off += ol;
	}
}

bool tether_host_find_dhcp(int baseline, uint8_t want_type, struct tether_dhcp_parse *out,
			 struct tether_host_ctx *host)
{
	for (int i = baseline; i < tether_tx_capture_count; i++) {
		const uint8_t *l3;
		size_t l3_len;
		uint8_t nh;

		if (!parse_frame_ipv6(&tether_tx_frames[i], &l3, &l3_len, &nh)) {
			continue;
		}
		if (nh != IPPROTO_UDP || l3_len < 48U) {
			continue;
		}

		const uint8_t *udp = l3 + 40U;
		uint16_t sport = sys_get_be16(udp);
		uint16_t dport = sys_get_be16(udp + 2);

		if (sport != DHCPV6_SERVER_PORT && dport != DHCPV6_SERVER_PORT) {
			continue;
		}

		const uint8_t *dhcp = udp + 8U;
		size_t dhcp_len = l3_len - 40U - 8U;

		if (dhcp_len < 4U || dhcp[0] != want_type) {
			continue;
		}

		memset(out, 0, sizeof(*out));
		out->msg_type = dhcp[0];

		const uint8_t *opts = dhcp + 4U;
		size_t opts_len = dhcp_len - 4U;
		const uint8_t *val;
		uint16_t vlen;

		if (host != NULL &&
		    dhcp_opt_find(opts, opts_len, DHCPV6_OPT_SERVERID, &val, &vlen) &&
		    vlen <= sizeof(host->server_duid)) {
			memcpy(host->server_duid, val, vlen);
			host->server_duid_len = vlen;
		}

		if (dhcp_opt_find(opts, opts_len, DHCPV6_OPT_IA_NA, &val, &vlen)) {
			dhcp_parse_iaaddr(val, vlen, out);
		}

		return true;
	}

	return false;
}

static bool ia_na_has_revoked_iaaddr(const uint8_t *ia_na, uint16_t ia_len)
{
	size_t off = 12U;

	while (off + 4U <= ia_len) {
		uint16_t oc = sys_get_be16(ia_na + off);
		uint16_t ol = sys_get_be16(ia_na + off + 2);

		off += 4U;
		if (off + ol > ia_len) {
			break;
		}
		if (oc == DHCPV6_OPT_IAADDR && ol >= 24U) {
			uint32_t pref = sys_get_be32(ia_na + off + 16);
			uint32_t valid = sys_get_be32(ia_na + off + 20);

			if (pref == 0U && valid == 0U) {
				return true;
			}
		}
		off += ol;
	}

	return false;
}

bool tether_host_dhcp_has_revoked_iaaddr(int baseline, uint8_t want_type)
{
	for (int i = baseline; i < tether_tx_capture_count; i++) {
		const uint8_t *l3;
		size_t l3_len;
		uint8_t nh;

		if (!parse_frame_ipv6(&tether_tx_frames[i], &l3, &l3_len, &nh)) {
			continue;
		}
		if (nh != IPPROTO_UDP || l3_len < 48U) {
			continue;
		}

		const uint8_t *udp = l3 + 40U;
		const uint8_t *dhcp = udp + 8U;
		size_t dhcp_len = l3_len - 40U - 8U;

		if (dhcp_len < 4U || dhcp[0] != want_type) {
			continue;
		}

		const uint8_t *opts = dhcp + 4U;
		size_t opts_len = dhcp_len - 4U;
		size_t off = 0U;

		while (off + 4U <= opts_len) {
			uint16_t oc = sys_get_be16(opts + off);
			uint16_t ol = sys_get_be16(opts + off + 2);
			const uint8_t *val;

			off += 4U;
			if (off + ol > opts_len) {
				break;
			}
			val = opts + off;
			if (oc == DHCPV6_OPT_IA_NA && ia_na_has_revoked_iaaddr(val, ol)) {
				return true;
			}
			off += ol;
		}
	}

	return false;
}
```

## src/tether_host_sim.h
```c
/*
 * Copyright (c) 2026 Nordic Semiconductor ASA
 *
 * SPDX-License-Identifier: LicenseRef-Nordic-5-Clause
 */

#ifndef TETHER_HOST_SIM_H_
#define TETHER_HOST_SIM_H_

#include <stdbool.h>
#include <stddef.h>
#include <stdint.h>
#include <zephyr/net/net_ip.h>

#include "dect_tether_ipv6_int.h"

#ifdef __cplusplus
extern "C" {
#endif

#define TETHER_HOST_MAC_LEN 6

struct tether_host_ctx {
	uint8_t mac[TETHER_HOST_MAC_LEN];
	struct in6_addr ll;
	uint32_t iaid;
	uint8_t tid[3];
	uint8_t server_duid[32];
	uint16_t server_duid_len;
};

struct tether_ra_parse {
	uint16_t router_lifetime;
	uint8_t flags;
	bool managed;
	bool has_pio;
	bool has_rdnss;
};

struct tether_dhcp_parse {
	uint8_t msg_type;
	bool has_iaaddr;
	struct in6_addr ula;
	struct in6_addr gua;
	bool have_ula;
	bool have_gua;
};

void tether_host_ctx_init(struct tether_host_ctx *host);
void tether_host_ctx_init_other(struct tether_host_ctx *host, uint8_t mac_last_octet);
int tether_host_install_neighbor(struct net_if *eth, struct tether_host_ctx *host);
int tether_host_send_rs(struct net_if *eth, struct tether_host_ctx *host);
int tether_host_send_solicit(struct net_if *eth, struct tether_host_ctx *host);
int tether_host_send_solicit_to(struct net_if *eth, struct tether_host_ctx *host,
			      const struct in6_addr *server_ll);
int tether_host_send_request(struct net_if *eth, struct tether_host_ctx *host,
			     const struct in6_addr *server_ll);
int tether_host_send_renew(struct net_if *eth, struct tether_host_ctx *host,
			   const struct in6_addr *server_ll);
int tether_host_send_rebind(struct net_if *eth, struct tether_host_ctx *host,
			    const struct in6_addr *server_ll);
int tether_host_send_confirm(struct net_if *eth, struct tether_host_ctx *host,
			     const struct in6_addr *server_ll);
int tether_host_send_info_request(struct net_if *eth, struct tether_host_ctx *host,
				  const struct in6_addr *server_ll, bool with_clientid);
int tether_host_send_solicit_no_clientid(struct net_if *eth, struct tether_host_ctx *host,
					 const struct in6_addr *server_ll);
int tether_host_send_request_bad_serverid(struct net_if *eth, struct tether_host_ctx *host,
					  const struct in6_addr *server_ll);
int tether_host_send_unknown_type(struct net_if *eth, struct tether_host_ctx *host,
				  const struct in6_addr *server_ll);

int tether_host_wait_tx_growth(int baseline, int timeout_ms);
bool tether_host_find_ra(int baseline, struct tether_ra_parse *out);
bool tether_host_find_dhcp(int baseline, uint8_t want_type, struct tether_dhcp_parse *out,
			   struct tether_host_ctx *host);
bool tether_host_dhcp_has_revoked_iaaddr(int baseline, uint8_t want_type);

#ifdef __cplusplus
}
#endif

#endif /* TETHER_HOST_SIM_H_ */
```

## src/tether_net_fixture.c
```c
/*
 * Copyright (c) 2026 Nordic Semiconductor ASA
 *
 * SPDX-License-Identifier: LicenseRef-Nordic-5-Clause
 */

#include <string.h>

#include <zephyr/kernel.h>
#include <zephyr/logging/log.h>
#include <zephyr/net/net_if.h>
#include <zephyr/net/net_ip.h>
#include <zephyr/net/net_mgmt.h>

#include <nrf_modem_dect.h>

extern void dect_mdm_ctrl_mdm_on_modem_lib_init(int ret, void *ctx);

#include "mock_nrf_modem_dect_mac.h"
#include "test_dect_utils.h"
#include "tether_dect_events.h"
#include "tether_net_fixture.h"
#include "tether_test_eth.h"

#include <net/dect/dect_tether_ipv6.h>
#include "dect_tether_ipv6_int.h"

LOG_MODULE_REGISTER(test_dect_tether, CONFIG_TEST_DECT_TETHER_LOG_LEVEL);

#define TETHER_TEST_BEACON_CHANNEL      1657
#define TETHER_TEST_BEACON_SHORT_RD_ID  0x1234
#define TETHER_TEST_BEACON_LONG_RD_ID   0x56789ABC
#define TETHER_TEST_BEACON_NETWORK_ID   0x9876

static const uint8_t tether_gua_prefix_a[8] = { 0x20, 0x01, 0x0d, 0xb8, 0, 0, 0, 0x01 };
static const uint8_t tether_gua_prefix_b[8] = { 0x20, 0x01, 0x0d, 0xb8, 0, 0, 0, 0x02 };

static struct net_if *tether_get_dect_iface(void)
{
	int idx = net_if_get_by_name(CONFIG_DECT_MDM_DEVICE_NAME);

	if (idx < 0) {
		return NULL;
	}

	return net_if_get_by_index(idx);
}

static int tether_assign_gua_prefix(struct net_if *dect, const uint8_t prefix[8])
{
	struct nrf_modem_dect_mac_ipv6_config_update_ntf_cb_params ntf = { 0 };
	struct net_in6_addr ula, gua;
	bool have_ula, have_gua;

	memcpy(ntf.ipv6_config.address, prefix, 8);
	ntf.ipv6_config.type = NRF_MODEM_DECT_MAC_IPV6_ADDRESS_TYPE_PREFIX;

	if (mock_ntf_callbacks.ipv6_config_update_ntf == NULL) {
		return -ENODEV;
	}

	mock_ntf_callbacks.ipv6_config_update_ntf(&ntf);
	k_msleep(200);

	if (!dect_tether_ipv6_dect_addrs_get(dect, &ula, &gua, &have_ula, &have_gua) || !have_gua) {
		LOG_ERR("GUA not available from dect after prefix update");
		return -ENOENT;
	}

	return 0;
}

int tether_net_fixture_setup(struct tether_net_fixture *fx)
{
	struct test_dect_scan_result scan = { 0 };
	struct test_dect_scan_beacon_params beacon = {
		.channel = TETHER_TEST_BEACON_CHANNEL,
		.transmitter_short_rd_id = TETHER_TEST_BEACON_SHORT_RD_ID,
		.transmitter_long_rd_id = TETHER_TEST_BEACON_LONG_RD_ID,
		.network_id = TETHER_TEST_BEACON_NETWORK_ID,
		.mcs = 1,
		.transmit_power = 8,
		.rssi_2 = -45,
		.snr = 20,
	};
	struct dect_scan_params scan_params = {
		.channel_count = 1,
		.channel_list = { TETHER_TEST_BEACON_CHANNEL },
		.channel_scan_time_ms = 100,
	};
	struct test_dect_association_result assoc = { 0 };
	struct in6_addr eth_ll;
	int err;

	memset(fx, 0, sizeof(*fx));

	err = tether_dect_events_init();
	if (err != 0) {
		return err;
	}

	fx->dect = tether_get_dect_iface();
	fx->eth = tether_test_eth_iface();
	if (fx->dect == NULL || fx->eth == NULL) {
		LOG_ERR("iface missing dect=%p eth=%p", fx->dect, fx->eth);
		return -ENODEV;
	}

	/* Same entry point as integration tests: simulate NRF_MODEM_LIB_ON_INIT. */
	dect_mdm_ctrl_mdm_on_modem_lib_init(0, NULL);
	if (k_sem_take(&tether_activation_done_sem, K_MSEC(500)) != 0 &&
	    !dect_activate_done_received) {
		LOG_ERR("DECT stack did not activate");
		return -ETIMEDOUT;
	}

#if defined(CONFIG_NET_INTERFACE_NAME)
	(void)net_if_set_name(fx->eth, CONFIG_DECT_TETHER_IPV6_HOST_ETH_IFACE);
#endif

	err = net_if_up(fx->eth);
	if (err != 0 && err != -EALREADY) {
		return err;
	}

	err = tether_test_eth_wait_ll(fx->eth, &eth_ll, 3000);
	if (err != 0) {
		return err;
	}
	fx->eth_ll = eth_ll;

	err = dect_tether_ipv6_init();
	if (err != 0 && err != -EALREADY) {
		return err;
	}
	fx->server_ll = fx->eth_ll;
	fx->tether_started = true;

	/* DHCP thread waits for host eth link-local. */
	k_msleep(300);

	{
		struct dect_settings reset = { 0 };

		reset.cmd_params.reset_to_driver_defaults = true;
		if (net_mgmt(NET_REQUEST_DECT_SETTINGS_WRITE, fx->dect, &reset,
			     sizeof(reset)) != 0) {
			return -EIO;
		}
	}

	tether_dect_events_reset_flags();
	err = test_dect_network_scan(fx->dect, &scan_params, &beacon, true, &scan);
	if (err != 0 || !scan.beacon_data_valid) {
		return err != 0 ? err : -EIO;
	}

	tether_dect_events_reset_flags();
	err = test_dect_association_request(fx->dect, TETHER_TEST_BEACON_LONG_RD_ID, NULL, true,
					    true, &assoc);
	if (err != 0 || !assoc.association_created_received) {
		return err != 0 ? err : -EIO;
	}

	err = tether_assign_gua_prefix(fx->dect, tether_gua_prefix_a);
	if (err != 0) {
		return err;
	}

	return 0;
}

void tether_net_fixture_teardown(struct tether_net_fixture *fx)
{
	if (fx->tether_started) {
		dect_tether_ipv6_deinit();
		fx->tether_started = false;
	}
	tether_dect_events_deinit();
}

int tether_net_fixture_parent_release(struct tether_net_fixture *fx)
{
	struct test_dect_association_release_result rel = { 0 };
	int err;

	tether_dect_events_reset_flags();
	err = test_dect_association_release(fx->dect, TETHER_TEST_BEACON_LONG_RD_ID, true, true,
					    &rel);
	if (err != 0) {
		return err;
	}

	k_msleep(200);
	return rel.association_changed_received ? 0 : -EIO;
}

int tether_net_fixture_change_gua_prefix(struct tether_net_fixture *fx)
{
	return tether_assign_gua_prefix(fx->dect, tether_gua_prefix_b);
}

/* Reverts to the baseline prefix set up by tether_net_fixture_setup(), without
 * the full DECT re-association tether_net_fixture_parent_restore() performs.
 */
int tether_net_fixture_revert_gua_prefix(struct tether_net_fixture *fx)
{
	return tether_assign_gua_prefix(fx->dect, tether_gua_prefix_a);
}

int tether_net_fixture_parent_restore(struct tether_net_fixture *fx)
{
	struct test_dect_association_result assoc = { 0 };
	int err;

	/* Re-associate with the same parent used in setup, no rescan needed:
	 * test_dect_association_request() issues NET_REQUEST_DECT_ASSOCIATION
	 * directly against the known long RD ID and simulates the modem's
	 * completion/joined callbacks.
	 */
	tether_dect_events_reset_flags();
	err = test_dect_association_request(fx->dect, TETHER_TEST_BEACON_LONG_RD_ID, NULL, true,
					    true, &assoc);
	if (err != 0 || !assoc.association_created_received) {
		return err != 0 ? err : -EIO;
	}

	/* Back to the baseline prefix used by setup, so tests that run after
	 * a restore see the same state as a freshly set up suite.
	 */
	return tether_assign_gua_prefix(fx->dect, tether_gua_prefix_a);
}
```

## src/tether_net_fixture.h
```c
/*
 * Copyright (c) 2026 Nordic Semiconductor ASA
 *
 * SPDX-License-Identifier: LicenseRef-Nordic-5-Clause
 */

#ifndef TETHER_NET_FIXTURE_H_
#define TETHER_NET_FIXTURE_H_

#include <zephyr/net/net_if.h>

#ifdef __cplusplus
extern "C" {
#endif

struct tether_net_fixture {
	struct net_if *dect;
	struct net_if *eth;
	struct in6_addr eth_ll;
	struct in6_addr server_ll;
	bool tether_started;
};

int tether_net_fixture_setup(struct tether_net_fixture *fx);
void tether_net_fixture_teardown(struct tether_net_fixture *fx);
int tether_net_fixture_parent_release(struct tether_net_fixture *fx);
int tether_net_fixture_parent_restore(struct tether_net_fixture *fx);
int tether_net_fixture_change_gua_prefix(struct tether_net_fixture *fx);
int tether_net_fixture_revert_gua_prefix(struct tether_net_fixture *fx);

#ifdef __cplusplus
}
#endif

#endif /* TETHER_NET_FIXTURE_H_ */
```
