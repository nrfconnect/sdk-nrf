## CMakeLists.txt
```
#
# Copyright (c) 2022 Nordic Semiconductor
#
# SPDX-License-Identifier: LicenseRef-Nordic-5-Clause
#

cmake_minimum_required(VERSION 3.20.0)

find_package(Zephyr REQUIRED HINTS $ENV{ZEPHYR_BASE})
project(download_client)

FILE(GLOB app_sources src/mock/*.c src/*.c)
target_sources(app PRIVATE ${app_sources})

target_include_directories(app
        PRIVATE
        ${ZEPHYR_NRF_MODULE_DIR}/include/net/
        ${ZEPHYR_BASE}/subsys/net/ip/
        ${ZEPHYR_BASE}/subsys/net/lib/sockets
        src/
        )

add_library(download_client STATIC
        ${ZEPHYR_NRF_MODULE_DIR}/subsys/net/lib/download_client/src/download_client.c
        ${ZEPHYR_NRF_MODULE_DIR}/subsys/net/lib/download_client/src/parse.c
        )
target_include_directories(download_client
        PRIVATE
        ${ZEPHYR_NRF_MODULE_DIR}/subsys/net/lib/download_client/include
        )

target_link_libraries(download_client PUBLIC zephyr_interface)
target_link_libraries(app PRIVATE download_client)

zephyr_append_cmake_library(download_client)

zephyr_compile_options(
        -DCONFIG_DOWNLOAD_CLIENT_BUF_SIZE=0x40
        -DCONFIG_DOWNLOAD_CLIENT_STACK_SIZE=2048
)

target_compile_definitions(
        download_client PRIVATE
        -DCONFIG_COAP=1
        -DCONFIG_DOWNLOAD_CLIENT_LOG_LEVEL=4
        -DCONFIG_DOWNLOAD_CLIENT_HTTP_FRAG_SIZE=256
        -DCONFIG_DOWNLOAD_CLIENT_MAX_HOSTNAME_SIZE=32
        -DCONFIG_DOWNLOAD_CLIENT_MAX_FILENAME_SIZE=64
        -DCONFIG_DOWNLOAD_CLIENT_TCP_SOCK_TIMEO_MS=0
)
```

## prj.conf
```kconfig
#
# Copyright (c) 2022-2023 Nordic Semiconductor ASA
#
# SPDX-License-Identifier: LicenseRef-Nordic-5-Clause
#
CONFIG_ZTEST=y
CONFIG_FLASH=y
CONFIG_ZTEST_MOCKING=y
CONFIG_ZTEST_STACK_SIZE=4096
CONFIG_MAIN_STACK_SIZE=4096
CONFIG_ZTEST_PARAMETER_COUNT=30

CONFIG_NETWORKING=y
CONFIG_NET_IPV4=y
CONFIG_NET_SOCKETS=y
CONFIG_NET_SOCKETS_OFFLOAD=y
CONFIG_COMMON_LIBC_MALLOC_ARENA_SIZE=2048
CONFIG_POSIX_API=y

CONFIG_COAP=n

CONFIG_TEST_LOGGING_DEFAULTS=y
```

## boards/native_sim.conf
```kconfig
CONFIG_ASAN=y
CONFIG_NET_TCP=y
CONFIG_NET_TCP_ISN_RFC6528=n
CONFIG_NET_UDP=y
CONFIG_MBEDTLS=n
```

## boards/qemu_cortex_m3.conf
```kconfig
CONFIG_NET_TCP=y
CONFIG_NET_TCP_ISN_RFC6528=n
CONFIG_NET_UDP=y
CONFIG_TEST_RANDOM_GENERATOR=y
CONFIG_NET_SLIP_TAP=n
```

## src/main.c
```c
/*
 * Copyright (c) 2022 Nordic Semiconductor ASA
 *
 * SPDX-License-Identifier: LicenseRef-Nordic-5-Clause
 */

#include <zephyr/kernel.h>
#include <zephyr/net/socket_offload.h>

#include <zephyr/ztest.h>
#include <download_client.h>

#include "mock/socket.h"
#include "mock/dl_coap.h"

static struct download_client client;
static const struct sockaddr_in addr_coap_me_http = {
	.sin_family = AF_INET,
	.sin_port = htons(80),
	.sin_addr.s4_addr = {134, 102, 218, 18},
};
static const struct sockaddr_in addr_example_com = {
	.sin_family = AF_INET,
	.sin_port = htons(5683),
	.sin_addr.s4_addr = {93, 184, 216, 34},
};

struct pipe {
	struct download_client_evt data[10];
	uint8_t wr_idx;
	uint8_t rd_idx;
};

static struct pipe event_pipe;
K_SEM_DEFINE(pipe_sem, 0, 10);

static void pipe_reset(struct pipe *pipe)
{
	memset(pipe, 0, sizeof(struct pipe));
}

static int pipe_put(struct pipe *pipe, const struct download_client_evt *evt)
{
	if (k_sem_count_get(&pipe_sem) >= 10) {
		printk("Pipe is full! Please check size!");
		return -ENOSPC;
	}

	memcpy(&pipe->data[pipe->wr_idx], evt, sizeof(struct download_client_evt));

	pipe->wr_idx++;
	pipe->wr_idx = CLAMP(pipe->wr_idx, 0,
			     (sizeof(pipe->data) / sizeof(struct download_client_evt)) - 1);

	k_sem_give(&pipe_sem);

	return 0;
}

static int pipe_get(struct pipe *pipe, struct download_client_evt *evt, k_timeout_t timeo)
{
	int err;

	err = k_sem_take(&pipe_sem, timeo);
	if (err) {
		return err;
	}

	memcpy(evt, &pipe->data[pipe->rd_idx], sizeof(struct download_client_evt));

	pipe->rd_idx++;
	pipe->rd_idx = CLAMP(pipe->rd_idx, 0,
			     (sizeof(pipe->data) / sizeof(struct download_client_evt)) - 1);

	return 0;
}

static int download_client_callback(const struct download_client_evt *event)
{
	if (event == NULL) {
		return -EINVAL;
	}

	printk("event: %d\n", event->id);
	pipe_put(&event_pipe, event);

	return 0;
}

static void mock_return_values(const char *func, int32_t *val, size_t len)
{
	size_t i;

	for (i = 0; i < len; i++) {
		z_ztest_returns_value(func, val[i]);
	}
}

static struct download_client_evt wait_for_event(enum download_client_evt_id event,
						 k_timeout_t timeout)
{
	struct download_client_evt evt;
	int err;

	while (true) {
		err = pipe_get(&event_pipe, &evt, timeout);
		zassert_ok(err);
		if (evt.id == event) {
			break;
		}
	}
	zassert_equal(evt.id, event);
	return evt;
}

static struct download_client_evt get_next_event(k_timeout_t timeout)
{
	struct download_client_evt evt;
	int err;

	err = pipe_get(&event_pipe, &evt, timeout);
	zassert_ok(err);
	return evt;
}

static struct download_client_cfg config = {
	.pdn_id = 0,
	.frag_size_override = 0,
};

static void init(void)
{
	static bool initialized;
	int err;

	if (!initialized) {
		memset(&client, 0, sizeof(struct download_client));
		err = download_client_init(&client, download_client_callback);
		zassert_ok(err, NULL);
		initialized = true;
	}
	pipe_reset(&event_pipe);
}

static void dl_coap_start(void)
{
	static const char host[] = "coap://example.com";
	int err;

	init();
	err = download_client_get(&client, host, &config, "no.file", 0);
	zassert_ok(err, NULL);
}

static void de_init(struct download_client *client)
{
	wait_for_event(DOWNLOAD_CLIENT_EVT_CLOSED, K_SECONDS(1));
}

ZTEST_SUITE(download_client, NULL, NULL, NULL, NULL, NULL);

ZTEST(download_client, test_download_simple)
{
	int32_t recvfrom_params[] = {25, 25, 25};
	int32_t sendto_params[] = {20, 20, 20};

	ztest_expect_data(mock_socket_offload_connect, addr, &addr_example_com);
	ztest_returns_value(mock_socket_offload_connect, 0);

	dl_coap_init(75, 20);

	mock_return_values("mock_socket_offload_recvfrom", recvfrom_params,
			   ARRAY_SIZE(recvfrom_params));
	mock_return_values("mock_socket_offload_sendto", sendto_params, ARRAY_SIZE(sendto_params));

	dl_coap_start();

	wait_for_event(DOWNLOAD_CLIENT_EVT_DONE, K_SECONDS(1));

	de_init(&client);
}

ZTEST(download_client, test_connection_failed)
{
	ztest_expect_data(mock_socket_offload_connect, addr, &addr_example_com);
	ztest_returns_value(mock_socket_offload_connect, ENETUNREACH);

	dl_coap_init(75, 20);

	dl_coap_start();

	struct download_client_evt evt = get_next_event(K_FOREVER);

	zassert_equal(evt.id, DOWNLOAD_CLIENT_EVT_ERROR);
	zassert_equal(evt.error, -ENETUNREACH);

	de_init(&client);
}

ZTEST(download_client, test_getaddr_failed)
{
	int err;
	struct download_client_evt evt;

	init();

	err = download_client_get(&client, "http://unknown_domain.com/file..bin", &config, NULL, 0);
	zassert_ok(err, NULL);
	evt = get_next_event(K_FOREVER);

	zassert_equal(evt.id, DOWNLOAD_CLIENT_EVT_ERROR);
	zassert_equal(evt.error, -EHOSTUNREACH);

	de_init(&client);
}

ZTEST(download_client, test_default_proto_http)
{
	int err;
	struct download_client_evt evt;

	init();
	ztest_expect_data(mock_socket_offload_connect, addr, &addr_coap_me_http);
	ztest_returns_value(mock_socket_offload_connect, EHOSTUNREACH);
	err = download_client_get(&client, "coap.me/file..bin", &config, NULL, 0);
	zassert_ok(err, NULL);
	evt = get_next_event(K_FOREVER);

	zassert_equal(evt.id, DOWNLOAD_CLIENT_EVT_ERROR);
	zassert_equal(evt.error, -EHOSTUNREACH);

	de_init(&client);
}

ZTEST(download_client, test_wrong_address)
{
	int err;
	struct download_client_evt evt;

	init();

	/* No host or config */
	err = download_client_get(&client, NULL, NULL, NULL, 0);
	zassert_equal(err, -EINVAL);

	/* Host, but no config */
	err = download_client_get(&client, "host", NULL, NULL, 0);
	zassert_equal(err, -EINVAL);

	/* Try twice to see client does not go into unusable mode */
	err = download_client_get(&client, "host", NULL, NULL, 0);
	zassert_equal(err, -EINVAL);

	/* Correct host+config buf fails to resolve */
	err = download_client_get(&client, "host", &config, NULL, 0);
	zassert_equal(err, 0);
	evt = wait_for_event(DOWNLOAD_CLIENT_EVT_ERROR, K_SECONDS(1));
	zassert_equal(evt.error, -EHOSTUNREACH);
	de_init(&client);

	/* IP that fails to convert */
	err = download_client_get(&client, "0.0.a", &config, NULL, 0);
	zassert_equal(err, 0);
	evt = wait_for_event(DOWNLOAD_CLIENT_EVT_ERROR, K_SECONDS(1));
	zassert_equal(evt.error, -EHOSTUNREACH);
	de_init(&client);

	/* Unsupported protocol */
	err = download_client_get(&client, "telnet://192.0.0.1/file.bin", &config, NULL, 0);
	zassert_equal(err, 0);
	evt = wait_for_event(DOWNLOAD_CLIENT_EVT_ERROR, K_SECONDS(1));
	zassert_equal(evt.error, -EPROTONOSUPPORT);
	de_init(&client);

}

ZTEST(download_client, test_download_reconnect_on_socket_error)
{
	int32_t recvfrom_params[] = {25, -1, 25, 25};
	int32_t sendto_params[] = {20, 20, 20, 20};
	struct download_client_evt evt;

	ztest_expect_data(mock_socket_offload_connect, addr, &addr_example_com);
	ztest_expect_data(mock_socket_offload_connect, addr, &addr_example_com);
	ztest_returns_value(mock_socket_offload_connect, 0);
	ztest_returns_value(mock_socket_offload_connect, 0);

	dl_coap_init(75, 20);

	mock_return_values("mock_socket_offload_recvfrom", recvfrom_params,
			   ARRAY_SIZE(recvfrom_params));
	mock_return_values("mock_socket_offload_sendto", sendto_params, ARRAY_SIZE(sendto_params));

	dl_coap_start();

	wait_for_event(DOWNLOAD_CLIENT_EVT_FRAGMENT, K_SECONDS(1));
	evt = wait_for_event(DOWNLOAD_CLIENT_EVT_ERROR, K_SECONDS(1));
	zassert_equal(evt.error, -ECONNRESET);
	wait_for_event(DOWNLOAD_CLIENT_EVT_FRAGMENT, K_SECONDS(1));
	wait_for_event(DOWNLOAD_CLIENT_EVT_FRAGMENT, K_SECONDS(1));
	wait_for_event(DOWNLOAD_CLIENT_EVT_DONE, K_SECONDS(1));

	de_init(&client);
}

ZTEST(download_client, test_download_reconnect_on_peer_close)
{
	int32_t recvfrom_params[] = {25, 0, 25, 25};
	int32_t sendto_params[] = {20, 20, 20, 20};
	struct download_client_evt evt;

	ztest_expect_data(mock_socket_offload_connect, addr, &addr_example_com);
	ztest_expect_data(mock_socket_offload_connect, addr, &addr_example_com);
	ztest_returns_value(mock_socket_offload_connect, 0);
	ztest_returns_value(mock_socket_offload_connect, 0);

	dl_coap_init(75, 20);

	mock_return_values("mock_socket_offload_recvfrom", recvfrom_params,
			   ARRAY_SIZE(recvfrom_params));
	mock_return_values("mock_socket_offload_sendto", sendto_params, ARRAY_SIZE(sendto_params));

	dl_coap_start();

	wait_for_event(DOWNLOAD_CLIENT_EVT_FRAGMENT, K_SECONDS(1));
	evt = get_next_event(K_SECONDS(1));
	zassert_equal(evt.id, DOWNLOAD_CLIENT_EVT_ERROR);
	zassert_equal(evt.error, -ECONNRESET);
	wait_for_event(DOWNLOAD_CLIENT_EVT_FRAGMENT, K_SECONDS(1));
	wait_for_event(DOWNLOAD_CLIENT_EVT_FRAGMENT, K_SECONDS(1));
	evt = get_next_event(K_SECONDS(1));
	zassert_equal(evt.id, DOWNLOAD_CLIENT_EVT_DONE);

	de_init(&client);
}

ZTEST(download_client, test_download_ignore_duplicate_block)
{
	int32_t recvfrom_params[] = {25, 25, 25, 25};
	int32_t sendto_params[] = {20, 20, 20};
	int32_t coap_parse_retv[] = {0, 0, 1, 0};
	struct download_client_evt evt;

	ztest_expect_data(mock_socket_offload_connect, addr, &addr_example_com);
	ztest_returns_value(mock_socket_offload_connect, 0);

	dl_coap_init(75, 20);

	mock_return_values("mock_socket_offload_recvfrom", recvfrom_params,
			   ARRAY_SIZE(recvfrom_params));
	mock_return_values("mock_socket_offload_sendto", sendto_params, ARRAY_SIZE(sendto_params));
	mock_return_values("coap_parse", coap_parse_retv, ARRAY_SIZE(coap_parse_retv));
	override_return_values.func_coap_parse = true;

	dl_coap_start();

	wait_for_event(DOWNLOAD_CLIENT_EVT_FRAGMENT, K_SECONDS(1));
	wait_for_event(DOWNLOAD_CLIENT_EVT_FRAGMENT, K_SECONDS(1));
	wait_for_event(DOWNLOAD_CLIENT_EVT_FRAGMENT, K_SECONDS(1));
	evt = get_next_event(K_SECONDS(1));
	zassert_equal(evt.id, DOWNLOAD_CLIENT_EVT_DONE);

	de_init(&client);
}

ZTEST(download_client, test_download_abort_on_invalid_block)
{
	int32_t recvfrom_params[] = {25, 25, 25};
	int32_t sendto_params[] = {20, 20, 20};
	int32_t coap_parse_retv[] = {0, 0, -1};

	ztest_expect_data(mock_socket_offload_connect, addr, &addr_example_com);
	ztest_returns_value(mock_socket_offload_connect, 0);

	dl_coap_init(75, 20);

	mock_return_values("mock_socket_offload_recvfrom", recvfrom_params,
			   ARRAY_SIZE(recvfrom_params));
	mock_return_values("mock_socket_offload_sendto", sendto_params, ARRAY_SIZE(sendto_params));
	mock_return_values("coap_parse", coap_parse_retv, ARRAY_SIZE(coap_parse_retv));
	override_return_values.func_coap_parse = true;

	dl_coap_start();

	wait_for_event(DOWNLOAD_CLIENT_EVT_ERROR, K_SECONDS(1));

	de_init(&client);
}

ZTEST(download_client, test_get)
{
	int err;
	int32_t recvfrom_params[] = {25, 25, 25};
	int32_t sendto_params[] = {20, 20, 20};

	ztest_expect_data(mock_socket_offload_connect, addr, &addr_example_com);
	ztest_returns_value(mock_socket_offload_connect, 0);

	dl_coap_init(75, 20);

	mock_return_values("mock_socket_offload_recvfrom", recvfrom_params,
			   ARRAY_SIZE(recvfrom_params));
	mock_return_values("mock_socket_offload_sendto", sendto_params, ARRAY_SIZE(sendto_params));

	err = download_client_get(&client, "coap://example.com/large", &config, NULL, 0);
	zassert_ok(err, NULL);
	wait_for_event(DOWNLOAD_CLIENT_EVT_DONE, K_SECONDS(1));
	wait_for_event(DOWNLOAD_CLIENT_EVT_CLOSED, K_SECONDS(1));
}

#define TEST_SOCKET_PRIO 40
NET_SOCKET_REGISTER(mock_socket, TEST_SOCKET_PRIO, AF_UNSPEC, mock_socket_is_supported,
		    mock_socket_create);
NET_DEVICE_OFFLOAD_INIT(mock_socket, "mock_socket", mock_nrf_modem_lib_socket_offload_init, NULL,
			&mock_socket_iface_data, NULL, 0, &mock_if_api, 1280);
```

## src/socket_mock.c
```c
/*
* Copyright (c) 2022 grandcentrix GmbH
*
* SPDX-License-Identifier: LicenseRef-Nordic-5-Clause
*/

#include "socket_mock.h"

#include <zephyr/net/socket_offload.h>
#include <sockets_internal.h>

void mock_socket_iface_init(struct net_if *iface);

struct mock_socket_iface_data {
	struct net_if *iface;
} mock_socket_iface_data;

struct net_if_api mock_if_api = {
	.init = mock_socket_iface_init,
};

/* All the functions contains a delay of 50 msec to avoid endless loops in
 * application code and simulate a bit the socket api as it would block
 * for a short moment anyway
 */

static size_t *mock_socket_offload_recvfrom_ret_values;
static size_t mock_socket_offload_recvfrom_ret_len;
static size_t mock_socket_offload_recvfrom_ret_cnt;

void test_set_ret_val_socket_offload_recvfrom(size_t *values, size_t len)
{
	mock_socket_offload_recvfrom_ret_values = values;
	mock_socket_offload_recvfrom_ret_len = len;
	mock_socket_offload_recvfrom_ret_cnt = 0;
}

static ssize_t mock_socket_offload_recvfrom(void *obj, void *buf, size_t len, int flags,
					    struct sockaddr *from, socklen_t *fromlen)
{
	int ret;

	if (mock_socket_offload_recvfrom_ret_cnt == mock_socket_offload_recvfrom_ret_len) {
		printk("Missing return values for mock_socket_offload_recvfrom\n");
		return 0;
	}

	k_sleep(K_MSEC(50));

	ret = mock_socket_offload_recvfrom_ret_values[mock_socket_offload_recvfrom_ret_cnt++];

	if (ret == -1) {
		errno = ETIMEDOUT;
	}

	return ret;
}

static ssize_t mock_socket_offload_read(void *obj, void *buffer, size_t count)
{
	return mock_socket_offload_recvfrom(obj, buffer, count, 0, NULL, 0);
}

static size_t *mock_socket_offload_sendto_ret_values;
static size_t mock_socket_offload_sendto_ret_len;
static size_t mock_socket_offload_sendto_ret_cnt;

void test_set_ret_val_socket_offload_sendto(size_t *values, size_t len)
{
	mock_socket_offload_sendto_ret_values = values;
	mock_socket_offload_sendto_ret_len = len;
	mock_socket_offload_sendto_ret_cnt = 0;
}

static ssize_t mock_socket_offload_sendto(void *obj, const void *buf, size_t len, int flags,
					  const struct sockaddr *to, socklen_t tolen)
{
	int ret;

	if (mock_socket_offload_sendto_ret_cnt == mock_socket_offload_sendto_ret_len) {
		printk("Missing return values for mock_socket_offload_recvfrom\n");
		return 0;
	}

	k_sleep(K_MSEC(50));

	ret = mock_socket_offload_sendto_ret_values[mock_socket_offload_sendto_ret_cnt++];

	if (ret == -1) {
		errno = ETIMEDOUT;
	}

	return ret;
}

void test_socket_mock_teardown(void)
{
	test_set_ret_val_socket_offload_recvfrom(NULL, 0);
	test_set_ret_val_socket_offload_sendto(NULL, 0);
}

static ssize_t mock_socket_offload_write(void *obj, const void *buffer, size_t count)
{
	return mock_socket_offload_sendto(obj, buffer, count, 0, NULL, 0);
}

static int mock_socket_offload_close(void *obj)
{
	k_sleep(K_MSEC(50));
	return zsock_close_ctx(obj);
}

static int mock_socket_offload_ioctl(void *obj, unsigned int request, va_list args)
{
	k_sleep(K_MSEC(50));

	switch (request) {
	case ZFD_IOCTL_POLL_PREPARE:
		return -EXDEV;

	case ZFD_IOCTL_POLL_UPDATE:
		return -EOPNOTSUPP;

	case ZFD_IOCTL_POLL_OFFLOAD: {
		return 0;
	}

	case ZFD_IOCTL_SET_LOCK: {
		return 0;
	}

	/* Otherwise, just forward to offloaded fcntl()
	 * In Zephyr, fcntl() is just an alias of ioctl().
	 */
	default:
		return 0;
	}

	return 0;
}

static int mock_socket_offload_bind(void *obj, const struct sockaddr *addr, socklen_t addrlen)
{
	k_sleep(K_MSEC(50));
	return 0;
}

static int mock_socket_offload_connect(void *obj, const struct sockaddr *addr, socklen_t addrlen)
{
	k_sleep(K_MSEC(50));
	return 0;
}

static int mock_socket_offload_listen(void *obj, int backlog)
{
	k_sleep(K_MSEC(50));
	return 0;
}

static int mock_socket_offload_accept(void *obj, struct sockaddr *addr, socklen_t *addrlen)
{
	k_sleep(K_MSEC(50));
	return 0;
}

static ssize_t mock_socket_offload_sendmsg(void *obj, const struct msghdr *msg, int flags)
{
	k_sleep(K_MSEC(50));
	return 0;
}

static int mock_socket_offload_setsockopt(void *obj, int level, int optname, const void *optval,
					  socklen_t optlen)
{
	struct timeval time;

	k_sleep(K_MSEC(50));

	if ((level == SOL_SOCKET) && ((optname == SO_RCVTIMEO) || (optname == SO_SNDTIMEO))) {
		time.tv_sec = ((struct timeval *)optval)->tv_sec;
		time.tv_usec = ((struct timeval *)optval)->tv_usec;
	}

	return 0;
}

static int mock_socket_offload_getsockopt(void *obj, int level, int optname, void *optval,
					  socklen_t *optlen)
{
	k_sleep(K_MSEC(50));
	return 0;
}

static const struct socket_op_vtable mock_socket_fd_op_vtable = {
	.fd_vtable = {
		.read = mock_socket_offload_read,
		.write = mock_socket_offload_write,
		.close = mock_socket_offload_close,
		.ioctl = mock_socket_offload_ioctl,
	},
	.bind = mock_socket_offload_bind,
	.connect = mock_socket_offload_connect,
	.listen = mock_socket_offload_listen,
	.accept = mock_socket_offload_accept,
	.sendto = mock_socket_offload_sendto,
	.sendmsg = mock_socket_offload_sendmsg,
	.recvfrom = mock_socket_offload_recvfrom,
	.getsockopt = mock_socket_offload_getsockopt,
	.setsockopt = mock_socket_offload_setsockopt,
};

/**
 * There is no support for dns lookup, node has to be a valid ip address
 * that is parseable via net_ipaddr_parse
 */
static int mock_socket_offload_getaddrinfo(const char *node, const char *service,
					   const struct zsock_addrinfo *hints,
					   struct zsock_addrinfo **res)
{
	struct sockaddr_in *ai_addr;
	struct zsock_addrinfo *ai;
	unsigned long port = 0;

	if (!node) {
		return -1;
	}

	if (service) {
		port = strtol(service, NULL, 10);
		if (port < 1 || port > USHRT_MAX) {
			return -1;
		}
	}

	if (!res) {
		return -1;
	}

	if (hints && hints->ai_family != AF_INET) {
		return -1;
	}

	*res = calloc(1, sizeof(struct zsock_addrinfo));
	ai = *res;
	if (!ai) {
		return -1;
	}

	ai_addr = calloc(1, sizeof(*ai_addr));
	if (!ai_addr) {
		free(*res);
		return -1;
	}

	ai->ai_family = AF_INET;
	ai->ai_socktype = hints ? hints->ai_socktype : SOCK_STREAM;
	ai->ai_protocol = ai->ai_socktype == SOCK_STREAM ? IPPROTO_TCP : IPPROTO_UDP;

	ai_addr->sin_family = ai->ai_family;
	ai_addr->sin_port = htons(port);

	if (!net_ipaddr_parse(node, strlen(node), (struct sockaddr *)ai_addr)) {
		free(ai_addr);
		free(*res);
		return -1;
	}

	ai->ai_addrlen = sizeof(*ai_addr);
	ai->ai_addr = (struct sockaddr *)ai_addr;

	return 0;
}

static void mock_socket_offload_freeaddrinfo(struct zsock_addrinfo *res)
{
	__ASSERT_NO_MSG(res);

	free(res->ai_addr);
	free(res);
}

bool mock_socket_is_supported(int family, int type, int proto)
{
	return true;
}

int mock_socket_create(int family, int type, int proto)
{
	int fd = z_reserve_fd();
	struct net_context *ctx;
	int res;

	if (fd < 0) {
		return -1;
	}

	if (proto == 0) {
		if (family == AF_INET || family == AF_INET6) {
			if (type == SOCK_DGRAM) {
				proto = IPPROTO_UDP;
			} else if (type == SOCK_STREAM) {
				proto = IPPROTO_TCP;
			}
		}
	}

	res = net_context_get(family, type, proto, &ctx);
	if (res < 0) {
		z_free_fd(fd);
		errno = -res;
		return -1;
	}

	/* Initialize user_data, all other calls will preserve it */
	ctx->user_data = NULL;

	/* The socket flags are stored here */
	ctx->socket_data = NULL;

	/* recv_q and accept_q are in union */
	k_fifo_init(&ctx->recv_q);

	/* Condition variable is used to avoid keeping lock for a long time
	 * when waiting data to be received
	 */
	k_condvar_init(&ctx->cond.recv);

	/* TCP context is effectively owned by both application
	 * and the stack: stack may detect that peer closed/aborted
	 * connection, but it must not dispose of the context behind
	 * the application back. Likewise, when application "closes"
	 * context, it's not disposed of immediately - there's yet
	 * closing handshake for stack to perform.
	 */
	if (proto == IPPROTO_TCP) {
		net_context_ref(ctx);
	}

	z_finalize_fd(fd, ctx, (const struct fd_op_vtable *)&mock_socket_fd_op_vtable);

	return fd;
}

static const struct socket_dns_offload mock_socket_dns_offload_ops = {
	.getaddrinfo = mock_socket_offload_getaddrinfo,
	.freeaddrinfo = mock_socket_offload_freeaddrinfo,
};

void mock_socket_iface_init(struct net_if *iface)
{
	mock_socket_iface_data.iface = iface;

	iface->if_dev->socket_offload = mock_socket_create;

	socket_offload_dns_register(&mock_socket_dns_offload_ops);
}

int mock_nrf_modem_lib_socket_offload_init(const struct device *dev)
{
	return 0;
}
```

## src/socket_mock.h
```c
/*
 * Copyright (c) 2022 grandcentrix GmbH
 *
 * SPDX-License-Identifier: LicenseRef-Nordic-5-Clause
 */

#ifndef SOCKET_MOCK_H
#define SOCKET_MOCK_H

#include <stdbool.h>
#include <stdio.h>

extern struct mock_socket_iface_data mock_socket_iface_data;
extern struct net_if_api mock_if_api;

void test_set_ret_val_socket_offload_recvfrom(size_t *values, size_t len);
void test_set_ret_val_socket_offload_sendto(size_t *values, size_t len);
void test_socket_mock_teardown(void);

bool mock_socket_is_supported(int family, int type, int proto);
int mock_socket_create(int family, int type, int proto);

#endif /* SOCKET_MOCK_H */
```

## src/stubs.c
```c
/*
 * Copyright (c) 2023 grandcentrix GmbH
 *
 * SPDX-License-Identifier: LicenseRef-Nordic-5-Clause
 */

#include "stubs.h"

#include <download_client.h>

extern int socket_send(const struct download_client *client, size_t len, int timeout);

DEFINE_FAKE_VALUE_FUNC(int, coap_block_init, struct download_client *, size_t);
DEFINE_FAKE_VALUE_FUNC(int, coap_get_recv_timeout, struct download_client *);
DEFINE_FAKE_VALUE_FUNC(int, coap_initiate_retransmission, struct download_client *);
DEFINE_FAKE_VALUE_FUNC(int, coap_parse, struct download_client *, size_t);
DEFINE_FAKE_VALUE_FUNC(int, coap_request_send, struct download_client *);

DEFINE_FAKE_VALUE_FUNC(int, http_parse, const struct download_client *, size_t);
DEFINE_FAKE_VALUE_FUNC(int, http_get_request_send, const struct download_client *);

int coap_get_recv_timeout_fake_default(struct download_client *dl)
{
	return 4000;
}

static size_t *mock_coap_initiate_retransmission_ret_values;
static size_t mock_coap_initiate_retransmission_ret_len;
static size_t mock_coap_initiate_retransmission_ret_cnt;

void test_set_ret_val_coap_initiate_retransmission(size_t *values, size_t len)
{
	mock_coap_initiate_retransmission_ret_values = values;
	mock_coap_initiate_retransmission_ret_len = len;
	mock_coap_initiate_retransmission_ret_cnt = 0;
}

int coap_initiate_retransmission_fake_default(struct download_client *dl)
{
	if (mock_coap_initiate_retransmission_ret_cnt < mock_coap_initiate_retransmission_ret_len) {
		return mock_coap_initiate_retransmission_ret_values
			[mock_coap_initiate_retransmission_ret_cnt++];
	}

	return 0;
}

static size_t *mock_coap_parse_ret_values;
static size_t mock_coap_parse_ret_len;
static size_t mock_coap_parse_ret_cnt;

void set_ret_val_coap_parse(size_t *values, size_t len)
{
	mock_coap_parse_ret_values = values;
	mock_coap_parse_ret_len = len;
	mock_coap_parse_ret_cnt = 0;
}

int coap_parse_fake_default(struct download_client *client, size_t len)
{
	int ret = 0;

	if (client->file_size == 0) {
		client->file_size = 75;
	}

	if (mock_coap_parse_ret_cnt < mock_coap_parse_ret_len) {
		ret = mock_coap_parse_ret_values[mock_coap_parse_ret_cnt++];
	}

	if (!ret) {
		client->progress += len;
	}

	return ret;
}

int coap_request_send_fake_default(struct download_client *client)
{
	int err = 0;

	err = socket_send(client, 20, 4000);
	if (err) {
		return err;
	}

	return 0;
}

void test_stubs_teardown(void)
{
	test_set_ret_val_coap_initiate_retransmission(NULL, 0);
	set_ret_val_coap_parse(NULL, 0);
}
```

## src/stubs.h
```c
/*
 * Copyright (c) 2023 grandcentrix GmbH
 *
 * SPDX-License-Identifier: LicenseRef-Nordic-5-Clause
 */

#ifndef STUBS_H
#define STUBS_H

#include <zephyr/fff.h>
#include <zephyr/ztest.h>

DECLARE_FAKE_VALUE_FUNC(int, coap_block_init, struct download_client *, size_t);
DECLARE_FAKE_VALUE_FUNC(int, coap_get_recv_timeout, struct download_client *);
DECLARE_FAKE_VALUE_FUNC(int, coap_initiate_retransmission, struct download_client *);
DECLARE_FAKE_VALUE_FUNC(int, coap_parse, struct download_client *, size_t);
DECLARE_FAKE_VALUE_FUNC(int, coap_request_send, struct download_client *);

DECLARE_FAKE_VALUE_FUNC(int, http_parse, const struct download_client *, size_t);
DECLARE_FAKE_VALUE_FUNC(int, http_get_request_send, const struct download_client *);

int coap_get_recv_timeout_fake_default(struct download_client *dl);
void test_set_ret_val_coap_initiate_retransmission(size_t *values, size_t len);
int coap_initiate_retransmission_fake_default(struct download_client *dl);
void set_ret_val_coap_parse(size_t *values, size_t len);
int coap_parse_fake_default(struct download_client *client, size_t len);
int coap_request_send_fake_default(struct download_client *client);
void test_stubs_teardown(void);

#define DO_FOREACH_FAKE(FUNC)                                                                      \
	do {                                                                                       \
		FUNC(coap_block_init)                                                              \
		FUNC(coap_get_recv_timeout)                                                        \
		FUNC(coap_initiate_retransmission)                                                 \
		FUNC(coap_parse)                                                                   \
		FUNC(coap_request_send)                                                            \
		FUNC(http_parse)                                                                   \
		FUNC(http_get_request_send)                                                        \
	} while (0)

#endif /* STUBS_H */
```
