## CMakeLists.txt
```
#
# Copyright (c) 2022 Nordic Semiconductor
#
# SPDX-License-Identifier: LicenseRef-Nordic-5-Clause
#

cmake_minimum_required(VERSION 3.20.0)

find_package(Zephyr REQUIRED HINTS $ENV{ZEPHYR_BASE})
project(nrf_cloud_init_uninit_test)

# NRF CLOUD TEST START
target_sources(app PRIVATE src/main.c)

# nrf_cloud.c is only included with the poll thread,
# so it needs to be included when the thread is disabled
if(NOT CONFIG_NRF_CLOUD_CONNECTION_POLL_THREAD)
  target_sources(app PRIVATE
    ${ZEPHYR_NRF_MODULE_DIR}/subsys/net/lib/nrf_cloud/mqtt/src/nrf_cloud.c
  )
endif()

target_include_directories(app PRIVATE
  src
  ${ZEPHYR_NRF_MODULE_DIR}/subsys/net/lib/nrf_cloud/common/include
  ${ZEPHYR_NRF_MODULE_DIR}/subsys/net/lib/nrf_cloud/common/src
  ${ZEPHYR_NRF_MODULE_DIR}/subsys/net/lib/nrf_cloud/mqtt/include
  ${ZEPHYR_NRF_MODULE_DIR}/subsys/net/lib/nrf_cloud/mqtt/src
  ${ZEPHYR_BASE}/subsys/testsuite/include
  ${ZEPHYR_CJSON_MODULE_DIR}
)

if(CONFIG_NRF_CLOUD_MQTT OR CONFIG_NRF_CLOUD_FOTA OR CONFIG_NRF_MODEM_LIB)
  if(CONFIG_NRF_CLOUD_MQTT OR CONFIG_NRF_CLOUD_FOTA)
    # These code files are mocked and/or not necessary to be included,
    # also prevent nrf_cloud.c to be included multiple times by KConfig
    set_source_files_properties(
      ${ZEPHYR_NRF_MODULE_DIR}/subsys/net/lib/nrf_cloud/mqtt/src/nrf_cloud.c
      ${ZEPHYR_NRF_MODULE_DIR}/subsys/net/lib/nrf_cloud/common/src/nrf_cloud_mem.c
      ${ZEPHYR_NRF_MODULE_DIR}/subsys/net/lib/nrf_cloud/mqtt/src/nrf_cloud_fota.c
      ${ZEPHYR_NRF_MODULE_DIR}/subsys/net/lib/nrf_cloud/common/src/nrf_cloud_fota_common.c
      ${ZEPHYR_NRF_MODULE_DIR}/subsys/net/lib/nrf_cloud/common/src/nrf_cloud_codec_internal.c
      ${ZEPHYR_NRF_MODULE_DIR}/subsys/net/lib/nrf_cloud/mqtt/src/nrf_cloud_codec_internal.c
      ${ZEPHYR_NRF_MODULE_DIR}/subsys/net/lib/nrf_cloud/mqtt/src/nrf_cloud_fsm.c
      ${ZEPHYR_NRF_MODULE_DIR}/subsys/net/lib/nrf_cloud/mqtt/src/nrf_cloud_transport.c
      ${ZEPHYR_NRF_MODULE_DIR}/subsys/net/lib/nrf_cloud/common/src/nrf_cloud_codec.c
      ${ZEPHYR_NRF_MODULE_DIR}/subsys/net/lib/nrf_cloud/common/src/nrf_cloud_info.c
      DIRECTORY ${ZEPHYR_NRF_MODULE_DIR}/subsys/net/lib/nrf_cloud/
      PROPERTIES HEADER_FILE_ONLY ON
    )

    # This code file has functions/structs/variables defined when
    # POSIX_API=y in zephyr/net/socket.h, so it needs to be excluded
    # when POSIX_API=n
    set_source_files_properties(
      ${ZEPHYR_NRF_MODULE_DIR}/subsys/net/lib/downloader/src/downloader.c
      DIRECTORY ${ZEPHYR_NRF_MODULE_DIR}/subsys/net/lib/downloader/
      PROPERTIES HEADER_FILE_ONLY ON
    )
  endif()

  if(CONFIG_NRF_MODEM_LIB)
    # Similarly, these files need to be excluded when POSIX_API=n
    set_source_files_properties(
      ${ZEPHYR_NRF_MODULE_DIR}/lib/nrf_modem_lib/sanity.c
      ${ZEPHYR_NRF_MODULE_DIR}/lib/nrf_modem_lib/nrf9x_sockets.c
      DIRECTORY ${ZEPHYR_NRF_MODULE_DIR}/lib/nrf_modem_lib/
      PROPERTIES HEADER_FILE_ONLY ON
    )
  else()
    # This code file uses NRF_MODEM_LIB, should not be included when it is off
    set_source_files_properties(
      ${ZEPHYR_NRF_MODULE_DIR}/subsys/dfu/dfu_target/src/dfu_target_modem_delta.c
      DIRECTORY ${ZEPHYR_NRF_MODULE_DIR}/subsys/dfu/dfu_target/
      PROPERTIES HEADER_FILE_ONLY ON
    )
  endif()
endif()
# NRF CLOUD TEST END

target_compile_options(app
  PRIVATE
  # Set the macro explicitly to log level DBG
  -DCONFIG_NRF_CLOUD_LOG_LEVEL=4
)
```

## prj.conf
```kconfig
#
# Copyright (c) 2022-2023 Nordic Semiconductor
#
# SPDX-License-Identifier: LicenseRef-Nordic-5-Clause
#

# ZTEST with new API
CONFIG_ZTEST=y

# Network
CONFIG_NETWORKING=y

# Disable sockets
CONFIG_NET_SOCKETS=n

# Dependencies
# Ineffective here: unsatisfied dependency NEWLIB_LIBC_SUPPORTED, so NEWLIB_LIBC stays n and the
# default C library is used.
# CONFIG_NEWLIB_LIBC=y
# Ineffective here: unsatisfied dependency NEWLIB_LIBC, so NEWLIB_LIBC_FLOAT_PRINTF stays n.
# CONFIG_NEWLIB_LIBC_FLOAT_PRINTF=y
```

## prj_qemu_cortex_m3.conf
```kconfig
#
# Copyright (c) 2023 Nordic Semiconductor
#
# SPDX-License-Identifier: LicenseRef-Nordic-5-Clause
#

# ZTEST with new API
CONFIG_ZTEST=y
CONFIG_ZTEST_NEW_API=y

# Disable networking
CONFIG_NETWORKING=n

# Disable sockets and POSIX wrappers
CONFIG_NET_SOCKETS=n
CONFIG_NET_SOCKETS_POSIX_NAMES=n

# Dependencies
CONFIG_NEWLIB_LIBC=y
CONFIG_NEWLIB_LIBC_FLOAT_PRINTF=y

# For the unit test to run in qemu_cortex_m3,
# we need the following KConfig values to be set.
# See https://github.com/zephyrproject-rtos/zephyr/issues/15565
CONFIG_ENTROPY_GENERATOR=y
CONFIG_TEST_RANDOM_GENERATOR=y
```

## boards/qemu_cortex_m3.conf
```kconfig
#
# Copyright (c) 2023 Nordic Semiconductor
#
# SPDX-License-Identifier: LicenseRef-Nordic-5-Clause
#

# Disable networking
CONFIG_NETWORKING=n

# For the unit test to run in qemu_cortex_m3,
# we need the following KConfig values to be set.
# See https://github.com/zephyrproject-rtos/zephyr/issues/15565
CONFIG_ENTROPY_GENERATOR=y
CONFIG_TEST_RANDOM_GENERATOR=y
```

## boards/nrf9160dk_nrf9160_ns.overlay
```dts
/*
 * Copyright (c) 2026 Nordic Semiconductor ASA
 *
 * SPDX-License-Identifier: LicenseRef-Nordic-5-Clause
 */

#include <samples/cellular/nrf91_crypto_partitions.dtsi>
```

## src/fakes.h
```c
/*
 * Copyright (c) 2022 Nordic Semiconductor ASA
 *
 * SPDX-License-Identifier: LicenseRef-Nordic-5-Clause
 */

#include <nrf_cloud_transport.h>
#include <nrf_cloud_codec_internal.h>
#include <net/nrf_cloud_codec.h>
#include <nrf_cloud_mem.h>
#include <zephyr/fff.h>
#include <zephyr/ztest.h>
#include <zephyr/net/socket.h>
#include "nrf_cloud_fsm.h"

DEFINE_FFF_GLOBALS;

int poll(struct zsock_pollfd *fds, int nfds, int timeout);

/* Fake functions declaration */
FAKE_VALUE_FUNC(int, nct_initialize, const struct nrf_cloud_init_param *);
FAKE_VALUE_FUNC(int, nfsm_init);
FAKE_VALUE_FUNC(int, nrf_cloud_codec_init, struct nrf_cloud_os_mem_hooks *);
FAKE_VOID_FUNC(nrf_cloud_set_app_version, const char *const);
FAKE_VALUE_FUNC(int, nrf_cloud_fota_fmfu_dev_set, const struct dfu_target_fmfu_fdev *);
FAKE_VALUE_FUNC(int, nct_disconnect);
FAKE_VOID_FUNC(nct_uninit);
FAKE_VALUE_FUNC(int, nrf_cloud_fota_uninit);
FAKE_VALUE_FUNC(int, nct_connect);
FAKE_VALUE_FUNC(int, nct_socket_get);
FAKE_VALUE_FUNC(int, nct_keepalive_time_left);
FAKE_VALUE_FUNC(int, nct_process);
FAKE_VALUE_FUNC(int, nct_cc_send, const struct nct_cc_data *);
FAKE_VALUE_FUNC(int, nct_dc_send, const struct nct_dc_data *);
FAKE_VALUE_FUNC(int, nct_dc_stream, const struct nct_dc_data *);
FAKE_VALUE_FUNC(int, nct_dc_bulk_send, const struct nct_dc_data *, enum mqtt_qos);
FAKE_VALUE_FUNC(int, nrf_cloud_shadow_dev_status_encode,
				const struct nrf_cloud_device_status *,
				struct nrf_cloud_data *, const bool, const bool);
FAKE_VALUE_FUNC(int, nct_dc_bin_send, const struct nct_dc_data *, enum mqtt_qos);
FAKE_VOID_FUNC(nrf_cloud_device_status_free, struct nrf_cloud_data *);
FAKE_VALUE_FUNC(int, nrf_cloud_sensor_data_encode, const struct nrf_cloud_sensor_data *,
				struct nrf_cloud_data *);
FAKE_VOID_FUNC(nrf_cloud_os_mem_hooks_init, struct nrf_cloud_os_mem_hooks *);
FAKE_VOID_FUNC(nrf_cloud_free, void *);
FAKE_VALUE_FUNC(int, poll, struct zsock_pollfd *, int, int);
FAKE_VALUE_FUNC(int, nrf_cloud_obj_cloud_encode, struct nrf_cloud_obj *const);
FAKE_VALUE_FUNC(int, nrf_cloud_obj_cloud_encoded_free, struct nrf_cloud_obj *const);
FAKE_VALUE_FUNC(int, nrf_cloud_print_details);

/* Custom fakes implementation */
int fake_nct_initialize__succeeds(const struct nrf_cloud_init_param *param)
{
	ARG_UNUSED(param);
	return 0;
}

int fake_nct_initialize__fails(const struct nrf_cloud_init_param *param)
{
	ARG_UNUSED(param);
	return -ENODEV;
}

int fake_nfsm_init__succeeds(void)
{
	return 0;
}

int fake_nrf_cloud_codec_init__succeeds(struct nrf_cloud_os_mem_hooks *hooks)
{
	ARG_UNUSED(hooks);
	return 0;
}

int fake_nrf_cloud_fota_fmfu_dev_set__succeeds(const struct dfu_target_fmfu_fdev *const dev_inf)
{
	ARG_UNUSED(dev_inf);
	return 0;
}

int fake_nrf_cloud_fota_fmfu_dev_set__fails(const struct dfu_target_fmfu_fdev *const dev_inf)
{
	ARG_UNUSED(dev_inf);
	return -ENODEV;
}

int fake_nct_disconnect__succeeds(void)
{
	struct nrf_cloud_evt evt = {
		.type = NRF_CLOUD_EVT_TRANSPORT_DISCONNECTED,
	};

	nfsm_set_current_state_and_notify(STATE_INITIALIZED, &evt);
	return 0;
}

int fake_nct_disconnect__not_actually_disconnect(void)
{
	return 0;
}

int fake_nct_disconnect__fails(void)
{
	return -ENOMEM;
}

int fake_nrf_cloud_fota_uninit__succeeds(void)
{
	return 0;
}

int fake_nrf_cloud_fota_uninit__busy(void)
{
	return -EBUSY;
}

int fake_nct_connect__succeeds(void)
{
	struct nrf_cloud_evt evt = {
		.type = NRF_CLOUD_EVT_TRANSPORT_CONNECTED,
	};

	nfsm_set_current_state_and_notify(STATE_CONNECTED, &evt);
	return 0;
}

int fake_nct_connect_with_cc_connect__succeeds(void)
{
	struct nrf_cloud_evt evt = {
		.type = NRF_CLOUD_EVT_TRANSPORT_CONNECTED,
	};

	nfsm_set_current_state_and_notify(STATE_CONNECTED, &evt);

	/* Sleep for 1s */
	k_sleep(K_MSEC(1000));

	evt.type = NRF_CLOUD_EVT_RX_DATA_GENERAL;
	nfsm_set_current_state_and_notify(STATE_CC_CONNECTED, &evt);
	return 0;
}

int fake_nct_connect_with_dc_connect__succeeds(void)
{
	struct nrf_cloud_evt evt = {
		.type = NRF_CLOUD_EVT_TRANSPORT_CONNECTED,
	};

	nfsm_set_current_state_and_notify(STATE_CONNECTED, &evt);

	/* Sleep for 1s */
	k_sleep(K_MSEC(1000));

	evt.type = NRF_CLOUD_EVT_READY;
	nfsm_set_current_state_and_notify(STATE_DC_CONNECTED, &evt);
	return 0;
}

int fake_nct_connect__invalid(void)
{
	return -EINVAL;
}

int fake_nct_socket_get_data(void)
{
	return 1234;
}

int fake_nct_keepalive_time_left_get(void)
{
	return 1000;
}

int fake_nct_keepalive_time_left_long_timeout(void)
{
	return 11000;
}

int fake_nct_process__succeeds(void)
{
	return 0;
}

int fake_nct_process__fails(void)
{
	return -EACCES;
}

int fake_nct_cc_send__succeeds(const struct nct_cc_data *data)
{
	ARG_UNUSED(data);
	return 0;
}

int fake_nct_cc_send__fails(const struct nct_cc_data *data)
{
	ARG_UNUSED(data);
	return -EINVAL;
}

int fake_nct_dc_send__succeeds(const struct nct_dc_data *data)
{
	ARG_UNUSED(data);
	return 0;
}

int fake_nct_dc_send__fails(const struct nct_dc_data *data)
{
	ARG_UNUSED(data);
	return -EINVAL;
}

int fake_nct_dc_stream__succeeds(const struct nct_dc_data *data)
{
	ARG_UNUSED(data);
	return 0;
}

int fake_nct_dc_stream__fails(const struct nct_dc_data *data)
{
	ARG_UNUSED(data);
	return -EINVAL;
}

int fake_nct_dc_bulk_send__succeeds(const struct nct_dc_data *data, enum mqtt_qos qos)
{
	ARG_UNUSED(data);
	ARG_UNUSED(qos);
	return 0;
}

int fake_nct_dc_bin_send__fails(const struct nct_dc_data *data, enum mqtt_qos qos)
{
	ARG_UNUSED(data);
	ARG_UNUSED(qos);
	return -EINVAL;
}

int fake_nct_dc_bin_send__succeeds(const struct nct_dc_data *data, enum mqtt_qos qos)
{
	ARG_UNUSED(data);
	ARG_UNUSED(qos);
	return 0;
}

int fake_nct_dc_bulk_send__fails(const struct nct_dc_data *data, enum mqtt_qos qos)
{
	ARG_UNUSED(data);
	ARG_UNUSED(qos);
	return -EINVAL;
}

int fake_device_status_shadow_encode__succeeds(
	const struct nrf_cloud_device_status * const dev_status,
	struct nrf_cloud_data * const output,
	const bool include_state, const bool include_reported)
{
	ARG_UNUSED(dev_status);
	ARG_UNUSED(output);
	ARG_UNUSED(include_state);
	ARG_UNUSED(include_reported);
	return 0;
}

int fake_device_status_shadow_encode__fails(
	const struct nrf_cloud_device_status * const dev_status,
	struct nrf_cloud_data * const output,
	const bool include_state, const bool include_reported)
{
	ARG_UNUSED(dev_status);
	ARG_UNUSED(output);
	ARG_UNUSED(include_state);
	ARG_UNUSED(include_reported);
	return -EINVAL;
}

int fake_nrf_cloud_sensor_data_encode__fails(
	const struct nrf_cloud_sensor_data *sensor,
	struct nrf_cloud_data *output)
{
	ARG_UNUSED(sensor);
	ARG_UNUSED(output);
	return -ENOMEM;
}

int fake_nrf_cloud_sensor_data_encode__succeeds(
	const struct nrf_cloud_sensor_data *sensor,
	struct nrf_cloud_data *output)
{
	ARG_UNUSED(sensor);
	output->ptr = NULL;
	return 0;
}

/* Declarations of functions and variables for nrf_cloud_run */
#define pollfd zsock_pollfd
#define POLLIN ZSOCK_POLLIN
#define POLLERR ZSOCK_POLLERR
#define POLLHUP ZSOCK_POLLHUP
#define POLLNVAL ZSOCK_POLLNVAL

int fake_poll__zero(struct zsock_pollfd *fds, int nfds, int timeout)
{
	ARG_UNUSED(fds);
	ARG_UNUSED(nfds);
	k_sleep(K_MSEC(timeout));
	return 0;
}

int fake_poll__negative(struct zsock_pollfd *fds, int nfds, int timeout)
{
	ARG_UNUSED(fds);
	ARG_UNUSED(nfds);
	k_sleep(K_MSEC(timeout));
	return -1;
}

int fake_poll__pollin(struct zsock_pollfd *fds, int nfds, int timeout)
{
	k_sleep(K_MSEC(timeout));
	fds[0].revents = POLLIN;
	return nfds;
}

int fake_poll__pollnval(struct zsock_pollfd *fds, int nfds, int timeout)
{
	k_sleep(K_MSEC(timeout));
	fds[0].revents = POLLNVAL;
	return nfds;
}

int fake_poll__pollhup(struct zsock_pollfd *fds, int nfds, int timeout)
{
	k_sleep(K_MSEC(timeout));
	fds[0].revents = POLLHUP;
	return nfds;
}

int fake_poll__pollerr(struct zsock_pollfd *fds, int nfds, int timeout)
{
	k_sleep(K_MSEC(timeout));
	fds[0].revents = POLLERR;
	return nfds;
}

int fake_nrf_cloud_obj_cloud_encode__fails(struct nrf_cloud_obj *const obj)
{
	ARG_UNUSED(obj);
	return -ENOMEM;
}

int fake_nrf_cloud_print_details__succeeds(void)
{
	return 0;
}
```
