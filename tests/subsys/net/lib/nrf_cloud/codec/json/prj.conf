## CMakeLists.txt
```
#
# Copyright (c) 2026 Nordic Semiconductor
#
# SPDX-License-Identifier: LicenseRef-Nordic-5-Clause
#

cmake_minimum_required(VERSION 3.20.0)

find_package(Zephyr REQUIRED HINTS $ENV{ZEPHYR_BASE})
project(nrf_cloud_codec_json_test)

# Test sources: the codec under test plus fakes for its internal helpers
target_sources(app PRIVATE
  src/main.c
  src/fakes.c
  ${ZEPHYR_NRF_MODULE_DIR}/subsys/net/lib/nrf_cloud/common/src/nrf_cloud_codec.c
)

target_include_directories(app PRIVATE
  src
  ${ZEPHYR_NRF_MODULE_DIR}/subsys/net/lib/nrf_cloud/common/include
  ${ZEPHYR_NRF_MODULE_DIR}/subsys/net/lib/nrf_cloud/common/src
  ${ZEPHYR_NRF_MODULE_DIR}/subsys/net/lib/nrf_cloud/mqtt/include
  ${ZEPHYR_NRF_MODULE_DIR}/subsys/net/lib/nrf_cloud/mqtt/src
  ${ZEPHYR_BASE}/subsys/testsuite/include
  ${ZEPHYR_CJSON_MODULE_DIR}
)

# Prevent the library versions of these files from being compiled.
# nrf_cloud_codec.c is added above as an explicit source; it depends
# only on the three helper functions and the memory wrappers provided
# in src/fakes.c. nrf_cloud_codec_internal.c and nrf_cloud_mem.c
# bring in heavy transitive dependencies (modem, FOTA, BT) that are
# not needed for these JSON codec unit tests.
#
# NOTE: CBOR codec tests are not yet implemented. They will live in
#       codec/cbor/ and require CONFIG_NRF_CLOUD_COAP=y plus their
#       own prj.conf and CMakeLists.txt.
set_source_files_properties(
  ${ZEPHYR_NRF_MODULE_DIR}/subsys/net/lib/nrf_cloud/common/src/nrf_cloud_codec_internal.c
  ${ZEPHYR_NRF_MODULE_DIR}/subsys/net/lib/nrf_cloud/common/src/nrf_cloud_mem.c
  PROPERTIES HEADER_FILE_ONLY ON
)
```

## Kconfig
```
#
# Copyright (c) 2026 Nordic Semiconductor ASA
#
# SPDX-License-Identifier: LicenseRef-Nordic-5-Clause
#

# NRF_CLOUD_LOG_LEVEL is normally generated by the Kconfig log_config template
# and depends on LOG being enabled. In this minimal test config LOG is not
# enabled, so the symbol is invisible.
config NRF_CLOUD_LOG_LEVEL
	default 4

source "Kconfig.zephyr"
```

## prj.conf
```kconfig
#
# Copyright (c) 2026 Nordic Semiconductor
#
# SPDX-License-Identifier: LicenseRef-Nordic-5-Clause
#

# ZTEST with new API
CONFIG_ZTEST=y

# Network (required by nrf_cloud headers)
CONFIG_NETWORKING=y

# Disable sockets (not needed for codec unit tests)
CONFIG_NET_SOCKETS=n

# cJSON library (required by nrf_cloud_codec.c)
CONFIG_CJSON_LIB=y

# C library with float printf support (required by cJSON)
# Ineffective here: unsatisfied dependency NEWLIB_LIBC_SUPPORTED, so NEWLIB_LIBC stays n and the
# default C library is used.
# CONFIG_NEWLIB_LIBC=y
# Ineffective here: unsatisfied dependency NEWLIB_LIBC, so NEWLIB_LIBC_FLOAT_PRINTF stays n.
# CONFIG_NEWLIB_LIBC_FLOAT_PRINTF=y
```

## src/fakes.c
```c
/*
 * Copyright (c) 2026 Nordic Semiconductor ASA
 *
 * SPDX-License-Identifier: LicenseRef-Nordic-5-Clause
 */

/*
 * Minimal fakes required to link nrf_cloud_codec.c in the test environment.
 *
 * nrf_cloud_codec.c calls three helper functions declared in
 * nrf_cloud_codec_internal.h and implemented in nrf_cloud_codec_internal.c.
 * Including the full nrf_cloud_codec_internal.c would pull in modem, FOTA,
 * Bluetooth, and other subsystems that are not needed for pure JSON codec
 * tests.  The three helpers are simple cJSON wrappers, so we reproduce them
 * here using the same logic as the originals.
 *
 * nrf_cloud_codec.c also references the nrf_cloud_calloc / nrf_cloud_free /
 * nrf_cloud_malloc memory wrappers from nrf_cloud_mem.c; those are provided
 * here as thin wrappers around the standard C library allocator (the Zephyr
 * kernel heap is not available in this minimal test configuration).
 */

#include <stdbool.h>
#include <stdlib.h>
#include <cJSON.h>
#include <errno.h>
#include <nrf_cloud_codec_internal.h>
#include <nrf_cloud_mem.h>

/*
 * cJSON helper fakes (mirrors of nrf_cloud_codec_internal.c).
 *
 * The real implementations live in nrf_cloud_codec_internal.c, which cannot
 * be compiled here because it pulls in modem_info, alerts, logging, and other
 * subsystems unavailable in this minimal test config.
 *
 * Signature correctness is enforced at compile time via the
 * nrf_cloud_codec_internal.h include above.  Behavioral divergence (e.g. a
 * changed error code) would not be caught here; if the real implementations
 * change materially, these fakes must be updated to match.
 */

int get_string_from_obj(const cJSON *const obj, const char *const key, char **string_out)
{
	if (!obj) {
		return -ENOENT;
	}

	cJSON *item = cJSON_GetObjectItem(obj, key);

	if (!cJSON_IsString(item)) {
		return item ? -ENOMSG : -ENODEV;
	}

	*string_out = item->valuestring;
	return 0;
}

int get_num_from_obj(const cJSON *const obj, const char *const key, double *num_out)
{
	if (!obj) {
		return -ENOENT;
	}

	cJSON *item = cJSON_GetObjectItem(obj, key);

	if (!cJSON_IsNumber(item)) {
		return item ? -ENOMSG : -ENODEV;
	}

	*num_out = item->valuedouble;
	return 0;
}

int get_bool_from_obj(const cJSON *const obj, const char *const key, bool *bool_out)
{
	if (!obj) {
		return -ENOENT;
	}

	cJSON *item = cJSON_GetObjectItem(obj, key);

	if (!cJSON_IsBool(item)) {
		return item ? -ENOMSG : -ENODEV;
	}

	*bool_out = (bool)cJSON_IsTrue(item);
	return 0;
}

/* Memory wrapper fakes (mirrors of nrf_cloud_mem.c) */

void *nrf_cloud_calloc(size_t count, size_t size)
{
	return calloc(count, size);
}

void *nrf_cloud_malloc(size_t size)
{
	return malloc(size);
}

void nrf_cloud_free(void *ptr)
{
	free(ptr);
}
```
