## CMakeLists.txt
```
#
# Copyright (c) 2026 Nordic Semiconductor
#
# SPDX-License-Identifier: LicenseRef-Nordic-5-Clause
#

cmake_minimum_required(VERSION 3.20.0)

find_package(Zephyr REQUIRED HINTS $ENV{ZEPHYR_BASE})
project(nrf_cloud_codec_shadow_test)

target_sources(app PRIVATE
  src/main.c
  ${ZEPHYR_NRF_MODULE_DIR}/subsys/net/lib/nrf_cloud/common/src/nrf_cloud_codec.c
  ${ZEPHYR_NRF_MODULE_DIR}/subsys/net/lib/nrf_cloud/common/src/nrf_cloud_codec_internal.c
  ${ZEPHYR_NRF_MODULE_DIR}/subsys/net/lib/nrf_cloud/common/src/nrf_cloud_mem.c
)

target_include_directories(app PRIVATE
  ${ZEPHYR_NRF_MODULE_DIR}/subsys/net/lib/nrf_cloud/common/include
  ${ZEPHYR_NRF_MODULE_DIR}/subsys/net/lib/nrf_cloud/mqtt/include
  ${ZEPHYR_CJSON_MODULE_DIR}
)
```

## prj.conf
```kconfig
#
# Copyright (c) 2026 Nordic Semiconductor
#
# SPDX-License-Identifier: LicenseRef-Nordic-5-Clause
#

# ZTEST with new API
CONFIG_ZTEST=y

# Network (required by nrf_cloud headers)
CONFIG_NETWORKING=y

# Disable sockets (not needed for codec unit tests)
CONFIG_NET_SOCKETS=n

# cJSON library (required by nrf_cloud_codec.c)
CONFIG_CJSON_LIB=y

# C library with float printf support (required by cJSON)
CONFIG_NEWLIB_LIBC=y
CONFIG_NEWLIB_LIBC_FLOAT_PRINTF=y

# k_malloc, used by the nrf_cloud and cJSON default allocators
CONFIG_HEAP_MEM_POOL_SIZE=4096
```

## boards/qemu_cortex_m3.conf
```kconfig
#
# Copyright (c) 2026 Nordic Semiconductor
#
# SPDX-License-Identifier: LicenseRef-Nordic-5-Clause
#

# qemu_cortex_m3 does not support the networking stack
CONFIG_NETWORKING=n

# Required for the test to run in qemu_cortex_m3
# See https://github.com/zephyrproject-rtos/zephyr/issues/15565
CONFIG_ENTROPY_GENERATOR=y
CONFIG_TEST_RANDOM_GENERATOR=y
```

## src/main.c
```c
/*
 * Copyright (c) 2026 Nordic Semiconductor ASA
 *
 * SPDX-License-Identifier: LicenseRef-Nordic-5-Clause
 */

/* Ownership tests for the shadow delta/transform decoders: after the caller
 * frees the input object and the decoded data, nothing may remain allocated.
 */

#include <zephyr/ztest.h>
#include <net/nrf_cloud_codec.h>
#include <net/nrf_cloud_defs.h>
#include <nrf_cloud_codec_internal.h>
#include <stdlib.h>
#include <string.h>

static int live_allocs;

static void *counting_malloc(size_t size)
{
	void *p = malloc(size);

	if (p) {
		live_allocs++;
	}
	return p;
}

static void counting_free(void *p)
{
	if (p) {
		live_allocs--;
	}
	free(p);
}

static void *setup(void)
{
	struct nrf_cloud_os_mem_hooks hooks = {
		.malloc_fn = counting_malloc,
		.free_fn = counting_free,
	};

	zassert_ok(nrf_cloud_codec_init(&hooks));
	return NULL;
}

static void before(void *f)
{
	ARG_UNUSED(f);
	live_allocs = 0;
}

static void decode_input(struct nrf_cloud_obj *obj, const char *json)
{
	const struct nrf_cloud_data in = { .ptr = json, .len = strlen(json) };

	zassert_ok(nrf_cloud_obj_input_decode(obj, &in));
	zassert_true(live_allocs > 0);
}

ZTEST_SUITE(nrf_cloud_shadow_decode, NULL, setup, before, NULL, NULL);

ZTEST(nrf_cloud_shadow_decode, test_transform_result_no_leak)
{
	NRF_CLOUD_OBJ_JSON_DEFINE(shadow_obj);
	struct nrf_cloud_obj_shadow_transform tf;

	decode_input(&shadow_obj, "{\"tf\":{\"pairing\":{\"state\":\"paired\"}}}");

	zassert_ok(nrf_cloud_obj_shadow_transform_decode(&shadow_obj, &tf));
	zassert_false(tf.is_err);
	zassert_not_null(tf.result.obj.json);

	nrf_cloud_obj_free(&shadow_obj);
	nrf_cloud_obj_shadow_transform_free(&tf);
	zassert_equal(live_allocs, 0, "%d allocation(s) leaked", live_allocs);
}

ZTEST(nrf_cloud_shadow_decode, test_transform_error_no_leak)
{
	NRF_CLOUD_OBJ_JSON_DEFINE(shadow_obj);
	struct nrf_cloud_obj_shadow_transform tf;

	decode_input(&shadow_obj, "{\"err\":40000,\"position\":3,\"message\":\"bad expr\"}");

	zassert_ok(nrf_cloud_obj_shadow_transform_decode(&shadow_obj, &tf));
	zassert_true(tf.is_err);
	zassert_equal(tf.error.code, 40000);
	zassert_equal(tf.error.pos, 3);

	/* Error data must outlive the input object; the MQTT FSM frees it before
	 * notifying the application.
	 */
	nrf_cloud_obj_free(&shadow_obj);
	zassert_true(live_allocs > 0);
	zassert_str_equal(tf.error.msg, "bad expr");

	nrf_cloud_obj_shadow_transform_free(&tf);
	zassert_equal(live_allocs, 0, "%d allocation(s) leaked", live_allocs);
}

ZTEST(nrf_cloud_shadow_decode, test_delta_state_no_leak)
{
	NRF_CLOUD_OBJ_JSON_DEFINE(shadow_obj);
	struct nrf_cloud_obj_shadow_delta delta;

	decode_input(&shadow_obj,
		     "{\"version\":7,\"timestamp\":1000,\"state\":{\"config\":{\"x\":1}}}");

	zassert_ok(nrf_cloud_obj_shadow_delta_decode(&shadow_obj, &delta));
	zassert_false(delta.is_err);
	zassert_equal(delta.ver, 7);
	zassert_not_null(delta.state.json);

	nrf_cloud_obj_free(&shadow_obj);
	nrf_cloud_obj_shadow_delta_free(&delta);
	zassert_equal(live_allocs, 0, "%d allocation(s) leaked", live_allocs);
}

ZTEST(nrf_cloud_shadow_decode, test_delta_error_no_leak)
{
	NRF_CLOUD_OBJ_JSON_DEFINE(shadow_obj);
	struct nrf_cloud_obj_shadow_delta delta;

	decode_input(&shadow_obj,
		     "{\"version\":7,\"timestamp\":1000,\"err\":40100,\"message\":\"conflict\"}");

	zassert_ok(nrf_cloud_obj_shadow_delta_decode(&shadow_obj, &delta));
	zassert_true(delta.is_err);
	zassert_equal(delta.error.code, 40100);

	nrf_cloud_obj_free(&shadow_obj);
	zassert_true(live_allocs > 0);
	zassert_str_equal(delta.error.msg, "conflict");

	nrf_cloud_obj_shadow_delta_free(&delta);
	zassert_equal(live_allocs, 0, "%d allocation(s) leaked", live_allocs);
}
```
