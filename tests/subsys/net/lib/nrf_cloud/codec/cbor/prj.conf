## CMakeLists.txt
```
#
# Copyright (c) 2026 Nordic Semiconductor
#
# SPDX-License-Identifier: LicenseRef-Nordic-5-Clause
#

cmake_minimum_required(VERSION 3.20.0)

find_package(Zephyr REQUIRED HINTS $ENV{ZEPHYR_BASE})
project(nrf_cloud_codec_cbor_test)

set(nrfxlib_modem_dir ${ZEPHYR_NRFXLIB_MODULE_DIR}/nrf_modem)
zephyr_include_directories(${nrfxlib_modem_dir}/include)

# Test sources: the CoAP CBOR codec under test, its generated zcbor
# encoder/decoder files, and stubs for the internal helpers it calls.
target_sources(app PRIVATE
  src/main.c
  src/fakes.c
  ${ZEPHYR_NRF_MODULE_DIR}/subsys/net/lib/nrf_cloud/coap/src/nrf_cloud_coap_codec.c
  ${ZEPHYR_NRF_MODULE_DIR}/subsys/net/lib/nrf_cloud/coap/generated/src/msg_encode.c
  ${ZEPHYR_NRF_MODULE_DIR}/subsys/net/lib/nrf_cloud/coap/generated/src/agnss_encode.c
  ${ZEPHYR_NRF_MODULE_DIR}/subsys/net/lib/nrf_cloud/coap/generated/src/pgnss_encode.c
  ${ZEPHYR_NRF_MODULE_DIR}/subsys/net/lib/nrf_cloud/coap/generated/src/pgnss_decode.c
  ${ZEPHYR_NRF_MODULE_DIR}/subsys/net/lib/nrf_cloud/coap/generated/src/ground_fix_encode.c
  ${ZEPHYR_NRF_MODULE_DIR}/subsys/net/lib/nrf_cloud/coap/generated/src/ground_fix_decode.c
)

target_include_directories(app PRIVATE
  src
  ${ZEPHYR_NRF_MODULE_DIR}/subsys/net/lib/nrf_cloud/common/include
  ${ZEPHYR_NRF_MODULE_DIR}/subsys/net/lib/nrf_cloud/common/src
  ${ZEPHYR_NRF_MODULE_DIR}/subsys/net/lib/nrf_cloud/coap/include
  ${ZEPHYR_NRF_MODULE_DIR}/subsys/net/lib/nrf_cloud/coap/generated/include
  ${ZEPHYR_NRF_MODULE_DIR}/subsys/net/lib/nrf_cloud/mqtt/include
  ${ZEPHYR_BASE}/subsys/testsuite/include
  ${ZEPHYR_CJSON_MODULE_DIR}
)

# Enabling NRF_CLOUD_AGNSS / NRF_CLOUD_PGNSS in Kconfig causes the nRF
# Cloud library CMakeLists to be added and a number of helper sources
# to be compiled.  Those sources reference Kconfig symbols that are
# only generated when the full NRF_CLOUD subsystem is enabled, which
# is incompatible with native_sim / qemu_cortex_m3 builds.
#
# Exclude them via HEADER_FILE_ONLY.  The CBOR codec functions under
# test are supplied directly via target_sources above, and fakes.c
# provides the few internal helpers they reach into.
set_source_files_properties(
  ${ZEPHYR_NRF_MODULE_DIR}/subsys/net/lib/nrf_cloud/common/src/nrf_cloud_codec_internal.c
  ${ZEPHYR_NRF_MODULE_DIR}/subsys/net/lib/nrf_cloud/common/src/nrf_cloud_log.c
  ${ZEPHYR_NRF_MODULE_DIR}/subsys/net/lib/nrf_cloud/common/src/nrf_cloud_codec.c
  ${ZEPHYR_NRF_MODULE_DIR}/subsys/net/lib/nrf_cloud/common/src/nrf_cloud_mem.c
  ${ZEPHYR_NRF_MODULE_DIR}/subsys/net/lib/nrf_cloud/common/src/nrf_cloud_client_id.c
  ${ZEPHYR_NRF_MODULE_DIR}/subsys/net/lib/nrf_cloud/common/src/nrf_cloud_sec_tag.c
  ${ZEPHYR_NRF_MODULE_DIR}/subsys/net/lib/nrf_cloud/common/src/nrf_cloud_info.c
  ${ZEPHYR_NRF_MODULE_DIR}/subsys/net/lib/nrf_cloud/common/src/nrf_cloud_agnss.c
  ${ZEPHYR_NRF_MODULE_DIR}/subsys/net/lib/nrf_cloud/common/src/nrf_cloud_agnss_utils.c
  ${ZEPHYR_NRF_MODULE_DIR}/subsys/net/lib/nrf_cloud/common/src/nrf_cloud_pgnss.c
  ${ZEPHYR_NRF_MODULE_DIR}/subsys/net/lib/nrf_cloud/common/src/nrf_cloud_pgnss_utils.c
  DIRECTORY ${ZEPHYR_NRF_MODULE_DIR}/subsys/net/lib/nrf_cloud/
  PROPERTIES HEADER_FILE_ONLY ON
)
```

## Kconfig
```
#
# Copyright (c) 2026 Nordic Semiconductor ASA
#
# SPDX-License-Identifier: LicenseRef-Nordic-5-Clause
#

# NRF_CLOUD_LOG_LEVEL and NRF_CLOUD_COAP_LOG_LEVEL are generated by
# Kconfig.template.log_config inside "if NRF_CLOUD" / "if NRF_CLOUD_COAP"
# blocks, so they do not exist in the Kconfig tree on native_sim.
# Defining them here makes them available without conflict.

config NRF_CLOUD_LOG_LEVEL
	default 0

config NRF_CLOUD_COAP_LOG_LEVEL
	default 0

# Enable AGNSS and PGNSS so the corresponding code paths in
# nrf_cloud_coap_codec.c (guarded by these CONFIG_* symbols) are
# compiled into the test binary.  The actual library .c files that
# would be pulled in by these symbols are excluded from the build via
# HEADER_FILE_ONLY in CMakeLists.txt; the codec sources are added
# explicitly there.
config NRF_CLOUD_AGNSS
	default y

config NRF_CLOUD_PGNSS
	default y

source "Kconfig.zephyr"
```

## prj.conf
```kconfig
#
# Copyright (c) 2026 Nordic Semiconductor
#
# SPDX-License-Identifier: LicenseRef-Nordic-5-Clause
#

# ZTEST with new API
CONFIG_ZTEST=y

# Network (required by nrf_cloud headers)
CONFIG_NETWORKING=y

# Disable sockets (not needed for codec unit tests)
CONFIG_NET_SOCKETS=n

# cJSON library (required for linking; JSON encode path not tested here)
CONFIG_CJSON_LIB=y

# zcbor CBOR library (required by generated encoder/decoder sources)
CONFIG_ZCBOR=y

# C library with float printf support
# Ineffective here: unsatisfied dependency NEWLIB_LIBC_SUPPORTED, so NEWLIB_LIBC stays n and the
# default C library is used.
# CONFIG_NEWLIB_LIBC=y
# Ineffective here: unsatisfied dependency NEWLIB_LIBC, so NEWLIB_LIBC_FLOAT_PRINTF stays n.
# CONFIG_NEWLIB_LIBC_FLOAT_PRINTF=y
```

## boards/native_sim.conf
```kconfig
#
# Copyright (c) 2026 Nordic Semiconductor
#
# SPDX-License-Identifier: LicenseRef-Nordic-5-Clause
#

# native_sim links against the host C library, so the picolibc printf level
# does not apply here.
CONFIG_PICOLIBC_IO_FLOAT=n
```

## boards/qemu_cortex_m3.conf
```kconfig
#
# Copyright (c) 2026 Nordic Semiconductor
#
# SPDX-License-Identifier: LicenseRef-Nordic-5-Clause
#

# qemu_cortex_m3 does not support the networking stack
CONFIG_NETWORKING=n

# coap_codec_ground_fix_req_encode() allocates a ~2.4 kB struct ground_fix_req
# on the stack.  The default ZTEST_STACK_SIZE on ARM (1024 B) is too small and
# causes a stack overflow leading to a kernel panic.
CONFIG_ZTEST_STACK_SIZE=4096

# Required for the test to run in qemu_cortex_m3
# See https://github.com/zephyrproject-rtos/zephyr/issues/15565
CONFIG_ENTROPY_GENERATOR=y
CONFIG_TEST_RANDOM_GENERATOR=y
```

## src/fakes.c
```c
/*
 * Copyright (c) 2026 Nordic Semiconductor ASA
 *
 * SPDX-License-Identifier: LicenseRef-Nordic-5-Clause
 */

/*
 * Minimal fakes required to link nrf_cloud_coap_codec.c in the test
 * environment.
 *
 * nrf_cloud_coap_codec.c references several symbols from
 * nrf_cloud_codec_internal.c and nrf_cloud_mem.c.  Including those full
 * implementations would drag in the modem, FOTA, and REST
 * subsystems that are irrelevant for pure CBOR codec unit tests.
 *
 * Only three of those symbols are reachable in the CBOR path that is
 * exercised by these tests:
 *   - nrf_cloud_agnss_type_array_get  (called in coap_codec_agnss_encode)
 *   - nrf_cloud_calloc / nrf_cloud_free / nrf_cloud_malloc  (link-time deps)
 *
 * The remaining symbols (nrf_cloud_encode_message, nrf_cloud_error_msg_decode,
 * nrf_cloud_coap_fota_execution_decode) are only reachable via JSON paths that
 * the CBOR tests do not exercise; they are stubbed out with safe no-op or
 * error-returning implementations so that the linker is satisfied.
 *
 * NOTE: This file is intentionally a copy of (and closely mirrors) the fakes
 * in codec/json/src/fakes.c.  A future refactor can hoist the shared fakes
 * into a common location; that is deferred until the full codec test suite
 * shape is known.
 */

#include <stdbool.h>
#include <stdlib.h>
#include <errno.h>
#include <net/nrf_cloud.h>
#include <nrf_modem_gnss.h>
#include <nrf_cloud_codec_internal.h>
#include <nrf_cloud_mem.h>

/* -------------------------------------------------------------------------
 * Memory wrappers (mirrors of nrf_cloud_mem.c)
 * -------------------------------------------------------------------------
 */

void *nrf_cloud_calloc(size_t count, size_t size)
{
	return calloc(count, size);
}

void *nrf_cloud_malloc(size_t size)
{
	return malloc(size);
}

void nrf_cloud_free(void *ptr)
{
	free(ptr);
}

/* -------------------------------------------------------------------------
 * JSON-path stubs — never called from the CBOR test path.
 * Returning an error code prevents silent mis-routing if they are ever
 * reached unexpectedly.
 * -------------------------------------------------------------------------
 */

int nrf_cloud_encode_message(const char *app_id, double value, const char *str_val,
			     const char *topic, int64_t ts, struct nrf_cloud_data *output)
{
	ARG_UNUSED(app_id);
	ARG_UNUSED(value);
	ARG_UNUSED(str_val);
	ARG_UNUSED(topic);
	ARG_UNUSED(ts);
	ARG_UNUSED(output);
	return -ENOTSUP;
}

int nrf_cloud_error_msg_decode(const char *const buf, const char *const app_id,
			       const char *const msg_type, enum nrf_cloud_error *const err)
{
	ARG_UNUSED(buf);
	ARG_UNUSED(app_id);
	ARG_UNUSED(msg_type);
	ARG_UNUSED(err);
	/* Return non-zero: signals "no JSON error message found", which causes
	 * the callers (ground_fix / agnss / pgnss decode) to return -EPROTO.
	 */
	return -ENOENT;
}

int nrf_cloud_coap_fota_execution_decode(const char *const response,
					 struct nrf_cloud_fota_job_info *const job)
{
	ARG_UNUSED(response);
	ARG_UNUSED(job);
	return -ENOTSUP;
}

/* -------------------------------------------------------------------------
 * nrf_cloud_agnss_type_array_get — called in the CBOR path of
 * coap_codec_agnss_encode when type == NRF_CLOUD_COAP_AGNSS_REQ_CUSTOM.
 *
 * The real implementation parses an nrf_modem_gnss_agnss_data_frame bitmask
 * and fills in an array of nrf_cloud_agnss_type values.  For unit testing
 * purposes a fixed two-element response is sufficient; it keeps the test
 * hermetic and produces a deterministic, non-empty CBOR output.
 * -------------------------------------------------------------------------
 */

int nrf_cloud_agnss_type_array_get(const struct nrf_modem_gnss_agnss_data_frame *const request,
				   enum nrf_cloud_agnss_type *array, const size_t array_size)
{
	ARG_UNUSED(request);

	if (!array || array_size < 2) {
		return -EINVAL;
	}

	array[0] = NRF_CLOUD_AGNSS_GPS_UTC_PARAMETERS;
	array[1] = NRF_CLOUD_AGNSS_GPS_EPHEMERIDES;

	return 2;
}
```
