## CMakeLists.txt
```
#
# Copyright (c) 2026 Nordic Semiconductor ASA
#
# SPDX-License-Identifier: LicenseRef-Nordic-5-Clause
#
cmake_minimum_required(VERSION 3.20.0)

find_package(Zephyr REQUIRED HINTS $ENV{ZEPHYR_BASE})
project(dect_rpc_server_test)

file(GLOB app_sources src/*.c)

target_sources(app PRIVATE
  ${app_sources}
  ../common/status_codec_helpers.c
  ../common/mock_dect_rpc_transport.c
)

# CONFIG_DECT_MDM_DRIVER_MOCK: HAL lives in src/dect_mdm_mock.c (not under drivers/dect).
target_include_directories(app PRIVATE
  src
  ${ZEPHYR_NRF_MODULE_DIR}/subsys/net/dect/rpc/common
  ${ZEPHYR_NRF_MODULE_DIR}/subsys/net/dect/rpc/server
  ../common
)
```

## prj.conf
```kconfig
#
# Copyright (c) 2026 Nordic Semiconductor ASA
#
# SPDX-License-Identifier: LicenseRef-Nordic-5-Clause
#
# DECT NR+ RPC server unit test (native_sim): DECT_MDM arch + mock driver, real l2_dect,
# RPC server, mocked nRF RPC transport.

CONFIG_ZTEST=y
CONFIG_TEST=y
CONFIG_TEST_RANDOM_GENERATOR=y

CONFIG_DECT=y
CONFIG_DECT_MDM=y
CONFIG_DECT_MDM_DRIVER_MOCK=y
CONFIG_DECT_CLUSTER_MAX_CHILD_ASSOCIATION_COUNT=16

CONFIG_DECT_NR_RPC=y
CONFIG_DECT_NR_RPC_SERVER=y
CONFIG_DECT_NR_RPC_NET_IF=y
CONFIG_DECT_NR_RPC_SHELL=y
CONFIG_DECT_NR_RPC_MAX_IP_PKT=500
CONFIG_DECT_NR_RPC_SERVER_EVT_PACING_MS=0

CONFIG_GETOPT_LONG=y
CONFIG_NET_SOCKETS=y
CONFIG_ZVFS_POLL_MAX=10

CONFIG_SHELL=y
CONFIG_SHELL_BACKEND_SERIAL=y
# RPC init is via nrf_rpc_init() in tc_setup(); not the dect_rpc_init shell (sample uses main()).
CONFIG_DECT_NR_RPC_SERVER_SHELL_RPC_INIT=n

CONFIG_MOCK_NRF_RPC=y
CONFIG_MOCK_DECT_RPC_TRANSPORT=y

CONFIG_NRF_RPC_CBOR=y
CONFIG_NRF_RPC_ZCBOR_BACKUPS=1
CONFIG_NRF_RPC_CBKPROXY_OUT_SLOTS=0
CONFIG_NRF_RPC_RESPONSE_TIMEOUT=50

CONFIG_SETTINGS=y
CONFIG_SETTINGS_NVS=y
CONFIG_FLASH=y
CONFIG_FLASH_MAP=y
CONFIG_MPU_ALLOW_FLASH_WRITE=y
CONFIG_NVS=y

CONFIG_NETWORKING=y
CONFIG_NET_NATIVE=y
CONFIG_NET_IPV6=y
CONFIG_NET_IPV4=n
CONFIG_NET_MGMT=y
CONFIG_NET_MGMT_EVENT=y
CONFIG_NET_MGMT_EVENT_INFO=y
CONFIG_NET_MGMT_EVENT_INFO_DEFAULT_DATA_SIZE=224
CONFIG_NET_CONNECTION_MANAGER=y
CONFIG_NET_L2_DECT_CONN_MGR=y
# Deterministic tests: fixture activates explicitly; RPC connect drives join.
CONFIG_NET_L2_DECT_CONN_MGR_AUTO_CONNECT=n

CONFIG_NET_IF_MAX_IPV6_COUNT=4
CONFIG_NET_IF_UNICAST_IPV6_ADDR_COUNT=6
CONFIG_NET_IF_MCAST_IPV6_ADDR_COUNT=10
CONFIG_NET_IF_IPV6_PREFIX_COUNT=4
CONFIG_NET_IPV6_MAX_NEIGHBORS=12
CONFIG_NET_IPV6_FORWARDING=y
CONFIG_NET_IPV6_NBR_CACHE=y
CONFIG_NET_IPV6_MLD=y

CONFIG_NET_BUF=y
CONFIG_NET_BUF_DATA_SIZE=128
CONFIG_NET_PKT_RX_COUNT=24
CONFIG_NET_BUF_RX_COUNT=48
CONFIG_NET_PKT_TX_COUNT=24
CONFIG_NET_BUF_TX_COUNT=48
CONFIG_NET_TX_STACK_SIZE=4096
CONFIG_NET_RX_STACK_SIZE=4096
CONFIG_NET_MGMT_EVENT_STACK_SIZE=2048
CONFIG_NET_MGMT_EVENT_QUEUE_SIZE=24

CONFIG_KERNEL_MEM_POOL=y
CONFIG_HEAP_MEM_POOL_SIZE=32768
CONFIG_ENTROPY_GENERATOR=y
CONFIG_NEWLIB_LIBC=y

CONFIG_ASAN=y
CONFIG_NRF_RPC_THREAD_STACK_SIZE=4096
CONFIG_ZTEST_STACK_SIZE=2560
CONFIG_MAIN_STACK_SIZE=4096
CONFIG_SYSTEM_WORKQUEUE_STACK_SIZE=8192

CONFIG_ASSERT=y
CONFIG_RESET_ON_FATAL_ERROR=n
```

## shell_disabled.conf
```kconfig
# Optional overlay: server built without L2 shell over RPC (see shell_rpc_suite.c).
CONFIG_DECT_NR_RPC_SHELL=n
```

## src/connect_suite.c
```c
/*
 * Copyright (c) 2026 Nordic Semiconductor ASA
 *
 * SPDX-License-Identifier: LicenseRef-Nordic-5-Clause
 *
 * DECT_RPC_CMD_CONNECT / DISCONNECT decoders: conn_mgr on the server DECT iface.
 */

#include <mock_dect_rpc_transport.h>
#include <dect_rpc_ids.h>
#include <test_rpc_env.h>
#include "dect_mdm_mock_test_seam.h"
#include "server_dect_fixture.h"

#include <zephyr/kernel.h>
#include <zephyr/ztest.h>

static void nrf_rpc_err_handler(const struct nrf_rpc_err_report *report)
{
	zassert_ok(report->code);
}

static void *suite_setup(void)
{
	zassert_not_null(server_dect_fixture_ensure_booted(), "DECT stack did not boot");
	return NULL;
}

static void tc_setup(void *f)
{
	ARG_UNUSED(f);

	mock_dect_rpc_tr_expect_add(RPC_INIT_REQ, RPC_INIT_RSP);
	zassert_ok(nrf_rpc_init(nrf_rpc_err_handler));
	mock_dect_rpc_tr_expect_reset();
}

ZTEST(dect_rpc_server_connect, test_connect_conn_mgr)
{
	int join_before = dect_mdm_mock_network_join_call_count;

	mock_dect_rpc_tr_expect_add(RPC_RSP(CBOR_UINT_SMALL(0)), NO_RSP);
	mock_dect_rpc_tr_receive(RPC_CMD(DECT_RPC_CMD_CONNECT));
	mock_dect_rpc_tr_expect_done();

	zassert_equal(dect_mdm_mock_network_join_call_count, join_before + 1,
		      "conn_mgr connect must reach HAL network_join_req on PT");
}

ZTEST(dect_rpc_server_connect, test_disconnect_conn_mgr)
{
	int unjoin_before = dect_mdm_mock_network_unjoin_call_count;

	mock_dect_rpc_tr_expect_add(RPC_RSP(CBOR_UINT_SMALL(0)), NO_RSP);
	mock_dect_rpc_tr_receive(RPC_CMD(DECT_RPC_CMD_DISCONNECT));
	mock_dect_rpc_tr_expect_done();

	zassert_equal(dect_mdm_mock_network_unjoin_call_count, unjoin_before + 1,
		      "conn_mgr disconnect must reach HAL network_unjoin_req on PT");
}

ZTEST_SUITE(dect_rpc_server_connect, NULL, suite_setup, tc_setup, NULL, NULL);
```

## src/dect_mdm_mock.c
```c
/*
 * Copyright (c) 2026 Nordic Semiconductor ASA
 *
 * SPDX-License-Identifier: LicenseRef-Nordic-5-Clause
 *
 * Test-side DECT_MDM_DRIVER_MOCK HAL (linked only from DECT NR+ RPC server ztests).
 */

#include "dect_mdm_mock_test_seam.h"

#include <string.h>

#include <zephyr/device.h>
#include <zephyr/kernel.h>
#include <zephyr/logging/log.h>
#include <zephyr/net/net_if.h>
#include <zephyr/net/net_pkt.h>

#include <net/dect/dect_net_l2.h>
#include <net/dect/dect_net_l2_mgmt.h>
#include <net/dect/dect_utils.h>

#if defined(CONFIG_NET_CONNECTION_MANAGER)
#include <net/dect/dect_net_l2_conn_mgr.h>
#endif

LOG_MODULE_REGISTER(dect_mdm_mock, CONFIG_DECT_MDM_LOG_LEVEL);

struct dect_mdm_mock_ctx {
	struct net_if *iface;
	bool activated;
	struct dect_settings settings;
};

static struct dect_mdm_mock_ctx mock_ctx;
static bool mock_iface_initialized;
static bool mock_status_override;
static struct dect_status_info mock_status_override_info;

int dect_mdm_mock_send_call_count;
int dect_mdm_mock_network_join_call_count;
int dect_mdm_mock_network_unjoin_call_count;
uint32_t dect_mdm_mock_last_send_long_rd_id;
size_t dect_mdm_mock_last_send_len;
uint8_t dect_mdm_mock_last_send_data[1280];

static void mock_default_settings(struct dect_settings *s)
{
	memset(s, 0, sizeof(*s));
	s->device_type = DECT_DEVICE_TYPE_PT;
	s->identities.network_id = 0x87654321;
	s->identities.transmitter_long_rd_id = 0x11112222;
}

static void mock_iface_init(struct net_if *iface)
{
	static uint8_t link_addr[8] = { 0x02, 0, 0, 0, 0, 0, 0, 0x01 };
	int err;

	if (mock_iface_initialized) {
		return;
	}

	mock_ctx.iface = iface;
	mock_default_settings(&mock_ctx.settings);

	if (net_if_get_link_addr(iface)->len == 0) {
		if (net_if_flag_is_set(iface, NET_IF_RUNNING)) {
			(void)net_if_down(iface);
		}
		err = net_if_set_link_addr(iface, link_addr, sizeof(link_addr), NET_LINK_UNKNOWN);
		if (err != 0) {
			LOG_ERR("set_link_addr failed: %d", err);
			return;
		}
	}

	err = net_if_set_name(iface, CONFIG_DECT_MDM_DEVICE_NAME);
	if (err != 0) {
		LOG_ERR("set_name failed: %d", err);
		return;
	}

	dect_net_l2_init(iface, &mock_ctx.settings);
	net_if_dormant_on(iface);
	mock_iface_initialized = true;
}

void dect_mdm_mock_status_info_set(const struct dect_status_info *status)
{
	mock_status_override_info = *status;
	mock_status_override = true;
}

void dect_mdm_mock_status_info_clear(void)
{
	mock_status_override = false;
}

static int mock_status_info_get(const struct device *dev, struct dect_status_info *status_out)
{
	ARG_UNUSED(dev);

	if (mock_status_override) {
		*status_out = mock_status_override_info;
		return 0;
	}

	memset(status_out, 0, sizeof(*status_out));
	status_out->mdm_activated = mock_ctx.activated;
	strncpy(status_out->fw_version_str, DECT_MDM_MOCK_FW_VERSION,
		sizeof(status_out->fw_version_str) - 1);
	return 0;
}

static int mock_activate_req(const struct device *dev)
{
	struct net_if *iface = mock_ctx.iface;

	ARG_UNUSED(dev);

	if (mock_ctx.activated) {
		return 0;
	}

	mock_ctx.activated = true;
	net_if_carrier_on(iface);
	dect_mgmt_activate_done_evt(iface, DECT_STATUS_OK);
	return 0;
}

static int mock_settings_read(const struct device *dev, struct dect_settings *settings_out)
{
	ARG_UNUSED(dev);

	memcpy(settings_out, &mock_ctx.settings, sizeof(*settings_out));
	return 0;
}

static int mock_network_join_req(const struct device *dev)
{
	ARG_UNUSED(dev);

	dect_mdm_mock_network_join_call_count++;
	return 0;
}

static int mock_network_unjoin_req(const struct device *dev)
{
	ARG_UNUSED(dev);

	dect_mdm_mock_network_unjoin_call_count++;
	return 0;
}

static int mock_deactivate_req(const struct device *dev)
{
	struct net_if *iface = mock_ctx.iface;

	ARG_UNUSED(dev);

	if (!mock_ctx.activated) {
		return 0;
	}

	mock_ctx.activated = false;
	net_if_carrier_off(iface);
	dect_mgmt_deactivate_done_evt(iface, DECT_STATUS_OK);
	return 0;
}

static int mock_send(const struct device *dev, struct net_pkt *pkt)
{
	uint32_t target_long_rd_id;
	int data_len;

	ARG_UNUSED(dev);
	__ASSERT_NO_MSG(pkt != NULL);

	if (net_pkt_family(pkt) != AF_INET6) {
		return -EINVAL;
	}

	target_long_rd_id = dect_utils_lib_dst_long_rd_id_get_from_pkt_dst_addr(pkt);
	if (!target_long_rd_id) {
		return -EINVAL;
	}

	data_len = net_pkt_get_len(pkt);
	if (data_len > (int)sizeof(dect_mdm_mock_last_send_data)) {
		return -EMSGSIZE;
	}

	if (net_pkt_is_empty(pkt)) {
		return -EIO;
	}

	memcpy(dect_mdm_mock_last_send_data, net_pkt_ip_data(pkt), data_len);

	dect_mdm_mock_send_call_count++;
	dect_mdm_mock_last_send_long_rd_id = target_long_rd_id;
	dect_mdm_mock_last_send_len = (size_t)data_len;

	return 0;
}

static int mock_driver_init(const struct device *dev)
{
	ARG_UNUSED(dev);
	return 0;
}

static const struct dect_nr_hal_api dect_mdm_mock_api = {
	.iface_api.init = mock_iface_init,
	.status_info_get = mock_status_info_get,
	.settings_read = mock_settings_read,
	.activate_req = mock_activate_req,
	.deactivate_req = mock_deactivate_req,
	.network_join_req = mock_network_join_req,
	.network_unjoin_req = mock_network_unjoin_req,
	.send = mock_send,
};

NET_DEVICE_INIT(dect_mdm_mock, CONFIG_DECT_MDM_DEVICE_NAME, mock_driver_init, NULL, &mock_ctx,
		NULL, CONFIG_KERNEL_INIT_PRIORITY_DEVICE, &dect_mdm_mock_api,
		DECT_L2, NET_L2_GET_CTX_TYPE(DECT_L2), DECT_MTU);

#if defined(CONFIG_NET_CONNECTION_MANAGER)
CONNECTIVITY_DECT_MGMT_BIND(dect_mdm_mock);
#endif
```

## src/dect_mdm_mock_test_seam.h
```c
/*
 * Copyright (c) 2026 Nordic Semiconductor ASA
 *
 * SPDX-License-Identifier: LicenseRef-Nordic-5-Clause
 */

#ifndef DECT_MDM_MOCK_TEST_SEAM_H_
#define DECT_MDM_MOCK_TEST_SEAM_H_

#include <net/dect/dect_net_l2.h>
#include <stdbool.h>
#include <stddef.h>
#include <stdint.h>

#define DECT_MDM_MOCK_FW_VERSION "Not available"

extern int dect_mdm_mock_send_call_count;
extern int dect_mdm_mock_network_join_call_count;
extern int dect_mdm_mock_network_unjoin_call_count;
extern uint32_t dect_mdm_mock_last_send_long_rd_id;
extern size_t dect_mdm_mock_last_send_len;
extern uint8_t dect_mdm_mock_last_send_data[1280];

/** Replace net_mgmt status until dect_mdm_mock_status_info_clear(). */
void dect_mdm_mock_status_info_set(const struct dect_status_info *status);

/** Restore default mock status (activated + DECT_MDM_MOCK_FW_VERSION). */
void dect_mdm_mock_status_info_clear(void);

#endif /* DECT_MDM_MOCK_TEST_SEAM_H_ */
```

## src/forward_recv_suite.c
```c
/*
 * Copyright (c) 2026 Nordic Semiconductor ASA
 *
 * SPDX-License-Identifier: LicenseRef-Nordic-5-Clause
 *
 * Exercises dect_rpc_server_forward_recv() -> evt msg queue (401-403) and
 * dect_rpc_evt_work_fn() IF_RECEIVE CBOR (175-189), including L2 recv when the
 * RPC client session is active (dect_net_l2.c -> dect_rpc_server_forward_recv).
 */

#include "dect_rpc_common.h"
#include <mock_dect_rpc_transport.h>
#include <dect_rpc_ids.h>
#include <test_rpc_env.h>
#include "server_dect_fixture.h"

#include <net/dect/dect_net_l2_rpc.h>
#include <string.h>

#include <zephyr/kernel.h>
#include <zephyr/net/net_if.h>
#include <zephyr/net/net_l2.h>
#include <zephyr/net/net_pkt.h>
#include <zephyr/ztest.h>

void dect_rpc_server_forward_recv(struct net_if *iface, struct net_pkt *pkt);
void dect_rpc_server_notify_addrs_changed(void);

static struct net_if *dect_iface;

static void nrf_rpc_err_handler(const struct nrf_rpc_err_report *report)
{
	zassert_ok(report->code);
}

static void *suite_setup(void)
{
	dect_iface = server_dect_fixture_ensure_booted();
	zassert_not_null(dect_iface, "DECT stack did not boot");
	return NULL;
}

static void tc_setup(void *f)
{
	ARG_UNUSED(f);

	mock_dect_rpc_tr_expect_add(RPC_INIT_REQ, RPC_INIT_RSP);
	zassert_ok(nrf_rpc_init(nrf_rpc_err_handler));
	mock_dect_rpc_tr_expect_reset();
}

/*
 * net_pkt_write() advances the read cursor; L2-delivered packets start at offset 0.
 * forward_recv() uses net_pkt_read() without rewinding.
 */
static struct net_pkt *pkt_with_payload(const uint8_t *data, size_t len)
{
	struct net_pkt *pkt;

	pkt = net_pkt_alloc_with_buffer(dect_iface, len, AF_INET6, 0, K_NO_WAIT);
	zassert_not_null(pkt, "net_pkt alloc failed");
	zassert_ok(net_pkt_write(pkt, data, len));
	net_pkt_cursor_init(pkt);
	return pkt;
}

static mock_dect_rpc_pkt_t if_receive_evt_bstr(const uint8_t *bstr, size_t len)
{
	static uint8_t wire[128];
	size_t off = 0;

	wire[off++] = 0x00;
	wire[off++] = DECT_RPC_CMD_IF_RECEIVE;
	wire[off++] = 0xff;
	wire[off++] = 0x00;
	wire[off++] = 0x00;

	if (len <= 23U) {
		wire[off++] = (uint8_t)(0x40U | len);
	} else {
		wire[off++] = 0x58;
		wire[off++] = (uint8_t)len;
	}
	memcpy(wire + off, bstr, len);
	off += len;
	wire[off++] = CBOR_NULL;

	return (mock_dect_rpc_pkt_t){ .data = wire, .len = off };
}

static void wait_for_mock_send_count(size_t expected)
{
	for (int i = 0; i < 30 && mock_dect_rpc_tr_sent_count() < expected; i++) {
		k_msleep(10);
	}
	zassert_equal(mock_dect_rpc_tr_sent_count(), expected, "mock send count");
}

ZTEST(dect_rpc_server_forward_recv, test_forward_recv_sends_if_receive_evt)
{
	static const uint8_t mini_pkt[8] = { 0x60, 0, 0, 0, 0, 0, 0, 0x3b };
	struct net_pkt *pkt;

	zassert_true(NRF_RPC_GROUP_STATUS(dect_rpc_group),
		     "RPC group must be bound (see tc_setup nrf_rpc_init)");

	mock_dect_rpc_tr_expect_add(
		RPC_EVT(DECT_RPC_CMD_IF_RECEIVE, CBOR_BSTR(8, mini_pkt[0], mini_pkt[1], mini_pkt[2],
							  mini_pkt[3], mini_pkt[4], mini_pkt[5],
							  mini_pkt[6], mini_pkt[7])),
		NO_RSP);

	pkt = pkt_with_payload(mini_pkt, sizeof(mini_pkt));
	dect_rpc_server_forward_recv(dect_iface, pkt);
	net_pkt_unref(pkt);

	k_msleep(100);
	zassert_equal(mock_dect_rpc_tr_sent_count(), 1U, "expected one IF_RECEIVE event on wire");
	mock_dect_rpc_tr_expect_reset();
}

ZTEST(dect_rpc_server_forward_recv, test_forward_recv_longer_payload_bstr_on_wire)
{
	static const uint8_t payload[24] = {
		0x60, 0, 0, 0, 0, 0, 0, 0x3b, 0x11, 0x22, 0x33, 0x44,
		0x55, 0x66, 0x77, 0x88, 0x99, 0xaa, 0xbb, 0xcc, 0xdd, 0xee, 0xff, 0x01,
	};
	struct net_pkt *pkt;

	zassert_true(NRF_RPC_GROUP_STATUS(dect_rpc_group), "RPC group bound");

	mock_dect_rpc_tr_expect_add(
		RPC_EVT(DECT_RPC_CMD_IF_RECEIVE,
			CBOR_BSTR8(24, payload[0], payload[1], payload[2], payload[3], payload[4],
				   payload[5], payload[6], payload[7], payload[8], payload[9],
				   payload[10], payload[11], payload[12], payload[13], payload[14],
				   payload[15], payload[16], payload[17], payload[18], payload[19],
				   payload[20], payload[21], payload[22], payload[23])),
		NO_RSP);

	pkt = pkt_with_payload(payload, sizeof(payload));
	dect_rpc_server_forward_recv(dect_iface, pkt);
	net_pkt_unref(pkt);

	k_msleep(100);
	zassert_equal(mock_dect_rpc_tr_sent_count(), 1U, "expected IF_RECEIVE with 24-byte bstr");
	mock_dect_rpc_tr_expect_reset();
}

ZTEST(dect_rpc_server_forward_recv, test_addrs_changed_survives_full_event_queue)
{
	static const uint8_t mini_pkt[8] = { 0x60, 0, 0, 0, 0, 0, 0, 0x3b };
	static const uint8_t expected_if_receive[] = {
		0x00, DECT_RPC_CMD_IF_RECEIVE, 0xff, 0x00, 0x00,
		CBOR_BSTR(8, 0x60, 0, 0, 0, 0, 0, 0, 0x3b), CBOR_NULL,
	};
	static const uint8_t expected_if_addrs_changed[] = {
		0x00, DECT_RPC_CMD_IF_ADDRS_CHANGED, 0xff, 0x00, 0x00, CBOR_UINT_SMALL(0),
		CBOR_NULL,
	};
	const mock_dect_rpc_pkt_t receive_expect = {
		.data = expected_if_receive,
		.len = sizeof(expected_if_receive),
	};
	const mock_dect_rpc_pkt_t addrs_changed_expect = {
		.data = expected_if_addrs_changed,
		.len = sizeof(expected_if_addrs_changed),
	};
	const size_t queue_len = CONFIG_DECT_NR_RPC_SERVER_EVT_QUEUE_LEN;
	struct net_pkt *pkt;

	zassert_true(NRF_RPC_GROUP_STATUS(dect_rpc_group), "RPC group must be bound");
	mock_dect_rpc_tr_expect_add(receive_expect, NO_RSP);
	mock_dect_rpc_tr_expect_add(addrs_changed_expect, NO_RSP);
	for (size_t i = 1; i < queue_len; i++) {
		mock_dect_rpc_tr_expect_add(receive_expect, NO_RSP);
	}

	/* Keep the worker from draining the bounded queue until it is full. */
	k_sched_lock();
	for (size_t i = 0; i < queue_len; i++) {
		pkt = pkt_with_payload(mini_pkt, sizeof(mini_pkt));
		dect_rpc_server_forward_recv(dect_iface, pkt);
		net_pkt_unref(pkt);
	}
	dect_rpc_server_notify_addrs_changed();
	k_sched_unlock();

	wait_for_mock_send_count(queue_len + 1);
	mock_dect_rpc_tr_expect_reset();
}

ZTEST(dect_rpc_server_forward_recv, test_l2_net_recv_forwards_to_rpc_client)
{
	static const uint8_t l2_ipv6_frame[40] = {
		0x60, 0x00, 0x00, 0x00, 0x00, 0x00, 0x00, 0x00, 0x00, 0x00, 0x00, 0x00,
		0x00, 0x00, 0x00, 0x00, 0x00, 0x00, 0x00, 0x00, 0x00, 0x00, 0x00, 0x00,
		0x00, 0x00, 0x00, 0x00, 0x00, 0x00, 0x00, 0x00, 0x00, 0x00, 0x00, 0x00,
		0x00, 0x00, 0x00, 0x00,
	};
	const struct net_l2 *l2 = net_if_l2(dect_iface);
	struct net_pkt *pkt;
	enum net_verdict verdict;

	zassert_true(NRF_RPC_GROUP_STATUS(dect_rpc_group), "RPC group bound");
	zassert_not_null(l2);
	zassert_not_null(l2->recv, "DECT L2 recv handler missing");

	dect_net_l2_rpc_client_set_connected(true);

	mock_dect_rpc_tr_expect_add(if_receive_evt_bstr(l2_ipv6_frame, sizeof(l2_ipv6_frame)),
				   NO_RSP);

	pkt = pkt_with_payload(l2_ipv6_frame, sizeof(l2_ipv6_frame));
	verdict = l2->recv(dect_iface, pkt);
	zassert_equal(verdict, NET_OK, "RPC session should consume pkt in L2 (forward to client)");

	wait_for_mock_send_count(1U);
	mock_dect_rpc_tr_expect_reset();
	dect_net_l2_rpc_client_set_connected(false);
}

ZTEST(dect_rpc_server_forward_recv, test_forward_recv_null_and_empty)
{
	zassert_equal(mock_dect_rpc_tr_sent_count(), 0U, "no RPC before test");

	dect_rpc_server_forward_recv(dect_iface, NULL);

	struct net_pkt *pkt = net_pkt_alloc_with_buffer(dect_iface, 4, AF_INET6, 0, K_NO_WAIT);

	zassert_not_null(pkt, "net_pkt alloc failed");
	dect_rpc_server_forward_recv(dect_iface, pkt);
	net_pkt_unref(pkt);

	k_msleep(50);
	zassert_equal(mock_dect_rpc_tr_sent_count(), 0U, "null/empty pkt must not emit IF_RECEIVE");
}

ZTEST_SUITE(dect_rpc_server_forward_recv, NULL, suite_setup, tc_setup, NULL, NULL);
```

## src/get_addrs_suite.c
```c
/*
 * Copyright (c) 2026 Nordic Semiconductor ASA
 *
 * SPDX-License-Identifier: LicenseRef-Nordic-5-Clause
 */

#include <mock_dect_rpc_transport.h>
#include <dect_rpc_ids.h>
#include <test_rpc_env.h>
#include "rpc_test_link_state_expect.h"
#include "rpc_test_rsp_builder.h"
#include "server_dect_fixture.h"

#include <zephyr/kernel.h>
#include <zephyr/ztest.h>

static void nrf_rpc_err_handler(const struct nrf_rpc_err_report *report)
{
	zassert_ok(report->code);
}

static void *suite_setup(void)
{
	zassert_not_null(server_dect_fixture_ensure_booted(), "DECT stack did not boot");
	return NULL;
}

static void tc_setup(void *f)
{
	ARG_UNUSED(f);

	mock_dect_rpc_tr_expect_add(RPC_INIT_REQ, RPC_INIT_RSP);
	zassert_ok(nrf_rpc_init(nrf_rpc_err_handler));
	mock_dect_rpc_tr_expect_reset();
}

ZTEST(dect_rpc_server_get_addrs, test_if_get_addrs_booted)
{
	struct net_if *iface = server_dect_fixture_ensure_booted();
	mock_dect_rpc_pkt_t rsp = rpc_test_expect_get_addrs_rsp(iface);

	mock_dect_rpc_tr_expect_add(rsp, NO_RSP);
	mock_dect_rpc_tr_receive(RPC_CMD(DECT_RPC_CMD_IF_GET_ADDRS));
	mock_dect_rpc_tr_expect_done();
}

ZTEST(dect_rpc_server_get_addrs, test_if_get_addrs_associated)
{
	struct net_if *iface = server_dect_fixture_ensure_booted();
	mock_dect_rpc_pkt_t rsp;

	EXPECT_LINK_STATE_TRANSITION(CBOR_TRUE, CBOR_FALSE);
	zassert_ok(server_dect_fixture_associate());
	k_msleep(100);
	mock_dect_rpc_tr_expect_reset();
	k_msleep(100);

	rsp = rpc_test_expect_get_addrs_rsp(iface);
	mock_dect_rpc_tr_expect_add(rsp, NO_RSP);
	mock_dect_rpc_tr_receive(RPC_CMD(DECT_RPC_CMD_IF_GET_ADDRS));
	mock_dect_rpc_tr_expect_done();

	EXPECT_LINK_STATE_TRANSITION(CBOR_TRUE, CBOR_TRUE);
	zassert_ok(server_dect_fixture_release());
	k_msleep(100);
	mock_dect_rpc_tr_expect_reset();
}

ZTEST_SUITE(dect_rpc_server_get_addrs, NULL, suite_setup, tc_setup, NULL, NULL);
```

## src/if_enable_suite.c
```c
/*
 * Copyright (c) 2026 Nordic Semiconductor ASA
 *
 * SPDX-License-Identifier: LicenseRef-Nordic-5-Clause
 */

#include <mock_dect_rpc_transport.h>
#include <dect_rpc_ids.h>
#include <test_rpc_env.h>
#include "server_dect_fixture.h"

#include <zephyr/kernel.h>
#include <zephyr/ztest.h>

static void nrf_rpc_err_handler(const struct nrf_rpc_err_report *report)
{
	zassert_ok(report->code);
}

static void *suite_setup(void)
{
	zassert_not_null(server_dect_fixture_ensure_booted(), "DECT stack did not boot");
	return NULL;
}

static void tc_setup(void *f)
{
	ARG_UNUSED(f);

	mock_dect_rpc_tr_expect_add(RPC_INIT_REQ, RPC_INIT_RSP);
	zassert_ok(nrf_rpc_init(nrf_rpc_err_handler));
	mock_dect_rpc_tr_expect_reset();
}

ZTEST(dect_rpc_server_if_enable, test_if_enable_true)
{
	mock_dect_rpc_tr_expect_add(RPC_RSP(), NO_RSP);
	mock_dect_rpc_tr_receive(RPC_CMD(DECT_RPC_CMD_IF_ENABLE, CBOR_TRUE));
	mock_dect_rpc_tr_expect_done();
}

ZTEST(dect_rpc_server_if_enable, test_if_enable_false)
{
	mock_dect_rpc_tr_expect_add(RPC_RSP(), NO_RSP);
	mock_dect_rpc_tr_receive(RPC_CMD(DECT_RPC_CMD_IF_ENABLE, CBOR_FALSE));
	mock_dect_rpc_tr_expect_done();
}

ZTEST_SUITE(dect_rpc_server_if_enable, NULL, suite_setup, tc_setup, NULL, NULL);
```

## src/if_send_errors_suite.c
```c
/*
 * Copyright (c) 2026 Nordic Semiconductor ASA
 *
 * SPDX-License-Identifier: LicenseRef-Nordic-5-Clause
 */

#include <mock_dect_rpc_transport.h>
#include <dect_rpc_ids.h>
#include <test_rpc_env.h>
#include "dect_mdm_mock_test_seam.h"
#include "server_dect_fixture.h"

#include <string.h>

#include <zephyr/kernel.h>
#include <zephyr/ztest.h>

static void nrf_rpc_err_handler(const struct nrf_rpc_err_report *report)
{
	zassert_ok(report->code);
}

static mock_dect_rpc_pkt_t rpc_test_if_send_cmd_pkt(const uint8_t *payload, size_t payload_len)
{
	static uint8_t buf[5 + 3 + 512 + 1];
	static mock_dect_rpc_pkt_t pkt;
	size_t pos = 0;

	buf[pos++] = 0x80;
	buf[pos++] = DECT_RPC_CMD_IF_SEND;
	buf[pos++] = 0xff;
	buf[pos++] = 0x00;
	buf[pos++] = 0x00;

	if (payload_len <= 23) {
		buf[pos++] = (uint8_t)(0x40 | payload_len);
	} else if (payload_len <= 255) {
		buf[pos++] = 0x58;
		buf[pos++] = (uint8_t)payload_len;
	} else if (payload_len <= 65535) {
		buf[pos++] = 0x59;
		buf[pos++] = (payload_len >> 8) & 0xff;
		buf[pos++] = payload_len & 0xff;
	} else {
		__ASSERT_NO_MSG(false);
	}
	memcpy(&buf[pos], payload, payload_len);
	pos += payload_len;
	buf[pos++] = 0xf6;

	pkt.data = buf;
	pkt.len = pos;
	return pkt;
}

static void *suite_setup(void)
{
	zassert_not_null(server_dect_fixture_ensure_booted(), "DECT stack did not boot");
	return NULL;
}

static void tc_setup(void *f)
{
	ARG_UNUSED(f);

	mock_dect_rpc_tr_expect_add(RPC_INIT_REQ, RPC_INIT_RSP);
	zassert_ok(nrf_rpc_init(nrf_rpc_err_handler));
	mock_dect_rpc_tr_expect_reset();
}

ZTEST(dect_rpc_server_if_send_errors, test_if_send_no_long_rd_id_in_dst)
{
	int baseline = dect_mdm_mock_send_call_count;
	static const uint8_t pkt[40] = {
		0x60, 0, 0, 0, 0, 0, 0x3b, 0x40, 0xfe, 0x80, 0, 0, 0, 0, 0, 0, 0, 0, 0, 0, 0, 0, 0,
		0, 0, 0, 0, 0, 0, 0, 0, 0, 0, 0, 0, 0, 0, 0, 0,
	};

	mock_dect_rpc_tr_expect_add(RPC_RSP(CBOR_NINT(22)), NO_RSP);
	mock_dect_rpc_tr_receive(rpc_test_if_send_cmd_pkt(pkt, sizeof(pkt)));
	mock_dect_rpc_tr_expect_done();

	zassert_equal(dect_mdm_mock_send_call_count, baseline,
		      "Driver send must not run when long_rd_id is missing");
}

ZTEST(dect_rpc_server_if_send_errors, test_if_send_payload_too_large)
{
	int baseline = dect_mdm_mock_send_call_count;
	static uint8_t pkt[501];
	mock_dect_rpc_pkt_t cmd;

	memset(pkt, 0, sizeof(pkt));
	pkt[0] = 0x60;
	/* long_rd_id in dst (last 4 bytes of IPv6 dst at offset 24+12). */
	pkt[39] = 0x01;
	__ASSERT_NO_MSG(sizeof(pkt) > 500);

	cmd = rpc_test_if_send_cmd_pkt(pkt, sizeof(pkt));

	mock_dect_rpc_tr_expect_add(RPC_RSP(CBOR_NINT8(90)), NO_RSP);
	mock_dect_rpc_tr_receive(cmd);
	mock_dect_rpc_tr_expect_done();

	zassert_equal(dect_mdm_mock_send_call_count, baseline,
		      "Driver send must not run for oversized RPC payload");
}

ZTEST_SUITE(dect_rpc_server_if_send_errors, NULL, suite_setup, tc_setup, NULL, NULL);
```

## src/if_send_suite.c
```c
/*
 * Copyright (c) 2026 Nordic Semiconductor ASA
 *
 * SPDX-License-Identifier: LicenseRef-Nordic-5-Clause
 */

#include <mock_dect_rpc_transport.h>
#include <dect_rpc_ids.h>
#include <test_rpc_env.h>
#include "dect_mdm_mock_test_seam.h"
#include "rpc_test_link_state_expect.h"
#include "server_dect_fixture.h"

#include <zephyr/kernel.h>
#include <zephyr/ztest.h>

static void nrf_rpc_err_handler(const struct nrf_rpc_err_report *report)
{
	zassert_ok(report->code);
}

static void *suite_setup(void)
{
	zassert_not_null(server_dect_fixture_ensure_booted(), "DECT stack did not boot");
	return NULL;
}

static void tc_setup(void *f)
{
	ARG_UNUSED(f);

	mock_dect_rpc_tr_expect_add(RPC_INIT_REQ, RPC_INIT_RSP);
	zassert_ok(nrf_rpc_init(nrf_rpc_err_handler));
	mock_dect_rpc_tr_expect_reset();
}

ZTEST(dect_rpc_server_if_send, test_if_send_short_payload_rejected)
{
	int baseline = dect_mdm_mock_send_call_count;

	mock_dect_rpc_tr_expect_add(RPC_RSP(0x35), NO_RSP);
	mock_dect_rpc_tr_receive(RPC_CMD(
		DECT_RPC_CMD_IF_SEND,
		CBOR_BSTR(20, 0x60, 0, 0, 0, 0, 0, 0x3b, 0x40, 0xfe, 0x80, 0, 0, 0, 0, 0, 0, 0, 0,
			 0, 0x01)));
	mock_dect_rpc_tr_expect_done();

	zassert_equal(dect_mdm_mock_send_call_count, baseline,
		      "Server must not reach the driver send() for a too-short payload");
}

ZTEST(dect_rpc_server_if_send, test_if_send_success)
{
	static const uint8_t expected_pkt[40] = {
		0x60, 0x00, 0x00, 0x00, 0x00, 0x00, 0x3b, 0x40, 0xfe, 0x80, 0, 0, 0, 0, 0, 0,
		0, 0, 0, 0, 0, 0, 0, 0x01, 0xfe, 0x80, 0, 0, 0, 0, 0, 0, 0, 0, 0, 0, 0x56, 0x78,
		0x9a, 0xbc,
	};

	EXPECT_LINK_STATE_TRANSITION(CBOR_TRUE, CBOR_FALSE);
	zassert_ok(server_dect_fixture_associate());
	k_msleep(100);
	mock_dect_rpc_tr_expect_reset();

	mock_dect_rpc_tr_expect_add(RPC_RSP(CBOR_UINT8(40)), NO_RSP);
#define TEST_IPV6_PKT                                                                              \
	0x60, 0x00, 0x00, 0x00, 0x00, 0x00, 0x3b, 0x40, 0xfe, 0x80, 0, 0, 0, 0, 0, 0, 0, 0, 0, 0, \
		0, 0, 0, 0x01, 0xfe, 0x80, 0, 0, 0, 0, 0, 0, 0, 0, 0, 0, 0x56, 0x78, 0x9a, 0xbc

	mock_dect_rpc_tr_receive(RPC_CMD(DECT_RPC_CMD_IF_SEND, CBOR_BSTR8(40, TEST_IPV6_PKT)));
	mock_dect_rpc_tr_expect_done();

	zassert_equal(dect_mdm_mock_last_send_long_rd_id, SERVER_DECT_FIXTURE_PARENT_LONG_RD_ID,
		      "Wrong long_rd_id derived from the IPv6 destination address");
	zassert_equal(dect_mdm_mock_last_send_len, sizeof(expected_pkt),
		      "Wrong sent packet length");
	zassert_mem_equal(dect_mdm_mock_last_send_data, expected_pkt, sizeof(expected_pkt),
			  "Sent packet payload does not match what was requested");

	EXPECT_LINK_STATE_TRANSITION(CBOR_TRUE, CBOR_TRUE);
	zassert_ok(server_dect_fixture_release());
	k_msleep(100);
	mock_dect_rpc_tr_expect_reset();
}

ZTEST_SUITE(dect_rpc_server_if_send, NULL, suite_setup, tc_setup, NULL, NULL);
```

## src/int32_rsp_codec_suite.c
```c
/*
 * Copyright (c) 2026 Nordic Semiconductor ASA
 *
 * SPDX-License-Identifier: LicenseRef-Nordic-5-Clause
 *
 * Roundtrip tests for dect_rpc_int32_rsp_encode/decode (CONNECT/DISCONNECT/IF_SEND rsp).
 */

#include "dect_rpc_common.h"

#include <mock_dect_rpc_transport.h>
#include <test_rpc_env.h>
#include <nrf_rpc.h>
#include <nrf_rpc/nrf_rpc_serialize.h>
#include <nrf_rpc_cbor.h>
#include <zcbor_encode.h>

#include <zephyr/kernel.h>
#include <zephyr/sys/util.h>
#include <zephyr/ztest.h>

static void nrf_rpc_err_handler(const struct nrf_rpc_err_report *report)
{
	zassert_ok(report->code);
}

static void *suite_setup(void)
{
	mock_dect_rpc_tr_expect_add(RPC_INIT_REQ, RPC_INIT_RSP);
	zassert_ok(nrf_rpc_init(nrf_rpc_err_handler));
	mock_dect_rpc_tr_expect_reset();
	return NULL;
}

static size_t int32_cbor_encoded_len(struct nrf_rpc_cbor_ctx *ctx)
{
	return (size_t)(ctx->zs[0].payload_mut - ctx->out_packet);
}

static void int32_cbor_decode_ctx_init(struct nrf_rpc_cbor_ctx *ctx, const uint8_t *data,
				       size_t len)
{
	zcbor_new_decode_state(ctx->zs, ARRAY_SIZE(ctx->zs), data, len, 1, NULL, 0);
	ctx->zs->constant_state->stop_on_error = true;
}

static bool int32_roundtrip(int32_t in, int32_t *out)
{
	struct nrf_rpc_cbor_ctx enc;
	struct nrf_rpc_cbor_ctx dec;
	size_t len;
	bool ok;

	NRF_RPC_CBOR_ALLOC(&dect_rpc_group, enc, 8);
	dect_rpc_int32_rsp_encode(&enc, in);
	zassert_true(zcbor_nil_put(enc.zs, NULL), "int32 encode nil");
	len = int32_cbor_encoded_len(&enc);

	int32_cbor_decode_ctx_init(&dec, enc.out_packet, len);
	ok = dect_rpc_int32_rsp_decode(&dec, out);
	if (ok) {
		ok = nrf_rpc_decoding_done_and_check(&dect_rpc_group, &dec);
	}

	NRF_RPC_CBOR_DISCARD(&dect_rpc_group, enc);
	return ok;
}

ZTEST(dect_rpc_server_int32_rsp_codec, test_roundtrip_values)
{
	static const int32_t values[] = { 0, 42, -19, -ENODEV, 1500, -ENOMEM };
	int32_t out;

	for (size_t i = 0; i < ARRAY_SIZE(values); i++) {
		zassert_true(int32_roundtrip(values[i], &out));
		zassert_equal(out, values[i]);
	}
}

ZTEST_SUITE(dect_rpc_server_int32_rsp_codec, NULL, suite_setup, NULL, NULL, NULL);
```

## src/link_state_suite.c
```c
/*
 * Copyright (c) 2026 Nordic Semiconductor ASA
 *
 * SPDX-License-Identifier: LicenseRef-Nordic-5-Clause
 *
 * Tests that real l2_dect association state changes genuinely drive the DECT NR+ RPC
 * server's registered hooks (dect_net_l2_link_state_register() ->
 * dect_rpc_server_link_state_changed()) -- not just that the hook function works when
 * called directly. server_dect_fixture_associate()/_release() drive a real network scan
 * via server_dect_fixture (L2 parent association create/remove), so this exercises the
 * actual hook wiring inside
 * subsys/net/dect/l2/dect_net_l2.c end to end.
 *
 * Event delivery (DECT_RPC_CMD_IF_LINK_STATE / DECT_RPC_CMD_IF_ADDRS_CHANGED) happens
 * asynchronously on the system workqueue (dect_rpc_evt_work in server/dect_rpc_if.c).
 * There is no client-driven acknowledgment the mock transport can block on for
 * server-initiated events (unlike command/response pairs), so
 * mock_dect_rpc_tr_expect_done() cannot be used here; it would block forever. Instead this
 * test:
 *
 *   1. Declares the exact expected event bytes via mock_dect_rpc_tr_expect_add(). Any
 *      MISMATCH is still caught synchronously inside the mock's send(), on whichever
 *      thread calls it (here: the system workqueue thread).
 *   2. Independently checks the real, synchronous l2_dect state (net_if_is_dormant())
 *      right after triggering -- this does not depend on timing and confirms the
 *      association codepath genuinely ran.
 *   3. Sleeps briefly to let the workqueue actually send the queued events before the
 *      test (and its teardown) moves on.
 *
 * Known gap: if the workqueue never ran at all, step 1 alone would not fail (the mock's
 * send() only asserts on a *mismatch*, not on "never called"); step 2 is what actually
 * guards against that for the l2_dect side.
 *
 * Associating/releasing also triggers *several* IF_ADDRS_CHANGED events per transition:
 * one from dect_rpc_server_link_state_changed() itself, plus one more per underlying
 * net_if_ipv6_addr_add/rm() or net_if_ipv6_prefix_add/rm() call l2_dect makes while
 * churning through IPv6 addressing (each independently observed by the separate
 * dect_rpc_server_ipv6_event_cb() net_mgmt listener). Concretely, on association,
 * dect_net_l2_ipv6_addressing_parent_added_handle() removes the old link-local address
 * and adds a new one (2 events), then dect_net_l2_ipv6_ula_sync_for_peer() adds a ULA
 * unicast address and its on-link prefix (2 more) -- and the reverse (address/prefix
 * *removal*) happens on release. So what is functionally "one" association/release
 * fans out to 4+ separate net_mgmt events, each independently producing an
 * IF_ADDRS_CHANGED notification. This is not wrong (the notification is a stateless
 * "please re-sync" with a constant payload, so redundant copies are harmless/idempotent
 * to the client) but it is noisy on the wire; debouncing multiple notifications queued
 * in quick succession into one could be a worthwhile follow-up in dect_rpc_if.c.
 * EXPECT_LINK_STATE_TRANSITION() below pads with enough identical expectations rather
 * than pin an exact count (see its own comment for the observed count and the mock's
 * cap in common/mock_dect_rpc_transport.c / CONFIG_MOCK_DECT_RPC_TR_MAX_EXPECTED_PKTS).
 */

#include <mock_dect_rpc_transport.h>
#include <dect_rpc_ids.h>
#include <test_rpc_env.h>
#include "rpc_test_link_state_expect.h"
#include "server_dect_fixture.h"

#include <zephyr/kernel.h>
#include <zephyr/net/net_if.h>
#include <zephyr/ztest.h>

static struct net_if *dect_iface;

static void nrf_rpc_err_handler(const struct nrf_rpc_err_report *report)
{
	zassert_ok(report->code);
}

static void *suite_setup(void)
{
	dect_iface = server_dect_fixture_ensure_booted();
	zassert_not_null(dect_iface, "DECT stack did not boot");
	return NULL;
}

static void tc_setup(void *f)
{
	ARG_UNUSED(f);

	mock_dect_rpc_tr_expect_add(RPC_INIT_REQ, RPC_INIT_RSP);
	zassert_ok(nrf_rpc_init(nrf_rpc_err_handler));
	mock_dect_rpc_tr_expect_reset();
}

ZTEST(dect_rpc_server_link_state, test_associate_sends_link_state_and_addrs_changed)
{
	/* carrier_ok=true after boot (mock HAL activate); dormant=false once associated. */
	EXPECT_LINK_STATE_TRANSITION(CBOR_TRUE, CBOR_FALSE);

	zassert_ok(server_dect_fixture_associate());

	/* Synchronous, timing-independent check: dect_net_l2_parent_association_created()
	 * calls net_if_dormant_off() directly (no workqueue involved).
	 */
	zassert_false(net_if_is_dormant(dect_iface), "iface should no longer be dormant");

	/* Let dect_rpc_evt_work (system workqueue) send the queued events. */
	k_msleep(100);
	zassert_true(mock_dect_rpc_tr_sent_count() > 0, "No link-state RPC event was sent");
	mock_dect_rpc_tr_expect_reset();

	/* Release so the next ZTEST case (which does its own associate) does not hit the
	 * "already associated" assert in dect_net_l2_parent_association_created() -- ztest
	 * case order is not relied upon elsewhere in this file, but cleaning up here keeps
	 * this test self-contained regardless.
	 */
	EXPECT_LINK_STATE_TRANSITION(CBOR_TRUE, CBOR_TRUE);
	zassert_ok(server_dect_fixture_release());
	k_msleep(100);
	mock_dect_rpc_tr_expect_reset();
}

ZTEST(dect_rpc_server_link_state, test_release_sends_link_state_and_addrs_changed)
{
	/* Associate first (self-contained: do not rely on ZTEST case ordering). Drop these
	 * events; only the *release* below is under test in this case.
	 */
	EXPECT_LINK_STATE_TRANSITION(CBOR_TRUE, CBOR_FALSE);
	zassert_ok(server_dect_fixture_associate());
	k_msleep(100);
	mock_dect_rpc_tr_expect_reset();

	zassert_false(net_if_is_dormant(dect_iface));

	EXPECT_LINK_STATE_TRANSITION(CBOR_TRUE, CBOR_TRUE);

	zassert_ok(server_dect_fixture_release());

	zassert_true(net_if_is_dormant(dect_iface), "iface should be dormant again after release");

	k_msleep(100);
	zassert_true(mock_dect_rpc_tr_sent_count() > 0, "No release link-state RPC event was sent");
	mock_dect_rpc_tr_expect_reset();
}

ZTEST_SUITE(dect_rpc_server_link_state, NULL, suite_setup, tc_setup, NULL, NULL);
```

## src/ping_suite.c
```c
/*
 * Copyright (c) 2026 Nordic Semiconductor ASA
 *
 * SPDX-License-Identifier: LicenseRef-Nordic-5-Clause
 *
 * Tests the server's DECT_RPC_CMD_PING decoder (dect_rpc_cmd_ping() in
 * server/dect_rpc_if.c): given an incoming PING command, does the server respond
 * with exactly the expected "0" response? Mirrors client/src/ping_suite.c, which
 * tests the same command from the client's side.
 */

#include <mock_dect_rpc_transport.h>
#include <dect_rpc_ids.h>
#include <test_rpc_env.h>

#include <zephyr/kernel.h>
#include <zephyr/ztest.h>

static void nrf_rpc_err_handler(const struct nrf_rpc_err_report *report)
{
	zassert_ok(report->code);
}

static void tc_setup(void *f)
{
	ARG_UNUSED(f);

	mock_dect_rpc_tr_expect_add(RPC_INIT_REQ, RPC_INIT_RSP);
	zassert_ok(nrf_rpc_init(nrf_rpc_err_handler));
	mock_dect_rpc_tr_expect_reset();
}

ZTEST(dect_rpc_server_ping, test_ping_command)
{
	/* Request payload content (the sequence number) is ignored by the server -- see
	 * nrf_rpc_decode_skip(ctx) in dect_rpc_cmd_ping() -- so its exact value does not
	 * matter here.
	 */
	mock_dect_rpc_tr_expect_add(RPC_RSP(CBOR_UINT_SMALL(0)), NO_RSP);
	mock_dect_rpc_tr_receive(RPC_CMD(DECT_RPC_CMD_PING, CBOR_UINT_SMALL(0)));
	mock_dect_rpc_tr_expect_done();
}

ZTEST_SUITE(dect_rpc_server_ping, NULL, NULL, tc_setup, NULL, NULL);
```

## src/rpc_test_link_state_expect.h
```c
/*
 * Copyright (c) 2026 Nordic Semiconductor ASA
 *
 * SPDX-License-Identifier: LicenseRef-Nordic-5-Clause
 *
 * RPC event expectations for L2 association transitions (must expand at test top level).
 */

#ifndef RPC_TEST_LINK_STATE_EXPECT_H_
#define RPC_TEST_LINK_STATE_EXPECT_H_

#include <mock_dect_rpc_transport.h>
#include <dect_rpc_ids.h>
#include <test_rpc_env.h>

#define EXPECT_ADDRS_CHANGED_PAD                                                                   \
	mock_dect_rpc_tr_expect_add(                                                               \
		RPC_EVT(DECT_RPC_CMD_IF_ADDRS_CHANGED, CBOR_UINT_SMALL(0)), NO_RSP)

#if defined(CONFIG_DECT_NR_RPC_SHELL)
/* IF_ADDRS_CHANGED and SHELL_LINE interleave during associate/release; pad with wildcards. */
#define EXPECT_LINK_STATE_POST_LINK_EVENTS()                                                       \
	do {                                                                                       \
		MOCK_DECT_RPC_EXPECT_ANY_SEND;                                                     \
		MOCK_DECT_RPC_EXPECT_ANY_SEND;                                                     \
		MOCK_DECT_RPC_EXPECT_ANY_SEND;                                                     \
		MOCK_DECT_RPC_EXPECT_ANY_SEND;                                                     \
		MOCK_DECT_RPC_EXPECT_ANY_SEND;                                                     \
		MOCK_DECT_RPC_EXPECT_ANY_SEND;                                                     \
		MOCK_DECT_RPC_EXPECT_ANY_SEND;                                                     \
		MOCK_DECT_RPC_EXPECT_ANY_SEND;                                                     \
		MOCK_DECT_RPC_EXPECT_ANY_SEND;                                                     \
		MOCK_DECT_RPC_EXPECT_ANY_SEND;                                                     \
		MOCK_DECT_RPC_EXPECT_ANY_SEND;                                                     \
		MOCK_DECT_RPC_EXPECT_ANY_SEND;                                                     \
		MOCK_DECT_RPC_EXPECT_ANY_SEND;                                                     \
		MOCK_DECT_RPC_EXPECT_ANY_SEND;                                                     \
		MOCK_DECT_RPC_EXPECT_ANY_SEND;                                                     \
		MOCK_DECT_RPC_EXPECT_ANY_SEND;                                                     \
	} while (0)
#else
#define EXPECT_LINK_STATE_POST_LINK_EVENTS()                                                       \
	EXPECT_ADDRS_CHANGED_PAD;                                                                  \
	EXPECT_ADDRS_CHANGED_PAD;                                                                  \
	EXPECT_ADDRS_CHANGED_PAD;                                                                  \
	EXPECT_ADDRS_CHANGED_PAD;                                                                  \
	EXPECT_ADDRS_CHANGED_PAD;                                                                  \
	EXPECT_ADDRS_CHANGED_PAD;                                                                  \
	EXPECT_ADDRS_CHANGED_PAD;                                                                  \
	EXPECT_ADDRS_CHANGED_PAD;                                                                  \
	EXPECT_ADDRS_CHANGED_PAD;                                                                  \
	EXPECT_ADDRS_CHANGED_PAD
#endif

#define EXPECT_LINK_STATE_TRANSITION(carrier_byte, dormant_byte)                                   \
	mock_dect_rpc_tr_expect_add(                                                               \
		RPC_EVT(DECT_RPC_CMD_IF_LINK_STATE, (carrier_byte), (dormant_byte)), NO_RSP);     \
	EXPECT_LINK_STATE_POST_LINK_EVENTS()

#endif /* RPC_TEST_LINK_STATE_EXPECT_H_ */
```
