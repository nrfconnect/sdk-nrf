## CMakeLists.txt
```
#
# Copyright (c) 2026 Nordic Semiconductor ASA
#
# SPDX-License-Identifier: LicenseRef-Nordic-5-Clause
#
cmake_minimum_required(VERSION 3.20.0)

find_package(Zephyr REQUIRED HINTS $ENV{ZEPHYR_BASE})
project(dect_rpc_client_hooks_test)

target_include_directories(app PRIVATE
  ${ZEPHYR_NRF_MODULE_DIR}/subsys/net/dect/rpc/common
  ${ZEPHYR_NRF_MODULE_DIR}/subsys/net/dect/rpc/client
  ../common
)

target_sources(app PRIVATE
  src/auto_sync_notify_suite.c
  ../common/mock_dect_rpc_transport.c
)
```

## prj.conf
```kconfig
#
# Same as ../client/prj.conf but CONFIG_DECT_NR_RPC_AUTO_SYNC=y for notify hook test.
#

CONFIG_ZTEST=y
CONFIG_TEST_RANDOM_GENERATOR=y

CONFIG_DECT=y
CONFIG_DECT_CLUSTER_MAX_CHILD_ASSOCIATION_COUNT=16

CONFIG_DECT_NR_RPC=y
CONFIG_DECT_NR_RPC_CLIENT=y
CONFIG_DECT_NR_RPC_NET_IF=y
CONFIG_DECT_NR_RPC_CLIENT_IFACE_NAME="dect0"
CONFIG_DECT_NR_RPC_CLIENT_SHELL=y
CONFIG_DECT_NR_RPC_CLIENT_SHELL_RPC_INIT=n
CONFIG_DECT_NR_RPC_CONN_MGR=y

CONFIG_DECT_NR_RPC_AUTO_SYNC=y
CONFIG_DECT_NR_RPC_AUTO_SYNC_DELAY_SEC=0
CONFIG_DECT_NR_RPC_ADDR_SYNC_INTERVAL_SEC=0
CONFIG_DECT_NR_RPC_MAX_IP_PKT=500

CONFIG_NRF_RPC_CBOR=y
CONFIG_NRF_RPC_ZCBOR_BACKUPS=1
CONFIG_NRF_RPC_CBKPROXY_OUT_SLOTS=0
CONFIG_NRF_RPC_THREAD_STACK_SIZE=4096
CONFIG_NRF_RPC_THREAD_PRIORITY=0
CONFIG_NRF_RPC_RESPONSE_TIMEOUT=400

CONFIG_NETWORKING=y
CONFIG_NET_NATIVE=y
CONFIG_NET_IPV6=y
CONFIG_NET_IPV4=n
CONFIG_NET_MGMT_EVENT_STACK_SIZE=2048
CONFIG_NET_CONNECTION_MANAGER_MONITOR_STACK_SIZE=2048
CONFIG_NET_SOCKETS=y
CONFIG_NET_SOCKETS_OFFLOAD=n
CONFIG_NET_MAX_CONN=6

CONFIG_NET_IF_UNICAST_IPV6_ADDR_COUNT=3
CONFIG_NET_IF_MAX_IPV6_COUNT=8
CONFIG_NET_INTERFACE_NAME=y

CONFIG_ZVFS_POLL_MAX=10

CONFIG_NET_BUF=y
CONFIG_NET_PKT_RX_COUNT=4
CONFIG_NET_BUF_RX_COUNT=8
CONFIG_NET_PKT_TX_COUNT=4
CONFIG_NET_BUF_TX_COUNT=8

CONFIG_SHELL=y
CONFIG_SHELL_STACK_SIZE=3072
CONFIG_NET_SHELL=y
CONFIG_SHELL_BACKEND_DUMMY=y
CONFIG_SHELL_BACKEND_DUMMY_BUF_SIZE=4096

CONFIG_HEAP_MEM_POOL_SIZE=2048

CONFIG_ASSERT=y
CONFIG_RESET_ON_FATAL_ERROR=n

CONFIG_MOCK_NRF_RPC=y
CONFIG_MOCK_DECT_RPC_TRANSPORT=y
CONFIG_NRF_RPC_GROUP_DEFAULT_INITIATOR=y

CONFIG_KERNEL_MEM_POOL=y
CONFIG_ASAN=y
CONFIG_ZTEST_STACK_SIZE=2560
CONFIG_MAIN_STACK_SIZE=2048
```

## src/auto_sync_notify_suite.c
```c
/*
 * Copyright (c) 2026 Nordic Semiconductor ASA
 *
 * SPDX-License-Identifier: LicenseRef-Nordic-5-Clause
 */

#include "dect_rpc_client_net.h"
#include <dect_rpc_ids.h>
#include <mock_dect_rpc_transport.h>
#include <net/dect/dect_rpc.h>
#include <test_rpc_env.h>

#include <nrf_rpc.h>
#include <zephyr/kernel.h>
#include <zephyr/net/net_if.h>
#include <zephyr/ztest.h>

static void nrf_rpc_err_handler(const struct nrf_rpc_err_report *report)
{
	zassert_ok(report->code);
}

static void *suite_setup(void)
{
	mock_dect_rpc_tr_expect_add(RPC_INIT_REQ, RPC_INIT_RSP);
	zassert_ok(nrf_rpc_init(nrf_rpc_err_handler));
	mock_dect_rpc_tr_expect_reset();
	return NULL;
}

ZTEST(dect_rpc_client_auto_sync, test_notify_rpc_init_done_schedules_sync)
{
	struct net_if *iface = net_if_get_first_by_type(&NET_L2_GET_NAME(DECT_RPC_L2));

	zassert_not_null(iface, "DECT RPC client iface missing");

	mock_dect_rpc_tr_expect_add((mock_dect_rpc_pkt_t){ .data = NULL, .len = 0 },
				   RPC_RSP(GET_ADDRS_RSP_BOOTED_UNASSOCIATED));
	dect_rpc_client_notify_rpc_init_done();
	k_msleep(100);
	mock_dect_rpc_tr_expect_done();

	zassert_equal(net_if_get_mtu(iface), 1280, "auto-sync should apply GET_ADDRS MTU");
}

ZTEST_SUITE(dect_rpc_client_auto_sync, NULL, suite_setup, NULL, NULL, NULL);
```
