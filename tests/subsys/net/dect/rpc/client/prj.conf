## CMakeLists.txt
```
#
# Copyright (c) 2026 Nordic Semiconductor ASA
#
# SPDX-License-Identifier: LicenseRef-Nordic-5-Clause
#
cmake_minimum_required(VERSION 3.20.0)

find_package(Zephyr REQUIRED HINTS $ENV{ZEPHYR_BASE})
project(dect_rpc_client_test)

file(GLOB app_sources src/*.c)

target_include_directories(app PRIVATE
  # Needed to access DECT NR+ RPC command/event IDs.
  ${ZEPHYR_NRF_MODULE_DIR}/subsys/net/dect/rpc/common
  ${ZEPHYR_NRF_MODULE_DIR}/subsys/net/dect/rpc/client
  ../common
)

target_sources(app PRIVATE
  ${app_sources}
  ../common/status_codec_helpers.c
  ../common/mock_dect_rpc_transport.c
)
```

## prj.conf
```kconfig
#
# Copyright (c) 2026 Nordic Semiconductor ASA
#
# SPDX-License-Identifier: LicenseRef-Nordic-5-Clause
#
# DECT NR+ RPC client unit test (native_sim). Kconfig follows
# samples/dect/dect_rpc/prj.conf (default client role) except:
#   - CONFIG_MOCK_DECT_RPC_TRANSPORT (no UART)
#   - CONFIG_NRF_RPC_GROUP_DEFAULT_INITIATOR=y so tc_setup() can bind the mock group
#     (sample client is UART follower; that path is the sample, not this test)
#   - CONFIG_SHELL_BACKEND_DUMMY for shell capture in ztest

CONFIG_ZTEST=y
CONFIG_TEST_RANDOM_GENERATOR=y

# --- samples/dect/dect_rpc/prj.conf (client) ---
CONFIG_DECT=y
CONFIG_DECT_CLUSTER_MAX_CHILD_ASSOCIATION_COUNT=16

CONFIG_DECT_NR_RPC=y
CONFIG_DECT_NR_RPC_CLIENT=y
CONFIG_DECT_NR_RPC_NET_IF=y
CONFIG_DECT_NR_RPC_CLIENT_IFACE_NAME="dect0"
CONFIG_DECT_NR_RPC_CLIENT_SHELL=y
CONFIG_DECT_NR_RPC_CLIENT_SHELL_RPC_INIT=n
CONFIG_DECT_NR_RPC_CONN_MGR=y

CONFIG_DECT_NR_RPC_AUTO_SYNC=n
CONFIG_DECT_NR_RPC_ADDR_SYNC_INTERVAL_SEC=0
CONFIG_DECT_NR_RPC_MAX_IP_PKT=500

CONFIG_NRF_RPC_CBOR=y
CONFIG_NRF_RPC_ZCBOR_BACKUPS=1
CONFIG_NRF_RPC_CBKPROXY_OUT_SLOTS=0
CONFIG_NRF_RPC_THREAD_STACK_SIZE=4096
CONFIG_NRF_RPC_THREAD_PRIORITY=0
CONFIG_NRF_RPC_RESPONSE_TIMEOUT=400

CONFIG_NETWORKING=y
CONFIG_NET_NATIVE=y
CONFIG_NET_IPV6=y
CONFIG_NET_IPV4=n
CONFIG_NET_MGMT_EVENT_STACK_SIZE=2048
CONFIG_NET_CONNECTION_MANAGER_MONITOR_STACK_SIZE=2048
CONFIG_NET_SOCKETS=y
CONFIG_NET_SOCKETS_OFFLOAD=n
CONFIG_NET_MAX_CONN=6

CONFIG_NET_IF_UNICAST_IPV6_ADDR_COUNT=3
CONFIG_NET_IF_MAX_IPV6_COUNT=8
CONFIG_NET_INTERFACE_NAME=y

CONFIG_ZVFS_POLL_MAX=10

CONFIG_NET_BUF=y
CONFIG_NET_PKT_RX_COUNT=4
CONFIG_NET_BUF_RX_COUNT=8
CONFIG_NET_PKT_TX_COUNT=4
CONFIG_NET_BUF_TX_COUNT=8

CONFIG_SHELL=y
CONFIG_SHELL_STACK_SIZE=3072
CONFIG_NET_SHELL=y
CONFIG_SHELL_BACKEND_DUMMY=y
CONFIG_SHELL_BACKEND_DUMMY_BUF_SIZE=4096

CONFIG_HEAP_MEM_POOL_SIZE=2048

CONFIG_ASSERT=y
CONFIG_RESET_ON_FATAL_ERROR=n

# --- test-only ---
CONFIG_MOCK_NRF_RPC=y
CONFIG_MOCK_DECT_RPC_TRANSPORT=y
CONFIG_NRF_RPC_GROUP_DEFAULT_INITIATOR=y

CONFIG_KERNEL_MEM_POOL=y
CONFIG_ASAN=y
CONFIG_ZTEST_STACK_SIZE=2560
CONFIG_MAIN_STACK_SIZE=2048
```

## src/api_suite.c
```c
/*
 * Copyright (c) 2026 Nordic Semiconductor ASA
 *
 * SPDX-License-Identifier: LicenseRef-Nordic-5-Clause
 *
 * Public client hooks from net/dect/dect_rpc.h (group pointer and post-init notify).
 */

#include "dect_rpc_common.h"
#include "dect_rpc_client_net.h"
#include <mock_dect_rpc_transport.h>
#include <net/dect/dect_rpc.h>
#include <test_rpc_env.h>

#include <nrf_rpc.h>
#include <zephyr/kernel.h>
#include <zephyr/ztest.h>

static void nrf_rpc_err_handler(const struct nrf_rpc_err_report *report)
{
	zassert_ok(report->code);
}

static void *suite_setup(void)
{
	mock_dect_rpc_tr_expect_add(RPC_INIT_REQ, RPC_INIT_RSP);
	zassert_ok(nrf_rpc_init(nrf_rpc_err_handler));
	mock_dect_rpc_tr_expect_reset();
	return NULL;
}

ZTEST(dect_rpc_client_api, test_get_group_returns_dect_rpc_group)
{
	const struct nrf_rpc_group *group = dect_rpc_client_get_group();

	zassert_not_null(group, "group pointer");
	zassert_equal_ptr(group, &dect_rpc_group, "must be the dect_rpc nRF RPC group");
	zassert_true(NRF_RPC_GROUP_STATUS(dect_rpc_group), "group bound after mock init");
}

ZTEST(dect_rpc_client_api, test_notify_rpc_init_done_no_auto_sync)
{
	/* CONFIG_DECT_NR_RPC_AUTO_SYNC=n in client/prj.conf: must be safe to call. */
	dect_rpc_client_notify_rpc_init_done();
}

ZTEST_SUITE(dect_rpc_client_api, NULL, suite_setup, NULL, NULL, NULL);
```

## src/connect_suite.c
```c
/*
 * Copyright (c) 2026 Nordic Semiconductor ASA
 *
 * SPDX-License-Identifier: LicenseRef-Nordic-5-Clause
 *
 * "dect connect" / "dect disconnect" via conn_mgr on the RPC net_if, and direct
 * dect_rpc_client_connect() / disconnect() for RPC timeout paths.
 */

#include <mock_dect_rpc_transport.h>
#include <dect_rpc_ids.h>
#include <test_rpc_env.h>

#include <string.h>

#include <nrf_rpc_errno.h>
#include <zephyr/kernel.h>
#include <zephyr/net/net_if.h>
#include <zephyr/ztest.h>
#include <zephyr/shell/shell.h>
#include <zephyr/shell/shell_dummy.h>

#include "dect_rpc_client_net.h"

static void nrf_rpc_err_handler(const struct nrf_rpc_err_report *report)
{
	zassert_ok(report->code);
}

static struct net_if *rpc_client_iface(void)
{
	return net_if_get_first_by_type(&NET_L2_GET_NAME(DECT_RPC_L2));
}

static void tc_setup(void *f)
{
	ARG_UNUSED(f);

	mock_dect_rpc_tr_expect_add(RPC_INIT_REQ, RPC_INIT_RSP);
	zassert_ok(nrf_rpc_init(nrf_rpc_err_handler));
	mock_dect_rpc_tr_expect_reset();
}

ZTEST(dect_rpc_client_connect, test_dect_connect_shell_success)
{
	const struct shell *sh = shell_backend_dummy_get_ptr();
	const char *output;
	size_t size;
	int err;

	zassert_not_null(rpc_client_iface(), "RPC client net_if missing");

	shell_backend_dummy_clear_output(sh);

	mock_dect_rpc_tr_expect_add(RPC_CMD(DECT_RPC_CMD_CONNECT), RPC_RSP(CBOR_UINT_SMALL(0)));
	err = shell_execute_cmd(sh, "dect connect");
	mock_dect_rpc_tr_expect_done();

	zassert_equal(err, 0, "Expected 'dect connect' to succeed, got %d", err);

	output = shell_backend_dummy_get_output(sh, &size);
	zassert_not_null(strstr(output, "Connect initiated on server (via RPC)"),
			 "Missing connect success message: %s", output);
}

ZTEST(dect_rpc_client_connect, test_dect_disconnect_shell_success)
{
	const struct shell *sh = shell_backend_dummy_get_ptr();
	const char *output;
	size_t size;
	int err;

	zassert_not_null(rpc_client_iface(), "RPC client net_if missing");

	shell_backend_dummy_clear_output(sh);

	mock_dect_rpc_tr_expect_add(RPC_CMD(DECT_RPC_CMD_DISCONNECT), RPC_RSP(CBOR_UINT_SMALL(0)));
	err = shell_execute_cmd(sh, "dect disconnect");
	mock_dect_rpc_tr_expect_done();

	zassert_equal(err, 0, "Expected 'dect disconnect' to succeed, got %d", err);

	output = shell_backend_dummy_get_output(sh, &size);
	zassert_not_null(strstr(output, "Disconnect initiated on server (via RPC)"),
			 "Missing disconnect success message: %s", output);
}

ZTEST(dect_rpc_client_connect, test_disconnect_rpc_timeout)
{
	int err;

	mock_dect_rpc_tr_expect_add(RPC_CMD(DECT_RPC_CMD_DISCONNECT), NO_RSP);
	err = dect_rpc_client_disconnect();
	mock_dect_rpc_tr_expect_reset();

	zassert_equal(err, -NRF_ETIMEDOUT,
		      "Expected RPC response timeout, got %d", err);
}

ZTEST(dect_rpc_client_connect, test_connect_rpc_timeout)
{
	int err;

	mock_dect_rpc_tr_expect_add(RPC_CMD(DECT_RPC_CMD_CONNECT), NO_RSP);
	err = dect_rpc_client_connect();
	mock_dect_rpc_tr_expect_reset();

	zassert_equal(err, -NRF_ETIMEDOUT,
		      "Expected RPC response timeout, got %d", err);
}

ZTEST_SUITE(dect_rpc_client_connect, NULL, NULL, tc_setup, NULL, NULL);
```

## src/events_suite.c
```c
/*
 * Copyright (c) 2026 Nordic Semiconductor ASA
 *
 * SPDX-License-Identifier: LicenseRef-Nordic-5-Clause
 */

#include <mock_dect_rpc_transport.h>
#include <dect_rpc_ids.h>
#include <test_rpc_env.h>

#include <zephyr/kernel.h>
#include <zephyr/net/net_if.h>
#include <zephyr/ztest.h>

#include "dect_rpc_client_net.h"

static void nrf_rpc_err_handler(const struct nrf_rpc_err_report *report)
{
	zassert_ok(report->code);
}

static void tc_setup(void *f)
{
	ARG_UNUSED(f);

	mock_dect_rpc_tr_expect_add(RPC_INIT_REQ, RPC_INIT_RSP);
	zassert_ok(nrf_rpc_init(nrf_rpc_err_handler));
	mock_dect_rpc_tr_expect_reset();
}

ZTEST(dect_rpc_client_events, test_if_receive_event)
{
	static const uint8_t mini_pkt[8] = { 0x60, 0, 0, 0, 0, 0, 0, 0x3b };

	mock_dect_rpc_tr_expect_add(RPC_EVT_ACK(DECT_RPC_CMD_IF_RECEIVE), NO_RSP);
	mock_dect_rpc_tr_receive(RPC_EVT(DECT_RPC_CMD_IF_RECEIVE, CBOR_BSTR(8, mini_pkt[0],
									   mini_pkt[1],
									   mini_pkt[2],
									   mini_pkt[3],
									   mini_pkt[4],
									   mini_pkt[5],
									   mini_pkt[6],
									   mini_pkt[7])));
	k_msleep(50);
	mock_dect_rpc_tr_expect_done();
}

ZTEST(dect_rpc_client_events, test_shell_line_event)
{
	mock_dect_rpc_tr_expect_add(RPC_EVT_ACK(DECT_RPC_CMD_SHELL_LINE), NO_RSP);
	mock_dect_rpc_tr_receive(RPC_EVT(DECT_RPC_CMD_SHELL_LINE,
					CBOR_BSTR(12, 'l', 'i', 'n', 'e', ' ', 'o', 'u', 't',
						  'p', 'u', 't', '\n')));
	k_msleep(50);
	mock_dect_rpc_tr_expect_done();
}

ZTEST(dect_rpc_client_events, test_if_link_state_event)
{
	struct net_if *iface = net_if_get_first_by_type(&NET_L2_GET_NAME(DECT_RPC_L2));

	zassert_not_null(iface, "DECT RPC client iface missing");

	/* Carrier off avoids IPv6 MLD join RPC side traffic on carrier-on. */
	mock_dect_rpc_tr_expect_add(RPC_EVT_ACK(DECT_RPC_CMD_IF_LINK_STATE), NO_RSP);
	mock_dect_rpc_tr_receive(RPC_EVT(DECT_RPC_CMD_IF_LINK_STATE, CBOR_FALSE, CBOR_TRUE));
	k_msleep(50);
	mock_dect_rpc_tr_expect_done();

	zassert_false(net_if_is_carrier_ok(iface), "carrier should mirror server event");
	zassert_true(net_if_is_dormant(iface), "dormant should mirror server event");
}

ZTEST(dect_rpc_client_events, test_if_addrs_changed_triggers_get_addrs)
{
	mock_dect_rpc_tr_expect_add(RPC_EVT_ACK(DECT_RPC_CMD_IF_ADDRS_CHANGED), NO_RSP);
	mock_dect_rpc_tr_expect_add(RPC_CMD(DECT_RPC_CMD_IF_GET_ADDRS, CBOR_UINT_SMALL(0)),
				   RPC_RSP(GET_ADDRS_RSP_BOOTED_UNASSOCIATED));
	mock_dect_rpc_tr_receive(RPC_EVT(DECT_RPC_CMD_IF_ADDRS_CHANGED, CBOR_UINT_SMALL(0)));
	k_msleep(100);
	mock_dect_rpc_tr_expect_done();
}

ZTEST_SUITE(dect_rpc_client_events, NULL, NULL, tc_setup, NULL, NULL);
```

## src/int32_rsp_codec_suite.c
```c
/*
 * Copyright (c) 2026 Nordic Semiconductor ASA
 *
 * SPDX-License-Identifier: LicenseRef-Nordic-5-Clause
 *
 * Roundtrip tests for dect_rpc_int32_rsp_encode/decode (CONNECT/DISCONNECT/IF_SEND rsp).
 */

#include "dect_rpc_common.h"

#include <mock_dect_rpc_transport.h>
#include <test_rpc_env.h>
#include <nrf_rpc.h>
#include <nrf_rpc/nrf_rpc_serialize.h>
#include <nrf_rpc_cbor.h>
#include <zcbor_encode.h>

#include <zephyr/kernel.h>
#include <zephyr/sys/util.h>
#include <zephyr/ztest.h>

static void nrf_rpc_err_handler(const struct nrf_rpc_err_report *report)
{
	zassert_ok(report->code);
}

static void *suite_setup(void)
{
	mock_dect_rpc_tr_expect_add(RPC_INIT_REQ, RPC_INIT_RSP);
	zassert_ok(nrf_rpc_init(nrf_rpc_err_handler));
	mock_dect_rpc_tr_expect_reset();
	return NULL;
}

static size_t int32_cbor_encoded_len(struct nrf_rpc_cbor_ctx *ctx)
{
	return (size_t)(ctx->zs[0].payload_mut - ctx->out_packet);
}

static void int32_cbor_decode_ctx_init(struct nrf_rpc_cbor_ctx *ctx, const uint8_t *data,
				       size_t len)
{
	zcbor_new_decode_state(ctx->zs, ARRAY_SIZE(ctx->zs), data, len, 1, NULL, 0);
	ctx->zs->constant_state->stop_on_error = true;
}

static bool int32_roundtrip(int32_t in, int32_t *out)
{
	struct nrf_rpc_cbor_ctx enc;
	struct nrf_rpc_cbor_ctx dec;
	size_t len;
	bool ok;

	NRF_RPC_CBOR_ALLOC(&dect_rpc_group, enc, 8);
	dect_rpc_int32_rsp_encode(&enc, in);
	zassert_true(zcbor_nil_put(enc.zs, NULL), "int32 encode nil");
	len = int32_cbor_encoded_len(&enc);

	int32_cbor_decode_ctx_init(&dec, enc.out_packet, len);
	ok = dect_rpc_int32_rsp_decode(&dec, out);
	if (ok) {
		ok = nrf_rpc_decoding_done_and_check(&dect_rpc_group, &dec);
	}

	NRF_RPC_CBOR_DISCARD(&dect_rpc_group, enc);
	return ok;
}

ZTEST(dect_rpc_client_int32_rsp_codec, test_roundtrip_values)
{
	static const int32_t values[] = { 0, 42, -19, -ENODEV, 1500, -ENOMEM };
	int32_t out;

	for (size_t i = 0; i < ARRAY_SIZE(values); i++) {
		zassert_true(int32_roundtrip(values[i], &out));
		zassert_equal(out, values[i]);
	}
}

ZTEST_SUITE(dect_rpc_client_int32_rsp_codec, NULL, suite_setup, NULL, NULL, NULL);
```

## src/l2_send_suite.c
```c
/*
 * Copyright (c) 2026 Nordic Semiconductor ASA
 *
 * SPDX-License-Identifier: LicenseRef-Nordic-5-Clause
 *
 * Client DECT_RPC_L2 send path -> DECT_RPC_CMD_IF_SEND (dect_rpc_l2_send in dect_rpc_if.c).
 */

#include <mock_dect_rpc_transport.h>
#include <dect_rpc_ids.h>
#include <test_rpc_env.h>

#include <string.h>

#include <zephyr/kernel.h>
#include <zephyr/net/net_if.h>
#include <zephyr/net/net_ip.h>
#include <zephyr/net/net_pkt.h>
#include <zephyr/ztest.h>

#include "dect_rpc_client_net.h"

#define TEST_IPV6_PKT                                                                              \
	0x60, 0x00, 0x00, 0x00, 0x00, 0x00, 0x3b, 0x40, 0xfe, 0x80, 0, 0, 0, 0, 0, 0, 0, 0, 0, 0, \
		0, 0, 0, 0x01, 0xfe, 0x80, 0, 0, 0, 0, 0, 0, 0, 0, 0, 0, 0x56, 0x78, 0x9a, 0xbc

static void nrf_rpc_err_handler(const struct nrf_rpc_err_report *report)
{
	zassert_ok(report->code);
}

static void tc_setup(void *f)
{
	ARG_UNUSED(f);

	mock_dect_rpc_tr_expect_add(RPC_INIT_REQ, RPC_INIT_RSP);
	zassert_ok(nrf_rpc_init(nrf_rpc_err_handler));
	mock_dect_rpc_tr_expect_reset();
}

ZTEST(dect_rpc_client_l2_send, test_l2_send_rejects_oversized_pkt)
{
	struct net_if *iface = net_if_get_first_by_type(&NET_L2_GET_NAME(DECT_RPC_L2));
	struct net_pkt *pkt;
	static uint8_t huge[501];
	enum net_verdict ret;

	zassert_not_null(iface, "DECT RPC client iface missing");

	pkt = net_pkt_alloc_with_buffer(iface, sizeof(huge), AF_INET6, IPPROTO_UDP, K_NO_WAIT);
	zassert_not_null(pkt, "net_pkt alloc failed");
	zassert_ok(net_pkt_write(pkt, huge, sizeof(huge)));

	ret = net_if_try_send_data(iface, pkt, K_NO_WAIT);

	zassert_equal(ret, NET_DROP, "oversized pkt must not be sent, got %d", ret);
}

ZTEST_SUITE(dect_rpc_client_l2_send, NULL, NULL, tc_setup, NULL, NULL);
```

## src/ping_suite.c
```c
/*
 * Copyright (c) 2026 Nordic Semiconductor ASA
 *
 * SPDX-License-Identifier: LicenseRef-Nordic-5-Clause
 *
 * Tests dect_rpc_client_ping(): verifies the client sends a DECT_RPC_CMD_PING command
 * over the (mocked) transport, and correctly reports success or timeout depending on
 * whether/what response it receives. This exercises subsys/net/dect/rpc/client/dect_rpc_if.c
 * directly; the mock transport only stands in for the real UART link.
 */

#include <mock_dect_rpc_transport.h>
#include <dect_rpc_ids.h>
#include <test_rpc_env.h>

#include <zephyr/kernel.h>
#include <zephyr/ztest.h>

#include "dect_rpc_client_net.h"

static void nrf_rpc_err_handler(const struct nrf_rpc_err_report *report)
{
	zassert_ok(report->code);
}

static void tc_setup(void *f)
{
	ARG_UNUSED(f);

	mock_dect_rpc_tr_expect_add(RPC_INIT_REQ, RPC_INIT_RSP);
	zassert_ok(nrf_rpc_init(nrf_rpc_err_handler));
	mock_dect_rpc_tr_expect_reset();
}

/*
 * Both scenarios live in one ZTEST case (rather than two) so the order in which the
 * shared dect_rpc_ping_seq counter (static, file-scope in client/dect_rpc_if.c) is
 * consumed is deterministic: seq=0 for the first ping, seq=1..3 for the second.
 */
ZTEST(dect_rpc_client_ping, test_ping)
{
	int err;

	/* 1. Server responds promptly: dect_rpc_client_ping() must return 0. */
	mock_dect_rpc_tr_expect_add(RPC_CMD(DECT_RPC_CMD_PING, CBOR_UINT_SMALL(0)),
				   RPC_RSP(CBOR_UINT_SMALL(0)));
	err = dect_rpc_client_ping(K_MSEC(2000));
	mock_dect_rpc_tr_expect_done();
	zassert_equal(err, 0, "Expected successful ping, got %d", err);

	/*
	 * 2. No response is ever sent back. nrf_rpc_cbor_cmd() (used by
	 * dect_rpc_client_ping()) blocks *internally* on CONFIG_NRF_RPC_RESPONSE_TIMEOUT
	 * for every attempt (see wait_for_response() in nrf_rpc_cmd_common(),
	 * nrfxlib/nrf_rpc/nrf_rpc.c) and returns non-zero on timeout -- so
	 * dect_rpc_client_ping()'s own retry loop (on `ret != 0`) fires all
	 * DECT_RPC_PING_ATTEMPTS (3) times, each sending a new PING with an incrementing
	 * sequence number, before giving up with -EIO. The `timeout` parameter passed to
	 * dect_rpc_client_ping() only bounds the *outer* semaphore wait after a *successful*
	 * send+response cycle (scenario 1 above); it does not shorten this retry loop.
	 *
	 * Do NOT call mock_dect_rpc_tr_expect_done() here: with no response ever queued, the
	 * mock's completion semaphore is never signaled and the call would block forever.
	 * mock_dect_rpc_tr_expect_reset() clears the expectations instead (the outgoing bytes
	 * of each attempt were already checked synchronously inside send()).
	 */
	mock_dect_rpc_tr_expect_add(RPC_CMD(DECT_RPC_CMD_PING, CBOR_UINT_SMALL(1)), NO_RSP);
	mock_dect_rpc_tr_expect_add(RPC_CMD(DECT_RPC_CMD_PING, CBOR_UINT_SMALL(2)), NO_RSP);
	mock_dect_rpc_tr_expect_add(RPC_CMD(DECT_RPC_CMD_PING, CBOR_UINT_SMALL(3)), NO_RSP);
	err = dect_rpc_client_ping(K_MSEC(200));
	mock_dect_rpc_tr_expect_reset();
	zassert_equal(err, -EIO, "Expected -EIO after exhausting retries, got %d", err);
}

ZTEST_SUITE(dect_rpc_client_ping, NULL, NULL, tc_setup, NULL, NULL);
```

## src/shell_run_suite.c
```c
/*
 * Copyright (c) 2026 Nordic Semiconductor ASA
 *
 * SPDX-License-Identifier: LicenseRef-Nordic-5-Clause
 */

#include <mock_dect_rpc_transport.h>
#include <dect_rpc_ids.h>
#include <test_rpc_env.h>

#include <string.h>

#include <zephyr/kernel.h>
#include <zephyr/ztest.h>
#include <zephyr/shell/shell.h>
#include <zephyr/shell/shell_dummy.h>

static void nrf_rpc_err_handler(const struct nrf_rpc_err_report *report)
{
	zassert_ok(report->code);
}

static void tc_setup(void *f)
{
	ARG_UNUSED(f);

	mock_dect_rpc_tr_expect_add(RPC_INIT_REQ, RPC_INIT_RSP);
	zassert_ok(nrf_rpc_init(nrf_rpc_err_handler));
	mock_dect_rpc_tr_expect_reset();
}

ZTEST(dect_rpc_client_shell_run, test_dect_run_shell_rpc)
{
	const struct shell *sh = shell_backend_dummy_get_ptr();
	int err;

	shell_backend_dummy_clear_output(sh);

	mock_dect_rpc_tr_expect_add(
		RPC_CMD(DECT_RPC_CMD_SHELL, CBOR_UINT_SMALL(1),
			CBOR_BSTR(7, 's', 't', 'a', 't', 'u', 's', 0)),
		RPC_RSP(CBOR_UINT_SMALL(0)));
	err = shell_execute_cmd(sh, "dect run status");
	mock_dect_rpc_tr_expect_done();

	zassert_equal(err, 0, "dect run status failed: %d", err);
}

ZTEST(dect_rpc_client_shell_run, test_dect_run_too_few_args)
{
	const struct shell *sh = shell_backend_dummy_get_ptr();

	zassert_equal(shell_execute_cmd(sh, "dect run"), -EINVAL);
}

ZTEST_SUITE(dect_rpc_client_shell_run, NULL, NULL, tc_setup, NULL, NULL);
```

## src/skip_ipv6_codec_suite.c
```c
/*
 * Copyright (c) 2026 Nordic Semiconductor ASA
 *
 * SPDX-License-Identifier: LicenseRef-Nordic-5-Clause
 *
 * Unit tests for dect_rpc_decode_skip_extra_ipv6_{addrs,prefixes} in common/dect_rpc_common.c.
 */

#include "dect_rpc_common.h"

#include <mock_dect_rpc_transport.h>
#include <test_rpc_env.h>
#include <nrf_rpc.h>
#include <nrf_rpc/nrf_rpc_serialize.h>
#include <nrf_rpc_cbor.h>

#include <zephyr/kernel.h>
#include <zephyr/ztest.h>

#define SKIP_CBOR_MAX_PARAMS 255

#define IPV6_BSTR_BYTES                                                                            \
	0x20, 0x01, 0x02, 0x03, 0x04, 0x05, 0x06, 0x07, 0x08, 0x09, 0x0a, 0x0b, 0x0c, 0x0d, 0x0e, \
		0x0f

static void nrf_rpc_err_handler(const struct nrf_rpc_err_report *report)
{
	zassert_ok(report->code);
}

static void *suite_setup(void)
{
	mock_dect_rpc_tr_expect_add(RPC_INIT_REQ, RPC_INIT_RSP);
	zassert_ok(nrf_rpc_init(nrf_rpc_err_handler));
	mock_dect_rpc_tr_expect_reset();
	return NULL;
}

static void cbor_decode_ctx_init(struct nrf_rpc_cbor_ctx *ctx, const uint8_t *data, size_t len)
{
	zcbor_new_decode_state(ctx->zs, ARRAY_SIZE(ctx->zs), data, len, SKIP_CBOR_MAX_PARAMS, NULL,
			       0);
	ctx->zs->constant_state->stop_on_error = true;
}

static void assert_cbor_fully_consumed(const struct nrf_rpc_cbor_ctx *ctx)
{
	zassert_equal(ctx->zs->payload_mut, ctx->zs->payload_end, "trailing CBOR after skip");
}

static void consume_one_prefix(struct nrf_rpc_cbor_ctx *ctx)
{
	size_t sz;

	zassert_not_null(nrf_rpc_decode_buffer_ptr_and_size(ctx, &sz));
	zassert_equal(sz, 16U);
	(void)nrf_rpc_decode_uint(ctx);
}

ZTEST(dect_rpc_skip_ipv6_codec, test_skip_prefixes_consumes_extra_entry)
{
	/* Two prefix tuples; skip the second after the first was applied. */
	static const uint8_t wire[] = {
		CBOR_BSTR(16, IPV6_BSTR_BYTES),
		CBOR_UINT8(64),
		CBOR_BSTR(16, IPV6_BSTR_BYTES),
		CBOR_UINT8(48),
	};
	struct nrf_rpc_cbor_ctx ctx;

	cbor_decode_ctx_init(&ctx, wire, sizeof(wire));
	consume_one_prefix(&ctx);

	dect_rpc_decode_skip_extra_ipv6_prefixes(&ctx, 2, 1);
	assert_cbor_fully_consumed(&ctx);
}

ZTEST(dect_rpc_skip_ipv6_codec, test_skip_prefixes_stops_on_empty_stream)
{
	static const uint8_t wire[] = { };
	struct nrf_rpc_cbor_ctx ctx;

	cbor_decode_ctx_init(&ctx, wire, sizeof(wire));
	dect_rpc_decode_skip_extra_ipv6_prefixes(&ctx, 1, 0);
	zassert_false(nrf_rpc_decode_valid(&ctx));
}

ZTEST(dect_rpc_skip_ipv6_codec, test_skip_prefixes_stops_on_non_bstr)
{
	static const uint8_t wire[] = { CBOR_UINT_SMALL(7) };
	struct nrf_rpc_cbor_ctx ctx;

	cbor_decode_ctx_init(&ctx, wire, sizeof(wire));
	dect_rpc_decode_skip_extra_ipv6_prefixes(&ctx, 1, 0);
	zassert_false(nrf_rpc_decode_valid(&ctx));
}

ZTEST(dect_rpc_skip_ipv6_codec, test_skip_prefixes_stops_after_bstr_without_len_uint)
{
	/* Prefix skip expects bstr then uint; truncated after bstr. */
	static const uint8_t wire[] = { CBOR_BSTR(16, IPV6_BSTR_BYTES) };
	struct nrf_rpc_cbor_ctx ctx;

	cbor_decode_ctx_init(&ctx, wire, sizeof(wire));
	dect_rpc_decode_skip_extra_ipv6_prefixes(&ctx, 1, 0);
	zassert_false(nrf_rpc_decode_valid(&ctx));
}

ZTEST(dect_rpc_skip_ipv6_codec, test_skip_addrs_consumes_extra_entry)
{
	static const uint8_t wire[] = {
		CBOR_BSTR(16, IPV6_BSTR_BYTES),
		CBOR_BSTR(16, IPV6_BSTR_BYTES),
	};
	struct nrf_rpc_cbor_ctx ctx;
	size_t sz;

	cbor_decode_ctx_init(&ctx, wire, sizeof(wire));
	zassert_not_null(nrf_rpc_decode_buffer_ptr_and_size(&ctx, &sz));
	zassert_equal(sz, 16U);

	dect_rpc_decode_skip_extra_ipv6_addrs(&ctx, 2, 1);
	assert_cbor_fully_consumed(&ctx);
}

ZTEST(dect_rpc_skip_ipv6_codec, test_skip_addrs_stops_on_empty_stream)
{
	static const uint8_t wire[] = { };
	struct nrf_rpc_cbor_ctx ctx;

	cbor_decode_ctx_init(&ctx, wire, sizeof(wire));
	dect_rpc_decode_skip_extra_ipv6_addrs(&ctx, 1, 0);
	zassert_false(nrf_rpc_decode_valid(&ctx));
}

ZTEST(dect_rpc_skip_ipv6_codec, test_skip_addrs_stops_on_non_bstr)
{
	static const uint8_t wire[] = { CBOR_FALSE };
	struct nrf_rpc_cbor_ctx ctx;

	cbor_decode_ctx_init(&ctx, wire, sizeof(wire));
	dect_rpc_decode_skip_extra_ipv6_addrs(&ctx, 1, 0);
	zassert_false(nrf_rpc_decode_valid(&ctx));
}

ZTEST(dect_rpc_skip_ipv6_codec, test_skip_addrs_stops_on_truncated_bstr)
{
	/* Declared 16-byte bstr but payload ends early. */
	static const uint8_t wire[] = { 0x50, 0xaa, 0xbb };
	struct nrf_rpc_cbor_ctx ctx;

	cbor_decode_ctx_init(&ctx, wire, sizeof(wire));
	dect_rpc_decode_skip_extra_ipv6_addrs(&ctx, 1, 0);
	zassert_false(nrf_rpc_decode_valid(&ctx));
}

ZTEST_SUITE(dect_rpc_skip_ipv6_codec, NULL, suite_setup, NULL, NULL, NULL);
```

## src/status_codec_suite.c
```c
/*
 * Copyright (c) 2026 Nordic Semiconductor ASA
 *
 * SPDX-License-Identifier: LicenseRef-Nordic-5-Clause
 *
 * Unit tests for DECT_RPC_CMD_IF_STATUS CBOR codec (dect_rpc_status_*).
 */

#include "status_codec_helpers.h"
#include "dect_rpc_common.h"

#include <mock_dect_rpc_transport.h>
#include <test_rpc_env.h>

#include <string.h>
#include <zephyr/kernel.h>
#include <zephyr/ztest.h>

static void nrf_rpc_err_handler(const struct nrf_rpc_err_report *report)
{
	zassert_ok(report->code);
}

static void *suite_setup(void)
{
	mock_dect_rpc_tr_expect_add(RPC_INIT_REQ, RPC_INIT_RSP);
	zassert_ok(nrf_rpc_init(nrf_rpc_err_handler));
	mock_dect_rpc_tr_expect_reset();
	return NULL;
}

ZTEST(dect_rpc_status_codec, test_roundtrip_empty)
{
	struct dect_status_info in, out;

	dect_rpc_status_init_empty(&in);
	zassert_true(dect_rpc_test_status_roundtrip(&in, &out));
	dect_rpc_test_status_assert_equal(&in, &out);
}

ZTEST(dect_rpc_status_codec, test_roundtrip_full_sample)
{
	struct dect_status_info in, out;

	dect_rpc_test_status_fill_sample(&in);
	zassert_true(dect_rpc_test_status_roundtrip(&in, &out));
	dect_rpc_test_status_assert_equal(&in, &out);
}

ZTEST(dect_rpc_status_codec, test_decode_matches_no_dect_if_macro)
{
	struct dect_status_info out;
	/* CBOR body of STATUS_RSP_NO_DECT_IF (see test_rpc_env.h). */
	static const uint8_t cbor[] = {
		CBOR_FALSE, CBOR_FALSE, CBOR_UINT_SMALL(0), CBOR_FALSE, CBOR_UINT_SMALL(0),
		CBOR_UINT_SMALL(0), CBOR_FALSE,
		CBOR_BSTR(16, 0, 0, 0, 0, 0, 0, 0, 0, 0, 0, 0, 0, 0, 0, 0, 0),
		CBOR_UINT_SMALL(0), CBOR_BSTR(1, 0x00),
	};

	zassert_true(dect_rpc_test_status_decode_cbor(cbor, sizeof(cbor), &out));
	zassert_false(out.mdm_activated);
	zassert_false(out.cluster_running);
	zassert_equal(out.cluster_channel, 0);
	zassert_false(out.nw_beacon_running);
	zassert_equal(out.parent_count, 0);
	zassert_equal(out.child_count, 0);
	zassert_false(out.br_global_ipv6_addr_prefix_set);
	zassert_is_null(out.br_net_iface);
}

ZTEST(dect_rpc_status_codec, test_parent_count_gt_one_single_wire_assoc)
{
	struct dect_status_info enc, out;

	dect_rpc_test_status_fill_sample(&enc);
	enc.parent_count = 3;

	zassert_true(dect_rpc_test_status_roundtrip(&enc, &out));
	zassert_equal(out.parent_count, 3);
	dect_rpc_test_status_assert_equal(&enc, &out);
}

ZTEST(dect_rpc_status_codec, test_decode_skips_extra_wire_children)
{
	struct dect_status_info enc, out;
	const uint32_t wire_child_count = DECT_RPC_MAX_STATUS_CHILDREN + 4;
	int i;

	dect_rpc_status_init_empty(&enc);
	enc.child_count = DECT_RPC_MAX_STATUS_CHILDREN;
	for (i = 0; i < DECT_RPC_MAX_STATUS_CHILDREN; i++) {
		enc.child_associations[i].long_rd_id = 0x1000 + i;
	}

	zassert_true(dect_rpc_test_status_decode_wire_extra_children(&enc, wire_child_count, &out));
	dect_rpc_test_status_assert_equal(&enc, &out);
}

ZTEST(dect_rpc_status_codec, test_decode_rejects_child_count_above_int_max)
{
	struct dect_status_info out;
	static const uint8_t cbor[] = {
		CBOR_FALSE, CBOR_FALSE, CBOR_UINT_SMALL(0), CBOR_FALSE, CBOR_UINT_SMALL(0),
		CBOR_UINT32(0x80000000U), CBOR_FALSE,
		CBOR_BSTR(16, 0, 0, 0, 0, 0, 0, 0, 0, 0, 0, 0, 0, 0, 0, 0, 0),
		CBOR_UINT_SMALL(0), CBOR_BSTR(1, 0x00),
	};

	zassert_false(dect_rpc_test_status_decode_cbor(cbor, sizeof(cbor), &out));
}

ZTEST_SUITE(dect_rpc_status_codec, NULL, suite_setup, NULL, NULL, NULL);
```

## src/status_suite.c
```c
/*
 * Copyright (c) 2026 Nordic Semiconductor ASA
 *
 * SPDX-License-Identifier: LicenseRef-Nordic-5-Clause
 *
 * Tests the "dect status" shell command on the DECT NR+ RPC client: verifies it sends
 * a DECT_RPC_CMD_IF_STATUS request and correctly decodes/prints a canned response.
 * Exercises subsys/net/dect/rpc/client/dect_rpc_shell.c (cmd_dect_status() and
 * print_dect_status_shell()) through the real shell command dispatcher, using Zephyr's
 * dummy shell backend to capture output without a real UART.
 */

#include <mock_dect_rpc_transport.h>
#include <dect_rpc_ids.h>
#include <status_codec_helpers.h>
#include <test_rpc_env.h>

#include <string.h>

#include <zephyr/kernel.h>
#include <zephyr/ztest.h>
#include <zephyr/shell/shell.h>
#include <zephyr/shell/shell_dummy.h>

static void nrf_rpc_err_handler(const struct nrf_rpc_err_report *report)
{
	zassert_ok(report->code);
}

static void tc_setup(void *f)
{
	ARG_UNUSED(f);

	mock_dect_rpc_tr_expect_add(RPC_INIT_REQ, RPC_INIT_RSP);
	zassert_ok(nrf_rpc_init(nrf_rpc_err_handler));
	mock_dect_rpc_tr_expect_reset();
}

ZTEST(dect_rpc_client_status, test_dect_status_shell_empty)
{
	const struct shell *sh = shell_backend_dummy_get_ptr();
	const char *output;
	size_t size;
	int err;

	shell_backend_dummy_clear_output(sh);

	/* First (and only, in this test) IF_STATUS request in the binary: dect_rpc_req_seq
	 * (static, file-scope in client/dect_rpc_shell.c) starts at 0.
	 */
	mock_dect_rpc_tr_expect_add(RPC_CMD(DECT_RPC_CMD_IF_STATUS, CBOR_UINT_SMALL(0)),
				   RPC_RSP(STATUS_RSP_NO_DECT_IF));
	err = shell_execute_cmd(sh, "dect status");
	mock_dect_rpc_tr_expect_done();

	zassert_equal(err, 0, "Expected 'dect status' to succeed, got %d", err);

	output = shell_backend_dummy_get_output(sh, &size);
	/* Match without a trailing newline: the dummy shell backend is defined with
	 * SHELL_FLAG_OLF_CRLF, which rewrites every '\n' written by shell_fprintf() to
	 * "\r\n", so a plain '\n' in these expected strings would never match.
	 */
	zassert_not_null(strstr(output, "DECT NR+ status (from DECT NR+ RPC server):"),
			 "Missing status header in output: %s", output);
	zassert_not_null(strstr(output, "  Modem activated:              no"),
			 "Modem activated field not reflected correctly: %s", output);
	zassert_not_null(strstr(output, "  Cluster running:              no"),
			 "Cluster running field not reflected correctly: %s", output);
	zassert_not_null(strstr(output, "  Border router global IPv6 address: not set"),
			 "Border router prefix should be reported as not set: %s", output);
}

ZTEST(dect_rpc_client_status, test_dect_status_shell_full)
{
	const struct shell *sh = shell_backend_dummy_get_ptr();
	struct dect_status_info sample;
	const char *output;
	size_t size;
	int err;

	dect_rpc_test_status_fill_sample(&sample);

	shell_backend_dummy_clear_output(sh);

	/* test_dect_status_shell_cmd runs first (alphabetically earlier name) and uses seq 0. */
	mock_dect_rpc_tr_expect_add(RPC_CMD(DECT_RPC_CMD_IF_STATUS, CBOR_UINT_SMALL(1)),
				   dect_rpc_test_status_rpc_rsp_from(&sample));
	err = shell_execute_cmd(sh, "dect status");
	mock_dect_rpc_tr_expect_done();

	zassert_ok(err, "dect status failed: %d", err);

	output = shell_backend_dummy_get_output(sh, &size);
	zassert_not_null(strstr(output, "  Modem activated:              yes"), "%s", output);
	zassert_not_null(strstr(output, "  Cluster running:              yes"), "%s", output);
	zassert_not_null(strstr(output, "  Cluster channel:              42"), "%s", output);
	zassert_not_null(strstr(output, "  Network beacon running:       yes"), "%s", output);
	zassert_not_null(strstr(output, "0xabcd1234"), "%s", output);
	zassert_not_null(strstr(output, "    Child #1 long RD ID:"), "%s", output);
	zassert_not_null(strstr(output, "    Child #2 long RD ID:"), "%s", output);
	zassert_not_null(strstr(output, "  Border router global IPv6 prefix/64:"), "%s", output);
	zassert_not_null(strstr(output, "  Modem FW version:             fw-1.2.3"), "%s", output);
}

ZTEST_SUITE(dect_rpc_client_status, NULL, NULL, tc_setup, NULL, NULL);
```

## src/sync_suite.c
```c
/*
 * Copyright (c) 2026 Nordic Semiconductor ASA
 *
 * SPDX-License-Identifier: LicenseRef-Nordic-5-Clause
 */

#include <mock_dect_rpc_transport.h>
#include <dect_rpc_ids.h>
#include <test_rpc_env.h>

#include <string.h>

#include <zephyr/kernel.h>
#include "dect_rpc_client_net.h"
#include <zephyr/net/net_event.h>
#include <zephyr/net/net_if.h>
#include <zephyr/net/net_ip.h>
#include <zephyr/net/net_mgmt.h>
#include <zephyr/sys/atomic.h>
#include <zephyr/ztest.h>
#include <zephyr/shell/shell.h>
#include <zephyr/shell/shell_dummy.h>

static void nrf_rpc_err_handler(const struct nrf_rpc_err_report *report)
{
	zassert_ok(report->code);
}

static struct net_if *sync_event_iface;
static atomic_t sync_addr_event_count;

static void sync_addr_event_handler(struct net_mgmt_event_callback *cb, uint64_t mgmt_event,
				    struct net_if *iface)
{
	ARG_UNUSED(cb);

	if (iface == sync_event_iface &&
	    (mgmt_event == NET_EVENT_IPV6_ADDR_ADD || mgmt_event == NET_EVENT_IPV6_ADDR_DEL)) {
		atomic_inc(&sync_addr_event_count);
	}
}

static void tc_setup(void *f)
{
	ARG_UNUSED(f);

	mock_dect_rpc_tr_expect_add(RPC_INIT_REQ, RPC_INIT_RSP);
	zassert_ok(nrf_rpc_init(nrf_rpc_err_handler));
	mock_dect_rpc_tr_expect_reset();
}

ZTEST(dect_rpc_client_sync, test_dect_sync_shell)
{
	const struct shell *sh = shell_backend_dummy_get_ptr();
	const char *output;
	size_t size;
	int err;

	shell_backend_dummy_clear_output(sh);

	mock_dect_rpc_tr_expect_add(RPC_CMD(DECT_RPC_CMD_IF_GET_ADDRS, CBOR_UINT_SMALL(1)),
				   RPC_RSP(GET_ADDRS_RSP_BOOTED_UNASSOCIATED));
	err = shell_execute_cmd(sh, "dect sync");
	mock_dect_rpc_tr_expect_done();

	zassert_equal(err, 0, "dect sync failed: %d", err);
	output = shell_backend_dummy_get_output(sh, &size);
	zassert_not_null(strstr(output, "Synced addresses/prefixes from server"),
			 "Missing sync success: %s", output);
}

ZTEST(dect_rpc_client_sync, test_sync_addrs_api_applies_mtu)
{
	struct net_if *iface = net_if_get_first_by_type(&NET_L2_GET_NAME(DECT_RPC_L2));
	int err;

	zassert_not_null(iface, "DECT RPC client iface missing");

	mock_dect_rpc_tr_expect_add(RPC_CMD(DECT_RPC_CMD_IF_GET_ADDRS, CBOR_UINT_SMALL(2)),
				   RPC_RSP(GET_ADDRS_RSP_BOOTED_UNASSOCIATED));
	err = dect_rpc_client_sync_addrs(iface);
	mock_dect_rpc_tr_expect_done();

	zassert_equal(err, 0, "sync addrs failed: %d", err);
	zassert_equal(net_if_get_mtu(iface), 1280, "MTU should mirror GET_ADDRS response");
}

#define ONE_ADDR_BYTES                                                                             \
	0x20, 0x01, 0x02, 0x03, 0x04, 0x05, 0x06, 0x07, 0x08, 0x09, 0x0a, 0x0b, 0x0c, 0x0d, 0x0e, \
		0x0f

#define ONE_PREFIX_BYTES                                                                           \
	0xfd, 0x00, 0x00, 0x00, 0x00, 0x00, 0x00, 0x00, 0x00, 0x00, 0x00, 0x00, 0x00, 0x00, 0x00, \
		0x01

static int count_ipv6_prefixes(struct net_if *iface)
{
	struct net_if_ipv6 *ipv6;
	int n = 0;

	if (net_if_config_ipv6_get(iface, &ipv6) < 0) {
		return -1;
	}

	for (int i = 0; i < NET_IF_MAX_IPV6_PREFIX; i++) {
		if (ipv6->prefix[i].is_used) {
			n++;
		}
	}

	return n;
}

static const struct net_in6_addr *first_ipv6_prefix(struct net_if *iface, uint8_t *len_out)
{
	struct net_if_ipv6 *ipv6;

	if (net_if_config_ipv6_get(iface, &ipv6) < 0) {
		return NULL;
	}

	for (int i = 0; i < NET_IF_MAX_IPV6_PREFIX; i++) {
		if (ipv6->prefix[i].is_used) {
			if (len_out) {
				*len_out = ipv6->prefix[i].len;
			}
			return &ipv6->prefix[i].prefix;
		}
	}

	return NULL;
}

ZTEST(dect_rpc_client_sync, test_sync_addrs_applies_one_addr)
{
	struct net_if *iface = net_if_get_first_by_type(&NET_L2_GET_NAME(DECT_RPC_L2));
	struct net_if_ipv6 *ipv6;
	int err;

	zassert_not_null(iface, "DECT RPC client iface missing");

	mock_dect_rpc_tr_expect_add(
		RPC_CMD(DECT_RPC_CMD_IF_GET_ADDRS, CBOR_UINT_SMALL(3)),
		RPC_RSP(CBOR_UINT_SMALL(1), CBOR_BSTR(16, ONE_ADDR_BYTES), CBOR_UINT_SMALL(0),
			CBOR_UINT16(1280), CBOR_FALSE, CBOR_TRUE));
	err = dect_rpc_client_sync_addrs(iface);
	mock_dect_rpc_tr_expect_done();

	zassert_equal(err, 0, "sync addrs failed: %d", err);
	zassert_ok(net_if_config_ipv6_get(iface, &ipv6));
	zassert_true(ipv6->unicast[0].is_used, "expected one unicast addr applied");
}

ZTEST(dect_rpc_client_sync, test_sync_addrs_applies_one_prefix)
{
	struct net_if *iface = net_if_get_first_by_type(&NET_L2_GET_NAME(DECT_RPC_L2));
	const struct net_in6_addr *prefix;
	uint8_t prefix_len = 0;
	int err;
	static const uint8_t expected_prefix[] = { ONE_PREFIX_BYTES };

	zassert_not_null(iface, "DECT RPC client iface missing");

	mock_dect_rpc_tr_expect_add(
		RPC_CMD(DECT_RPC_CMD_IF_GET_ADDRS, CBOR_UINT_SMALL(4)),
		RPC_RSP(CBOR_UINT_SMALL(0), CBOR_UINT_SMALL(1), CBOR_BSTR(16, ONE_PREFIX_BYTES),
			CBOR_UINT8(64), CBOR_UINT16(1280), CBOR_TRUE, CBOR_TRUE));
	err = dect_rpc_client_sync_addrs(iface);
	mock_dect_rpc_tr_expect_done();

	zassert_equal(err, 0, "sync addrs failed: %d", err);
	zassert_equal(count_ipv6_prefixes(iface), 1, "expected one prefix applied");
	prefix = first_ipv6_prefix(iface, &prefix_len);
	zassert_not_null(prefix, "prefix missing on iface");
	zassert_equal(prefix_len, 64, "prefix length");
	zassert_mem_equal(prefix->s6_addr, expected_prefix, sizeof(expected_prefix),
			  "prefix bytes");
}

ZTEST(dect_rpc_client_sync, test_sync_addrs_skips_prefix_len_over_128)
{
	struct net_if *iface = net_if_get_first_by_type(&NET_L2_GET_NAME(DECT_RPC_L2));
	int err;

	zassert_not_null(iface, "DECT RPC client iface missing");

	mock_dect_rpc_tr_expect_add(
		RPC_CMD(DECT_RPC_CMD_IF_GET_ADDRS, CBOR_UINT_SMALL(7)),
		RPC_RSP(CBOR_UINT_SMALL(0), CBOR_UINT_SMALL(1), CBOR_BSTR(16, ONE_PREFIX_BYTES),
			CBOR_UINT8(129), CBOR_UINT16(1280), CBOR_TRUE, CBOR_TRUE));
	err = dect_rpc_client_sync_addrs(iface);
	mock_dect_rpc_tr_expect_done();

	zassert_equal(err, 0, "sync addrs failed: %d", err);
	zassert_equal(count_ipv6_prefixes(iface), 0, "invalid prefix len must not be applied");
}

ZTEST(dect_rpc_client_sync, test_sync_addrs_skips_extra_wire_addrs)
{
	struct net_if *iface = net_if_get_first_by_type(&NET_L2_GET_NAME(DECT_RPC_L2));
	int err;

	zassert_not_null(iface, "DECT RPC client iface missing");

	/* Wire claims 9 unicast addrs; client applies 8, then skips extras on decode. */
	mock_dect_rpc_tr_expect_add(
		RPC_CMD(DECT_RPC_CMD_IF_GET_ADDRS, CBOR_UINT_SMALL(5)),
		RPC_RSP(CBOR_UINT_SMALL(9),
			CBOR_BSTR(16, ONE_ADDR_BYTES), CBOR_BSTR(16, ONE_ADDR_BYTES),
			CBOR_BSTR(16, ONE_ADDR_BYTES), CBOR_BSTR(16, ONE_ADDR_BYTES),
			CBOR_BSTR(16, ONE_ADDR_BYTES), CBOR_BSTR(16, ONE_ADDR_BYTES),
			CBOR_BSTR(16, ONE_ADDR_BYTES), CBOR_BSTR(16, ONE_ADDR_BYTES),
			CBOR_BSTR(16, ONE_ADDR_BYTES),
			CBOR_UINT_SMALL(0), CBOR_UINT16(1280), CBOR_TRUE, CBOR_TRUE));
	err = dect_rpc_client_sync_addrs(iface);
	mock_dect_rpc_tr_expect_done();

	zassert_equal(err, 0, "sync addrs failed: %d", err);
}

ZTEST(dect_rpc_client_sync, test_sync_addrs_skips_extra_wire_prefixes)
{
	struct net_if *iface = net_if_get_first_by_type(&NET_L2_GET_NAME(DECT_RPC_L2));
	int err;

	zassert_not_null(iface, "DECT RPC client iface missing");

	/* Wire claims 5 prefixes; client applies 4, then skips extras on decode. */
	mock_dect_rpc_tr_expect_add(
		RPC_CMD(DECT_RPC_CMD_IF_GET_ADDRS, CBOR_UINT_SMALL(6)),
		RPC_RSP(CBOR_UINT_SMALL(0), CBOR_UINT_SMALL(5),
			CBOR_BSTR(16, ONE_PREFIX_BYTES), CBOR_UINT8(64),
			CBOR_BSTR(16, ONE_PREFIX_BYTES), CBOR_UINT8(64),
			CBOR_BSTR(16, ONE_PREFIX_BYTES), CBOR_UINT8(64),
			CBOR_BSTR(16, ONE_PREFIX_BYTES), CBOR_UINT8(64),
			CBOR_BSTR(16, ONE_PREFIX_BYTES), CBOR_UINT8(64),
			CBOR_UINT16(1280), CBOR_TRUE, CBOR_TRUE));
	err = dect_rpc_client_sync_addrs(iface);
	mock_dect_rpc_tr_expect_done();

	zassert_equal(err, 0, "sync addrs failed: %d", err);
}

ZTEST(dect_rpc_client_sync, test_z_sync_addrs_is_idempotent_and_rejects_malformed_response)
{
	static const uint8_t expected_addr[] = { ONE_ADDR_BYTES };
	struct net_if *iface = net_if_get_first_by_type(&NET_L2_GET_NAME(DECT_RPC_L2));
	struct net_if_ipv6 *ipv6;
	struct net_mgmt_event_callback event_cb;
	int err;

	zassert_not_null(iface, "DECT RPC client iface missing");
	sync_event_iface = iface;
	atomic_set(&sync_addr_event_count, 0);
	net_mgmt_init_event_callback(&event_cb, sync_addr_event_handler,
				    NET_EVENT_IPV6_ADDR_ADD | NET_EVENT_IPV6_ADDR_DEL);
	net_mgmt_add_event_callback(&event_cb);

	/* First sync establishes the mirrored address; a repeated response must be a no-op. */
	mock_dect_rpc_tr_expect_add(
		(mock_dect_rpc_pkt_t){ .data = NULL, .len = 0 },
		RPC_RSP(CBOR_UINT_SMALL(1), CBOR_BSTR(16, ONE_ADDR_BYTES), CBOR_UINT_SMALL(0),
			CBOR_UINT16(1280), CBOR_TRUE, CBOR_TRUE));
	err = dect_rpc_client_sync_addrs(iface);
	mock_dect_rpc_tr_expect_done();
	zassert_equal(err, 0, "initial sync failed: %d", err);
	k_msleep(50);

	atomic_set(&sync_addr_event_count, 0);
	mock_dect_rpc_tr_expect_add(
		(mock_dect_rpc_pkt_t){ .data = NULL, .len = 0 },
		RPC_RSP(CBOR_UINT_SMALL(1), CBOR_BSTR(16, ONE_ADDR_BYTES), CBOR_UINT_SMALL(0),
			CBOR_UINT16(1280), CBOR_TRUE, CBOR_TRUE));
	err = dect_rpc_client_sync_addrs(iface);
	mock_dect_rpc_tr_expect_done();
	zassert_equal(err, 0, "repeated sync failed: %d", err);
	k_msleep(50);
	zassert_equal(atomic_get(&sync_addr_event_count), 0,
		      "unchanged sync must not emit IPv6 address events");

	/* A short address payload makes the response invalid; retain the last good address. */
	mock_dect_rpc_tr_expect_add(
		(mock_dect_rpc_pkt_t){ .data = NULL, .len = 0 },
		RPC_RSP(CBOR_UINT_SMALL(1), CBOR_BSTR(15, 0x20, 0x01, 0x02, 0x03, 0x04, 0x05,
					     0x06, 0x07, 0x08, 0x09, 0x0a, 0x0b, 0x0c,
					     0x0d, 0x0e),
			CBOR_UINT_SMALL(0), CBOR_UINT16(1280), CBOR_TRUE, CBOR_TRUE));
	err = dect_rpc_client_sync_addrs(iface);
	mock_dect_rpc_tr_expect_done();
	zassert_equal(err, -EIO, "malformed sync should fail: %d", err);
	zassert_ok(net_if_config_ipv6_get(iface, &ipv6));
	zassert_true(ipv6->unicast[0].is_used, "malformed sync removed the previous address");
	zassert_mem_equal(ipv6->unicast[0].address.in6_addr.s6_addr,
			  expected_addr, sizeof(expected_addr),
			  "malformed sync changed the previous address");

	net_mgmt_del_event_callback(&event_cb);
	sync_event_iface = NULL;
}

ZTEST_SUITE(dect_rpc_client_sync, NULL, NULL, tc_setup, NULL, NULL);
```
