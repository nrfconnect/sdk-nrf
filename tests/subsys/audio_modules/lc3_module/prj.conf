## CMakeLists.txt
```
#
# Copyright (c) 2024 Nordic Semiconductor ASA
#
# SPDX-License-Identifier: LicenseRef-Nordic-5-Clause
#

cmake_minimum_required(VERSION 3.20.0)

find_package(Zephyr REQUIRED HINTS $ENV{ZEPHYR_BASE})
project("Audio T2 LC3 module")

target_sources(app PRIVATE
	src/main.c
	src/fakes.c
	src/decoder_test.c
)

zephyr_include_directories(
	${NRFXLIB_DIR}/lc3/codec/inc
	${NRFXLIB_DIR}/lc3/platform/os/inc
	${NRFXLIB_DIR}/lc3/platform/os/baremetal/inc
)
```

## prj.conf
```kconfig
#
# Copyright (c) 2024 Nordic Semiconductor ASA
#
# SPDX-License-Identifier: LicenseRef-Nordic-5-Clause
#
CONFIG_ZTEST=y
CONFIG_ZTEST_STACK_SIZE=8000
CONFIG_IRQ_OFFLOAD=y
CONFIG_DATA_FIFO=y
CONFIG_AUDIO_MODULE=y
CONFIG_AUDIO_MODULE_T2_LC3_DECODER_TEST=y
CONFIG_AUDIO_MODULE_T2_LC3_DECODER=y

# Added large stack sizes. Can be optimized.
CONFIG_MAIN_STACK_SIZE=18000

# Decoder settings
CONFIG_SW_CODEC_LC3_T2_SOFTWARE=y
CONFIG_LC3_DECODER_BIT_DEPTH_16=y
CONFIG_LC3_DECODER_FRAME_DURATION_10_MS=y
CONFIG_LC3_DECODER_SAMPLE_RATE_48000_HZ=y
CONFIG_LC3_DECODER_BIT_DEPTH_16=y

CONFIG_STACK_SENTINEL=y
```

## src/main.c
```c
/*
 * Copyright (c) 2024 Nordic Semiconductor ASA
 *
 * SPDX-License-Identifier: LicenseRef-Nordic-5-Clause
 */

#include <zephyr/fff.h>
#include <zephyr/ztest.h>
#include <errno.h>
#include "fakes.h"

/* This function runs before each test */
static void run_before(void *fixture)
{
	ARG_UNUSED(fixture);

	/* Register resets */
	DO_FOREACH_FAKE(RESET_FAKE);

	/* Reset common FFF internal structures */
	FFF_RESET_HISTORY();
}

ZTEST_SUITE(suite_lc3_decoder_functional, NULL, NULL, run_before, NULL, NULL);
```

## src/fakes.c
```c
/*
 * Copyright (c) 2024 Nordic Semiconductor ASA
 *
 * SPDX-License-Identifier: LicenseRef-Nordic-5-Clause
 */

#include <zephyr/fff.h>
#include <zephyr/ztest.h>
#include <errno.h>
#include <stdint.h>

#include "LC3API.h"
#include "fakes.h"
#include "lc3_test_common.h"

#include <zephyr/logging/log.h>
LOG_MODULE_REGISTER(module_fakes, 4);

#define TEST_ENC_SESSIONS_NUM (5)
#define TEST_DEC_SESSIONS_NUM (10)

struct lc3_dec_session {
	bool session_init;
	uint8_t *ref_data;
	int ref_read_size;
	int ref_remaining;
};

uint8_t *wav_ref;
int wav_ref_size;
int wav_ref_read_size;

static int enc_count;
static int dec_count;
static LC3DecoderHandle_t enc_session[TEST_ENC_SESSIONS_NUM];

struct lc3_dec_session dec_session_ctx[TEST_DEC_SESSIONS_NUM];

/*
 * Stubs are defined here, so that multiple .C files can share them
 * without having linker issues.
 */
DEFINE_FFF_GLOBALS;

DEFINE_FAKE_VALUE_FUNC(int32_t OSALCALL, LC3Initialize, uint8_t, uint8_t, LC3FrameSizeConfig_t,
		       uint8_t, uint8_t *, uint32_t *);
DEFINE_FAKE_VALUE_FUNC(int32_t OSALCALL, LC3Deinitialize);
DEFINE_FAKE_VALUE_FUNC(LC3EncoderHandle_t OSALCALL, LC3EncodeSessionOpen, uint16_t, uint8_t,
		       LC3FrameSize_t, uint8_t *, uint16_t *, int32_t *);
DEFINE_FAKE_VALUE_FUNC(int32_t OSALCALL, LC3EncodeSessionData, LC3EncoderHandle_t,
		       LC3EncodeInput_t *, LC3EncodeOutput_t *);
DEFINE_FAKE_VOID_FUNC1(LC3EncodeSessionClose, LC3EncoderHandle_t);
DEFINE_FAKE_VALUE_FUNC(LC3DecoderHandle_t, LC3DecodeSessionOpen, uint16_t, uint8_t, LC3FrameSize_t,
		       uint8_t *, uint16_t *, int32_t *);
DEFINE_FAKE_VALUE_FUNC(int32_t, LC3DecodeSessionData, LC3DecoderHandle_t, LC3DecodeInput_t *,
		       LC3DecodeOutput_t *);
DEFINE_FAKE_VOID_FUNC1(LC3DecodeSessionClose, LC3DecoderHandle_t);
DEFINE_FAKE_VALUE_FUNC(uint16_t, LC3BitstreamBuffersize, uint16_t, uint32_t, LC3FrameSize_t,
		       int32_t *);
DEFINE_FAKE_VALUE_FUNC(uint16_t, LC3PCMBuffersize, uint16_t, uint8_t, LC3FrameSize_t, int32_t *);

/* Custom fakes implementation */
int32_t fake_LC3Initialize__succeeds(uint8_t encoderSampleRates, uint8_t decoderSampleRates,
				     LC3FrameSizeConfig_t frameSizeConfig, uint8_t uniqueSessions,
				     uint8_t *buffer, uint32_t *bufferSize)
{
	ARG_UNUSED(encoderSampleRates);
	ARG_UNUSED(decoderSampleRates);
	ARG_UNUSED(frameSizeConfig);
	ARG_UNUSED(uniqueSessions);
	ARG_UNUSED(buffer);
	ARG_UNUSED(bufferSize);

	enc_count = 0;
	dec_count = 0;

	for (int i = 0; i < TEST_DEC_SESSIONS_NUM; i++) {
		dec_session_ctx[i].session_init = false;
		dec_session_ctx[i].ref_data = NULL;
		dec_session_ctx[i].ref_read_size = 0;
		dec_session_ctx[i].ref_remaining = 0;
	}

	return 0;
}

/* Custom fakes implementation */
int32_t fake_LC3Initialize__fails(uint8_t encoderSampleRates, uint8_t decoderSampleRates,
				  LC3FrameSizeConfig_t frameSizeConfig, uint8_t uniqueSessions,
				  uint8_t *buffer, uint32_t *bufferSize)
{
	ARG_UNUSED(encoderSampleRates);
	ARG_UNUSED(decoderSampleRates);
	ARG_UNUSED(frameSizeConfig);
	ARG_UNUSED(uniqueSessions);
	ARG_UNUSED(buffer);
	ARG_UNUSED(bufferSize);

	return -1;
}

/* Custom fakes implementation */
int32_t fake_LC3Deinitialize__succeeds(void)
{
	enc_count = 0;
	dec_count = 0;

	for (int i = 0; i < TEST_DEC_SESSIONS_NUM; i++) {
		dec_session_ctx[i].session_init = false;
		dec_session_ctx[i].ref_data = NULL;
		dec_session_ctx[i].ref_read_size = 0;
		dec_session_ctx[i].ref_remaining = 0;
	}

	return 0;
}

/* Custom fakes implementation */
int32_t fake_LC3Deinitialize__fails(void)
{
	return -1;
}

/* Custom fakes implementation */
LC3EncoderHandle_t fake_LC3EncodeSessionOpen__succeeds(uint16_t sampleRate, uint8_t bitsPerSample,
						       LC3FrameSize_t frameSize, uint8_t *buffer,
						       uint16_t *bufferSize, int32_t *result)
{
	ARG_UNUSED(sampleRate);
	ARG_UNUSED(bitsPerSample);
	ARG_UNUSED(frameSize);
	ARG_UNUSED(buffer);
	ARG_UNUSED(bufferSize);
	ARG_UNUSED(result);

	return &enc_session[enc_count++];
}

/* Custom fakes implementation */
LC3EncoderHandle_t fake_LC3EncodeSessionOpen__fails(uint16_t sampleRate, uint8_t bitsPerSample,
						    LC3FrameSize_t frameSize, uint8_t *buffer,
						    uint16_t *bufferSize, int32_t *result)
{
	ARG_UNUSED(sampleRate);
	ARG_UNUSED(bitsPerSample);
	ARG_UNUSED(frameSize);
	ARG_UNUSED(buffer);
	ARG_UNUSED(bufferSize);
	ARG_UNUSED(result);

	return NULL;
}

int32_t fake_LC3EncodeSessionData__succeeds(LC3EncoderHandle_t encodeHandle,
					    LC3EncodeInput_t *encodeInput,
					    LC3EncodeOutput_t *encodeOutput)
{
	ARG_UNUSED(encodeHandle);
	ARG_UNUSED(encodeInput);
	ARG_UNUSED(encodeOutput);

	return 0;
}

int32_t fake_LC3EncodeSessionData__fails(LC3EncoderHandle_t encodeHandle,
					 LC3EncodeInput_t *encodeInput,
					 LC3EncodeOutput_t *encodeOutput)
{
	ARG_UNUSED(encodeHandle);
	ARG_UNUSED(encodeInput);
	ARG_UNUSED(encodeOutput);

	return -1;
}

void fake_LC3EncodeSessionClose__succeeds(LC3EncoderHandle_t encodeHandle)
{
	ARG_UNUSED(encodeHandle);
}

void fake_LC3EncodeSessionClose__fails(LC3EncoderHandle_t encodeHandle)
{
	ARG_UNUSED(encodeHandle);
}

LC3DecoderHandle_t fake_LC3DecodeSessionOpen__succeeds(uint16_t sampleRate, uint8_t bitsPerSample,
						       LC3FrameSize_t frameSize, uint8_t *buffer,
						       uint16_t *bufferSize, int32_t *result)
{
	ARG_UNUSED(sampleRate);
	ARG_UNUSED(bitsPerSample);
	ARG_UNUSED(frameSize);
	ARG_UNUSED(buffer);
	ARG_UNUSED(bufferSize);
	struct lc3_dec_session *session = (struct lc3_dec_session *)&dec_session_ctx[dec_count];

	session->session_init = true;
	session->ref_data = wav_ref;
	session->ref_read_size = wav_ref_read_size;
	session->ref_remaining = wav_ref_size;

	dec_count++;

	*result = 0;

	return (void *)session;
}

LC3DecoderHandle_t fake_LC3DecodeSessionOpen__fails(uint16_t sampleRate, uint8_t bitsPerSample,
						    LC3FrameSize_t frameSize, uint8_t *buffer,
						    uint16_t *bufferSize, int32_t *result)
{
	ARG_UNUSED(sampleRate);
	ARG_UNUSED(bitsPerSample);
	ARG_UNUSED(frameSize);
	ARG_UNUSED(buffer);
	ARG_UNUSED(bufferSize);

	*result = -1;

	return NULL;
}

int32_t fake_LC3DecodeSessionData__succeeds(LC3DecoderHandle_t decodeHandle,
					    LC3DecodeInput_t *decodeInput,
					    LC3DecodeOutput_t *decodeOutput)
{
	ARG_UNUSED(decodeInput);
	struct lc3_dec_session *session = (struct lc3_dec_session *)decodeHandle;
	uint8_t *data_out = (uint8_t *)decodeOutput->PCMData;
	uint8_t *ref_data = session->ref_data;
	int size;

	if (session->ref_read_size > session->ref_remaining) {
		size = session->ref_remaining;
		session->ref_remaining = 0;
	} else {
		size = session->ref_read_size;
		session->ref_remaining -= session->ref_read_size;
	}

	for (int i = 0; i < size; i++) {
		*data_out++ = *ref_data++;
	}

	session->ref_data = ref_data;

	decodeOutput->bytesWritten = size;

	return 0;
}

int32_t fake_LC3DecodeSessionData__fails(LC3DecoderHandle_t decodeHandle,
					 LC3DecodeInput_t *decodeInput,
					 LC3DecodeOutput_t *decodeOutput)
{
	ARG_UNUSED(decodeHandle);
	ARG_UNUSED(decodeInput);
	ARG_UNUSED(decodeOutput);

	return -1;
}

void fake_LC3DecodeSessionClose__succeeds(LC3DecoderHandle_t decodeHandle)
{
	struct lc3_dec_session *session = (struct lc3_dec_session *)decodeHandle;

	session->session_init = false;
	session->ref_data = NULL;
	session->ref_read_size = 0;
}

void fake_LC3DecodeSessionClose__fails(LC3DecoderHandle_t decodeHandle)
{
	ARG_UNUSED(decodeHandle);
}

uint16_t fake_LC3BitstreamBuffersize__succeeds(uint16_t sampleRate, uint32_t maxBitRate,
					       LC3FrameSize_t frameSize, int32_t *result)
{
	ARG_UNUSED(sampleRate);
	ARG_UNUSED(maxBitRate);
	ARG_UNUSED(frameSize);
	ARG_UNUSED(result);

	return TEST_ENC_MONO_BUF_SIZE;
}

uint16_t fake_LC3BitstreamBuffersize__fails(uint16_t sampleRate, uint32_t maxBitRate,
					    LC3FrameSize_t frameSize, int32_t *result)
{
	ARG_UNUSED(sampleRate);
	ARG_UNUSED(maxBitRate);
	ARG_UNUSED(frameSize);
	ARG_UNUSED(result);

	return 0;
}

uint16_t fake_LC3PCMBuffersize__succeeds(uint16_t sampleRate, uint8_t bitDepth,
					 LC3FrameSize_t frameSize, int32_t *result)
{
	ARG_UNUSED(sampleRate);
	ARG_UNUSED(bitDepth);
	ARG_UNUSED(frameSize);
	ARG_UNUSED(result);

	return 0;
}

uint16_t fake_LC3PCMBuffersize__fails(uint16_t sampleRate, uint8_t bitDepth,
				      LC3FrameSize_t frameSize, int32_t *result)
{
	ARG_UNUSED(sampleRate);
	ARG_UNUSED(bitDepth);
	ARG_UNUSED(frameSize);
	ARG_UNUSED(result);

	return -1;
}
```

## src/fakes.h
```c
/*
 * Copyright (c) 2024 Nordic Semiconductor ASA
 *
 * SPDX-License-Identifier: LicenseRef-Nordic-5-Clause
 */

#ifndef _FAKES_H_
#define _FAKES_H_

#include <zephyr/fff.h>
#include <zephyr/ztest.h>
#include <errno.h>
#include <stdint.h>

#include "LC3API.h"

/* Fake functions declaration */
DECLARE_FAKE_VALUE_FUNC(int32_t, LC3Initialize, uint8_t, uint8_t, LC3FrameSizeConfig_t, uint8_t,
			uint8_t *, uint32_t *);
DECLARE_FAKE_VALUE_FUNC(int32_t OSALCALL, LC3Deinitialize);
DECLARE_FAKE_VALUE_FUNC(LC3EncoderHandle_t OSALCALL, LC3EncodeSessionOpen, uint16_t, uint8_t,
			LC3FrameSize_t, uint8_t *, uint16_t *, int32_t *);
DECLARE_FAKE_VALUE_FUNC(int32_t, LC3EncodeSessionData, LC3EncoderHandle_t, LC3EncodeInput_t *,
			LC3EncodeOutput_t *);
DECLARE_FAKE_VOID_FUNC1(LC3EncodeSessionClose, LC3EncoderHandle_t);
DECLARE_FAKE_VALUE_FUNC(LC3DecoderHandle_t, LC3DecodeSessionOpen, uint16_t, uint8_t, LC3FrameSize_t,
			uint8_t *, uint16_t *, int32_t *);
DECLARE_FAKE_VALUE_FUNC(int32_t, LC3DecodeSessionData, LC3DecoderHandle_t, LC3DecodeInput_t *,
			LC3DecodeOutput_t *);
DECLARE_FAKE_VOID_FUNC1(LC3DecodeSessionClose, LC3DecoderHandle_t);
DECLARE_FAKE_VALUE_FUNC(uint16_t, LC3BitstreamBuffersize, uint16_t, uint32_t, LC3FrameSize_t,
			int32_t *);
DECLARE_FAKE_VALUE_FUNC(uint16_t, LC3PCMBuffersize, uint16_t, uint8_t, LC3FrameSize_t, int32_t *);

/* List of fakes used by this unit tester */
#define DO_FOREACH_FAKE(FUNC)                                                                      \
	do {                                                                                       \
		FUNC(LC3Initialize)                                                                \
		FUNC(LC3Deinitialize)                                                              \
		FUNC(LC3EncodeSessionOpen)                                                         \
		FUNC(LC3EncodeSessionData)                                                         \
		FUNC(LC3EncodeSessionClose)                                                        \
		FUNC(LC3DecodeSessionOpen)                                                         \
		FUNC(LC3DecodeSessionData)                                                         \
		FUNC(LC3DecodeSessionClose)                                                        \
		FUNC(LC3BitstreamBuffersize)                                                       \
		FUNC(LC3PCMBuffersize)                                                             \
	} while (0)

int32_t fake_LC3Initialize__succeeds(uint8_t encoderSampleRates, uint8_t decoderSampleRates,
				     LC3FrameSizeConfig_t frameSizeConfig, uint8_t uniqueSessions,
				     uint8_t *buffer, uint32_t *bufferSize);
int32_t fake_LC3Initialize__fails(uint8_t encoderSampleRates, uint8_t decoderSampleRates,
				  LC3FrameSizeConfig_t frameSizeConfig, uint8_t uniqueSessions,
				  uint8_t *buffer, uint32_t *bufferSize);
int32_t fake_LC3Deinitialize__succeeds(void);
int32_t fake_LC3Deinitialize__fails(void);
LC3EncoderHandle_t fake_LC3EncodeSessionOpen__succeeds(uint16_t sampleRate, uint8_t bitsPerSample,
						       LC3FrameSize_t frameSize, uint8_t *buffer,
						       uint16_t *bufferSize, int32_t *result);
LC3EncoderHandle_t fake_LC3EncodeSessionOpen__fails(uint16_t sampleRate, uint8_t bitsPerSample,
						    LC3FrameSize_t frameSize, uint8_t *buffer,
						    uint16_t *bufferSize, int32_t *result);
int32_t fake_LC3EncodeSessionData__succeeds(LC3EncoderHandle_t encodeHandle,
					    LC3EncodeInput_t *encodeInput,
					    LC3EncodeOutput_t *encodeOutput);
int32_t fake_LC3EncodeSessionData__fails(LC3EncoderHandle_t encodeHandle,
					 LC3EncodeInput_t *encodeInput,
					 LC3EncodeOutput_t *encodeOutput);
void fake_LC3EncodeSessionClose__succeeds(LC3EncoderHandle_t encodeHandle);
void fake_LC3EncodeSessionClose__fails(LC3EncoderHandle_t encodeHandle);
LC3DecoderHandle_t fake_LC3DecodeSessionOpen__succeeds(uint16_t sampleRate, uint8_t bitsPerSample,
						       LC3FrameSize_t frameSize, uint8_t *buffer,
						       uint16_t *bufferSize, int32_t *result);
LC3DecoderHandle_t fake_LC3DecodeSessionOpen__fails(uint16_t sampleRate, uint8_t bitsPerSample,
						    LC3FrameSize_t frameSize, uint8_t *buffer,
						    uint16_t *bufferSize, int32_t *result);
int32_t fake_LC3DecodeSessionData__succeeds(LC3DecoderHandle_t decodeHandle,
					    LC3DecodeInput_t *decodeInput,
					    LC3DecodeOutput_t *decodeOutput);
int32_t fake_LC3DecodeSessionData__fails(LC3DecoderHandle_t decodeHandle,
					 LC3DecodeInput_t *decodeInput,
					 LC3DecodeOutput_t *decodeOutput);
void fake_LC3DecodeSessionClose__succeeds(LC3DecoderHandle_t decodeHandle);
void fake_LC3DecodeSessionClose__fails(LC3DecoderHandle_t decodeHandle);
uint16_t fake_LC3BitstreamBuffersize__succeeds(uint16_t sampleRate, uint32_t maxBitRate,
					       LC3FrameSize_t frameSize, int32_t *result);
uint16_t fake_LC3BitstreamBuffersize__fails(uint16_t sampleRate, uint32_t maxBitRate,
					    LC3FrameSize_t frameSize, int32_t *result);
uint16_t fake_LC3PCMBuffersize__succeeds(uint16_t sampleRate, uint8_t bitDepth,
					 LC3FrameSize_t frameSize, int32_t *result);
uint16_t fake_LC3PCMBuffersize__fails(uint16_t sampleRate, uint8_t bitDepth,
				      LC3FrameSize_t frameSize, int32_t *result);

extern uint8_t *wav_ref;
extern int wav_ref_size;
extern int wav_ref_read_size;

#endif /* _FAKES_H_ */
```

## src/lc3_test_common.h
```c
/*
 * Copyright (c) 2024 Nordic Semiconductor ASA
 *
 * SPDX-License-Identifier: LicenseRef-Nordic-5-Clause
 */

#ifndef _COMMON_H_
#define _COMMON_H_

#include "audio_module/audio_module.h"

#define TEST_SAMPLE_BIT_DEPTH	    16
#define TEST_PCM_BIT_DEPTH	    16
#define TEST_ENC_MONO_BUF_SIZE	    120
#define TEST_ENC_STEREO_BUF_SIZE    (TEST_ENC_MONO_BUF_SIZE * 2)
#define TEST_DEC_MONO_BUF_SIZE	    960
#define TEST_DEC_MONO_BUF_SAMPLES   (TEST_DEC_MONO_BUF_SIZE / (TEST_PCM_BIT_DEPTH / 8))
#define TEST_DEC_STEREO_BUF_SIZE    (TEST_DEC_MONO_BUF_SIZE * 2)
#define TEST_DEC_STEREO_BUF_SAMPLES (TEST_DEC_STEREO_BUF_SIZE / (TEST_PCM_BIT_DEPTH / 8))
#define TEST_PCM_SAMPLE_RATE	    48000
#define TEST_LC3_BITRATE	    96000
#define TEST_LC3_FRAME_SIZE_US	    10000

#define TEST_AUDIO_CHANNELS_MONO      1
#define TEST_AUDIO_CHANNELS_DUAL_MONO 2
#define TEST_AUDIO_CHANNELS_STEREO    2
#define TEST_AUDIO_CHANNELS_MAX	      6

#define TEST_AUDIO_MONO_LEFT_LOCATIONS	   (1 << AUDIO_CH_L)
#define TEST_AUDIO_MONO_RIGHT_LOCATIONS	   (1 << AUDIO_CH_R)
#define TEST_AUDIO_STEREO_LOCATIONS	   ((1 << AUDIO_CH_L) | (1 << AUDIO_CH_R))
#define TEST_AUDIO_MULTI_CHANNEL_LOCATIONS ((1 << AUDIO_CH_L) | (1 << AUDIO_CH_R))

#define TEST_ENC_MULTI_BUF_SIZE (TEST_ENC_MONO_BUF_SIZE * TEST_AUDIO_CHANNELS_MAX)
#define TEST_DEC_MULTI_BUF_SIZE (TEST_DEC_MONO_BUF_SIZE * TEST_AUDIO_CHANNELS_MAX)

#endif /* _COMMON_H_ */
```

## src/sweep21ms_16b48khz_mono_lc3_in.h
```c
/*
 * Copyright (c) 2024 Nordic Semiconductor ASA
 *
 * SPDX-License-Identifier:  LicenseRef-Nordic-5-Clause
 */

#ifndef _LC3_IN_H_
#define _LC3_IN_H_

#include <stdint.h>

#define LC3_MONO_IN_SIZE (384)

uint8_t lc3_mono_in[LC3_MONO_IN_SIZE] = {
	0x1C, 0xCC, 0x12, 0x00, 0xE0, 0x01, 0xC0, 0x03, 0x01, 0x00, 0xE8, 0x03, 0x00, 0x00, 0xE8,
	0x03, 0x00, 0x00, 0x78, 0x00, 0x45, 0x0B, 0x24, 0xBE, 0x5E, 0xAC, 0xFA, 0x38, 0xEE, 0x5B,
	0xFD, 0x7C, 0x8B, 0x9E, 0xF8, 0xC9, 0xF7, 0xED, 0xB9, 0x2C, 0x2A, 0xB3, 0x73, 0x7A, 0x1B,
	0x99, 0x1B, 0x65, 0x5E, 0x44, 0x7D, 0x5A, 0x3A, 0xDE, 0x9F, 0x2F, 0xD8, 0x1B, 0x65, 0xE4,
	0x2E, 0x21, 0x8D, 0x82, 0x21, 0x03, 0x35, 0x00, 0x15, 0xA9, 0xDE, 0x67, 0xA1, 0xF0, 0x00,
	0x00, 0x05, 0x5A, 0x78, 0xE2, 0x7F, 0x08, 0xAB, 0xFE, 0x0B, 0x91, 0xEA, 0x8B, 0x7E, 0x9B,
	0x1E, 0xB4, 0xFE, 0xBE, 0x7C, 0xAC, 0xC7, 0x0B, 0xE8, 0x2F, 0xA0, 0x86, 0x31, 0x5F, 0x5F,
	0x47, 0x2A, 0xF0, 0x3C, 0x47, 0x06, 0x52, 0xFB, 0x08, 0x14, 0xF2, 0x36, 0x17, 0xB2, 0x16,
	0x1F, 0x65, 0x08, 0x3B, 0x23, 0x72, 0x3C, 0x16, 0x01, 0x71, 0xC2, 0xA2, 0xBF, 0x14, 0xAA,
	0x33, 0x9C, 0x3A, 0xA6, 0x3C, 0x78, 0x00, 0x6A, 0x58, 0x75, 0x1A, 0x61, 0x1E, 0xBE, 0xE5,
	0xE8, 0x7A, 0x7D, 0xB0, 0x4D, 0x06, 0x71, 0x53, 0xB9, 0x60, 0xF3, 0x10, 0x1A, 0x03, 0xFB,
	0x47, 0x29, 0x23, 0x12, 0x5A, 0x05, 0x01, 0xA5, 0xB4, 0x20, 0x6F, 0xEA, 0xEF, 0x11, 0x39,
	0xE1, 0x0E, 0x13, 0x21, 0x45, 0x62, 0x4F, 0x18, 0xD8, 0xF9, 0x04, 0xD9, 0x70, 0xCA, 0xF0,
	0xF1, 0x61, 0xC7, 0xD2, 0x3D, 0x2D, 0xF6, 0x87, 0xC8, 0xC6, 0x43, 0x16, 0xCD, 0xD5, 0xAB,
	0xF0, 0x4D, 0xBF, 0xFF, 0x00, 0x00, 0x1F, 0xFC, 0x03, 0xF8, 0x1F, 0x83, 0xE1, 0xE0, 0x74,
	0x7F, 0xC4, 0xB9, 0x42, 0x73, 0x22, 0xCC, 0xD6, 0xD0, 0xDC, 0x06, 0xB4, 0xB2, 0x27, 0x4B,
	0xF2, 0x35, 0x3E, 0x21, 0xC2, 0xE5, 0x83, 0x59, 0x65, 0x69, 0x29, 0x8D, 0x65, 0x92, 0xE0,
	0xF9, 0x9C, 0x08, 0xD6, 0x3F, 0x93, 0x84, 0x78, 0x00, 0xA3, 0xDB, 0xB6, 0x61, 0x33, 0x77,
	0xF9, 0x63, 0x88, 0x1B, 0xC6, 0x03, 0x73, 0x20, 0x04, 0xFF, 0xEF, 0xE8, 0x38, 0x01, 0x35,
	0x97, 0x6A, 0x6D, 0x93, 0xDF, 0x1C, 0x26, 0x0E, 0x99, 0x82, 0x14, 0xCB, 0x08, 0xCF, 0x19,
	0x95, 0x4A, 0x6D, 0x13, 0xCD, 0xDF, 0xEF, 0x17, 0xF1, 0xF6, 0xC5, 0xFA, 0x41, 0xA0, 0x9B,
	0x45, 0x6E, 0xCE, 0xD6, 0x87, 0xCF, 0x9E, 0x05, 0x1C, 0x31, 0x38, 0x7B, 0xAB, 0x9B, 0x60,
	0x8F, 0xA2, 0x18, 0xC8, 0x70, 0x81, 0xEA, 0xAE, 0x06, 0xF6, 0x11, 0x45, 0xA2, 0xBA, 0x17,
	0xA5, 0x72, 0x02, 0xAF, 0x2A, 0xA5, 0x56, 0x35, 0x4A, 0x8A, 0x6D, 0x0F, 0xC5, 0x51, 0xA9,
	0x25, 0x5B, 0x1A, 0x94, 0xF1, 0xB7, 0xF1, 0x0C, 0xC0, 0xD4, 0xFB, 0x1D, 0x6B, 0x62, 0xF9,
	0x61, 0x83, 0xB9, 0x3F, 0xE9, 0xF1, 0x3D, 0x75, 0x2C,
};

#endif /* _LC3_IN_H_ */
```

## src/sweep21ms_16b48khz_mono_lc3_ref.h
```c
/*
 * Copyright (c) 2024 Nordic Semiconductor ASA
 *
 * SPDX-License-Identifier:  LicenseRef-Nordic-5-Clause
 */

#ifndef _LC3_REF_H_
#define _LC3_REF_H_

#include <stdint.h>

#define LC3_MONO_REF_SIZE (384)

uint8_t lc3_mono_ref[LC3_MONO_REF_SIZE] = {
	0x1C, 0xCC, 0x12, 0x00, 0xE0, 0x01, 0xC0, 0x03, 0x01, 0x00, 0xE8, 0x03, 0x00, 0x00, 0xE8,
	0x03, 0x00, 0x00, 0x78, 0x00, 0x45, 0x0B, 0x24, 0xBE, 0x5E, 0xAC, 0xFA, 0x38, 0xEE, 0x5B,
	0xFD, 0x7C, 0x8B, 0x9E, 0xF8, 0xC9, 0xF7, 0xED, 0xB9, 0x2C, 0x2A, 0xB3, 0x73, 0x7A, 0x1B,
	0x99, 0x1B, 0x65, 0x5E, 0x44, 0x7D, 0x5A, 0x3A, 0xDE, 0x9F, 0x2F, 0xD8, 0x1B, 0x65, 0xE4,
	0x2E, 0x21, 0x8D, 0x82, 0x21, 0x03, 0x35, 0x00, 0x15, 0xA9, 0xDE, 0x67, 0xA1, 0xF0, 0x00,
	0x00, 0x05, 0x5A, 0x78, 0xE2, 0x7F, 0x08, 0xAB, 0xFE, 0x0B, 0x91, 0xEA, 0x8B, 0x7E, 0x9B,
	0x1E, 0xB4, 0xFE, 0xBE, 0x7C, 0xAC, 0xC7, 0x0B, 0xE8, 0x2F, 0xA0, 0x86, 0x31, 0x5F, 0x5F,
	0x47, 0x2A, 0xF0, 0x3C, 0x47, 0x06, 0x52, 0xFB, 0x08, 0x14, 0xF2, 0x36, 0x17, 0xB2, 0x16,
	0x1F, 0x65, 0x08, 0x3B, 0x23, 0x72, 0x3C, 0x16, 0x01, 0x71, 0xC2, 0xA2, 0xBF, 0x14, 0xAA,
	0x33, 0x9C, 0x3A, 0xA6, 0x3C, 0x78, 0x00, 0x6A, 0x58, 0x75, 0x1A, 0x61, 0x1E, 0xBE, 0xE5,
	0xE8, 0x7A, 0x7D, 0xB0, 0x4D, 0x06, 0x71, 0x53, 0xB9, 0x60, 0xF3, 0x10, 0x1A, 0x03, 0xFB,
	0x47, 0x29, 0x23, 0x12, 0x5A, 0x05, 0x01, 0xA5, 0xB4, 0x20, 0x6F, 0xEA, 0xEF, 0x11, 0x39,
	0xE1, 0x0E, 0x13, 0x21, 0x45, 0x62, 0x4F, 0x18, 0xD8, 0xF9, 0x04, 0xD9, 0x70, 0xCA, 0xF0,
	0xF1, 0x61, 0xC7, 0xD2, 0x3D, 0x2D, 0xF6, 0x87, 0xC8, 0xC6, 0x43, 0x16, 0xCD, 0xD5, 0xAB,
	0xF0, 0x4D, 0xBF, 0xFF, 0x00, 0x00, 0x1F, 0xFC, 0x03, 0xF8, 0x1F, 0x83, 0xE1, 0xE0, 0x74,
	0x7F, 0xC4, 0xB9, 0x42, 0x73, 0x22, 0xCC, 0xD6, 0xD0, 0xDC, 0x06, 0xB4, 0xB2, 0x27, 0x4B,
	0xF2, 0x35, 0x3E, 0x21, 0xC2, 0xE5, 0x83, 0x59, 0x65, 0x69, 0x29, 0x8D, 0x65, 0x92, 0xE0,
	0xF9, 0x9C, 0x08, 0xD6, 0x3F, 0x93, 0x84, 0x78, 0x00, 0xA3, 0xDB, 0xB6, 0x61, 0x33, 0x77,
	0xF9, 0x63, 0x88, 0x1B, 0xC6, 0x03, 0x73, 0x20, 0x04, 0xFF, 0xEF, 0xE8, 0x38, 0x01, 0x35,
	0x97, 0x6A, 0x6D, 0x93, 0xDF, 0x1C, 0x26, 0x0E, 0x99, 0x82, 0x14, 0xCB, 0x08, 0xCF, 0x19,
	0x95, 0x4A, 0x6D, 0x13, 0xCD, 0xDF, 0xEF, 0x17, 0xF1, 0xF6, 0xC5, 0xFA, 0x41, 0xA0, 0x9B,
	0x45, 0x6E, 0xCE, 0xD6, 0x87, 0xCF, 0x9E, 0x05, 0x1C, 0x31, 0x38, 0x7B, 0xAB, 0x9B, 0x60,
	0x8F, 0xA2, 0x18, 0xC8, 0x70, 0x81, 0xEA, 0xAE, 0x06, 0xF6, 0x11, 0x45, 0xA2, 0xBA, 0x17,
	0xA5, 0x72, 0x02, 0xAF, 0x2A, 0xA5, 0x56, 0x35, 0x4A, 0x8A, 0x6D, 0x0F, 0xC5, 0x51, 0xA9,
	0x25, 0x5B, 0x1A, 0x94, 0xF1, 0xB7, 0xF1, 0x0C, 0xC0, 0xD4, 0xFB, 0x1D, 0x6B, 0x62, 0xF9,
	0x61, 0x83, 0xB9, 0x3F, 0xE9, 0xF1, 0x3D, 0x75, 0x2C,
};

#endif /* _LC3_REF_H_ */
```

## src/sweep21ms_16b48khz_mono_wav_in.h
```c
/*
 * Copyright (c) 2024 Nordic Semiconductor ASA
 *
 * SPDX-License-Identifier:  LicenseRef-Nordic-5-Clause
 */

#ifndef _WAV_IN_H_
#define _WAV_IN_H_

#include <stdint.h>

#define WAV_MONO_IN_SIZE (1000)

uint16_t wav_mono_in[WAV_IN_SIZE] = {
	0xFFFF, 0x0047, 0x0087, 0x00D1, 0x0116, 0x0159, 0x01A7, 0x01E7, 0x0234, 0x027C, 0x02C2,
	0x030F, 0x0357, 0x03A2, 0x03EE, 0x0437, 0x0487, 0x04CE, 0x0522, 0x056A, 0x05B9, 0x060B,
	0x0657, 0x06A7, 0x06FA, 0x0746, 0x079C, 0x07EB, 0x0840, 0x0890, 0x08E6, 0x0939, 0x098C,
	0x09E6, 0x0A36, 0x0A91, 0x0AE4, 0x0B3F, 0x0B95, 0x0BEE, 0x0C49, 0x0C9D, 0x0D01, 0x0D51,
	0x0DB7, 0x0E0B, 0x0E6C, 0x0EC9, 0x0F26, 0x0F84, 0x0FE4, 0x1045, 0x10A2, 0x1109, 0x1162,
	0x11CC, 0x1229, 0x1291, 0x12F1, 0x135B, 0x13B8, 0x1427, 0x1486, 0x14F2, 0x1559, 0x15BE,
	0x162D, 0x168F, 0x1702, 0x1765, 0x17D7, 0x183E, 0x18AE, 0x191B, 0x1987, 0x19F9, 0x1A66,
	0x1AD7, 0x1B47, 0x1BB9, 0x1C2B, 0x1C9C, 0x1D13, 0x1D81, 0x1DFB, 0x1E6E, 0x1EE2, 0x1F5D,
	0x1FCF, 0x204A, 0x20C1, 0x213B, 0x21B2, 0x2231, 0x22A6, 0x2328, 0x239D, 0x2421, 0x2497,
	0x251C, 0x2596, 0x2617, 0x2697, 0x2716, 0x2799, 0x281A, 0x289B, 0x2920, 0x29A1, 0x2A29,
	0x2AA8, 0x2B33, 0x2BB3, 0x2C3F, 0x2CC3, 0x2D4A, 0x2DD3, 0x2E5B, 0x2EE5, 0x2F6F, 0x2FF7,
	0x3084, 0x310D, 0x319B, 0x3226, 0x32B1, 0x3344, 0x33C8, 0x3460, 0x34E7, 0x357B, 0x3608,
	0x3698, 0x3727, 0x37BB, 0x3848, 0x38DF, 0x3969, 0x3A02, 0x3A8F, 0x3B26, 0x3BB7, 0x3C4A,
	0x3CDF, 0x3D71, 0x3E06, 0x3E9B, 0x3F2E, 0x3FC4, 0x4057, 0x40EF, 0x4181, 0x4218, 0x42AE,
	0x433F, 0x43DC, 0x4469, 0x4505, 0x4597, 0x462F, 0x46C1, 0x475A, 0x47EB, 0x4884, 0x4916,
	0x49AC, 0x4A41, 0x4AD3, 0x4B69, 0x4BFA, 0x4C90, 0x4D21, 0x4DB4, 0x4E45, 0x4ED8, 0x4F67,
	0x4FFA, 0x5087, 0x5117, 0x51A7, 0x5231, 0x52C5, 0x5348, 0x53DE, 0x545C, 0x54F2, 0x5572,
	0x55FE, 0x5684, 0x5707, 0x578F, 0x5810, 0x5891, 0x5915, 0x5990, 0x5A13, 0x5A8B, 0x5B07,
	0x5B83, 0x5BF6, 0x5C71, 0x5CE2, 0x5D55, 0x5DC7, 0x5E35, 0x5EA0, 0x5F0E, 0x5F73, 0x5FDD,
	0x603C, 0x60A4, 0x60FE, 0x615F, 0x61B6, 0x6210, 0x6263, 0x62B8, 0x6305, 0x6352, 0x639D,
	0x63E2, 0x6425, 0x6467, 0x64A1, 0x64DC, 0x6512, 0x6543, 0x6573, 0x659C, 0x65C5, 0x65E7,
	0x6605, 0x6622, 0x6636, 0x664B, 0x6657, 0x6661, 0x6665, 0x6667, 0x6660, 0x6659, 0x6648,
	0x6634, 0x661E, 0x65FD, 0x65DC, 0x65B2, 0x6580, 0x6552, 0x6512, 0x64D5, 0x648F, 0x6440,
	0x63F1, 0x6395, 0x6339, 0x62D0, 0x6266, 0x61F0, 0x617A, 0x60F5, 0x6070, 0x5FDF, 0x5F49,
	0x5EAC, 0x5E05, 0x5D5B, 0x5CA4, 0x5BE9, 0x5B25, 0x5A58, 0x5987, 0x58A8, 0x57C6, 0x56D8,
	0x55E4, 0x54E7, 0x53E2, 0x52D2, 0x51BE, 0x509D, 0x4F74, 0x4E46, 0x4D07, 0x4BCB, 0x4A79,
	0x492B, 0x47C6, 0x4667, 0x44EF, 0x437F, 0x41F5, 0x4070, 0x3ED9, 0x3D3C, 0x3B97, 0x39E6,
	0x382F, 0x366D, 0x34A2, 0x32D1, 0x30F2, 0x2F10, 0x2D20, 0x2B2B, 0x292C, 0x2726, 0x2515,
	0x22FE, 0x20E0, 0x1EB4, 0x1C8D, 0x1A4C, 0x1818, 0x15CB, 0x1383, 0x1130, 0x0ED5, 0x0C76,
	0x0A12, 0x07A3, 0x0537, 0x02BE, 0x0045, 0xFDC6, 0xFB41, 0xF8BD, 0xF631, 0xF3A5, 0xF116,
	0xEE82, 0xEBF1, 0xE95B, 0xE6C7, 0xE431, 0xE19C, 0xDF08, 0xDC76, 0xD9E4, 0xD757, 0xD4CA,
	0xD245, 0xCFC1, 0xCD43, 0xCACC, 0xC857, 0xC5F1, 0xC38B, 0xC131, 0xBEE2, 0xBC98, 0xBA5F,
	0xB82B, 0xB60B, 0xB3EE, 0xB1EC, 0xAFEC, 0xAE05, 0xAC29, 0xAA60, 0xA8AA, 0xA706, 0xA578,
	0xA3FA, 0xA297, 0xA147, 0xA00F, 0x9EF1, 0x9DEA, 0x9CFD, 0x9C2C, 0x9B76, 0x9AD9, 0x9A62,
	0x99FC, 0x99C2, 0x999D, 0x999D, 0x99BD, 0x99FF, 0x9A5F, 0x9AE9, 0x9B8E, 0x9C5B, 0x9D4E,
	0x9E5E, 0x9F9C, 0xA0F8, 0xA27C, 0xA426, 0xA5F4, 0xA7E9, 0xAA04, 0xAC42, 0xAEA9, 0xB131,
	0xB3E2, 0xB6B3, 0xB9AE, 0xBCC5, 0xC005, 0xC360, 0xC6E6, 0xCA80, 0xCE45, 0xD21B, 0xD619,
	0xDA2C, 0xDE58, 0xE2A1, 0xE6F8, 0xEB6D, 0xEFEC, 0xF481, 0xF920, 0xFDD0, 0x0281, 0x0746,
	0x0BFF, 0x10CA, 0x1587, 0x1A48, 0x1EFE, 0x23AC, 0x284A, 0x2CDC, 0x3156, 0x35BB, 0x3A05,
	0x3E32, 0x423B, 0x4624, 0x49DF, 0x4D71, 0x50D5, 0x5403, 0x56FE, 0x59BD, 0x5C41, 0x5E83,
	0x6085, 0x623B, 0x63B2, 0x64D0, 0x65AF, 0x662E, 0x6669, 0x6644, 0x65CE, 0x6502, 0x63D7,
	0x625C, 0x607C, 0x5E4B, 0x5BBB, 0x58D2, 0x5593, 0x51FA, 0x4E0D, 0x49CC, 0x453B, 0x405A,
	0x3B34, 0x35C1, 0x3010, 0x2A23, 0x23F7, 0x1DA5, 0x171A, 0x1072, 0x09A8, 0x02C7, 0xFBD9,
	0xF4DE, 0xEDEE, 0xE6FA, 0xE027, 0xD965, 0xD2CC, 0xCC65, 0xC630, 0xC041, 0xBA9C, 0xB549,
	0xB05A, 0xABCB, 0xA7B0, 0xA40B, 0xA0E7, 0x9E49, 0x9C3A, 0x9ABF, 0x99DC, 0x999B, 0x99F9,
	0x9AFD, 0x9CA7, 0x9EF6, 0xA1F2, 0xA58D, 0xA9CD, 0xAEAC, 0xB420, 0xBA2A, 0xC0BD, 0xC7CF,
	0xCF57, 0xD74B, 0xDF97, 0xE836, 0xF111, 0xFA17, 0x0340, 0x0C69, 0x1591, 0x1E97, 0x276A,
	0x2FFD, 0x382D, 0x3FF3, 0x4734, 0x4DDE, 0x53DD, 0x5922, 0x5D98, 0x6133, 0x63E7, 0x65A0,
	0x6661, 0x6617, 0x64C3, 0x6267, 0x5EF6, 0x5A88, 0x550C, 0x4EA6, 0x4748, 0x3F1F, 0x3621,
	0x2C80, 0x2240, 0x178A, 0x0C77, 0x012B, 0xF5C6, 0xEA6F, 0xDF48, 0xD47C, 0xCA2B, 0xC083,
	0xB79F, 0xAFAA, 0xA8C4, 0xA307, 0x9E97, 0x9B7E, 0x99DF, 0x99B8, 0x9B22, 0x9E0E, 0xA28A,
	0xA87C, 0xAFE1, 0xB89A, 0xC28E, 0xCD96, 0xD988, 0xE63A, 0xF36F, 0x00FB, 0x0E91, 0x1C04,
	0x2907, 0x3564, 0x40D1, 0x4B1F, 0x5407, 0x5B5F, 0x60F8, 0x64A1, 0x6652, 0x65DE, 0x6351,
	0x5EA3, 0x57E3, 0x4F31, 0x44AE, 0x388D, 0x2B18, 0x1C7D, 0x0D33, 0xFD68, 0xEDA6, 0xDE2A,
	0xCF73, 0xC1D3, 0xB5AE, 0xAB61, 0xA32E, 0x9D6A, 0x9A33, 0x99C4, 0x9C1E, 0xA147, 0xA928,
	0xB392, 0xC048, 0xCEF5, 0xDF33, 0xF08B, 0x027E, 0x1477, 0x25F0, 0x364E, 0x4505, 0x5193,
	0x5B7B, 0x625E, 0x65F0, 0x65F8, 0x626C, 0x5B54, 0x50DF, 0x4363, 0x3346, 0x2126, 0x0D99,
	0xF969, 0xE555, 0xD22E, 0xC0C0, 0xB1CE, 0xA5FF, 0x9DE9, 0x99F6, 0x9A66, 0x9F51, 0xA890,
	0xB5D4, 0xC693, 0xDA1B, 0xEF8F, 0x05EE, 0x1C2D, 0x312F, 0x43E8, 0x534D, 0x5E97, 0x64FF,
	0x6631, 0x61EA, 0x5857, 0x49DD, 0x372D, 0x2144, 0x094C, 0xF0A6, 0xD8B5, 0xC2F8, 0xB0BA,
	0xA33E, 0x9B62, 0x99D2, 0x9EBA, 0xA9FA, 0xBAE8, 0xD08F, 0xE98A, 0x0439, 0x1ECD, 0x3764,
	0x4C36, 0x5BAF, 0x648F, 0x660B, 0x5FE0, 0x525C, 0x3E68, 0x256D, 0x0950, 0xEC3F, 0xD09E,
	0xB8B3, 0xA69F, 0x9BFB, 0x99EC, 0xA0BD, 0xB00E, 0xC6A4, 0xE297, 0x0178, 0x2061, 0x3C78,
	0x52E4, 0x616C, 0x6664, 0x612B, 0x5204, 0x3A57, 0x1C66, 0xFB44, 0xDA69, 0xBD6E, 0xA798,
	0x9B7D, 0x9AB3, 0xA586, 0xBAFD, 0xD8B2, 0xFB5D, 0x1EC4, 0x3EA9, 0x56EF, 0x6461, 0x6511,
	0x589C, 0x406C, 0x1F73, 0xFA05, 0xD529, 0xB602, 0xA119, 0x9999, 0xA0E7, 0xB634, 0xD6AA,
	0xFD8A, 0x2517, 0x471B, 0x5E31, 0x6666, 0x5E1D, 0x465F, 0x22C3, 0xF919, 0xD04F, 0xAF88,
	0x9CA2, 0x9B47, 0xAC15, 0xCC48, 0xF653, 0x2265, 0x4843, 0x6065, 0x65DC, 0x572C, 0x36E0,
	0x0B30, 0xDCEF, 0xB5AE, 0x9DFB, 0x9B2B, 0xAE55, 0xD3A6, 0x0323, 0x3239, 0x560A, 0x660B,
	0x5E00, 0x3F6B, 0x1134, 0xDE7F, 0xB3CD, 0x9C1E, 0x9DE5, 0xB92A, 0xE744, 0x1C44, 0x49F0,
	0x63A2, 0x61C9, 0x4460, 0x1342, 0xDC45, 0xAF65, 0x9A40, 0xA397, 0xC942, 0x0012, 0x373C,
	0x5D21, 0x654B, 0x4C5C, 0x1A0C, 0xDEA3, 0xAE41, 0x99B8, 0xA8CF, 0xD6D9, 0x13F0, 0x4A24,
	0x655C, 0x5ADD, 0x2DF0, 0xEF18, 0xB67A, 0x9A75, 0xA6D7, 0xD75B, 0x18D6, 0x5060, 0x6666,
	0x50D9, 0x1837, 0xD4A3, 0xA3EA, 0x9C5E, 0xC22F, 0x04D4, 0x458D, 0x65B0, 0x5510, 0x1AF1,
	0xD328, 0xA169, 0x9F57, 0xCEE6, 0x1849, 0x5548, 0x6508, 0x3E31, 0xF4FC, 0xB187, 0x99DF,
	0xBC60, 0x062D, 0x4CBB, 0x662B, 0x4246, 0xF5D5, 0xAF3F, 0x9AC9, 0xC656, 0x1724, 0x594D,
	0x6102, 0x27FC, 0xD3AC, 0x9D3E, 0xAB18, 0xF4A9, 0x46B0, 0x6628, 0x3B1F, 0xE424, 0xA19A,
	0xA66A, 0xF02C, 0x469E, 0x65BF, 0x33B4, 0xD78D, 0x9C22, 0xB362, 0x0B35, 0x59DF, 0x5B60,
	0x0CFE, 0xB2C9, 0x9D5B, 0xE16B, 0x41DC, 0x6574, 0x2980, 0xC5B3, 0x99D1, 0xD1CE, 0x37D5,
	0x6638, 0x2CE9, 0xC51D, 0x9A4B, 0xDA9C, 0x4326, 0x6371, 0x16F6, 0xB0B4, 0xA31C, 0xFF04,
	0x5C6B, 0x4E7C, 0xE3F8, 0x9A87, 0xCB74, 0x3CD2, 0x6344, 0x0D6D, 0xA648, 0xB200, 0x231F,
	0x6667, 0x218F, 0xAF4F, 0xAABD, 0x1BD0, 0x665C, 0x2076, 0xABFB, 0xB0BD, 0x2998, 0x6518,
	0x0938, 0x9F26, 0xC973, 0x4886, 0x55F8, 0xDAD7, 0x9B37, 0xFF55, 0x64BA, 0x22B8, 0xA62F,
	0xC254, 0x48AE, 0x50A9, 0xCAA6, 0xA377, 0x22E5, 0x62E1, 0xECDE, 0x9A62, 0x0725, 0x665E,
	0x00A3, 0x99A5, 0xFBEF, 0x6650, 0x0312, 0x9999, 0x026F, 0x662A, 0xF38F, 0x9B67, 0x1AD0,
	0x6011, 0xD31A, 0xA98E, 0x4118, 0x458E, 0xAB76, 0xD451, 0x62B0, 0x08E6, 0x9A31, 0x1FC9,
	0x5812, 0xB8EC, 0xC9B2, 0x61C8, 0x0342, 0x9CCF, 0x352E, 0x433D, 0xA17A, 0xF9D4, 0x6233,
	0xC227, 0xCAAA, 0x6516, 0xE786, 0xAEE1, 0x5A97, 0x0457, 0xA245, 0x4F40, 0x146C, 0x9E1F,
	0x4A51, 0x176B, 0x9E8B, 0x4E30, 0x0D45, 0xA41C, 0x5940, 0xF550, 0xB425, 0x649D, 0xD11C,
	0xD687, 0x627F, 0xAAA1, 0x0E52, 0x4121, 0x99D6, 0x4C52, 0xF9E3, 0xBDA1, 0x65B2, 0xAC59,
	0x186E, 0x2D39, 0xA302, 0x63A6, 0xBEB7, 0x064A, 0x359C, 0xA2B5, 0x6535, 0xB27C};

#endif /* _WAV_IN_H_ */
```

## src/sweep21ms_16b48khz_mono_wav_ref.h
```c
/*
 * Copyright (c) 2024 Nordic Semiconductor ASA
 *
 * SPDX-License-Identifier:  LicenseRef-Nordic-5-Clause
 */

#ifndef _WAV_REF_H_
#define _WAV_REF_H_

#include <stdint.h>

#define WAV_MONO_REF_SIZE (1000)

uint16_t wav_mono_ref[WAV_MONO_REF_SIZE] = {
	0xFFFF, 0x0047, 0x0087, 0x00D1, 0x0116, 0x0159, 0x01A7, 0x01E7, 0x0234, 0x027C, 0x02C2,
	0x030F, 0x0357, 0x03A2, 0x03EE, 0x0437, 0x0487, 0x04CE, 0x0522, 0x056A, 0x05B9, 0x060B,
	0x0657, 0x06A7, 0x06FA, 0x0746, 0x079C, 0x07EB, 0x0840, 0x0890, 0x08E6, 0x0939, 0x098C,
	0x09E6, 0x0A36, 0x0A91, 0x0AE4, 0x0B3F, 0x0B95, 0x0BEE, 0x0C49, 0x0C9D, 0x0D01, 0x0D51,
	0x0DB7, 0x0E0B, 0x0E6C, 0x0EC9, 0x0F26, 0x0F84, 0x0FE4, 0x1045, 0x10A2, 0x1109, 0x1162,
	0x11CC, 0x1229, 0x1291, 0x12F1, 0x135B, 0x13B8, 0x1427, 0x1486, 0x14F2, 0x1559, 0x15BE,
	0x162D, 0x168F, 0x1702, 0x1765, 0x17D7, 0x183E, 0x18AE, 0x191B, 0x1987, 0x19F9, 0x1A66,
	0x1AD7, 0x1B47, 0x1BB9, 0x1C2B, 0x1C9C, 0x1D13, 0x1D81, 0x1DFB, 0x1E6E, 0x1EE2, 0x1F5D,
	0x1FCF, 0x204A, 0x20C1, 0x213B, 0x21B2, 0x2231, 0x22A6, 0x2328, 0x239D, 0x2421, 0x2497,
	0x251C, 0x2596, 0x2617, 0x2697, 0x2716, 0x2799, 0x281A, 0x289B, 0x2920, 0x29A1, 0x2A29,
	0x2AA8, 0x2B33, 0x2BB3, 0x2C3F, 0x2CC3, 0x2D4A, 0x2DD3, 0x2E5B, 0x2EE5, 0x2F6F, 0x2FF7,
	0x3084, 0x310D, 0x319B, 0x3226, 0x32B1, 0x3344, 0x33C8, 0x3460, 0x34E7, 0x357B, 0x3608,
	0x3698, 0x3727, 0x37BB, 0x3848, 0x38DF, 0x3969, 0x3A02, 0x3A8F, 0x3B26, 0x3BB7, 0x3C4A,
	0x3CDF, 0x3D71, 0x3E06, 0x3E9B, 0x3F2E, 0x3FC4, 0x4057, 0x40EF, 0x4181, 0x4218, 0x42AE,
	0x433F, 0x43DC, 0x4469, 0x4505, 0x4597, 0x462F, 0x46C1, 0x475A, 0x47EB, 0x4884, 0x4916,
	0x49AC, 0x4A41, 0x4AD3, 0x4B69, 0x4BFA, 0x4C90, 0x4D21, 0x4DB4, 0x4E45, 0x4ED8, 0x4F67,
	0x4FFA, 0x5087, 0x5117, 0x51A7, 0x5231, 0x52C5, 0x5348, 0x53DE, 0x545C, 0x54F2, 0x5572,
	0x55FE, 0x5684, 0x5707, 0x578F, 0x5810, 0x5891, 0x5915, 0x5990, 0x5A13, 0x5A8B, 0x5B07,
	0x5B83, 0x5BF6, 0x5C71, 0x5CE2, 0x5D55, 0x5DC7, 0x5E35, 0x5EA0, 0x5F0E, 0x5F73, 0x5FDD,
	0x603C, 0x60A4, 0x60FE, 0x615F, 0x61B6, 0x6210, 0x6263, 0x62B8, 0x6305, 0x6352, 0x639D,
	0x63E2, 0x6425, 0x6467, 0x64A1, 0x64DC, 0x6512, 0x6543, 0x6573, 0x659C, 0x65C5, 0x65E7,
	0x6605, 0x6622, 0x6636, 0x664B, 0x6657, 0x6661, 0x6665, 0x6667, 0x6660, 0x6659, 0x6648,
	0x6634, 0x661E, 0x65FD, 0x65DC, 0x65B2, 0x6580, 0x6552, 0x6512, 0x64D5, 0x648F, 0x6440,
	0x63F1, 0x6395, 0x6339, 0x62D0, 0x6266, 0x61F0, 0x617A, 0x60F5, 0x6070, 0x5FDF, 0x5F49,
	0x5EAC, 0x5E05, 0x5D5B, 0x5CA4, 0x5BE9, 0x5B25, 0x5A58, 0x5987, 0x58A8, 0x57C6, 0x56D8,
	0x55E4, 0x54E7, 0x53E2, 0x52D2, 0x51BE, 0x509D, 0x4F74, 0x4E46, 0x4D07, 0x4BCB, 0x4A79,
	0x492B, 0x47C6, 0x4667, 0x44EF, 0x437F, 0x41F5, 0x4070, 0x3ED9, 0x3D3C, 0x3B97, 0x39E6,
	0x382F, 0x366D, 0x34A2, 0x32D1, 0x30F2, 0x2F10, 0x2D20, 0x2B2B, 0x292C, 0x2726, 0x2515,
	0x22FE, 0x20E0, 0x1EB4, 0x1C8D, 0x1A4C, 0x1818, 0x15CB, 0x1383, 0x1130, 0x0ED5, 0x0C76,
	0x0A12, 0x07A3, 0x0537, 0x02BE, 0x0045, 0xFDC6, 0xFB41, 0xF8BD, 0xF631, 0xF3A5, 0xF116,
	0xEE82, 0xEBF1, 0xE95B, 0xE6C7, 0xE431, 0xE19C, 0xDF08, 0xDC76, 0xD9E4, 0xD757, 0xD4CA,
	0xD245, 0xCFC1, 0xCD43, 0xCACC, 0xC857, 0xC5F1, 0xC38B, 0xC131, 0xBEE2, 0xBC98, 0xBA5F,
	0xB82B, 0xB60B, 0xB3EE, 0xB1EC, 0xAFEC, 0xAE05, 0xAC29, 0xAA60, 0xA8AA, 0xA706, 0xA578,
	0xA3FA, 0xA297, 0xA147, 0xA00F, 0x9EF1, 0x9DEA, 0x9CFD, 0x9C2C, 0x9B76, 0x9AD9, 0x9A62,
	0x99FC, 0x99C2, 0x999D, 0x999D, 0x99BD, 0x99FF, 0x9A5F, 0x9AE9, 0x9B8E, 0x9C5B, 0x9D4E,
	0x9E5E, 0x9F9C, 0xA0F8, 0xA27C, 0xA426, 0xA5F4, 0xA7E9, 0xAA04, 0xAC42, 0xAEA9, 0xB131,
	0xB3E2, 0xB6B3, 0xB9AE, 0xBCC5, 0xC005, 0xC360, 0xC6E6, 0xCA80, 0xCE45, 0xD21B, 0xD619,
	0xDA2C, 0xDE58, 0xE2A1, 0xE6F8, 0xEB6D, 0xEFEC, 0xF481, 0xF920, 0xFDD0, 0x0281, 0x0746,
	0x0BFF, 0x10CA, 0x1587, 0x1A48, 0x1EFE, 0x23AC, 0x284A, 0x2CDC, 0x3156, 0x35BB, 0x3A05,
	0x3E32, 0x423B, 0x4624, 0x49DF, 0x4D71, 0x50D5, 0x5403, 0x56FE, 0x59BD, 0x5C41, 0x5E83,
	0x6085, 0x623B, 0x63B2, 0x64D0, 0x65AF, 0x662E, 0x6669, 0x6644, 0x65CE, 0x6502, 0x63D7,
	0x625C, 0x607C, 0x5E4B, 0x5BBB, 0x58D2, 0x5593, 0x51FA, 0x4E0D, 0x49CC, 0x453B, 0x405A,
	0x3B34, 0x35C1, 0x3010, 0x2A23, 0x23F7, 0x1DA5, 0x171A, 0x1072, 0x09A8, 0x02C7, 0xFBD9,
	0xF4DE, 0xEDEE, 0xE6FA, 0xE027, 0xD965, 0xD2CC, 0xCC65, 0xC630, 0xC041, 0xBA9C, 0xB549,
	0xB05A, 0xABCB, 0xA7B0, 0xA40B, 0xA0E7, 0x9E49, 0x9C3A, 0x9ABF, 0x99DC, 0x999B, 0x99F9,
	0x9AFD, 0x9CA7, 0x9EF6, 0xA1F2, 0xA58D, 0xA9CD, 0xAEAC, 0xB420, 0xBA2A, 0xC0BD, 0xC7CF,
	0xCF57, 0xD74B, 0xDF97, 0xE836, 0xF111, 0xFA17, 0x0340, 0x0C69, 0x1591, 0x1E97, 0x276A,
	0x2FFD, 0x382D, 0x3FF3, 0x4734, 0x4DDE, 0x53DD, 0x5922, 0x5D98, 0x6133, 0x63E7, 0x65A0,
	0x6661, 0x6617, 0x64C3, 0x6267, 0x5EF6, 0x5A88, 0x550C, 0x4EA6, 0x4748, 0x3F1F, 0x3621,
	0x2C80, 0x2240, 0x178A, 0x0C77, 0x012B, 0xF5C6, 0xEA6F, 0xDF48, 0xD47C, 0xCA2B, 0xC083,
	0xB79F, 0xAFAA, 0xA8C4, 0xA307, 0x9E97, 0x9B7E, 0x99DF, 0x99B8, 0x9B22, 0x9E0E, 0xA28A,
	0xA87C, 0xAFE1, 0xB89A, 0xC28E, 0xCD96, 0xD988, 0xE63A, 0xF36F, 0x00FB, 0x0E91, 0x1C04,
	0x2907, 0x3564, 0x40D1, 0x4B1F, 0x5407, 0x5B5F, 0x60F8, 0x64A1, 0x6652, 0x65DE, 0x6351,
	0x5EA3, 0x57E3, 0x4F31, 0x44AE, 0x388D, 0x2B18, 0x1C7D, 0x0D33, 0xFD68, 0xEDA6, 0xDE2A,
	0xCF73, 0xC1D3, 0xB5AE, 0xAB61, 0xA32E, 0x9D6A, 0x9A33, 0x99C4, 0x9C1E, 0xA147, 0xA928,
	0xB392, 0xC048, 0xCEF5, 0xDF33, 0xF08B, 0x027E, 0x1477, 0x25F0, 0x364E, 0x4505, 0x5193,
	0x5B7B, 0x625E, 0x65F0, 0x65F8, 0x626C, 0x5B54, 0x50DF, 0x4363, 0x3346, 0x2126, 0x0D99,
	0xF969, 0xE555, 0xD22E, 0xC0C0, 0xB1CE, 0xA5FF, 0x9DE9, 0x99F6, 0x9A66, 0x9F51, 0xA890,
	0xB5D4, 0xC693, 0xDA1B, 0xEF8F, 0x05EE, 0x1C2D, 0x312F, 0x43E8, 0x534D, 0x5E97, 0x64FF,
	0x6631, 0x61EA, 0x5857, 0x49DD, 0x372D, 0x2144, 0x094C, 0xF0A6, 0xD8B5, 0xC2F8, 0xB0BA,
	0xA33E, 0x9B62, 0x99D2, 0x9EBA, 0xA9FA, 0xBAE8, 0xD08F, 0xE98A, 0x0439, 0x1ECD, 0x3764,
	0x4C36, 0x5BAF, 0x648F, 0x660B, 0x5FE0, 0x525C, 0x3E68, 0x256D, 0x0950, 0xEC3F, 0xD09E,
	0xB8B3, 0xA69F, 0x9BFB, 0x99EC, 0xA0BD, 0xB00E, 0xC6A4, 0xE297, 0x0178, 0x2061, 0x3C78,
	0x52E4, 0x616C, 0x6664, 0x612B, 0x5204, 0x3A57, 0x1C66, 0xFB44, 0xDA69, 0xBD6E, 0xA798,
	0x9B7D, 0x9AB3, 0xA586, 0xBAFD, 0xD8B2, 0xFB5D, 0x1EC4, 0x3EA9, 0x56EF, 0x6461, 0x6511,
	0x589C, 0x406C, 0x1F73, 0xFA05, 0xD529, 0xB602, 0xA119, 0x9999, 0xA0E7, 0xB634, 0xD6AA,
	0xFD8A, 0x2517, 0x471B, 0x5E31, 0x6666, 0x5E1D, 0x465F, 0x22C3, 0xF919, 0xD04F, 0xAF88,
	0x9CA2, 0x9B47, 0xAC15, 0xCC48, 0xF653, 0x2265, 0x4843, 0x6065, 0x65DC, 0x572C, 0x36E0,
	0x0B30, 0xDCEF, 0xB5AE, 0x9DFB, 0x9B2B, 0xAE55, 0xD3A6, 0x0323, 0x3239, 0x560A, 0x660B,
	0x5E00, 0x3F6B, 0x1134, 0xDE7F, 0xB3CD, 0x9C1E, 0x9DE5, 0xB92A, 0xE744, 0x1C44, 0x49F0,
	0x63A2, 0x61C9, 0x4460, 0x1342, 0xDC45, 0xAF65, 0x9A40, 0xA397, 0xC942, 0x0012, 0x373C,
	0x5D21, 0x654B, 0x4C5C, 0x1A0C, 0xDEA3, 0xAE41, 0x99B8, 0xA8CF, 0xD6D9, 0x13F0, 0x4A24,
	0x655C, 0x5ADD, 0x2DF0, 0xEF18, 0xB67A, 0x9A75, 0xA6D7, 0xD75B, 0x18D6, 0x5060, 0x6666,
	0x50D9, 0x1837, 0xD4A3, 0xA3EA, 0x9C5E, 0xC22F, 0x04D4, 0x458D, 0x65B0, 0x5510, 0x1AF1,
	0xD328, 0xA169, 0x9F57, 0xCEE6, 0x1849, 0x5548, 0x6508, 0x3E31, 0xF4FC, 0xB187, 0x99DF,
	0xBC60, 0x062D, 0x4CBB, 0x662B, 0x4246, 0xF5D5, 0xAF3F, 0x9AC9, 0xC656, 0x1724, 0x594D,
	0x6102, 0x27FC, 0xD3AC, 0x9D3E, 0xAB18, 0xF4A9, 0x46B0, 0x6628, 0x3B1F, 0xE424, 0xA19A,
	0xA66A, 0xF02C, 0x469E, 0x65BF, 0x33B4, 0xD78D, 0x9C22, 0xB362, 0x0B35, 0x59DF, 0x5B60,
	0x0CFE, 0xB2C9, 0x9D5B, 0xE16B, 0x41DC, 0x6574, 0x2980, 0xC5B3, 0x99D1, 0xD1CE, 0x37D5,
	0x6638, 0x2CE9, 0xC51D, 0x9A4B, 0xDA9C, 0x4326, 0x6371, 0x16F6, 0xB0B4, 0xA31C, 0xFF04,
	0x5C6B, 0x4E7C, 0xE3F8, 0x9A87, 0xCB74, 0x3CD2, 0x6344, 0x0D6D, 0xA648, 0xB200, 0x231F,
	0x6667, 0x218F, 0xAF4F, 0xAABD, 0x1BD0, 0x665C, 0x2076, 0xABFB, 0xB0BD, 0x2998, 0x6518,
	0x0938, 0x9F26, 0xC973, 0x4886, 0x55F8, 0xDAD7, 0x9B37, 0xFF55, 0x64BA, 0x22B8, 0xA62F,
	0xC254, 0x48AE, 0x50A9, 0xCAA6, 0xA377, 0x22E5, 0x62E1, 0xECDE, 0x9A62, 0x0725, 0x665E,
	0x00A3, 0x99A5, 0xFBEF, 0x6650, 0x0312, 0x9999, 0x026F, 0x662A, 0xF38F, 0x9B67, 0x1AD0,
	0x6011, 0xD31A, 0xA98E, 0x4118, 0x458E, 0xAB76, 0xD451, 0x62B0, 0x08E6, 0x9A31, 0x1FC9,
	0x5812, 0xB8EC, 0xC9B2, 0x61C8, 0x0342, 0x9CCF, 0x352E, 0x433D, 0xA17A, 0xF9D4, 0x6233,
	0xC227, 0xCAAA, 0x6516, 0xE786, 0xAEE1, 0x5A97, 0x0457, 0xA245, 0x4F40, 0x146C, 0x9E1F,
	0x4A51, 0x176B, 0x9E8B, 0x4E30, 0x0D45, 0xA41C, 0x5940, 0xF550, 0xB425, 0x649D, 0xD11C,
	0xD687, 0x627F, 0xAAA1, 0x0E52, 0x4121, 0x99D6, 0x4C52, 0xF9E3, 0xBDA1, 0x65B2, 0xAC59,
	0x186E, 0x2D39, 0xA302, 0x63A6, 0xBEB7, 0x064A, 0x359C, 0xA2B5, 0x6535, 0xB27C,
};

#endif /* _WAV_REF_H_ */
```
