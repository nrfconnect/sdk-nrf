## tests/subsys/bootloader/backward_compatibility/v3.2/smp_svr/sysbuild/mcuboot/boards/nrf54l15dk_nrf54l15_cpuapp_ext_flash.conf
```kconfig
# MCUboot needs SPI to reach the external flash (mx25r64) that holds the
# secondary slot, and a higher sector limit than the shared base conf provides.
CONFIG_FLASH=y
CONFIG_MULTITHREADING=y

CONFIG_BOOT_MAX_IMG_SECTORS_AUTO=n
CONFIG_BOOT_MAX_IMG_SECTORS=512

CONFIG_SPI=y
CONFIG_SPI_NOR=y
CONFIG_SPI_NOR_FLASH_LAYOUT_PAGE_SIZE=4096
CONFIG_SPI_NRFX_RAM_BUFFER_SIZE=32

CONFIG_MCUBOOT_DOWNGRADE_PREVENTION=y

CONFIG_LOG=y
CONFIG_LOG_MODE_MINIMAL=y
CONFIG_LOG_DEFAULT_LEVEL=0
CONFIG_MCUBOOT_LOG_LEVEL_INF=y
CONFIG_CBPRINTF_NANO=y
CONFIG_MINIMAL_LIBC=y

CONFIG_FW_INFO_FIRMWARE_VERSION=2
```
