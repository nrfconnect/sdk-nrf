## tests/subsys/bluetooth/mesh/models/testcase.yaml
```yaml
common:
  build_only: true
  platform_allow: nrf52840dk/nrf52840
  tags: bluetooth ci_build
  integration_platforms:
    - nrf52840dk/nrf52840
tests:
  bluetooth.mesh.build_models:
    sysbuild: true
    extra_args:
      - EXTRA_DTC_OVERLAY_FILE=dm.overlay
    # Explicitly disabling settings to ensure they're not "imply"'d by anything:
    extra_configs:
      - CONFIG_BT_SETTINGS=n
    tags: sysbuild
  bluetooth.mesh.build_models.settings:
    sysbuild: true
    extra_args:
      - EXTRA_DTC_OVERLAY_FILE=dm.overlay
    # Include persistent storage:
    # Some models depend on BT_SETTINGS, and have to be excluded from the
    # no-settings build. These should be listed here, and be wrapped
    # in an #ifdef CONFIG_BT_SETTINGS in main.c.
    extra_configs:
      - CONFIG_BT_SETTINGS=y
      - CONFIG_BT_MESH_SCENE_SRV=y
      - CONFIG_BT_MESH_SCHEDULER_SRV=y
    tags: sysbuild
  bluetooth.mesh.build_models.shell:
    sysbuild: true
    extra_args:
      - OVERLAY_CONFIG=overlay-mesh-shell.conf
      - EXTRA_DTC_OVERLAY_FILE=dm.overlay
    extra_configs:
      - CONFIG_BT_SETTINGS=n
    tags: sysbuild
  bluetooth.mesh.build_models.emds:
    sysbuild: true
    # Include emergency data storage (EMDS):
    # The models that uses the EMDS is already included, remove the models that
    # does not use EMDS.
    extra_args:
      - OVERLAY_CONFIG=overlay-mesh-emds.conf
      - EXTRA_DTC_OVERLAY_FILE=dm.overlay
    tags: sysbuild
```

## tests/subsys/bluetooth/mesh/scheduler_model/action_planning/testcase.yaml
```yaml
tests:
  bluetooth.mesh.scheduler_model.action_planning:
    sysbuild: true
    platform_allow: native_sim
    tags:
      - bluetooth
      - ci_build
      - sysbuild
    integration_platforms:
      - native_sim
```

## tests/subsys/bluetooth/mesh/scheduler_model/message_validity/boards/native_sim.conf
```kconfig
# nrf_security only supports Cortex-M via PSA crypto libraries.
# Enforcing usage of built-in Mbed TLS for native simulator.
CONFIG_MBEDTLS=y
CONFIG_MBEDTLS_BUILTIN=y
```

## tests/subsys/bluetooth/mesh/scheduler_model/message_validity/testcase.yaml
```yaml
tests:
  bluetooth.mesh.scheduler_model.message_validity:
    sysbuild: true
    platform_allow: native_sim
    tags:
      - bluetooth
      - ci_build
      - sysbuild
    integration_platforms:
      - native_sim
```

## tests/subsys/bluetooth/mesh/scheduler_model/timing/testcase.yaml
```yaml
tests:
  bluetooth.mesh.scheduler_model:
    sysbuild: true
    platform_allow: native_sim
    tags:
      - bluetooth
      - ci_build
      - sysbuild
    integration_platforms:
      - native_sim
```

## tests/subsys/bluetooth/mesh/sensor_subsys/testcase.yaml
```yaml
tests:
  bluetooth.mesh.sensor_subsys:
    sysbuild: true
    platform_allow:
      - native_sim
    tags:
      - bluetooth
      - ci_build
      - sysbuild
    integration_platforms:
      - native_sim
```

## tests/subsys/bluetooth/mesh/silvair_enocean_model/testcase.yaml
```yaml
tests:
  bluetooth.mesh.silvair_enocean_model:
    sysbuild: true
    platform_allow:
      - native_sim
    tags:
      - bluetooth
      - ci_build
      - sysbuild
    integration_platforms:
      - native_sim
```

## tests/subsys/bluetooth/mesh/time_model/boards/native_sim.conf
```kconfig
# nrf_security only supports Cortex-M via PSA crypto libraries.
# Enforcing usage of built-in Mbed TLS for native simulator.
CONFIG_MBEDTLS=y
CONFIG_MBEDTLS_BUILTIN=y
CONFIG_PSA_CRYPTO_PROVIDER_MBEDTLS=y
```

## tests/subsys/bluetooth/mesh/time_model/testcase.yaml
```yaml
tests:
  bluetooth.mesh.time_model:
    sysbuild: true
    platform_allow: native_sim
    tags:
      - bluetooth
      - ci_build
      - sysbuild
      - ci_tests_subsys_bluetooth_mesh
    integration_platforms:
      - native_sim
```

## tests/subsys/bluetooth/rpc_gatt_service/testcase.yaml
```yaml
tests:
  bluetooth.rpc_gatt_service:
    platform_allow: native_sim
    tags:
      - ci_build
      - bluetooth
      - ci_tests_subsys_bluetooth
    integration_platforms:
      - native_sim
```

## tests/subsys/bootloader/b0_lock/testcase.yaml
```yaml
tests:
  b0.self_lock:
    sysbuild: true
    extra_args:
      - SB_CONFIG_SECURE_BOOT_GENERATE_DEFAULT_KMU_KEYFILE=y
    platform_allow: nrf54l15dk/nrf54l15/cpuapp
    integration_platforms:
      - nrf54l15dk/nrf54l15/cpuapp
    tags:
      - b0
      - ci_tests_subsys_bootloader
```

## tests/subsys/bootloader/b0_lock_rwx/Kconfig
```kconfig
#
# Copyright (c) 2022 Nordic Semiconductor
#
# SPDX-License-Identifier: LicenseRef-Nordic-5-Clause
#

config TEST_IMMUTABLE_REGION
	int
	default 3
	default 2 if SOC_NRF54LS05B

config TEST_ADDITIONAL_REGION
	int
	default 4

config TEST_B0_LOCK_READS
	bool "Test read prevention"
	help
	  Reads are disabled after writes has been disabled, therefore testing against reads
	  implies portion of the memory cannot be accessed at all.
	  In case this symbol isn't selected, tests against writes are performed.

config TEST_B0_LOCK_USE_S1
	bool "MCUBoot is running from S1 image for the test"

config TEST_MCUBOOT_ALONE
	bool "b0 absent"

menu "Zephyr"
source "Kconfig.zephyr"
endmenu
```

## tests/subsys/bootloader/b0_lock_rwx/modules/run_from_s1/zephyr/Kconfig
```kconfig
#
# Copyright (c) 2025 Nordic Semiconductor
#
# SPDX-License-Identifier: LicenseRef-Nordic-5-Clause
#

config TEST_B0_LOCK_USE_S1
	bool "Ensures the S1 image is started by b0"
	help
	  This option causes b0 to invalidate the S0 image during startup,
	  which ensures that the main function starts the S1 image.
```

## tests/subsys/bootloader/b0_lock_rwx/sysbuild/mcuboot/boards/nrf54l15dk_nrf54l15_cpuapp_b0_mcuboot.conf
```kconfig
#
# Copyright (c) 2026 Nordic Semiconductor ASA
#
# SPDX-License-Identifier: LicenseRef-Nordic-5-Clause
#

CONFIG_BOOT_MAX_IMG_SECTORS=26
```

## tests/subsys/bootloader/b0_lock_rwx/testcase.yaml
```yaml
common:
  sysbuild: true
  tags:
    - b0
    - ci_tests_subsys_bootloader

tests:
  b0.w:
    platform_allow:
      - nrf54l15dk/nrf54l15/cpuapp
      - nrf54lm20dk/nrf54lm20a/cpuapp
    integration_platforms:
      - nrf54l15dk/nrf54l15/cpuapp
      - nrf54lm20dk/nrf54lm20a/cpuapp
  b0.rwx:
    extra_args:
      - b0_CONFIG_SB_DISABLE_SELF_RWX=y
      - CONFIG_TEST_B0_LOCK_READS=y
    platform_allow:
      - nrf54l15dk/nrf54l15/cpuapp
      - nrf54lv10dk/nrf54lv10a/cpuapp
      - nrf54lm20dk/nrf54lm20a/cpuapp
      - nrf54lm20dk/nrf54lm20b/cpuapp
    integration_platforms:
      - nrf54l15dk/nrf54l15/cpuapp
      - nrf54lv10dk/nrf54lv10a/cpuapp
      - nrf54lm20dk/nrf54lm20a/cpuapp
      - nrf54lm20dk/nrf54lm20b/cpuapp
  b0.mcuboot.w:
    extra_args:
      - b0_CONFIG_SB_DISABLE_SELF_RWX=y
      - b0_CONFIG_SB_DISABLE_NEXT_W=y
      - SB_CONFIG_BOOTLOADER_MCUBOOT=y
      - SB_CONFIG_MCUBOOT_GENERATE_DEFAULT_KEY_FILE=y
    platform_allow:
      - nrf54l15dk/nrf54l15/cpuapp
      - nrf54lv10dk/nrf54lv10a/cpuapp
      - nrf54lm20dk/nrf54lm20a/cpuapp
      - nrf54lm20dk/nrf54lm20b/cpuapp
    integration_platforms:
      - nrf54l15dk/nrf54l15/cpuapp
      - nrf54lv10dk/nrf54lv10a/cpuapp
      - nrf54lm20dk/nrf54lm20a/cpuapp
      - nrf54lm20dk/nrf54lm20b/cpuapp

  mcuboot.rwx:
    extra_args:
      - SB_CONFIG_SECURE_BOOT_APPCORE=n
      - SB_CONFIG_SECURE_BOOT_GENERATE_DEFAULT_KMU_KEYFILE=n
      - SB_CONFIG_SECURE_BOOT_BOOTCONF_LOCK_WRITES=n
      - mcuboot_CONFIG_NCS_MCUBOOT_DISABLE_SELF_RWX=y
      - SB_CONFIG_BOOTLOADER_MCUBOOT=y
      - CONFIG_TEST_MCUBOOT_ALONE=y
      - CONFIG_NRFX_RRAMC=y
      - mcuboot_CONFIG_PM_PARTITION_SIZE_MCUBOOT=0x16000
    platform_allow:
      - nrf54lv10dk/nrf54lv10a/cpuapp
      - nrf54lm20dk/nrf54lm20a/cpuapp
      - nrf54lm20dk/nrf54lm20b/cpuapp
      - nrf54ls05dk/nrf54ls05b/cpuapp
    integration_platforms:
      - nrf54lv10dk/nrf54lv10a/cpuapp
      - nrf54lm20dk/nrf54lm20a/cpuapp
      - nrf54lm20dk/nrf54lm20b/cpuapp
      - nrf54ls05dk/nrf54ls05b/cpuapp
  b0.mcuboot.rwx:
    extra_args:
      - b0_CONFIG_SB_DISABLE_SELF_RWX=y
      - b0_CONFIG_SB_DISABLE_NEXT_W=y
      - mcuboot_CONFIG_NCS_MCUBOOT_DISABLE_SELF_RWX=y
      - SB_CONFIG_BOOTLOADER_MCUBOOT=y
      - SB_CONFIG_MCUBOOT_GENERATE_DEFAULT_KEY_FILE=y
      - CONFIG_TEST_B0_LOCK_READS=y
    platform_allow:
      - nrf54l15dk/nrf54l15/cpuapp
      - nrf54lv10dk/nrf54lv10a/cpuapp
      - nrf54lm20dk/nrf54lm20a/cpuapp
      - nrf54lm20dk/nrf54lm20b/cpuapp
    integration_platforms:
      - nrf54l15dk/nrf54l15/cpuapp
      - nrf54lv10dk/nrf54lv10a/cpuapp
      - nrf54lm20dk/nrf54lm20a/cpuapp
      - nrf54lm20dk/nrf54lm20b/cpuapp
  b0.mcuboot.s1.w:
    extra_args:
      - b0_CONFIG_SB_DISABLE_SELF_RWX=y
      - b0_CONFIG_SB_DISABLE_NEXT_W=y
      - b0_CONFIG_TEST_B0_LOCK_USE_S1=y
      - SB_CONFIG_BOOTLOADER_MCUBOOT=y
      - SB_CONFIG_MCUBOOT_GENERATE_DEFAULT_KEY_FILE=y
      - CONFIG_TEST_B0_LOCK_USE_S1=y
    platform_allow:
      - nrf54l15dk/nrf54l15/cpuapp
      - nrf54lv10dk/nrf54lv10a/cpuapp
      - nrf54lm20dk/nrf54lm20a/cpuapp
      - nrf54lm20dk/nrf54lm20b/cpuapp
    integration_platforms:
      - nrf54l15dk/nrf54l15/cpuapp
      - nrf54lv10dk/nrf54lv10a/cpuapp
      - nrf54lm20dk/nrf54lm20a/cpuapp
      - nrf54lm20dk/nrf54lm20b/cpuapp
  b0.mcuboot.s1.rwx:
    extra_args:
      - b0_CONFIG_SB_DISABLE_SELF_RWX=y
      - b0_CONFIG_SB_DISABLE_NEXT_W=y
      - b0_CONFIG_TEST_B0_LOCK_USE_S1=y
      - mcuboot_CONFIG_NCS_MCUBOOT_DISABLE_SELF_RWX=y
      - SB_CONFIG_BOOTLOADER_MCUBOOT=y
      - SB_CONFIG_MCUBOOT_GENERATE_DEFAULT_KEY_FILE=y
      - CONFIG_TEST_B0_LOCK_READS=y
      - CONFIG_TEST_B0_LOCK_USE_S1=y
    platform_allow:
      - nrf54l15dk/nrf54l15/cpuapp
      - nrf54lv10dk/nrf54lv10a/cpuapp
      - nrf54lm20dk/nrf54lm20a/cpuapp
      - nrf54lm20dk/nrf54lm20b/cpuapp
    integration_platforms:
      - nrf54l15dk/nrf54l15/cpuapp
      - nrf54lv10dk/nrf54lv10a/cpuapp
      - nrf54lm20dk/nrf54lm20a/cpuapp
      - nrf54lm20dk/nrf54lm20b/cpuapp
  b0.mcuboot.rwx.b0_did_not_lock:
    extra_args:
      - mcuboot_CONFIG_NCS_MCUBOOT_DISABLE_SELF_RWX=y
      - SB_CONFIG_BOOTLOADER_MCUBOOT=y
      - SB_CONFIG_MCUBOOT_GENERATE_DEFAULT_KEY_FILE=y
      - CONFIG_TEST_B0_LOCK_READS=y
    platform_allow:
      - nrf54l15dk/nrf54l15/cpuapp
      - nrf54lv10dk/nrf54lv10a/cpuapp
      - nrf54lm20dk/nrf54lm20a/cpuapp
      - nrf54lm20dk/nrf54lm20b/cpuapp
    integration_platforms:
      - nrf54l15dk/nrf54l15/cpuapp
      - nrf54lv10dk/nrf54lv10a/cpuapp
      - nrf54lm20dk/nrf54lm20a/cpuapp
      - nrf54lm20dk/nrf54lm20b/cpuapp
  b0.mcuboot.s1.rwx.b0_did_not_lock:
    extra_args:
      - b0_CONFIG_TEST_B0_LOCK_USE_S1=y
      - mcuboot_CONFIG_NCS_MCUBOOT_DISABLE_SELF_RWX=y
      - SB_CONFIG_BOOTLOADER_MCUBOOT=y
      - SB_CONFIG_MCUBOOT_GENERATE_DEFAULT_KEY_FILE=y
      - CONFIG_TEST_B0_LOCK_READS=y
      - CONFIG_TEST_B0_LOCK_USE_S1=y
    platform_allow:
      - nrf54l15dk/nrf54l15/cpuapp
      - nrf54lv10dk/nrf54lv10a/cpuapp
      - nrf54lm20dk/nrf54lm20a/cpuapp
      - nrf54lm20dk/nrf54lm20b/cpuapp
    integration_platforms:
      - nrf54l15dk/nrf54l15/cpuapp
      - nrf54lv10dk/nrf54lv10a/cpuapp
      - nrf54lm20dk/nrf54lm20a/cpuapp
      - nrf54lm20dk/nrf54lm20b/cpuapp
```

## tests/subsys/bootloader/b0_mcuboot_lock/testcase.yaml
```yaml
tests:
  b0.disable_next_w_:
    sysbuild: true
    extra_args:
      - b0_CONFIG_SB_DISABLE_NEXT_W=y
    platform_allow: nrf54l15dk/nrf54l15/cpuapp
    integration_platforms:
      - nrf54l15dk/nrf54l15/cpuapp
    tags:
      - b0
      - ci_tests_subsys_bootloader
```

## tests/subsys/bootloader/b0_ram_cleanup/sysbuild/b0/boards/nrf54l15dk_nrf54l15_cpuapp.conf
```kconfig
#
# Copyright (c) 2026 Nordic Semiconductor ASA
#
# SPDX-License-Identifier: LicenseRef-Nordic-5-Clause
#

# Link Time Optimizations
CONFIG_ISR_TABLES_LOCAL_DECLARATION=y
CONFIG_LTO=y
```

## tests/subsys/bootloader/b0_ram_cleanup/testcase.yaml
```yaml
common:
  sysbuild: true
  tags:
    - b0
    - ci_tests_subsys_bootloader

tests:
  b0.cleanup_ram:
    platform_allow:
      - nrf54l15dk/nrf54l15/cpuapp
    integration_platforms:
      - nrf54l15dk/nrf54l15/cpuapp
```

## tests/subsys/bootloader/backward_compatibility/v3.2/ab/sysbuild/mcuboot/boards/nrf54l15dk_nrf54l15_cpuapp.conf
```kconfig
# The default MCUboot is too large to support fprotect.
CONFIG_FPROTECT=n

# Enable boot requests through retained memory.
CONFIG_RETAINED_MEM=y
CONFIG_RETENTION=y
```

## tests/subsys/bootloader/backward_compatibility/v3.2/ab/testcase.yaml
```yaml
common:
  sysbuild: true
  build_only: true
  tags:
    - mcuboot
    - ci_tests_subsys_bootloader

tests:
  # BC-aware configuration for the AB Direct-XIP sample on nRF54L15.
  # nrf54l15dk_nrf54l15_cpuapp_common.dtsi pins the partition layout (no
  # Partition Manager) to the NCS v3.2 flash map so the update image is
  # accepted by an NCS v3.2 MCUboot.
  mcuboot.backward_compatibility.ab:
    platform_allow:
      - nrf54l15dk/nrf54l15/cpuapp
```

## tests/subsys/bootloader/backward_compatibility/v3.2/ab_split/testcase.yaml
```yaml
common:
  sysbuild: true
  build_only: true
  tags:
    - mcuboot
    - ci_tests_subsys_bootloader

tests:
  # BC-aware configuration for the ab_split sample on nRF54H20.
  # Power management had to be disabled (CONFIG_PM=n) for compatibility.
  mcuboot.backward_compatibility.ab_split:
    extra_configs:
      - CONFIG_MCUMGR_GRP_IMG_ALLOW_CONFIRM_NON_ACTIVE_IMAGE_ANY=y
    platform_allow:
      - nrf54h20dk/nrf54h20/cpuapp
```

## tests/subsys/bootloader/backward_compatibility/v3.2/dfu_multi_image/testcase.yaml
```yaml
common:
  sysbuild: true
  build_only: true
  tags:
    - mcuboot
    - ci_tests_subsys_bootloader

tests:
  # BC-aware configuration for the dfu_multi_image sample on nRF54H20.
  # Restores the reduced MCUboot code size configuration from NCS v3.2.
  mcuboot.backward_compatibility.dfu_multi_image:
    platform_allow:
      - nrf54h20dk/nrf54h20/cpuapp
```

## tests/subsys/bootloader/backward_compatibility/v3.2/single_slot/testcase.yaml
```yaml
common:
  sysbuild: true
  build_only: true
  tags:
    - mcuboot
    - ci_tests_subsys_bootloader

tests:
  # BC-aware configuration for the single_slot firmware-updater sample
  # on nRF54L15. boards/nrf54l15dk_nrf54l15_cpuapp.overlay pins the flash map
  # (via DTS, no Partition Manager) to the released NCS v3.2.0 layout, since
  # current NCS uses a larger application slot that an NCS v3.2 MCUboot would
  # reject.
  mcuboot.backward_compatibility.single_slot:
    platform_allow:
      - nrf54l15dk/nrf54l15/cpuapp
```

## tests/subsys/bootloader/backward_compatibility/v3.2/smp_svr/sysbuild/mcuboot/boards/nrf54l15dk_nrf54l10_cpuapp_ext_flash.conf
```kconfig
# nRF54L10 has no shared base MCUboot conf here, so this file is self-contained:
# SPI access to the external flash (mx25r64) for the secondary slot, a higher
# sector limit, and disabled fprotect with a larger stack for MCUboot.
CONFIG_FLASH=y
CONFIG_MULTITHREADING=y

CONFIG_BOOT_MAX_IMG_SECTORS_AUTO=n
CONFIG_BOOT_MAX_IMG_SECTORS=512

CONFIG_SPI=y
CONFIG_SPI_NOR=y
CONFIG_SPI_NOR_FLASH_LAYOUT_PAGE_SIZE=4096
CONFIG_SPI_NRFX_RAM_BUFFER_SIZE=32

CONFIG_MCUBOOT_DOWNGRADE_PREVENTION=y

CONFIG_FPROTECT=n
CONFIG_MAIN_STACK_SIZE=16384

CONFIG_LOG=y
CONFIG_LOG_MODE_MINIMAL=y
CONFIG_LOG_DEFAULT_LEVEL=0
CONFIG_MCUBOOT_LOG_LEVEL_INF=y
CONFIG_CBPRINTF_NANO=y
CONFIG_MINIMAL_LIBC=y

CONFIG_FW_INFO_FIRMWARE_VERSION=2
```
