## CMakeLists.txt
```
#
# Copyright (c) 2022-2026 Nordic Semiconductor ASA
#
# SPDX-License-Identifier: LicenseRef-Nordic-5-Clause
#

cmake_minimum_required(VERSION 3.20.0)

find_package(Zephyr REQUIRED HINTS $ENV{ZEPHYR_BASE})
project("Fast Pair storage of Account Keys unit test")

# Add test sources
target_sources(app PRIVATE
  src/main.c
  src/settings_mock.c
  src/test_corrupted_data.c
  ../common/src/common_utils.c
)
target_include_directories(app PRIVATE include)
target_include_directories(app PRIVATE ../common/include)

# Add Fast Pair storage as part of the test
set(NCS_FAST_PAIR_BASE ${ZEPHYR_NRF_MODULE_DIR}/subsys/bluetooth/fast_pair)
add_subdirectory(${NCS_FAST_PAIR_BASE}/fp_storage fp_storage)
target_link_libraries(app PRIVATE fp_storage)
```

## Kconfig
```
#
# Copyright (c) 2022-2026 Nordic Semiconductor
#
# SPDX-License-Identifier: LicenseRef-Nordic-5-Clause
#

config TEST_BT_FAST_PAIR_STORAGE_OWNER_ACCOUNT_KEY
	bool "Enable support for the Owner Account Key in the Storage module to be able to test it"
	select BT_FAST_PAIR_STORAGE_OWNER_ACCOUNT_KEY
	help
	  Enable support for the Owner Account Key in the Storage module to be able to test it.

menu "Test configuration"
source "$(ZEPHYR_NRF_MODULE_DIR)/subsys/bluetooth/fast_pair/fp_storage/Kconfig.fp_storage"
endmenu

menu "Zephyr"
source "Kconfig.zephyr"
endmenu
```

## prj.conf
```kconfig
#
# Copyright (c) 2022-2023 Nordic Semiconductor ASA
#
# SPDX-License-Identifier: LicenseRef-Nordic-5-Clause
#

CONFIG_ZTEST=y
CONFIG_ZTEST_SHUFFLE=y
CONFIG_ZTEST_REPEAT=y
CONFIG_ZTEST_SUITE_REPEAT_COUNT=1
CONFIG_ZTEST_TEST_REPEAT_COUNT=2

CONFIG_SETTINGS=y
CONFIG_SETTINGS_CUSTOM=y
CONFIG_HEAP_MEM_POOL_SIZE=1024

# Prevent flooding logs with information about erasing the oldest Account Key.
CONFIG_FP_STORAGE_LOG_LEVEL_WRN=y

# Private API is used to prepopulate settings wtih mocked data in corrupted data test.
CONFIG_BT_FAST_PAIR_STORAGE_EXPOSE_PRIV_API=y
```

## src/main.c
```c
/*
 * Copyright (c) 2022 Nordic Semiconductor ASA
 *
 * SPDX-License-Identifier: LicenseRef-Nordic-5-Clause
 */

#include <zephyr/ztest.h>
#include <zephyr/settings/settings.h>

#include "fp_storage_ak.h"
#include "fp_storage.h"
#include "fp_storage_ak_priv.h"
#include "fp_storage_manager_priv.h"
#include "fp_common.h"

#include "storage_mock.h"
#include "common_utils.h"

#define ACCOUNT_KEY_MAX_CNT	CONFIG_BT_FAST_PAIR_STORAGE_ACCOUNT_KEY_MAX

/* Account Key storage bond management feature is not yet supported by the unit test. */
BUILD_ASSERT(!IS_ENABLED(CONFIG_BT_FAST_PAIR_STORAGE_AK_BOND));

static void reload_keys_from_storage(void)
{
	int err;

	fp_storage_ak_ram_clear();
	fp_storage_manager_ram_clear();
	cu_account_keys_validate_uninitialized();
	err = settings_load();
	zassert_ok(err, "Failed to load settings");

	err = fp_storage_init();
	zassert_ok(err, "Failed to initialize module");
}

static void before_fn(void *f)
{
	ARG_UNUSED(f);

	int err;

	cu_account_keys_validate_uninitialized();

	/* Load empty settings before the test to initialize fp_storage. */
	err = settings_load();
	zassert_ok(err, "Settings load failed");

	err = fp_storage_init();
	zassert_ok(err, "Failed to initialize module");
}

static void after_fn(void *f)
{
	ARG_UNUSED(f);

	fp_storage_ak_ram_clear();
	fp_storage_manager_ram_clear();
	storage_mock_clear();
	cu_account_keys_validate_uninitialized();
}

ZTEST(suite_fast_pair_storage_common, test_settings_unloaded)
{
	int err;

	/* Check that Account Key storage operations fail when settings are unloaded. */
	after_fn(NULL);

	err = fp_storage_init();
	zassert_not_equal(err, 0, "Expected error before settings load");

	cu_account_keys_validate_uninitialized();
}

ZTEST(suite_fast_pair_storage_common, test_uninitialized)
{
	int err;

	/* Check that Account Key storage operations fail when fp_storage is uninitialized */
	after_fn(NULL);

	err = settings_load();
	zassert_ok(err, "Settings load failed");

	cu_account_keys_validate_uninitialized();
}

ZTEST(suite_fast_pair_storage_common, test_one_key)
{
	static const uint8_t seed = 5;

	int err;
	struct fp_account_key account_key;

	cu_generate_account_key(seed, &account_key);
	err = fp_storage_ak_save(&account_key, NULL);
	zassert_ok(err, "Unexpected error during Account Key save");

	struct fp_account_key read_keys[ACCOUNT_KEY_MAX_CNT];
	size_t read_cnt = ACCOUNT_KEY_MAX_CNT;

	zassert_equal(fp_storage_ak_count(), 1, "Invalid Account Key count");
	err = fp_storage_ak_get(read_keys, &read_cnt);
	zassert_ok(err, "Getting Account Keys failed");
	zassert_equal(read_cnt, 1, "Invalid Account Key count");
	zassert_true(cu_check_account_key_seed(seed, &read_keys[0]), "Invalid key on read");

	/* Reload keys from storage and validate them again. */
	reload_keys_from_storage();
	memset(read_keys, 0, sizeof(read_keys));
	read_cnt = ACCOUNT_KEY_MAX_CNT;

	zassert_equal(fp_storage_ak_count(), 1, "Invalid Account Key count");
	err = fp_storage_ak_get(read_keys, &read_cnt);
	zassert_ok(err, "Getting Account Keys failed");
	zassert_equal(read_cnt, 1, "Invalid Account Key count");
	zassert_true(cu_check_account_key_seed(seed, &read_keys[0]), "Invalid key on read");
}

ZTEST(suite_fast_pair_storage_common, test_reinitialization)
{
	static const uint8_t first_seed;
	static const size_t test_key_cnt = MIN(ACCOUNT_KEY_MAX_CNT, 5);
	int err;

	cu_account_keys_generate_and_store(first_seed, test_key_cnt);
	cu_account_keys_validate_loaded(first_seed, test_key_cnt);

	err = fp_storage_uninit();
	zassert_ok(err, "Uninitialization failed");
	cu_account_keys_validate_uninitialized();

	err = fp_storage_init();
	zassert_ok(err, "Initialization failed");
	cu_account_keys_validate_loaded(first_seed, test_key_cnt);
}

ZTEST(suite_fast_pair_storage_common, test_duplicate)
{
	static const uint8_t seed = 3;

	int err;
	struct fp_account_key account_key;

	cu_generate_account_key(seed, &account_key);
	err = fp_storage_ak_save(&account_key, NULL);
	zassert_ok(err, "Unexpected error during Account Key save");

	/* Try to add key duplicate. */
	err = fp_storage_ak_save(&account_key, NULL);
	if (!IS_ENABLED(CONFIG_BT_FAST_PAIR_STORAGE_OWNER_ACCOUNT_KEY)) {
		zassert_ok(err, "Unexpected error during Account Key save");
	} else {
		zassert_equal(err, -EALREADY, "Error expected if second key added");
	}

	struct fp_account_key read_keys[ACCOUNT_KEY_MAX_CNT];
	size_t read_cnt = ACCOUNT_KEY_MAX_CNT;

	zassert_equal(fp_storage_ak_count(), 1, "Invalid Account Key count");
	err = fp_storage_ak_get(read_keys, &read_cnt);
	zassert_ok(err, "Getting Account Keys failed");
	zassert_equal(read_cnt, 1, "Invalid Account Key count");
	zassert_true(cu_check_account_key_seed(seed, &read_keys[0]), "Invalid key on read");

	/* Reload keys from storage and validate them again. */
	reload_keys_from_storage();
	memset(read_keys, 0, sizeof(read_keys));
	read_cnt = ACCOUNT_KEY_MAX_CNT;

	zassert_equal(fp_storage_ak_count(), 1, "Invalid Account Key count");
	err = fp_storage_ak_get(read_keys, &read_cnt);
	zassert_ok(err, "Getting Account Keys failed");
	zassert_equal(read_cnt, 1, "Invalid Account Key count");
	zassert_true(cu_check_account_key_seed(seed, &read_keys[0]), "Invalid key on read");
}

ZTEST(suite_fast_pair_storage_common, test_invalid_calls)
{
	static const uint8_t first_seed = 3;
	static const uint8_t test_key_cnt = MIN(ACCOUNT_KEY_MAX_CNT, 3);

	int err;
	struct fp_account_key found_key;
	struct fp_account_key read_keys[ACCOUNT_KEY_MAX_CNT];

	cu_account_keys_generate_and_store(first_seed, test_key_cnt);

	for (size_t read_cnt = 0; read_cnt <= ACCOUNT_KEY_MAX_CNT; read_cnt++) {
		size_t read_cnt_ret = read_cnt;

		err = fp_storage_ak_get(read_keys, &read_cnt_ret);

		if (read_cnt < test_key_cnt) {
			zassert_equal(err, -EINVAL, "Expected error when array is too small");
		} else {
			zassert_ok(err, "Unexpected error during Account Keys get");
			zassert_equal(read_cnt_ret, test_key_cnt, "Inavlid account key count");

			for (size_t i = 0; i < read_cnt_ret; i++) {
				zassert_true(cu_check_account_key_seed(
						first_seed + i, &read_keys[i]),
					     "Invalid key on read");
			}
		}
	}

	uint8_t find_seed = first_seed;

	err = fp_storage_ak_find(&found_key, NULL, &find_seed);
	zassert_equal(err, -EINVAL, "Expected error when callback is NULL");
}

static bool account_key_find_cb(const struct fp_account_key *account_key, void *context)
{
	uint8_t *seed = context;

	return cu_check_account_key_seed(*seed, account_key);
}

ZTEST(suite_fast_pair_storage_common, test_find)
{
	static const uint8_t first_seed;
	static const size_t test_key_cnt = MIN(ACCOUNT_KEY_MAX_CNT, 3);
	int err = 0;

	cu_account_keys_generate_and_store(first_seed, test_key_cnt);

	for (uint8_t seed = first_seed; seed < (first_seed + test_key_cnt); seed++) {
		struct fp_account_key account_key;
		uint8_t prev_seed = seed;

		err = fp_storage_ak_find(&account_key, account_key_find_cb, &seed);
		zassert_ok(err, "Failed to find Account Key");
		zassert_equal(prev_seed, seed, "Context should not be modified");
		zassert_true(cu_check_account_key_seed(seed, &account_key),
			     "Found wrong Account Key");
	}

	for (uint8_t seed = first_seed; seed < (first_seed + test_key_cnt + 1); seed++) {
		uint8_t prev_seed = seed;

		err = fp_storage_ak_find(NULL, account_key_find_cb, &seed);
		zassert_equal(prev_seed, seed, "Context should not be modified");
		if (err) {
			zassert_equal(seed, (first_seed + test_key_cnt),
				      "Failed to find Acount Key");
			break;
		}
	}

	zassert_equal(err, -ESRCH, "Expected error when key cannot be found");
}

ZTEST(suite_fast_pair_storage_common, test_bt_has_ak)
{
	static const uint8_t first_seed;
	static const size_t test_key_cnt = MIN(ACCOUNT_KEY_MAX_CNT, 3);

	zassert_false(fp_storage_ak_has_account_key(), "No account key should be stored");

	cu_account_keys_generate_and_store(first_seed, test_key_cnt);
	zassert_true(fp_storage_ak_has_account_key(), "Account key should be stored");

	/* Reload keys from storage and validate them again. */
	reload_keys_from_storage();
	zassert_true(fp_storage_ak_has_account_key(), "Account key should be stored after reload");
}

ZTEST(suite_fast_pair_storage_common, test_loop)
{
	if (IS_ENABLED(CONFIG_BT_FAST_PAIR_STORAGE_OWNER_ACCOUNT_KEY) &&
	   (ACCOUNT_KEY_CNT < 2)) {
		ztest_test_skip();
	}

	static const uint8_t first_seed;

	for (uint8_t i = 1; i < UCHAR_MAX; i++) {
		/* Triggering before function twice in a row would lead to assertion failure.
		 * The function checks if settings are not loaded and then loads the settings.
		 */
		if (i > 1) {
			before_fn(NULL);
		}

		cu_account_keys_generate_and_store(first_seed, i);
		cu_account_keys_validate_loaded(first_seed, i);

		/* Reload keys from storage and validate them again. */
		reload_keys_from_storage();
		cu_account_keys_validate_loaded(first_seed, i);

		after_fn(NULL);
	}
}

ZTEST(suite_fast_pair_storage_common, test_owner_key)
{
	if (!IS_ENABLED(CONFIG_BT_FAST_PAIR_STORAGE_OWNER_ACCOUNT_KEY)) {
		ztest_test_skip();
	} else {
		static const uint8_t seed;

		int ret;
		struct fp_account_key account_key;
		struct fp_account_key next_account_key;

		cu_generate_account_key(seed, &account_key);
		ret = fp_storage_ak_is_owner(&account_key);
		zassert_equal(ret, -ESRCH, "No owner account key should be stored");

		ret = fp_storage_ak_save(&account_key, NULL);
		zassert_ok(ret, "Unexpected error during Account Key save");

		ret = fp_storage_ak_is_owner(&account_key);
		zassert_equal(ret, 1, "Owner account key should be stored");

		cu_generate_account_key(seed + 1, &next_account_key);
		ret = fp_storage_ak_is_owner(&next_account_key);
		zassert_equal(ret, 0, "Owner account key different than questioned");

		/* Reload keys from storage and validate them again. */
		reload_keys_from_storage();

		ret = fp_storage_ak_is_owner(&account_key);
		zassert_equal(ret, 1, "Owner account key should be stored");

		ret = fp_storage_ak_is_owner(&next_account_key);
		zassert_equal(ret, 0, "Owner account key different than questioned");
	}
}

ZTEST_SUITE(suite_fast_pair_storage_common, NULL, NULL, before_fn, after_fn, NULL);
```

## include/storage_mock.h
```c
/*
 * Copyright (c) 2022 Nordic Semiconductor ASA
 *
 * SPDX-License-Identifier: LicenseRef-Nordic-5-Clause
 */

#ifndef _STORAGE_MOCK_H_
#define _STORAGE_MOCK_H_

/**
 * @defgroup fp_storage_test_storage_mock Fast Pair storage unit test's mocked storage
 * @brief API of mocked storage used by the Fast Pair storage unit test
 *
 * The mocked storage registers Zephyr's setting backend and provides API to clear stored data.
 *
 * @{
 */

#ifdef __cplusplus
extern "C" {
#endif

/** Clear mocked settings storage.
 *
 * The function removes all data stored in the mocked storage.
 */
void storage_mock_clear(void);

#ifdef __cplusplus
}
#endif

/**
 * @}
 */

#endif /* _STORAGE_MOCK_H_ */
```

## include/test_corrupted_data.h
```c
/*
 * Copyright (c) 2022 Nordic Semiconductor ASA
 *
 * SPDX-License-Identifier: LicenseRef-Nordic-5-Clause
 */

#ifndef _TEST_CORRUPTED_DATA_H_
#define _TEST_CORRUPTED_DATA_H_

/**
 * @defgroup fp_storage_test_corrupted_data Fast Pair storage corrupted data unit test
 * @brief Unit test of handling corrupted data in the Fast Pair storage
 *
 * @{
 */

#ifdef __cplusplus
extern "C" {
#endif

/** Start test suite of corrupted data handling in the Fast Pair storage.
 *
 * The test suite verifies handling of corrupted settings data in the Fast Pair storage module.
 */
void test_corrupted_data_run(void);

#ifdef __cplusplus
}
#endif

/**
 * @}
 */

#endif /* _TEST_CORRUPTED_DATA_H_ */
```

## src/settings_mock.c
```c
/*
 * Copyright (c) 2022 Nordic Semiconductor ASA
 *
 * SPDX-License-Identifier: LicenseRef-Nordic-5-Clause
 */

#include <zephyr/ztest.h>
#include <string.h>
#include <zephyr/settings/settings.h>
#include <zephyr/device.h>

#include "storage_mock.h"

struct settings_data {
	sys_snode_t node;
	char *name;
	char *val;
	size_t val_len;
};

static sys_slist_t settings_list;


void storage_mock_clear(void)
{
	while (!sys_slist_is_empty(&settings_list)) {
		sys_snode_t *cur_node = sys_slist_get(&settings_list);
		struct settings_data *data = CONTAINER_OF(cur_node, struct settings_data, node);

		k_free(data->val);
		k_free(data->name);
		k_free(data);
	}
}

static ssize_t settings_mock_read_fn(void *back_end, void *data, size_t len)
{
	struct settings_data *settings_data = back_end;

	zassert_true(len <= settings_data->val_len, "Invalid readout length");
	memcpy(data, settings_data->val, len);

	return len;
}

static int settings_mock_load(struct settings_store *cs, const struct settings_load_arg *arg)
{
	zassert_is_null(arg->subtree, "Reading only specified subtree is not supported");

	int err = 0;
	sys_snode_t *cur_node;

	SYS_SLIST_FOR_EACH_NODE(&settings_list, cur_node) {
		struct settings_data *data = CONTAINER_OF(cur_node, struct settings_data, node);

		err = settings_call_set_handler(data->name, data->val_len, settings_mock_read_fn,
						data, arg);

		if (err) {
			break;
		}
	}

	return err;
}

static int settings_mock_save(struct settings_store *cs, const char *name, const char *value,
			      size_t val_len)
{
	const static size_t max_name_len = 64;

	struct settings_data *record;
	bool found = false;
	size_t name_len = strnlen(name, max_name_len);

	zassert_not_equal(name_len, max_name_len, "Too long settings key");

	sys_snode_t *cur_node;

	/* Update record if exists. */
	SYS_SLIST_FOR_EACH_NODE(&settings_list, cur_node) {
		record = CONTAINER_OF(cur_node, struct settings_data, node);

		if (!strcmp(record->name, name)) {
			found = true;
			break;
		}
	}

	if (found) {
		if (val_len == 0) {
			bool ret;

			k_free(record->val);
			k_free(record->name);
			ret = sys_slist_find_and_remove(&settings_list, &(record->node));
			zassert_true(ret, "Unable to delete settings item");
			k_free(record);

			return 0;
		}

		if (val_len != record->val_len) {
			k_free(record->val);

			record->val = k_malloc(val_len);
			zassert_not_null(record->val, "Heap too small. Increase heap size.");
			record->val_len = val_len;
		}

		memcpy(record->val, value, val_len);

		return 0;
	}

	if (val_len == 0) {
		return 0;
	}

	record = k_malloc(sizeof(*record));
	zassert_not_null(record, "Heap too small. Increase heap size.");

	record->name = k_malloc(name_len + 1);
	zassert_not_null(record->name, "Heap too small. Increase heap size.");
	strcpy(record->name, name);

	record->val = k_malloc(val_len);
	zassert_not_null(record->val, "Heap too small. Increase heap size.");
	memcpy(record->val, value, val_len);
	record->val_len = val_len;

	sys_slist_append(&settings_list, &record->node);

	return 0;
}

static struct settings_store_itf settings_mock_itf = {
	.csi_load = settings_mock_load,
	.csi_save = settings_mock_save,
};

static struct settings_store settings_mock_store = {
	.cs_itf = &settings_mock_itf
};

int settings_mock_init(void)
{
	sys_slist_init(&settings_list);

	settings_dst_register(&settings_mock_store);
	settings_src_register(&settings_mock_store);

	return 0;
}

SYS_INIT(settings_mock_init, POST_KERNEL, CONFIG_KERNEL_INIT_PRIORITY_DEVICE);
```

## src/test_corrupted_data.c
```c
/*
 * Copyright (c) 2022 Nordic Semiconductor ASA
 *
 * SPDX-License-Identifier: LicenseRef-Nordic-5-Clause
 */

#include <zephyr/ztest.h>
#include <zephyr/settings/settings.h>

#include "fp_storage_ak.h"
#include "fp_storage.h"
#include "fp_storage_ak_priv.h"
#include "fp_storage_manager_priv.h"

#include "storage_mock.h"
#include "common_utils.h"

BUILD_ASSERT((ACCOUNT_KEY_CNT == 1) ||
	     !IS_ENABLED(CONFIG_BT_FAST_PAIR_STORAGE_OWNER_ACCOUNT_KEY),
	     "This test suite does not support storage configuration with the Owner Account Key "
	     "and standard Account Keys");

/* This function is made just for this corrupted data test.
 * It assumes that the least recently used key is always the oldest key that has been written.
 * It's not meant to be used anywhere else.
 */
static uint8_t next_account_key_id(uint8_t account_key_id)
{
	if (account_key_id == ACCOUNT_KEY_MAX_ID) {
		return ACCOUNT_KEY_MIN_ID;
	}

	return account_key_id + 1;
}

static void store_key(uint8_t key_id, bool is_owner)
{
	int err;
	char settings_key[SETTINGS_AK_NAME_MAX_SIZE] = SETTINGS_AK_FULL_PREFIX;
	struct account_key_data data;

	zassert_true(('0' + account_key_id_to_idx(key_id)) <= '9', "Key index out of range");
	settings_key[ARRAY_SIZE(settings_key) - 2] = ('0' + account_key_id_to_idx(key_id));

	data.account_key_metadata = 0;
	ACCOUNT_KEY_METADATA_FIELD_SET(data.account_key_metadata, ID, key_id);
	if (IS_ENABLED(CONFIG_BT_FAST_PAIR_STORAGE_OWNER_ACCOUNT_KEY)
	    && is_owner) {
		ACCOUNT_KEY_METADATA_FIELD_SET(data.account_key_metadata, OWNER, 1);
	}
	cu_generate_account_key(key_id, &data.account_key);

	err = settings_save_one(settings_key, &data, sizeof(data));
	zassert_ok(err, "Unexpected error in settings save");
}

static void self_test_after(void *f)
{
	fp_storage_ak_ram_clear();
	fp_storage_manager_ram_clear();
	storage_mock_clear();
	cu_account_keys_validate_uninitialized();
}

ZTEST(suite_settings_mock_self_test, test_self_basic)
{
	int err;
	uint8_t key_id = ACCOUNT_KEY_MIN_ID;
	uint8_t key_cnt = 0;

	for (size_t i = 0; i < ACCOUNT_KEY_CNT; i++) {
		if (i == 0) {
			store_key(key_id, true);
		} else {
			store_key(key_id, false);
		}
		key_cnt++;
		key_id = next_account_key_id(key_id);
	}


	err = settings_load();
	zassert_ok(err, "Unexpected error in settings load");

	err = fp_storage_init();
	zassert_ok(err, "Unexpected error in modules init");

	cu_account_keys_validate_loaded(ACCOUNT_KEY_MIN_ID, key_cnt);
}

ZTEST(suite_settings_mock_self_test, test_self_rollover)
{
	if (IS_ENABLED(CONFIG_BT_FAST_PAIR_STORAGE_OWNER_ACCOUNT_KEY)) {
		ztest_test_skip();
	}

	int err;
	uint8_t key_id = ACCOUNT_KEY_MIN_ID;
	uint8_t key_cnt = 0;

	for (size_t i = 0; i < ACCOUNT_KEY_CNT; i++) {
		if (i == 0) {
			store_key(key_id, true);
		} else {
			store_key(key_id, false);
		}
		key_cnt++;
		key_id = next_account_key_id(key_id);
	}

	store_key(key_id, false);
	key_cnt++;


	err = settings_load();
	zassert_ok(err, "Unexpected error in settings load");

	err = fp_storage_init();
	zassert_ok(err, "Unexpected error in modules init");

	cu_account_keys_validate_loaded(ACCOUNT_KEY_MIN_ID, key_cnt);
}

ZTEST_SUITE(suite_settings_mock_self_test, NULL, NULL, NULL, self_test_after, NULL);


static void before_fn(void *f)
{
	/* Make sure that settings are not yet loaded. Settings will be populated with data and
	 * loaded by the unit test.
	 */
	ARG_UNUSED(f);

	cu_account_keys_validate_uninitialized();
}

static void after_fn(void *f)
{
	ARG_UNUSED(f);

	fp_storage_ak_ram_clear();
	fp_storage_manager_ram_clear();
	storage_mock_clear();
}

static void initialization_error_validate(void)
{
	int err;

	err = settings_load();
	zassert_ok(err, "Unexpected error in settings load");

	err = fp_storage_init();
	zassert_not_equal(err, 0, "Expected error during initialization");
	cu_account_keys_validate_uninitialized();
}

ZTEST(suite_fast_pair_storage_corrupted, test_wrong_settings_key)
{
	static const uint8_t key_id = ACCOUNT_KEY_MIN_ID;

	int err;
	struct account_key_data data;

	data.account_key_metadata = 0;
	ACCOUNT_KEY_METADATA_FIELD_SET(data.account_key_metadata, ID, key_id);
	cu_generate_account_key(key_id, &data.account_key);

	err = settings_save_one(SETTINGS_AK_SUBTREE_NAME SETTINGS_NAME_SEPARATOR_STR
				"not_account_key", &data, sizeof(data));
	zassert_ok(err, "Unexpected error in settings save");

	initialization_error_validate();
}

ZTEST(suite_fast_pair_storage_corrupted, test_wrong_data_len)
{
	static const uint8_t key_id = ACCOUNT_KEY_MIN_ID;

	int err;
	char settings_key[SETTINGS_AK_NAME_MAX_SIZE] = SETTINGS_AK_FULL_PREFIX;
	struct account_key_data data;

	zassert_true(('0' + account_key_id_to_idx(key_id)) <= '9', "Key index out of range");
	settings_key[ARRAY_SIZE(settings_key) - 2] = ('0' + account_key_id_to_idx(key_id));

	data.account_key_metadata = 0;
	ACCOUNT_KEY_METADATA_FIELD_SET(data.account_key_metadata, ID, key_id);
	cu_generate_account_key(key_id, &data.account_key);

	err = settings_save_one(settings_key, &data, sizeof(data) - 1);
	zassert_ok(err, "Unexpected error in settings save");

	initialization_error_validate();
}

ZTEST(suite_fast_pair_storage_corrupted, test_inconsistent_key_id)
{
	static const uint8_t key_id = ACCOUNT_KEY_MIN_ID;

	int err;
	char settings_key[SETTINGS_AK_NAME_MAX_SIZE] = SETTINGS_AK_FULL_PREFIX;
	struct account_key_data data;

	zassert_true(('0' + account_key_id_to_idx(key_id)) <= '9', "Key index out of range");
	settings_key[ARRAY_SIZE(settings_key) - 2] = ('0' + account_key_id_to_idx(key_id));

	data.account_key_metadata = 0;
	ACCOUNT_KEY_METADATA_FIELD_SET(data.account_key_metadata, ID, next_account_key_id(key_id));
	cu_generate_account_key(key_id, &data.account_key);

	err = settings_save_one(settings_key, &data, sizeof(data));
	zassert_ok(err, "Unexpected error in settings save");

	initialization_error_validate();
}

ZTEST(suite_fast_pair_storage_corrupted, test_drop_first_key)
{
	if (ACCOUNT_KEY_CNT < 2) {
		store_key(ACCOUNT_KEY_MIN_ID + 1, false);
	} else {
		store_key(next_account_key_id(ACCOUNT_KEY_MIN_ID), false);
	}

	initialization_error_validate();
}

ZTEST(suite_fast_pair_storage_corrupted, test_drop_key)
{
	if (ACCOUNT_KEY_CNT < 2) {
		ztest_test_skip();
	}

	uint8_t key_id = ACCOUNT_KEY_MIN_ID;

	store_key(key_id, true);

	key_id = next_account_key_id(key_id);
	store_key(key_id, false);

	key_id = next_account_key_id(key_id);
	key_id = next_account_key_id(key_id);
	store_key(key_id, false);

	initialization_error_validate();
}

ZTEST(suite_fast_pair_storage_corrupted, test_drop_keys)
{
	if (ACCOUNT_KEY_CNT < 2) {
		ztest_test_skip();
	}

	uint8_t key_id = ACCOUNT_KEY_MIN_ID;

	store_key(key_id, true);

	for (size_t i = 0; i < ACCOUNT_KEY_CNT; i++) {
		key_id = next_account_key_id(key_id);
	}

	zassert_equal(account_key_id_to_idx(ACCOUNT_KEY_MIN_ID), account_key_id_to_idx(key_id),
		      "Test should write key exactly after rollover");
	store_key(key_id, false);

	initialization_error_validate();
}

ZTEST(suite_fast_pair_storage_corrupted, test_no_account_key_metadata_owner)
{
	if (!IS_ENABLED(CONFIG_BT_FAST_PAIR_STORAGE_OWNER_ACCOUNT_KEY)) {
		ztest_test_skip();
	} else {
		static const uint8_t key_id = ACCOUNT_KEY_MIN_ID;

		store_key(key_id, false);

		initialization_error_validate();
	}
}

ZTEST_SUITE(suite_fast_pair_storage_corrupted, NULL, NULL, before_fn, after_fn, NULL);
```
