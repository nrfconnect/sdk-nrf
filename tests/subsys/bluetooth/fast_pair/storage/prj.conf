## CMakeLists.txt
```
#
# Copyright (c) 2022 Nordic Semiconductor ASA
#
# SPDX-License-Identifier: LicenseRef-Nordic-5-Clause
#

cmake_minimum_required(VERSION 3.20.0)

find_package(Zephyr REQUIRED HINTS $ENV{ZEPHYR_BASE})
project("Fast Pair storage unit test")

# Add test sources
target_sources(app PRIVATE
	       src/main.c
	       src/common_utils.c
	       src/settings_mock.c
	       src/test_corrupted_data.c
)
target_include_directories(app PRIVATE include)

# Add Fast Pair storage as part of the test
set(NCS_FAST_PAIR_BASE ${NRF_DIR}/subsys/bluetooth/services/fast_pair)
add_subdirectory(${NCS_FAST_PAIR_BASE}/fp_storage fp_storage)
target_link_libraries(app PRIVATE fp_storage)
```

## Kconfig
```
#
# Copyright (c) 2022 Nordic Semiconductor
#
# SPDX-License-Identifier: LicenseRef-Nordic-5-Clause
#

source "Kconfig.zephyr"

config BT_FAST_PAIR_STORAGE_ACCOUNT_KEY_MAX
	int "Maximum number of stored Account Keys"
	range 5 10
	default 5
	help
	  Maximum number of stored account keys. According to Fast Pair specification, it should be
	  at least equal to 5. It can not be larger than 10, because then Account Key Filter length
	  would not fit in the "field length and type" data field specified in the non-discoverable
	  advertising packet.

module = BT_FAST_PAIR
module-str = Fast Pair Service
source "${ZEPHYR_BASE}/subsys/logging/Kconfig.template.log_config"
```

## prj.conf
```kconfig
#
# Copyright (c) 2022 Nordic Semiconductor ASA
#
# SPDX-License-Identifier: LicenseRef-Nordic-5-Clause
#

CONFIG_ZTEST=y
CONFIG_SETTINGS=y
CONFIG_SETTINGS_CUSTOM=y
CONFIG_HEAP_MEM_POOL_SIZE=1024

# Prevent flooding logs with information about erasing the oldest Account Key.
CONFIG_FP_STORAGE_LOG_LEVEL_WRN=y

# Private API is used to prepopulate settings wtih mocked data in corrupted data test.
CONFIG_BT_FAST_PAIR_STORAGE_EXPOSE_PRIV_API=y
```

## src/main.c
```c
/*
 * Copyright (c) 2022 Nordic Semiconductor ASA
 *
 * SPDX-License-Identifier: LicenseRef-Nordic-5-Clause
 */

#include <zephyr/ztest.h>
#include <zephyr/settings/settings.h>

#include "fp_storage_ak.h"
#include "fp_common.h"

#include "storage_mock.h"
#include "common_utils.h"
#include "test_corrupted_data.h"

#define ACCOUNT_KEY_MAX_CNT	CONFIG_BT_FAST_PAIR_STORAGE_ACCOUNT_KEY_MAX


static void reload_keys_from_storage(void)
{
	int err;

	fp_storage_ak_ram_clear();
	cu_account_keys_validate_unloaded();
	err = settings_load();

	zassert_ok(err, "Failed to load settings");
}

static void setup_fn(void)
{
	int err;

	cu_account_keys_validate_unloaded();

	/* Load empty settings before the test to initialize fp_storage. */
	err = settings_load();

	zassert_ok(err, "Settings load failed");
}

static void teardown_fn(void)
{
	fp_storage_ak_ram_clear();
	storage_mock_clear();
	cu_account_keys_validate_unloaded();
}

static void test_unloaded(void)
{
	static const uint8_t seed = 0;

	int err;
	struct fp_account_key account_key;

	cu_account_keys_validate_unloaded();
	cu_generate_account_key(seed, &account_key);

	err = fp_storage_ak_save(&account_key);
	zassert_equal(err, -ENODATA, "Expected error before settings load");
}

static void test_one_key(void)
{
	static const uint8_t seed = 5;

	int err;
	struct fp_account_key account_key;

	cu_generate_account_key(seed, &account_key);
	err = fp_storage_ak_save(&account_key);
	zassert_ok(err, "Unexpected error during Account Key save");

	struct fp_account_key read_keys[ACCOUNT_KEY_MAX_CNT];
	size_t read_cnt = ACCOUNT_KEY_MAX_CNT;

	zassert_equal(fp_storage_ak_count(), 1, "Invalid Account Key count");
	err = fp_storage_ak_get(read_keys, &read_cnt);
	zassert_ok(err, "Getting Account Keys failed");
	zassert_equal(read_cnt, 1, "Invalid Account Key count");
	zassert_true(cu_check_account_key_seed(seed, &read_keys[0]), "Invalid key on read");

	/* Reload keys from storage and validate them again. */
	reload_keys_from_storage();
	memset(read_keys, 0, sizeof(read_keys));
	read_cnt = ACCOUNT_KEY_MAX_CNT;

	zassert_equal(fp_storage_ak_count(), 1, "Invalid Account Key count");
	err = fp_storage_ak_get(read_keys, &read_cnt);
	zassert_ok(err, "Getting Account Keys failed");
	zassert_equal(read_cnt, 1, "Invalid Account Key count");
	zassert_true(cu_check_account_key_seed(seed, &read_keys[0]), "Invalid key on read");
}

static void test_duplicate(void)
{
	static const uint8_t seed = 3;

	int err;
	struct fp_account_key account_key;

	cu_generate_account_key(seed, &account_key);
	err = fp_storage_ak_save(&account_key);
	zassert_ok(err, "Unexpected error during Account Key save");

	/* Try to add key duplicate. */
	err = fp_storage_ak_save(&account_key);
	zassert_ok(err, "Unexpected error during Account Key save");

	struct fp_account_key read_keys[ACCOUNT_KEY_MAX_CNT];
	size_t read_cnt = ACCOUNT_KEY_MAX_CNT;

	zassert_equal(fp_storage_ak_count(), 1, "Invalid Account Key count");
	err = fp_storage_ak_get(read_keys, &read_cnt);
	zassert_ok(err, "Getting Account Keys failed");
	zassert_equal(read_cnt, 1, "Invalid Account Key count");
	zassert_true(cu_check_account_key_seed(seed, &read_keys[0]), "Invalid key on read");

	/* Reload keys from storage and validate them again. */
	reload_keys_from_storage();
	memset(read_keys, 0, sizeof(read_keys));
	read_cnt = ACCOUNT_KEY_MAX_CNT;

	zassert_equal(fp_storage_ak_count(), 1, "Invalid Account Key count");
	err = fp_storage_ak_get(read_keys, &read_cnt);
	zassert_ok(err, "Getting Account Keys failed");
	zassert_equal(read_cnt, 1, "Invalid Account Key count");
	zassert_true(cu_check_account_key_seed(seed, &read_keys[0]), "Invalid key on read");
}

static void generate_and_store_keys(uint8_t first_seed, uint8_t gen_count)
{
	int err;
	struct fp_account_key account_key;

	zassert_true((first_seed + gen_count) <= (UCHAR_MAX + 1), "Invalid seed range");

	for (uint8_t i = 0; i < gen_count; i++) {
		cu_generate_account_key(i + first_seed, &account_key);

		err = fp_storage_ak_save(&account_key);
		zassert_ok(err, "Failed to store Account Key");
	}
}

static void test_invalid_calls(void)
{
	static const uint8_t first_seed = 3;
	static const uint8_t test_key_cnt = 3;

	int err;
	struct fp_account_key found_key;
	struct fp_account_key read_keys[ACCOUNT_KEY_MAX_CNT];

	generate_and_store_keys(first_seed, test_key_cnt);

	for (size_t read_cnt = 0; read_cnt <= ACCOUNT_KEY_MAX_CNT; read_cnt++) {
		size_t read_cnt_ret = read_cnt;

		err = fp_storage_ak_get(read_keys, &read_cnt_ret);

		if (read_cnt < test_key_cnt) {
			zassert_equal(err, -EINVAL, "Expected error when array is too small");
		} else {
			zassert_ok(err, "Unexpected error during Account Keys get");
			zassert_equal(read_cnt_ret, test_key_cnt, "Inavlid account key count");

			for (size_t i = 0; i < read_cnt_ret; i++) {
				zassert_true(cu_check_account_key_seed(
						first_seed + i, &read_keys[i]),
					     "Invalid key on read");
			}
		}
	}

	uint8_t find_seed = first_seed;

	err = fp_storage_ak_find(&found_key, NULL, &find_seed);
	zassert_equal(err, -EINVAL, "Expected error when callback is NULL");
}

static bool account_key_find_cb(const struct fp_account_key *account_key, void *context)
{
	uint8_t *seed = context;

	return cu_check_account_key_seed(*seed, account_key);
}

static void test_find(void)
{
	static const uint8_t first_seed = 0;
	static const size_t test_key_cnt = 3;
	int err = 0;

	generate_and_store_keys(first_seed, test_key_cnt);

	for (uint8_t seed = first_seed; seed < (first_seed + test_key_cnt); seed++) {
		struct fp_account_key account_key;
		uint8_t prev_seed = seed;

		err = fp_storage_ak_find(&account_key, account_key_find_cb, &seed);
		zassert_ok(err, "Failed to find Account Key");
		zassert_equal(prev_seed, seed, "Context should not be modified");
		zassert_true(cu_check_account_key_seed(seed, &account_key),
			     "Found wrong Account Key");
	}

	for (uint8_t seed = first_seed; seed < (first_seed + test_key_cnt + 1); seed++) {
		uint8_t prev_seed = seed;

		err = fp_storage_ak_find(NULL, account_key_find_cb, &seed);
		zassert_equal(prev_seed, seed, "Context should not be modified");
		if (err) {
			zassert_equal(seed, (first_seed + test_key_cnt),
				      "Failed to find Acount Key");
			break;
		}
	}

	zassert_equal(err, -ESRCH, "Expected error when key cannot be found");
}

static void test_loop(void)
{
	static const uint8_t first_seed = 0;

	for (uint8_t i = 1; i < UCHAR_MAX; i++) {
		setup_fn();

		generate_and_store_keys(first_seed, i);
		cu_account_keys_validate_loaded(first_seed, i);

		/* Reload keys from storage and validate them again. */
		reload_keys_from_storage();
		cu_account_keys_validate_loaded(first_seed, i);

		teardown_fn();
	}
}

void test_main(void)
{
	ztest_test_suite(fast_pair_storage_tests,
			 ztest_unit_test(test_unloaded),
			 ztest_unit_test_setup_teardown(test_one_key, setup_fn, teardown_fn),
			 ztest_unit_test_setup_teardown(test_duplicate, setup_fn, teardown_fn),
			 ztest_unit_test_setup_teardown(test_invalid_calls, setup_fn, teardown_fn),
			 ztest_unit_test_setup_teardown(test_find, setup_fn, teardown_fn),
			 ztest_unit_test(test_loop)
			 );

	ztest_run_test_suite(fast_pair_storage_tests);
	/* Test cases verifying that module properly handles settings data corruption.
	 * Corrupted data test suite relies on internal data representation.
	 */
	test_corrupted_data_run();
}
```

## include/common_utils.h
```c
/*
 * Copyright (c) 2022 Nordic Semiconductor ASA
 *
 * SPDX-License-Identifier: LicenseRef-Nordic-5-Clause
 */

#ifndef _COMMON_UTILS_H_
#define _COMMON_UTILS_H_

/**
 * @defgroup fp_storage_test_common_utils Fast Pair storage unit test common utilities
 * @brief Common utilities of the Fast Pair storage unit test
 *
 * @{
 */

#ifdef __cplusplus
extern "C" {
#endif

/** Generate mocked Account Key data.
 *
 * @param[in]  seed		Seed used to generate the Account Key.
 * @param[out] account_key 	Buffer used to store generated Account Key.
 */
void cu_generate_account_key(uint8_t seed, struct fp_account_key *account_key);

/** Check if Account Key data was generated from provided seed.
 *
 * @param[in] seed		Seed to be verified.
 * @param[in] account_key	Account Key data to be verified.
 *
 * @return true If the Account Key data was generated from provided seed.
 *              Otherwise, false is returned.
 */
bool cu_check_account_key_seed(uint8_t seed, const struct fp_account_key *account_key);

/** Validate that Account Keys are not loaded.
 *
 * The function uses Fast Pair storage API to validate that the data is not loaded from settings.
 * Ztest asserts are used to signalize error.
 */
void cu_account_keys_validate_unloaded(void);

/** Validate the loaded Account Keys.
 *
 * The function uses Fast Pair storage API to validate that the data is valid.
 * The function assumes that @ref cu_generate_account_key was used to generate subsequent Account
 * Keys and seed value was incremented by one for each subsequent Account Key.
 * Ztest asserts are used to signalize error.
 *
 * @param[in] seed_first	Seed assigned to the first generated Account Key.
 * @param[in] stored_cnt	Number of stored keys.
 */
void cu_account_keys_validate_loaded(uint8_t seed_first, uint8_t stored_cnt);

#ifdef __cplusplus
}
#endif

/**
 * @}
 */

#endif /* _COMMON_UTILS_H_ */
```

## src/common_utils.c
```c
/*
 * Copyright (c) 2022 Nordic Semiconductor ASA
 *
 * SPDX-License-Identifier: LicenseRef-Nordic-5-Clause
 */

#include <zephyr/ztest.h>

#include "fp_common.h"
#include "fp_storage_ak.h"

#define ACCOUNT_KEY_MAX_CNT	CONFIG_BT_FAST_PAIR_STORAGE_ACCOUNT_KEY_MAX
#define ACCOUNT_KEY_LEN		FP_ACCOUNT_KEY_LEN


void cu_generate_account_key(uint8_t seed, struct fp_account_key *account_key)
{
	memset(account_key->key, seed, ACCOUNT_KEY_LEN);
}

bool cu_check_account_key_seed(uint8_t seed, const struct fp_account_key *account_key)
{
	if (account_key->key[0] != seed) {
		return false;
	}

	uint8_t expected[ACCOUNT_KEY_LEN - 1];

	memset(expected, seed, sizeof(expected));
	zassert_mem_equal(&account_key->key[1], expected, sizeof(expected), "Invalid Account Key");

	return true;
}

static bool unloaded_account_key_find_cb(const struct fp_account_key *account_key, void *context)
{
	zassert_true(false, "Callback should not be called before settings are loaded");

	return false;
}

void cu_account_keys_validate_unloaded(void)
{
	int err;
	struct fp_account_key all_keys[ACCOUNT_KEY_MAX_CNT];
	size_t key_count = ACCOUNT_KEY_MAX_CNT;

	err = fp_storage_ak_count();
	zassert_equal(err, -ENODATA, "Expected error before settings load");

	err = fp_storage_ak_get(all_keys, &key_count);
	zassert_equal(err, -ENODATA, "Expected error before settings load");

	err = fp_storage_ak_find(&all_keys[0], unloaded_account_key_find_cb, NULL);
	zassert_equal(err, -ENODATA, "Expected error before settings load");
}

void cu_account_keys_validate_loaded(uint8_t seed_first, uint8_t stored_cnt)
{
	int res;
	int key_cnt;
	struct fp_account_key read_keys[ACCOUNT_KEY_MAX_CNT];
	size_t read_cnt = ACCOUNT_KEY_MAX_CNT;

	key_cnt = fp_storage_ak_count();

	res = fp_storage_ak_get(read_keys, &read_cnt);
	zassert_ok(res, "Getting Account Keys failed");
	zassert_equal(key_cnt, read_cnt, "Invalid key count");
	zassert_equal(key_cnt, MIN(stored_cnt, ACCOUNT_KEY_MAX_CNT), "Invalid key count");

	size_t seed_min = (stored_cnt < ACCOUNT_KEY_MAX_CNT) ?
			  (0) : (stored_cnt - ACCOUNT_KEY_MAX_CNT);
	size_t seed_max = stored_cnt - 1;

	seed_min += seed_first;
	seed_max += seed_first;

	for (size_t i = seed_min; i <= seed_max; i++) {
		bool found = false;

		for (size_t j = 0; j < read_cnt; j++) {
			if (found) {
				zassert_false(cu_check_account_key_seed(i, &read_keys[j]),
					      "Key duplicate found");
			}

			if (cu_check_account_key_seed(i, &read_keys[j])) {
				found = true;
			}
		}

		zassert_true(found, "Key dropped by the Fast Pair storage");
	}
}
```

## src/settings_mock.c
```c
/*
 * Copyright (c) 2022 Nordic Semiconductor ASA
 *
 * SPDX-License-Identifier: LicenseRef-Nordic-5-Clause
 */

#include <ztest.h>
#include <string.h>
#include <zephyr/settings/settings.h>
#include <zephyr/device.h>

#include "storage_mock.h"

struct settings_data {
	sys_snode_t node;
	char *name;
	char *val;
	size_t val_len;
};

static sys_slist_t settings_list;


void storage_mock_clear(void)
{
	while (!sys_slist_is_empty(&settings_list)) {
		sys_snode_t *cur_node = sys_slist_get(&settings_list);
		struct settings_data *data = CONTAINER_OF(cur_node, struct settings_data, node);

		k_free(data->val);
		k_free(data->name);
		k_free(data);
	}
}

static ssize_t settings_mock_read_fn(void *back_end, void *data, size_t len)
{
	struct settings_data *settings_data = back_end;

	zassert_true(len <= settings_data->val_len, "Invalid readout length");
	memcpy(data, settings_data->val, len);

	return len;
}

static int settings_mock_load(struct settings_store *cs, const struct settings_load_arg *arg)
{
	zassert_is_null(arg->subtree, "Reading only specified subtree is not supported");

	int err = 0;
	sys_snode_t *cur_node;

	SYS_SLIST_FOR_EACH_NODE(&settings_list, cur_node) {
		struct settings_data *data = CONTAINER_OF(cur_node, struct settings_data, node);

		err = settings_call_set_handler(data->name, data->val_len, settings_mock_read_fn,
						data, arg);

		if (err) {
			break;
		}
	}

	return err;
}

static int settings_mock_save(struct settings_store *cs, const char *name, const char *value,
			      size_t val_len)
{
	const static size_t max_name_len = 64;

	struct settings_data *record;
	size_t name_len = strnlen(name, max_name_len);

	zassert_not_equal(name_len, max_name_len, "Too long settings key");

	sys_snode_t *cur_node;

	/* Update record if exists. */
	SYS_SLIST_FOR_EACH_NODE(&settings_list, cur_node) {
		record = CONTAINER_OF(cur_node, struct settings_data, node);

		if (!strcmp(record->name, name)) {
			if (val_len != record->val_len) {
				k_free(record->val);

				record->val = k_malloc(val_len);
				zassert_not_null(record->val, "Heap too small. Increase heap size.");
				record->val_len = val_len;
			}

			memcpy(record->val, value, val_len);
			return 0;
		}
	}

	record = k_malloc(sizeof(*record));
	zassert_not_null(record, "Heap too small. Increase heap size.");

	record->name = k_malloc(name_len + 1);
	zassert_not_null(record->name, "Heap too small. Increase heap size.");
	strcpy(record->name, name);

	record->val = k_malloc(val_len);
	zassert_not_null(record->val, "Heap too small. Increase heap size.");
	memcpy(record->val, value, val_len);
	record->val_len = val_len;

	sys_slist_append(&settings_list, &record->node);

	return 0;
}

static struct settings_store_itf settings_mock_itf = {
	.csi_load = settings_mock_load,
	.csi_save = settings_mock_save,
};

static struct settings_store settings_mock_store = {
	.cs_itf = &settings_mock_itf
};

int settings_mock_init(const struct device *unused)
{
	ARG_UNUSED(unused);
	sys_slist_init(&settings_list);

	settings_dst_register(&settings_mock_store);
	settings_src_register(&settings_mock_store);

	return 0;
}

SYS_INIT(settings_mock_init, POST_KERNEL, CONFIG_KERNEL_INIT_PRIORITY_DEVICE);
```

## src/test_corrupted_data.c
```c
/*
 * Copyright (c) 2022 Nordic Semiconductor ASA
 *
 * SPDX-License-Identifier: LicenseRef-Nordic-5-Clause
 */

#include <zephyr/ztest.h>
#include <zephyr/settings/settings.h>

#include "fp_storage_ak.h"
#include "fp_storage_ak_priv.h"

#include "storage_mock.h"
#include "common_utils.h"

#include "test_corrupted_data.h"


static void setup_fn(void)
{
	/* Make sure that settings are not yet loaded. Settings will be populated with data and
	 * loaded by the unit test.
	 */
	cu_account_keys_validate_unloaded();
}

static void teardown_fn(void)
{
	int err = settings_load();

	zassert_not_equal(err, 0, "Expected error in settings load");
	cu_account_keys_validate_unloaded();

	fp_storage_ak_ram_clear();
	storage_mock_clear();
}

/* Self test is done to ensure that the test method is valid. */
static void test_self_teardown_fn(void)
{
	fp_storage_ak_ram_clear();
	storage_mock_clear();
	cu_account_keys_validate_unloaded();
}

static void test_wrong_settings_key(void)
{
	static const uint8_t key_id = ACCOUNT_KEY_MIN_ID;

	int err;
	struct account_key_data data;

	data.account_key_id = key_id;
	cu_generate_account_key(key_id, &data.account_key);

	err = settings_save_one(SETTINGS_AK_SUBTREE_NAME SETTINGS_NAME_SEPARATOR_STR
				"not_account_key", &data, sizeof(data));
	zassert_ok(err, "Unexpected error in settings save");
}

static void test_wrong_data_len(void)
{
	static const uint8_t key_id = ACCOUNT_KEY_MIN_ID;

	int err;
	char settings_key[SETTINGS_AK_NAME_MAX_SIZE] = SETTINGS_AK_FULL_PREFIX;
	struct account_key_data data;

	zassert_true(('0' + account_key_id_to_idx(key_id)) <= '9', "Key index out of range");
	settings_key[ARRAY_SIZE(settings_key) - 2] = ('0' + account_key_id_to_idx(key_id));

	data.account_key_id = key_id;
	cu_generate_account_key(key_id, &data.account_key);

	err = settings_save_one(settings_key, &data, sizeof(data) - 1);
	zassert_ok(err, "Unexpected error in settings save");
}

static void test_inconsistent_key_id(void)
{
	static const uint8_t key_id = ACCOUNT_KEY_MIN_ID;

	int err;
	char settings_key[SETTINGS_AK_NAME_MAX_SIZE] = SETTINGS_AK_FULL_PREFIX;
	struct account_key_data data;

	zassert_true(('0' + account_key_id_to_idx(key_id)) <= '9', "Key index out of range");
	settings_key[ARRAY_SIZE(settings_key) - 2] = ('0' + account_key_id_to_idx(key_id));

	data.account_key_id = next_account_key_id(key_id);
	cu_generate_account_key(key_id, &data.account_key);

	err = settings_save_one(settings_key, &data, sizeof(data));
	zassert_ok(err, "Unexpected error in settings save");
}

static void store_key(uint8_t key_id)
{
	int err;
	char settings_key[SETTINGS_AK_NAME_MAX_SIZE] = SETTINGS_AK_FULL_PREFIX;
	struct account_key_data data;

	zassert_true(('0' + account_key_id_to_idx(key_id)) <= '9', "Key index out of range");
	settings_key[ARRAY_SIZE(settings_key) - 2] = ('0' + account_key_id_to_idx(key_id));

	data.account_key_id = key_id;
	cu_generate_account_key(key_id, &data.account_key);

	err = settings_save_one(settings_key, &data, sizeof(data));
	zassert_ok(err, "Unexpected error in settings save");
}

static void test_self(void)
{
	int err;
	uint8_t key_id = ACCOUNT_KEY_MIN_ID;
	uint8_t key_cnt = 0;

	store_key(key_id);
	key_cnt++;
	key_id = next_account_key_id(key_id);

	store_key(key_id);
	key_cnt++;
	key_id = next_account_key_id(key_id);

	store_key(key_id);
	key_cnt++;

	err = settings_load();
	zassert_ok(err, "Unexpected error in settings load");

	cu_account_keys_validate_loaded(ACCOUNT_KEY_MIN_ID, key_cnt);
}

static void test_self_rollover(void)
{
	int err;
	uint8_t key_id = ACCOUNT_KEY_MIN_ID;
	uint8_t key_cnt = 0;

	for (size_t i = 0; i < ACCOUNT_KEY_CNT; i++) {
		store_key(key_id);
		key_cnt++;
		key_id = next_account_key_id(key_id);
	}

	store_key(key_id);
	key_cnt++;
	key_id = next_account_key_id(key_id);

	store_key(key_id);
	key_cnt++;

	err = settings_load();
	zassert_ok(err, "Unexpected error in settings load");

	cu_account_keys_validate_loaded(ACCOUNT_KEY_MIN_ID, key_cnt);
}

static void test_drop_first_key(void)
{
	store_key(next_account_key_id(ACCOUNT_KEY_MIN_ID));
}

static void test_drop_key(void)
{
	uint8_t key_id = ACCOUNT_KEY_MIN_ID;

	store_key(key_id);

	key_id = next_account_key_id(key_id);
	store_key(key_id);

	key_id = next_account_key_id(key_id);
	key_id = next_account_key_id(key_id);
	store_key(key_id);
}

static void test_drop_keys(void)
{
	uint8_t key_id = ACCOUNT_KEY_MIN_ID;

	store_key(key_id);

	for (size_t i = 0; i < ACCOUNT_KEY_CNT; i++) {
		key_id = next_account_key_id(key_id);
	}

	zassert_equal(account_key_id_to_idx(ACCOUNT_KEY_MIN_ID), account_key_id_to_idx(key_id),
		      "Test should write key exactly after rollover");
	store_key(key_id);
}

static void test_drop_rollover(void)
{
	uint8_t key_id = ACCOUNT_KEY_MIN_ID;

	for (size_t i = 0; i < ACCOUNT_KEY_CNT; i++) {
		store_key(key_id);
		key_id = next_account_key_id(key_id);
	}

	zassert_equal(account_key_id_to_idx(ACCOUNT_KEY_MIN_ID), account_key_id_to_idx(key_id),
		      "Test should drop key exactly after rollover");
	key_id = next_account_key_id(key_id);
	store_key(key_id);
}

void test_corrupted_data_run(void)
{
	ztest_test_suite(fast_pair_storage_courrupted_data_tests,
			 ztest_unit_test_setup_teardown(test_self, setup_fn, test_self_teardown_fn),
			 ztest_unit_test_setup_teardown(test_self_rollover, setup_fn,
							test_self_teardown_fn),
			 ztest_unit_test_setup_teardown(test_wrong_settings_key, setup_fn,
							teardown_fn),
			 ztest_unit_test_setup_teardown(test_wrong_data_len, setup_fn, teardown_fn),
			 ztest_unit_test_setup_teardown(test_inconsistent_key_id, setup_fn,
							teardown_fn),
			 ztest_unit_test_setup_teardown(test_drop_first_key, setup_fn, teardown_fn),
			 ztest_unit_test_setup_teardown(test_drop_key, setup_fn, teardown_fn),
			 ztest_unit_test_setup_teardown(test_drop_keys, setup_fn, teardown_fn),
			 ztest_unit_test_setup_teardown(test_drop_rollover, setup_fn, teardown_fn)
			 );

	ztest_run_test_suite(fast_pair_storage_courrupted_data_tests);
}
```
