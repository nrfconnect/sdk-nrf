## CMakeLists.txt
```
#
# Copyright (c) 2020 Nordic Semiconductor ASA
#
# SPDX-License-Identifier: LicenseRef-Nordic-5-Clause
#

cmake_minimum_required(VERSION 3.20.0)

find_package(Zephyr REQUIRED HINTS $ENV{ZEPHYR_BASE})
project(NONE)

FILE(GLOB app_sources src/*.c)
target_sources(app PRIVATE ${app_sources})
target_include_directories(app PRIVATE .)
```

## Kconfig
```
#
# Copyright (c) 2021 Nordic Semiconductor ASA
#
# SPDX-License-Identifier: LicenseRef-Nordic-5-Clause
#

config SB_DEBUG_NO_VERIFY_HASHES
	bool
	default y

source "Kconfig.zephyr"
```

## Kconfig.sysbuild
```
#
# Copyright (c) 2024 Nordic Semiconductor ASA
#
# SPDX-License-Identifier: LicenseRef-Nordic-5-Clause
#

config PARTITION_MANAGER
	default n if SOC_SERIES_NRF91

config SECURE_BOOT_DEBUG_NO_VERIFY_HASHES
	bool
	default y

config SECURE_BOOT_PUBLIC_KEY_FILES
	default "$(ZEPHYR_NRF_MODULE_DIR)/tests/subsys/bootloader/bl_validation_ff_key/ff_pub.pem"

source "share/sysbuild/Kconfig"
```

## sysbuild.conf
```
#
# Copyright (c) 2024 Nordic Semiconductor
#
# SPDX-License-Identifier: LicenseRef-Nordic-5-Clause
#

SB_CONFIG_SECURE_BOOT_APPCORE=y
SB_CONFIG_SECURE_BOOT_PUBLIC_KEY_FILES="ff_pub.pem"
SB_CONFIG_PARTITION_MANAGER=n
```

## prj.conf
```kconfig
#
# Copyright (c) 2020-2023 Nordic Semiconductor ASA
#
# SPDX-License-Identifier: LicenseRef-Nordic-5-Clause
#

CONFIG_ZTEST=y
CONFIG_SECURE_BOOT=y
CONFIG_FW_INFO=y
```

## src/main.c
```c
/*
 * Copyright (c) 2020 Nordic Semiconductor ASA
 *
 * SPDX-License-Identifier: LicenseRef-Nordic-5-Clause
 */

#include <zephyr/ztest.h>

ZTEST(bl_validation_ff_test, test_ff_key)
{
	/* This test has been built with a public key whose hash contains
	 * 0xFFFF, which can be manipulated when the key is in OTP. The
	 * bootloader checks this and should refuse to boot when it finds such
	 * a key hash.
	 */
	zassert_true(false, "Should not have booted.");
}

ZTEST_SUITE(bl_validation_ff_test, NULL, NULL, NULL, NULL, NULL);
```
