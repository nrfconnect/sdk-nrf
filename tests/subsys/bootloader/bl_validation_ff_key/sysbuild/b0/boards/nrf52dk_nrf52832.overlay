/*
 * Copyright (c) 2026 Nordic Semiconductor ASA
 *
 * SPDX-License-Identifier: LicenseRef-Nordic-5-Clause
 */

#include "../../../boards/nrf52dk_nrf52832.overlay"

/ {
	chosen {
		zephyr,code-partition = &b0_partition;
	};
};
