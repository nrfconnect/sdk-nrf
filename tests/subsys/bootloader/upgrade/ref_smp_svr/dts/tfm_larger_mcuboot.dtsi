/*
 * Copyright (c) 2026 Nordic Semiconductor ASA
 *
 * SPDX-License-Identifier: LicenseRef-Nordic-5-Clause
 *
 * Enlarge the MCUboot partition to 0xf800 for TF-M NS builds (matches the
 * former PM_PARTITION_SIZE_MCUBOOT setting used by upgrade tests).
 */

&flash0 {
	partitions {
		boot_partition: partition@0 {
			reg = <0x00000000 0xf800>;
		};
	};
};
