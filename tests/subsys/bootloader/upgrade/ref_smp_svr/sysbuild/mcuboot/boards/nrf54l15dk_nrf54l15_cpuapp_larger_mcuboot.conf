## tests/subsys/bootloader/upgrade/ref_smp_svr/sysbuild/mcuboot/boards/nrf54l15dk_nrf54l15_cpuapp_larger_mcuboot.conf
```kconfig
# increasead for encryption ed25519
CONFIG_PM_PARTITION_SIZE_MCUBOOT=0x16000

# disable fprotect (to allow boot with bigger MCUboot)
CONFIG_FPROTECT=n
```

## tests/subsys/bootloader/upgrade/ref_smp_svr/sysbuild/mcuboot/boards/nrf54lc10dk_nrf54lc10a_cpuapp.conf
```kconfig
CONFIG_PM_PARTITION_SIZE_MCUBOOT=0x10800
# FPROTECT can not handle large MCUboot partition
CONFIG_FPROTECT=n

CONFIG_BOOT_WATCHDOG_FEED=n
```

## tests/subsys/bootloader/upgrade/ref_smp_svr/sysbuild/mcuboot/boards/nrf54lm20dk_nrf54lm20a_cpuapp_fprotect.conf
```kconfig
CONFIG_FPROTECT=y
CONFIG_MULTITHREADING=n

# from mcuboot/boot/zephyr/boards
CONFIG_SPI_NOR=n
CONFIG_BOOT_WATCHDOG_FEED=n
```

## tests/subsys/bootloader/upgrade/ref_smp_svr/sysbuild/mcuboot/boards/nrf54lm20dk_nrf54lm20a_cpuapp_larger_mcuboot.conf
```kconfig
# increasead for encryption ed25519
CONFIG_PM_PARTITION_SIZE_MCUBOOT=0x14000

# from mcuboot/boot/zephyr/boards
CONFIG_SPI_NOR=n
CONFIG_FPROTECT=n
CONFIG_BOOT_WATCHDOG_FEED=n
```

## tests/subsys/bootloader/upgrade/ref_smp_svr/sysbuild/mcuboot/boards/nrf54lm20dk_nrf54lm20b_cpuapp.conf
```kconfig
# from mcuboot/boot/zephyr/boards
CONFIG_SPI_NOR=n
CONFIG_FPROTECT=n
CONFIG_BOOT_WATCHDOG_FEED=n

CONFIG_ISR_TABLES_LOCAL_DECLARATION=y
CONFIG_LTO=y
```

## tests/subsys/bootloader/upgrade/ref_smp_svr/sysbuild/mcuboot/boards/nrf54ls05dk_nrf54ls05b_cpuapp.conf
```kconfig
CONFIG_MAIN_STACK_SIZE=10240
CONFIG_FPROTECT=n

CONFIG_MCUBOOT_LOG_LEVEL_DBG=y
CONFIG_ISR_TABLES_LOCAL_DECLARATION=y
CONFIG_LTO=y
```

## tests/subsys/bootloader/upgrade/ref_smp_svr/sysbuild/mcuboot/boards/nrf54lv10dk_nrf54lv10a_cpuapp_direct_xip.conf
```kconfig
CONFIG_PM_PARTITION_SIZE_MCUBOOT=0x10800
# Used MCUboot partition size is too big for FPROTECT to work.
CONFIG_FPROTECT=n
```

## tests/subsys/bootloader/upgrade/ref_smp_svr/sysbuild/mcuboot/boards/nrf54lv10dk_nrf54lv10a_cpuapp_larger_mcuboot.conf
```kconfig
CONFIG_PM_PARTITION_SIZE_MCUBOOT=0x14000
# The size of MCUboot partition is not supported with FPROTECT
CONFIG_FPROTECT=n
```

## tests/subsys/bootloader/upgrade/ref_smp_svr/sysbuild/mcuboot/boards/nrf9251dk_nrf9251_cpuapp.conf
```kconfig
# disable fprotect (to allow boot with bigger MCUboot)
CONFIG_FPROTECT=n

CONFIG_ISR_TABLES_LOCAL_DECLARATION=y
CONFIG_LTO=y
```
