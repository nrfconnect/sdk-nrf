## tests/subsys/bootloader/upgrade/ref_smp_svr/testcase.yaml
```yaml
common:
  sysbuild: true
  timeout: 600
  slow: true
  harness: pytest
  tags:
    - pytest
    - mcuboot
    - mcumgr
    - ci_tests_subsys_bootloader

tests:
  no_mcuboot_uart:
    platform_allow:
      - nrf54h20dk/nrf54h20/cpuapp
    extra_args:
      - SB_CONFIG_MCUBOOT_MODE_DIRECT_XIP=y
      - FILE_SUFFIX=direct_xip
      - CONFIG_SOC_NRF54H20_CPURAD_ENABLE=y
      - ipc_radio_CONFIG_SERIAL=y
      - ipc_radio_CONFIG_UART_CONSOLE=y
      - ipc_radio_CONFIG_LOG=y
      - mcuboot_CONFIG_SERIAL=n

  swapped_uart_v1:
    platform_allow:
      - nrf54h20dk/nrf54h20/cpuapp
    extra_args:
      - SB_CONFIG_MCUBOOT_MODE_DIRECT_XIP=y
      - FILE_SUFFIX=direct_xip
      - CONFIG_SOC_NRF54H20_CPURAD_ENABLE=y
      - ipc_radio_CONFIG_SERIAL=y
      - ipc_radio_CONFIG_UART_CONSOLE=y
      - ipc_radio_CONFIG_LOG=y
      - mcuboot_CONFIG_SERIAL=n
    required_snippets:
      - swap-uart

  swapped_uart_v2:
    platform_allow:
      - nrf54h20dk/nrf54h20/cpuapp
    extra_args:
      - SB_CONFIG_MCUBOOT_MODE_DIRECT_XIP=y
      - FILE_SUFFIX=direct_xip
      - CONFIG_SOC_NRF54H20_CPURAD_ENABLE=y
      - ipc_radio_CONFIG_SERIAL=y
      - ipc_radio_CONFIG_UART_CONSOLE=y
      - ipc_radio_CONFIG_LOG=y
      - mcuboot_CONFIG_SERIAL=n
      - CONFIG_MCUBOOT_IMGTOOL_SIGN_VERSION="2.2.2+2"
    required_snippets:
      - swap-uart

  mcuboot.upgrade.basic:
    platform_allow:
      - nrf52840dk/nrf52840
      - nrf5340dk/nrf5340/cpuapp
      - nrf9160dk/nrf9160
      - nrf54l15dk/nrf54l15/cpuapp
      - nrf54l15dk/nrf54l10/cpuapp
      - nrf54l15dk/nrf54l05/cpuapp
      - nrf54h20dk/nrf54h20/cpuapp
      - nrf54lm20dk/nrf54lm20a/cpuapp
      - nrf54lv10dk/nrf54lv10a/cpuapp
    integration_platforms:
      - nrf52840dk/nrf52840
      - nrf54l15dk/nrf54l15/cpuapp
      - nrf54l15dk/nrf54l05/cpuapp
      - nrf54h20dk/nrf54h20/cpuapp
      - nrf54lm20dk/nrf54lm20a/cpuapp
      - nrf54lv10dk/nrf54lv10a/cpuapp
    harness_config:
      pytest_root:
        - "../pytest/test_upgrade.py"
        - "../pytest/test_invalid_image.py::test_invalid_signature"
    extra_args:
      - mcuboot_CONFIG_MCUBOOT_DOWNGRADE_PREVENTION=y

  mcuboot.upgrade.serial_recovery_no_bootable_app:
    tags:
      - serial_recovery
    platform_allow:
      - nrf52840dk/nrf52840
      - nrf5340dk/nrf5340/cpuapp
      - nrf9160dk/nrf9160
      - nrf54l15dk/nrf54l15/cpuapp
      - nrf54lm20dk/nrf54lm20a/cpuapp
      - nrf54lv10dk/nrf54lv10a/cpuapp
    integration_platforms:
      - nrf54l15dk/nrf54l15/cpuapp
      - nrf54lm20dk/nrf54lm20a/cpuapp
      - nrf54lv10dk/nrf54lv10a/cpuapp
    harness_config:
      pytest_root:
        - "../pytest/test_serial_recovery.py::test_serial_recovery_after_damaging_app"
    extra_args:
      - mcuboot_CONFIG_MCUBOOT_SERIAL=y
      - mcuboot_CONFIG_UART_CONSOLE=n
      - mcuboot_CONFIG_BOOT_SERIAL_NO_APPLICATION=y
      - FILE_SUFFIX=larger_mcuboot

  mcuboot.upgrade.serial_recovery_pin_reset:
    tags:
      - serial_recovery
    platform_allow:
      - nrf52840dk/nrf52840
      - nrf5340dk/nrf5340/cpuapp
      - nrf9160dk/nrf9160
      - nrf54l15dk/nrf54l15/cpuapp
      - nrf54lm20dk/nrf54lm20a/cpuapp
      - nrf54lv10dk/nrf54lv10a/cpuapp
    integration_platforms:
      - nrf52840dk/nrf52840
    harness_config:
      pytest_root:
        - "../pytest/test_serial_recovery.py::test_serial_recovery_after_pin_reset"
    extra_args:
      - mcuboot_CONFIG_MCUBOOT_SERIAL=y
      - mcuboot_CONFIG_UART_CONSOLE=n
      - mcuboot_CONFIG_BOOT_SERIAL_PIN_RESET=y
      - FILE_SUFFIX=larger_mcuboot

  mcuboot.upgrade.nrf54l_fprotect:
    platform_allow:
      - nrf54l15dk/nrf54l15/cpuapp
      - nrf54lm20dk/nrf54lm20a/cpuapp
    harness_config:
      pytest_root:
        - "../pytest/test_upgrade.py::test_upgrade_with_revert"
    extra_args:
      - FILE_SUFFIX=fprotect

  tfm.mcuboot.upgrade.basic:
    platform_allow:
      - nrf5340dk/nrf5340/cpuapp/ns
      - nrf9160dk/nrf9160/ns
    harness_config:
      pytest_root:
        - "../pytest/test_upgrade.py"
    extra_args:
      - mcuboot_CONFIG_MCUBOOT_DOWNGRADE_PREVENTION=y
      - mcuboot_CONFIG_PM_PARTITION_SIZE_MCUBOOT=0xfe00

  nsib.mcuboot.upgrade.basic:
    tags:
      - nsib
    platform_allow:
      - nrf52840dk/nrf52840
      - nrf54l15dk/nrf54l15/cpuapp
      - nrf54lm20dk/nrf54lm20a/cpuapp
      - nrf54lv10dk/nrf54lv10a/cpuapp
    harness_config:
      pytest_root:
        - "../pytest/test_upgrade.py::test_upgrade_with_revert"
        - "../pytest/test_upgrade_mcuboot_nsib.py"
    extra_args:
      - SB_CONFIG_SECURE_BOOT_APPCORE=y
      - mcuboot_CONFIG_MCUBOOT_DOWNGRADE_PREVENTION=y

  mcuboot.direct_xip.basic:
    timeout: 900
    tags:
      - direct_xip
    platform_allow:
      - nrf52840dk/nrf52840
      - nrf5340dk/nrf5340/cpuapp
      - nrf54l15dk/nrf54l15/cpuapp
      - nrf54lm20dk/nrf54lm20a/cpuapp
      - nrf54lv10dk/nrf54lv10a/cpuapp
      - nrf54h20dk/nrf54h20/cpuapp
    integration_platforms:
      - nrf54l15dk/nrf54l15/cpuapp
      - nrf54h20dk/nrf54h20/cpuapp
    harness_config:
      pytest_root:
        - "../pytest/test_direct_xip.py::TestDirectXip"
    extra_args:
      - SB_CONFIG_MCUBOOT_MODE_DIRECT_XIP=y
      # for nrf5340 and nrf54lv10 to align size of mcuboot image
      - FILE_SUFFIX=direct_xip

  mcuboot.direct_xip.with_revert:
    timeout: 1200
    tags:
      - direct_xip
    platform_allow:
      - nrf52840dk/nrf52840
      - nrf5340dk/nrf5340/cpuapp
      - nrf54l15dk/nrf54l15/cpuapp
      - nrf54lm20dk/nrf54lm20a/cpuapp
      - nrf54lv10dk/nrf54lv10a/cpuapp
      - nrf54h20dk/nrf54h20/cpuapp
    integration_platforms:
      - nrf54l15dk/nrf54l15/cpuapp
      - nrf54lm20dk/nrf54lm20a/cpuapp
      - nrf54lv10dk/nrf54lv10a/cpuapp
      - nrf54h20dk/nrf54h20/cpuapp
    harness_config:
      pytest_root:
        - "../pytest/test_direct_xip.py::TestDirectXipWithRevert"
    extra_args:
      - SB_CONFIG_MCUBOOT_MODE_DIRECT_XIP_WITH_REVERT=y
      - FILE_SUFFIX=direct_xip

  nsib.mcuboot.upgrade.unusable_secondary_slot:
    platform_allow:
      - nrf52840dk/nrf52840
      - nrf5340dk/nrf5340/cpuapp
    tags:
      - nsib
    harness_config:
      pytest_root:
        - "../pytest/test_upgrade_secondary_slot_issue.py"
    extra_args:
      - SB_CONFIG_SECURE_BOOT_APPCORE=y
      - mcuboot_CONFIG_MCUBOOT_CLEANUP_UNUSABLE_SECONDARY=y

  # Encryption test cases
  mcuboot.upgrade.encryption.rsa:
    platform_allow:
      - nrf52840dk/nrf52840
      - nrf5340dk/nrf5340/cpuapp
      - nrf54l15dk/nrf54l15/cpuapp
      - nrf54lm20dk/nrf54lm20a/cpuapp
      - nrf54lv10dk/nrf54lv10a/cpuapp
    integration_platforms:
      - nrf52840dk/nrf52840
    tags:
      - encryption
    harness_config:
      pytest_root:
        - "../pytest/test_upgrade.py"
        - "../pytest/test_invalid_image.py::test_invalid_encryption"
    extra_args:
      - SB_CONFIG_BOOT_ENCRYPTION=y
      - SB_CONFIG_BOOT_SIGNATURE_TYPE_RSA=y
      - mcuboot_CONFIG_MCUBOOT_DOWNGRADE_PREVENTION=y
      - FILE_SUFFIX=larger_mcuboot

  mcuboot.upgrade.encryption.ecdsa_p256:
    platform_allow:
      - nrf52840dk/nrf52840
      - nrf5340dk/nrf5340/cpuapp
      - nrf54l15dk/nrf54l15/cpuapp
      - nrf54h20dk/nrf54h20/cpuapp
      - nrf54lm20dk/nrf54lm20a/cpuapp
      - nrf54lv10dk/nrf54lv10a/cpuapp
    integration_platforms:
      - nrf5340dk/nrf5340/cpuapp
    tags:
      - encryption
    harness_config:
      pytest_root:
        - "../pytest/test_upgrade.py::test_upgrade_with_revert"
    extra_args:
      - SB_CONFIG_BOOT_ENCRYPTION=y
      - SB_CONFIG_BOOT_SIGNATURE_TYPE_ECDSA_P256=y
      - FILE_SUFFIX=larger_mcuboot

  mcuboot.upgrade.encryption.ed25519:
    platform_allow:
      - nrf52840dk/nrf52840
      - nrf5340dk/nrf5340/cpuapp
      - nrf54l15dk/nrf54l15/cpuapp
      - nrf54lm20dk/nrf54lm20a/cpuapp
      - nrf54lv10dk/nrf54lv10a/cpuapp
    integration_platforms:
      - nrf54l15dk/nrf54l15/cpuapp
      - nrf54lm20dk/nrf54lm20a/cpuapp
      - nrf54lv10dk/nrf54lv10a/cpuapp
    tags:
      - encryption
    harness_config:
      pytest_root:
        - "../pytest/test_upgrade.py::test_upgrade_with_revert"
        - "../pytest/test_invalid_image.py::test_invalid_encryption"
    extra_args:
      - FILE_SUFFIX=larger_mcuboot
      - SB_CONFIG_BOOT_ENCRYPTION=y
      - SB_CONFIG_BOOT_SIGNATURE_TYPE_ED25519=y

  mcuboot.upgrade.signature.none:
    platform_allow:
      - nrf52840dk/nrf52840
      - nrf5340dk/nrf5340/cpuapp
      - nrf54l15dk/nrf54l15/cpuapp
      - nrf54h20dk/nrf54h20/cpuapp
      - nrf54lm20dk/nrf54lm20a/cpuapp
      - nrf54lv10dk/nrf54lv10a/cpuapp
    integration_platforms:
      - nrf54l15dk/nrf54l15/cpuapp
    tags:
      - signature
    harness_config:
      pytest_root:
        - "../pytest/test_upgrade.py::test_upgrade_with_revert"
    extra_args:
      - SB_CONFIG_BOOT_SIGNATURE_TYPE_NONE=y

  mcuboot.upgrade.signature.ed25519:
    platform_allow:
      - nrf54l15dk/nrf54l15/cpuapp
      - nrf54lm20dk/nrf54lm20a/cpuapp
      - nrf54lv10dk/nrf54lv10a/cpuapp
      - nrf54h20dk/nrf54h20/cpuapp
    integration_platforms:
      - nrf54l15dk/nrf54l15/cpuapp
      - nrf54h20dk/nrf54h20/cpuapp
    tags:
      - signature
    harness_config:
      pytest_root:
        - "../pytest/test_upgrade.py::test_upgrade_with_revert"
    extra_args:
      - SB_CONFIG_BOOT_SIGNATURE_TYPE_ED25519=y

  mcuboot.upgrade.signature.ecdsa_p256:
    platform_allow:
      - nrf54h20dk/nrf54h20/cpuapp
    tags:
      - signature
    harness_config:
      pytest_root:
        - "../pytest/test_upgrade.py::test_upgrade_with_revert"
        - "../pytest/test_invalid_image.py::test_invalid_signature"
    extra_args:
      - SB_CONFIG_BOOT_SIGNATURE_TYPE_ECDSA_P256=y

  mcuboot.upgrade.signature.pure:
    platform_allow:
      - nrf54l15dk/nrf54l15/cpuapp
      - nrf54h20dk/nrf54h20/cpuapp
    tags:
      - signature
    harness_config:
      pytest_root:
        - "../pytest/test_upgrade.py::test_upgrade_with_revert"
    extra_args:
      - SB_CONFIG_BOOT_SIGNATURE_TYPE_ED25519=y
      - SB_CONFIG_BOOT_SIGNATURE_TYPE_PURE=y

  mcuboot.upgrade.kmu.basic:
    platform_allow:
      - nrf54l15dk/nrf54l15/cpuapp
      - nrf54l15dk/nrf54l10/cpuapp
      - nrf54l15dk/nrf54l05/cpuapp
      - nrf54lm20dk/nrf54lm20a/cpuapp
      - nrf54lv10dk/nrf54lv10a/cpuapp
    integration_platforms:
      - nrf54l15dk/nrf54l15/cpuapp
      - nrf54lm20dk/nrf54lm20a/cpuapp
      - nrf54lv10dk/nrf54lv10a/cpuapp
    tags: kmu
    harness_config:
      pytest_root:
        - "../pytest/test_upgrade.py::test_upgrade_with_revert"
    extra_args:
      - SB_CONFIG_MCUBOOT_SIGNATURE_USING_KMU=y
      - SB_CONFIG_BOOT_SIGNATURE_TYPE_ED25519=y

  nsib.mcuboot.upgrade.kmu.basic:
    platform_allow:
      - nrf54l15dk/nrf54l15/cpuapp
      - nrf54lm20dk/nrf54lm20a/cpuapp
      - nrf54lv10dk/nrf54lv10a/cpuapp
    tags:
      - kmu
      - nsib
    harness_config:
      pytest_root:
        - "../pytest/test_upgrade.py::test_upgrade_with_revert"
        - "../pytest/test_upgrade_mcuboot_nsib.py::test_upgrade_of_mcuboot_with_nsib"
    extra_args:
      - SB_CONFIG_SECURE_BOOT_APPCORE=y
      - SB_CONFIG_MCUBOOT_SIGNATURE_USING_KMU=y
      - SB_CONFIG_BOOT_SIGNATURE_TYPE_ED25519=y

  mcuboot.upgrade.kmu.revocation:
    platform_allow:
      - nrf54l15dk/nrf54l15/cpuapp
      - nrf54lm20dk/nrf54lm20a/cpuapp
      - nrf54lv10dk/nrf54lv10a/cpuapp
    integration_platforms:
      - nrf54l15dk/nrf54l15/cpuapp
    tags: kmu
    harness_config:
      pytest_root:
        - "../pytest/test_kmu_extra.py"
    extra_args:
      - SB_CONFIG_MCUBOOT_SIGNATURE_USING_KMU=y
      - SB_CONFIG_BOOT_SIGNATURE_TYPE_ED25519=y
      - mcuboot_CONFIG_BOOT_SIGNATURE_KMU_SLOTS=3
      - mcuboot_CONFIG_BOOT_KEYS_REVOCATION=y

  mcuboot.nrf_compress.basic:
    tags:
      - nrf_compress
    platform_allow:
      - nrf52840dk/nrf52840
      - nrf5340dk/nrf5340/cpuapp
      - nrf54l15dk/nrf54l15/cpuapp
      - nrf54h20dk/nrf54h20/cpuapp
      - nrf54lm20dk/nrf54lm20a/cpuapp
      - nrf54lv10dk/nrf54lv10a/cpuapp
    integration_platforms:
      - nrf54l15dk/nrf54l15/cpuapp
      - nrf54h20dk/nrf54h20/cpuapp
      - nrf54lm20dk/nrf54lm20a/cpuapp
      - nrf54lv10dk/nrf54lv10a/cpuapp
    harness_config:
      pytest_root:
        - "../pytest/test_nrf_compress.py"
        - "../pytest/test_invalid_image.py::test_invalid_signature"
    extra_args:
      - SB_CONFIG_MCUBOOT_MODE_OVERWRITE_ONLY=y
      - SB_CONFIG_MCUBOOT_COMPRESSED_IMAGE_SUPPORT=y
      - FILE_SUFFIX=larger_mcuboot

  mcuboot.nrf_compress.encryption_rsa:
    platform_allow:
      - nrf52840dk/nrf52840
      - nrf5340dk/nrf5340/cpuapp
    tags:
      - encryption
      - nrf_compress
    harness_config:
      pytest_root:
        - "../pytest/test_nrf_compress.py"
    extra_args:
      - SB_CONFIG_MCUBOOT_MODE_OVERWRITE_ONLY=y
      - SB_CONFIG_MCUBOOT_COMPRESSED_IMAGE_SUPPORT=y
      - SB_CONFIG_BOOT_ENCRYPTION=y
      - SB_CONFIG_BOOT_SIGNATURE_TYPE_RSA=y
      - FILE_SUFFIX=larger_mcuboot

  mcuboot.nrf_compress.encryption_ecdsa_p256:
    platform_allow:
      - nrf5340dk/nrf5340/cpuapp
      - nrf54l15dk/nrf54l15/cpuapp
      - nrf54h20dk/nrf54h20/cpuapp
      - nrf54lm20dk/nrf54lm20a/cpuapp
      - nrf54lv10dk/nrf54lv10a/cpuapp
    integration_platforms:
      - nrf54l15dk/nrf54l15/cpuapp
    tags:
      - encryption
      - nrf_compress
    harness_config:
      pytest_root:
        - "../pytest/test_nrf_compress.py"
    extra_args:
      - SB_CONFIG_MCUBOOT_MODE_OVERWRITE_ONLY=y
      - SB_CONFIG_MCUBOOT_COMPRESSED_IMAGE_SUPPORT=y
      - SB_CONFIG_BOOT_ENCRYPTION=y
      - SB_CONFIG_BOOT_SIGNATURE_TYPE_ECDSA_P256=y
      - FILE_SUFFIX=larger_mcuboot

  mcuboot.nrf_compress.encryption_ed25519:
    platform_allow:
      - nrf52840dk/nrf52840
      - nrf5340dk/nrf5340/cpuapp
      - nrf54l15dk/nrf54l15/cpuapp
      - nrf54lm20dk/nrf54lm20a/cpuapp
      - nrf54lv10dk/nrf54lv10a/cpuapp
    integration_platforms:
      - nrf54l15dk/nrf54l15/cpuapp
      - nrf54lm20dk/nrf54lm20a/cpuapp
      - nrf54lv10dk/nrf54lv10a/cpuapp
    tags:
      - encryption
      - nrf_compress
    harness_config:
      pytest_root:
        - "../pytest/test_nrf_compress.py"
        - "../pytest/test_invalid_image.py::test_invalid_encryption"
    extra_args:
      - SB_CONFIG_MCUBOOT_MODE_OVERWRITE_ONLY=y
      - SB_CONFIG_MCUBOOT_COMPRESSED_IMAGE_SUPPORT=y
      - SB_CONFIG_BOOT_ENCRYPTION=y
      - SB_CONFIG_BOOT_SIGNATURE_TYPE_ED25519=y
      - FILE_SUFFIX=larger_mcuboot

  # Test Hardware Downgrade Prevention and Monotonic Counters
  mcuboot.upgrade.hw_downgrade_prevention:
    tags:
      - hw_downgrade_prevention
    platform_allow:
      - nrf5340dk/nrf5340/cpuapp
      - nrf9160dk/nrf9160
      - nrf54l15dk/nrf54l15/cpuapp
      - nrf54lm20dk/nrf54lm20a/cpuapp
      - nrf54lv10dk/nrf54lv10a/cpuapp
    integration_platforms:
      - nrf54l15dk/nrf54l15/cpuapp
    harness_config:
      pytest_root:
        - "../pytest/test_downgrade_prevention.py"
    extra_args:
      - SB_CONFIG_MCUBOOT_HARDWARE_DOWNGRADE_PREVENTION=y
      - SB_CONFIG_MCUBOOT_HW_DOWNGRADE_PREVENTION_COUNTER_SLOTS=2
      - SB_CONFIG_MCUBOOT_HW_DOWNGRADE_PREVENTION_COUNTER_VALUE=2

  nsib.mcuboot.upgrade.hw_downgrade_prevention:
    tags:
      - nsib
      - hw_downgrade_prevention
    platform_allow:
      - nrf52840dk/nrf52840
      - nrf5340dk/nrf5340/cpuapp
      - nrf9160dk/nrf9160
      - nrf54l15dk/nrf54l15/cpuapp
      - nrf54lm20dk/nrf54lm20a/cpuapp
      - nrf54lv10dk/nrf54lv10a/cpuapp
    integration_platforms:
      - nrf54l15dk/nrf54l15/cpuapp
    harness_config:
      pytest_root:
        - "../pytest/test_downgrade_prevention_nsib.py"
    extra_args:
      - SB_CONFIG_SECURE_BOOT_APPCORE=y
      - SB_CONFIG_SECURE_BOOT_GENERATE_DEFAULT_KMU_KEYFILE=y
      - mcuboot_CONFIG_SB_MONOTONIC_COUNTER=y
      - mcuboot_CONFIG_SB_NUM_VER_COUNTER_SLOTS=2
```
