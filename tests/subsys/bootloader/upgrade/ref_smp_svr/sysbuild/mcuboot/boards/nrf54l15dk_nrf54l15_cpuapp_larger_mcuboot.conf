## tests/subsys/bootloader/upgrade/ref_smp_svr_ext_flash/Kconfig.sysbuild
```kconfig
#
# Copyright (c) 2024 Nordic Semiconductor
#
# SPDX-License-Identifier: LicenseRef-Nordic-5-Clause
#

config PM_EXTERNAL_FLASH_MCUBOOT_SECONDARY
	default y if BOARD_NRF5340DK_NRF5340_CPUAPP

choice MCUBOOT_MODE
	default MCUBOOT_MODE_OVERWRITE_ONLY if SOC_SERIES_NRF53 && !NETCORE_NONE
endchoice

config SECURE_BOOT_NETCORE
	default y if BOARD_NRF5340DK_NRF5340_CPUAPP && !NETCORE_NONE

config NETCORE_APP_UPDATE
	default y if SECURE_BOOT_NETCORE

config SECURE_BOOT_SIGNING_KEY_FILE
	default "$ZEPHYR_BASE/../bootloader/mcuboot/root-ed25519.pem" if SECURE_BOOT_SIGNATURE_TYPE_ED25519
	default "$ZEPHYR_BASE/../bootloader/mcuboot/root-ec-p256.pem" if SECURE_BOOT_SIGNATURE_TYPE_ECDSA

config MCUBOOT_USE_ALL_AVAILABLE_RAM
	default y if BOARD_NRF5340DK_NRF5340_CPUAPP_NS

source "${ZEPHYR_BASE}/share/sysbuild/Kconfig"
```

## tests/subsys/bootloader/upgrade/ref_smp_svr_ext_flash/boards/nrf9160dk_nrf9160_ns.conf
```kconfig
CONFIG_SPI=y
CONFIG_SPI_NOR=y
CONFIG_SPI_NRFX_RAM_BUFFER_SIZE=32

CONFIG_BUILD_WITH_TFM=y
```

## tests/subsys/bootloader/upgrade/ref_smp_svr_ext_flash/sysbuild/mcuboot/boards/nrf5340dk_nrf5340_cpuapp_network_core.conf
```kconfig
CONFIG_NORDIC_QSPI_NOR=y
CONFIG_NORDIC_QSPI_NOR_FLASH_LAYOUT_PAGE_SIZE=4096
CONFIG_NORDIC_QSPI_NOR_STACK_WRITE_BUFFER_SIZE=16

# The following configurations are required to support simultaneous multi-image update
CONFIG_FW_INFO=y
CONFIG_PCD_APP=y
CONFIG_PCD_READ_NETCORE_APP_VERSION=y

# The network core cannot access external flash directly. The flash simulator must be used to
# provide a memory region that is used to forward the new firmware to the network core
CONFIG_FLASH_SIMULATOR=y
CONFIG_FLASH_SIMULATOR_DOUBLE_WRITES=y
CONFIG_FLASH_SIMULATOR_STATS=n
```

## tests/subsys/bootloader/upgrade/ref_smp_svr_ext_flash/sysbuild/mcuboot/boards/nrf54l15dk_nrf54l10_cpuapp.conf
```kconfig
# SPI
CONFIG_SPI=y
CONFIG_SPI_NOR=y
CONFIG_SPI_NOR_FLASH_LAYOUT_PAGE_SIZE=4096
CONFIG_SPI_NRFX_RAM_BUFFER_SIZE=32

CONFIG_PM_OVERRIDE_EXTERNAL_DRIVER_CHECK=y

# alignment for nsib
CONFIG_PM_PARTITION_SIZE_MCUBOOT=0x10800

# disable fprotect (to allow boot with bigger MCUboot)
CONFIG_FPROTECT=n
```

## tests/subsys/bootloader/upgrade/ref_smp_svr_ext_flash/sysbuild/mcuboot/boards/nrf54l15dk_nrf54l15_cpuapp.conf
```kconfig
# SPI
CONFIG_SPI=y
CONFIG_SPI_NOR=y
CONFIG_SPI_NOR_FLASH_LAYOUT_PAGE_SIZE=4096
CONFIG_SPI_NRFX_RAM_BUFFER_SIZE=32

# disable fprotect (to allow boot with bigger MCUboot)
CONFIG_FPROTECT=n
```

## tests/subsys/bootloader/upgrade/ref_smp_svr_ext_flash/sysbuild/mcuboot/boards/nrf54l15dk_nrf54l15_cpuapp_larger_mcuboot.conf
```kconfig
# SPI
CONFIG_SPI=y
CONFIG_SPI_NOR=y
CONFIG_SPI_NOR_FLASH_LAYOUT_PAGE_SIZE=4096
CONFIG_SPI_NRFX_RAM_BUFFER_SIZE=32

CONFIG_PM_OVERRIDE_EXTERNAL_DRIVER_CHECK=y

# increasead for encryption ed25519
CONFIG_PM_PARTITION_SIZE_MCUBOOT=0x14000

# disable fprotect (to allow boot with bigger MCUboot)
CONFIG_FPROTECT=n
```

## tests/subsys/bootloader/upgrade/ref_smp_svr_ext_flash/sysbuild/mcuboot/boards/nrf54lm20dk_nrf54lm20a_cpuapp.conf
```kconfig
# SPI
CONFIG_SPI=y
CONFIG_SPI_NOR=y
CONFIG_SPI_NOR_FLASH_LAYOUT_PAGE_SIZE=4096
CONFIG_SPI_NRFX_RAM_BUFFER_SIZE=32

CONFIG_PM_OVERRIDE_EXTERNAL_DRIVER_CHECK=y

CONFIG_PM_PARTITION_SIZE_MCUBOOT=0x10800

# from mcuboot/boot/zephyr/boards
CONFIG_FPROTECT=n
CONFIG_BOOT_WATCHDOG_FEED=n
```

## tests/subsys/bootloader/upgrade/ref_smp_svr_ext_flash/sysbuild/mcuboot/boards/nrf54lm20dk_nrf54lm20b_cpuapp.conf
```kconfig
# SPI
CONFIG_SPI=y
CONFIG_SPI_NOR=y
CONFIG_SPI_NOR_FLASH_LAYOUT_PAGE_SIZE=4096
CONFIG_SPI_NRFX_RAM_BUFFER_SIZE=32

# from mcuboot/boot/zephyr/boards
CONFIG_FPROTECT=n
CONFIG_BOOT_WATCHDOG_FEED=n
```

## tests/subsys/bootloader/upgrade/ref_smp_svr_ext_flash/sysbuild/mcuboot/boards/nrf9160dk_nrf9160.conf
```kconfig
# SPI
CONFIG_SPI=y
CONFIG_SPI_NOR=y
CONFIG_SPI_NOR_FLASH_LAYOUT_PAGE_SIZE=4096
CONFIG_SPI_NRFX_RAM_BUFFER_SIZE=32
```

## tests/subsys/bootloader/upgrade/ref_smp_svr_ext_flash/testcase.yaml
```yaml
common:
  sysbuild: true
  timeout: 600
  slow: true
  harness: pytest
  tags:
    - pytest
    - mcuboot
    - mcumgr
    - external_flash
    - ci_tests_subsys_bootloader

tests:
  mcuboot.external_flash.upgrade.basic:
    platform_allow:
      - nrf52840dk/nrf52840
      - nrf5340dk/nrf5340/cpuapp
      - nrf9160dk/nrf9160
      - nrf54l15dk/nrf54l15/cpuapp
      - nrf54l15dk/nrf54l10/cpuapp
      - nrf54l15dk/nrf54l05/cpuapp
      - nrf54lm20dk/nrf54lm20a/cpuapp
    integration_platforms:
      - nrf52840dk/nrf52840
      - nrf54l15dk/nrf54l15/cpuapp
      - nrf54l15dk/nrf54l05/cpuapp
      - nrf54lm20dk/nrf54lm20a/cpuapp
    harness_config:
      pytest_root:
        - "../pytest/test_upgrade.py"
        - "../pytest/test_invalid_image.py::test_invalid_signature"
    extra_args:
      - mcuboot_CONFIG_MCUBOOT_DOWNGRADE_PREVENTION=y

  tfm.mcuboot.external_flash.upgrade.basic:
    platform_allow:
      - nrf5340dk/nrf5340/cpuapp/ns
      - nrf9160dk/nrf9160/ns
    harness_config:
      pytest_root:
        - "../pytest/test_upgrade.py"
    extra_args:
      - mcuboot_CONFIG_MCUBOOT_DOWNGRADE_PREVENTION=y
      - mcuboot_CONFIG_PM_PARTITION_SIZE_MCUBOOT=0xfe00

  mcuboot.external_flash.upgrade.hw_downgrade_prevention:
    tags:
      - hw_downgrade_prevention
    platform_allow:
      - nrf5340dk/nrf5340/cpuapp
      - nrf9160dk/nrf9160
      - nrf54l15dk/nrf54l15/cpuapp
    integration_platforms:
      - nrf54l15dk/nrf54l15/cpuapp
    harness_config:
      pytest_root:
        - "../pytest/test_downgrade_prevention.py::test_hw_downgrade_prevention_with_sign_version"
    extra_args:
      - SB_CONFIG_MCUBOOT_HARDWARE_DOWNGRADE_PREVENTION=y

  mcuboot.external_flash.upgrade.netcore:
    timeout: 800
    tags:
      - netcore
    platform_allow:
      - nrf5340dk/nrf5340/cpuapp
    harness_config:
      pytest_root:
        - "../pytest/test_upgrade_netcore.py"
    extra_args:
      - FILE_SUFFIX=network_core
      - SB_CONFIG_NETCORE_EMPTY=y
      - mcuboot_CONFIG_MCUBOOT_DOWNGRADE_PREVENTION=y
      - b0n_CONFIG_PCD_READ_NETCORE_APP_VERSION=y
      - b0n_CONFIG_FW_INFO_FIRMWARE_VERSION=2

  nsib.mcuboot.external_flash.upgrade.netcore_and_mcuboot:
    timeout: 800
    tags:
      - netcore
      - nsib
    platform_allow:
      - nrf5340dk/nrf5340/cpuapp
    harness_config:
      pytest_root:
        - "../pytest/test_upgrade_netcore.py"
        - "../pytest/test_upgrade_mcuboot_nsib.py"
    extra_args:
      - FILE_SUFFIX=network_core
      - SB_CONFIG_SECURE_BOOT_APPCORE=y
      - SB_CONFIG_NETCORE_EMPTY=y
      - mcuboot_CONFIG_MCUBOOT_DOWNGRADE_PREVENTION=y
      - b0n_CONFIG_PCD_READ_NETCORE_APP_VERSION=y

  nsib.mcuboot.external_flash.upgrade.basic:
    tags:
      - nsib
    platform_allow:
      - nrf52840dk/nrf52840
      - nrf54l15dk/nrf54l15/cpuapp
      - nrf54lm20dk/nrf54lm20a/cpuapp
    integration_platforms:
      - nrf54l15dk/nrf54l15/cpuapp
      - nrf54lm20dk/nrf54lm20a/cpuapp
    harness_config:
      pytest_root:
        - "../pytest/test_upgrade.py::test_upgrade_with_revert"
    extra_args:
      - SB_CONFIG_SECURE_BOOT_APPCORE=y
      - mcuboot_CONFIG_MCUBOOT_DOWNGRADE_PREVENTION=y

  mcuboot.external_flash.nrf_compress.basic:
    tags:
      - nrf_compress
    platform_allow:
      - nrf52840dk/nrf52840
      - nrf5340dk/nrf5340/cpuapp
      - nrf54l15dk/nrf54l15/cpuapp
    integration_platforms:
      - nrf54l15dk/nrf54l15/cpuapp
    harness_config:
      pytest_root:
        - "../pytest/test_nrf_compress.py"
    extra_args:
      - SB_CONFIG_MCUBOOT_MODE_OVERWRITE_ONLY=y
      - SB_CONFIG_MCUBOOT_COMPRESSED_IMAGE_SUPPORT=y
      - FILE_SUFFIX=larger_mcuboot

  mcuboot.external_flash.nrf_compress.encryption_rsa:
    platform_allow:
      - nrf52840dk/nrf52840
      - nrf5340dk/nrf5340/cpuapp
    integration_platforms:
      - nrf52840dk/nrf52840
    tags:
      - encryption
      - nrf_compress
    harness_config:
      pytest_root:
        - "../pytest/test_nrf_compress.py"
    extra_args:
      - SB_CONFIG_MCUBOOT_MODE_OVERWRITE_ONLY=y
      - SB_CONFIG_MCUBOOT_COMPRESSED_IMAGE_SUPPORT=y
      - SB_CONFIG_BOOT_ENCRYPTION=y
      - SB_CONFIG_BOOT_SIGNATURE_TYPE_RSA=y

  mcuboot.external_flash.nrf_compress.encryption_ed25519:
    platform_allow:
      - nrf54l15dk/nrf54l15/cpuapp
      - nrf54lm20dk/nrf54lm20a/cpuapp
    tags:
      - encryption
      - nrf_compress
    harness_config:
      pytest_root:
        - "../pytest/test_nrf_compress.py"
        - "../pytest/test_invalid_image.py::test_invalid_encryption"
    extra_args:
      - SB_CONFIG_MCUBOOT_MODE_OVERWRITE_ONLY=y
      - SB_CONFIG_MCUBOOT_COMPRESSED_IMAGE_SUPPORT=y
      - SB_CONFIG_BOOT_ENCRYPTION=y
      - SB_CONFIG_BOOT_SIGNATURE_TYPE_ED25519=y
      - mcuboot_CONFIG_PM_PARTITION_SIZE_MCUBOOT=0x16000
```

## tests/subsys/caf/sensor_data_aggregator/boards/nrf9160dk_nrf9160_ns.conf
```kconfig
# Copyright (c) 2026 Nordic Semiconductor ASA
#
# SPDX-License-Identifier: LicenseRef-Nordic-5-Clause

CONFIG_TFM_PROFILE_TYPE_MINIMAL=y
```

## tests/subsys/caf/sensor_data_aggregator/testcase.yaml
```yaml
tests:
  caf_sensor_aggregator.core:
    sysbuild: true
    platform_allow:
      - nrf52dk/nrf52832
      - nrf52840dk/nrf52840
      - nrf5340dk/nrf5340/cpuapp
      - nrf9160dk/nrf9160/ns
      - qemu_cortex_m3
    integration_platforms:
      - nrf52dk/nrf52832
      - nrf52840dk/nrf52840
      - nrf5340dk/nrf5340/cpuapp
      - nrf9160dk/nrf9160/ns
      - qemu_cortex_m3
    tags: sysbuild
```

## tests/subsys/debug/cpu_load/testcase.yaml
```yaml
tests:
  debug.cpu_load:
    sysbuild: true
    platform_allow: nrf52840dk/nrf52840 nrf9160dk/nrf9160
    integration_platforms:
      - nrf52840dk/nrf52840
      - nrf9160dk/nrf9160
    build_only: true
    tags: ci_build debug sysbuild ci_tests_subsys_debug
  debug.cpu_load.shared_dppi:
    sysbuild: true
    platform_allow: nrf9160dk/nrf9160
    integration_platforms:
      - nrf9160dk/nrf9160
    build_only: true
    tags: ci_build debug sysbuild ci_tests_subsys_debug
    extra_configs:
      - CONFIG_CPU_LOAD_USE_SHARED_DPPI_CHANNELS=y
```
