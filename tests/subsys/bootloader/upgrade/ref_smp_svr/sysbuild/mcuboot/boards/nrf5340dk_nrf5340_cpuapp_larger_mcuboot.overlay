/*
 * Copyright (c) 2026 Nordic Semiconductor ASA
 *
 * SPDX-License-Identifier: LicenseRef-Nordic-5-Clause
 */

#include "../../../boards/nrf5340dk_nrf5340_cpuapp_larger_mcuboot.overlay"

/ {
	chosen {
		zephyr,code-partition = &boot_partition;
	};
};
