/*
 * Copyright (c) 2026 Nordic Semiconductor ASA
 *
 * SPDX-License-Identifier: LicenseRef-Nordic-5-Clause
 */

#define THIS_IS_MCUBOOT_IMAGE

#include "../../../boards/nrf54lm20dk_nrf54lm20b_cpuapp_b0_mcuboot.overlay"
