## CMakeLists.txt
```
# SPDX-License-Identifier: Apache-2.0

cmake_minimum_required(VERSION 3.13.1)

set(mcuboot_CONF_FILE ${CMAKE_CURRENT_SOURCE_DIR}/mcuboot_prj.conf)

include($ENV{ZEPHYR_BASE}/cmake/app/boilerplate.cmake NO_POLICY_SCOPE)
project(external_flash_test)

target_sources(app PRIVATE src/main.c)
target_include_directories(app PRIVATE src)
```

## prj.conf
```kconfig
# nothing here
#CONFIG_ZTEST=y
CONFIG_BOOTLOADER_MCUBOOT=y
CONFIG_FLASH=y
CONFIG_NORDIC_QSPI_NOR=y
CONFIG_NORDIC_QSPI_NOR_FLASH_LAYOUT_PAGE_SIZE=4096
CONFIG_NORDIC_QSPI_NOR_FLASH_ALLOW_STACK_USAGE_FOR_DATA_IN_FLASH=y
CONFIG_ASSERT=y
CONFIG_FLASH=y
CONFIG_IMG_ERASE_PROGRESSIVELY=y
CONFIG_IMG_MANAGER=y
CONFIG_MPU_ALLOW_FLASH_WRITE=y
CONFIG_PM_EXTERNAL_FLASH=y
CONFIG_PM_EXTERNAL_FLASH_DEV_NAME="MX25R64"
CONFIG_PM_EXTERNAL_FLASH_SIZE=0xf4000
CONFIG_PM_EXTERNAL_FLASH_BASE=0
CONFIG_GPIO=y
CONFIG_HEAP_MEM_POOL_SIZE=4096
```

## mcuboot_prj.conf
```kconfig
CONFIG_CONSOLE_HANDLER=y
CONFIG_DEBUG=y
CONFIG_SYSTEM_CLOCK_DISABLE=y
CONFIG_SYS_POWER_MANAGEMENT=n

CONFIG_MAIN_STACK_SIZE=10240
CONFIG_MBEDTLS_CFG_FILE="mcuboot-mbedtls-cfg.h"

CONFIG_BOOT_SWAP_SAVE_ENCTLV=n
CONFIG_BOOT_ENCRYPT_RSA=n
CONFIG_BOOT_ENCRYPT_EC256=n
CONFIG_BOOT_ENCRYPT_X25519=n

CONFIG_BOOT_UPGRADE_ONLY=n
CONFIG_BOOT_BOOTSTRAP=n

### Default to RSA
CONFIG_BOOT_SIGNATURE_TYPE_RSA=y
CONFIG_BOOT_SIGNATURE_TYPE_RSA_LEN=2048
CONFIG_BOOT_SIGNATURE_TYPE_ECDSA_P256=n
CONFIG_BOOT_SIGNATURE_TYPE_ED25519=n

### The bootloader generates its own signature verification based on a
### key file which needs to be provided and needs to match the selected signing
### algorithm (CONFIG_BOOT_SIGNATURE_TYPE_).
### The PEM files below are provided as examples.
CONFIG_BOOT_SIGNATURE_KEY_FILE="root-rsa-2048.pem"
#CONFIG_BOOT_SIGNATURE_KEY_FILE="root-rsa-3072.pem"
#CONFIG_BOOT_SIGNATURE_KEY_FILE="root-ec-p256.pem"
#CONFIG_BOOT_SIGNATURE_KEY_FILE="root-ed25519.pem"

### mbedTLS has its own heap
# CONFIG_HEAP_MEM_POOL_SIZE is not set

### We never want Zephyr's copy of tinycrypt.  If tinycrypt is needed,
### MCUboot has its own copy in tree.
# CONFIG_TINYCRYPT is not set
# CONFIG_TINYCRYPT_ECC_DSA is not set
# CONFIG_TINYCRYPT_SHA256 is not set

CONFIG_FLASH=y
CONFIG_FPROTECT=y
CONFIG_SIZE_OPTIMIZATIONS=y

CONFIG_MULTITHREADING=y
CONFIG_BOOT_MAX_IMG_SECTORS=256
CONFIG_NORDIC_QSPI_NOR=y
CONFIG_NORDIC_QSPI_NOR_FLASH_LAYOUT_PAGE_SIZE=4096
CONFIG_NORDIC_QSPI_NOR_FLASH_ALLOW_STACK_USAGE_FOR_DATA_IN_FLASH=y
CONFIG_PM_EXTERNAL_FLASH=y
CONFIG_PM_EXTERNAL_FLASH_DEV_NAME="MX25R64"
CONFIG_PM_EXTERNAL_FLASH_SIZE=0xf4000
CONFIG_PM_EXTERNAL_FLASH_BASE=0
### Various Zephyr boards enable features that we don't want.
# CONFIG_BT is not set
# CONFIG_BT_CTLR is not set
# CONFIG_I2C is not set

CONFIG_LOG=y
### Ensure Zephyr logging changes don't use more resources
CONFIG_LOG_DEFAULT_LEVEL=0
```

## src/main.c
```c
/*
 * Copyright (c) 2012-2014 Wind River Systems, Inc.
 *
 * SPDX-License-Identifier: Apache-2.0
 */

#include <zephyr.h>
#include <sys/printk.h>
#include <app_update.h>
#include <dfu/flash_img.h>
#include <dfu/mcuboot.h>
#include <drivers/gpio.h>


void main(void)
{

	printk("Hello World! %s upgrader sample\n", CONFIG_BOARD);
	struct flash_img_context flash_img;
	int err = flash_img_init(&flash_img);
	if (err != 0) {
		__ASSERT(true, "flash_img_init error %d", err);
	}

	printk("Writing app to external flash: %d\n", app_update_bin_len);
	err = flash_img_buffered_write(&flash_img, (u8_t *)app_update_bin, app_update_bin_len, false);
	if (err != 0) {
		__ASSERT(true, "flash_img_buffered_write error %d", err);
	}

	err = flash_img_buffered_write(&flash_img, NULL, 0, true);
	if (err != 0) {
		__ASSERT(true, "flash_img_buffered_write error %d", err);
	}
	
	err = boot_request_upgrade(BOOT_UPGRADE_TEST);
	printk("upgrade requested: %d \n", err);
	if (err != 0) {
		__ASSERT(true, "reguest upgrade failed %d", err);
	}
	printk("Upgrade done\n");

}
```
