/*
 * Copyright (c) 2026 Nordic Semiconductor ASA
 *
 * SPDX-License-Identifier: LicenseRef-Nordic-5-Clause
 */

/* Give MCUboot the same slot geometry as the application. */

#include "../../../boards/nrf54l15dk_nrf54l15_cpuapp_ext_flash.overlay"

/ {
	chosen {
		zephyr,code-partition = &boot_partition;
	};
};
