/*
 * Copyright (c) 2026 Nordic Semiconductor ASA
 *
 * SPDX-License-Identifier: LicenseRef-Nordic-5-Clause
 */

#include "../../../dts/nrf54h20dk_nrf54h20_ext_flash.dtsi"
#include "../../../dts/nrf54h20dk_nrf54h20_bootchain_bt.dtsi"

/ {
	chosen {
		zephyr,code-partition = &boot_partition;
	};
};
