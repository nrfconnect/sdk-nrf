## tests/subsys/bootloader/backward_compatibility/v3.2/smp_svr/sysbuild/mcuboot/boards/nrf54l15dk_nrf54l15_cpuapp_larger_mcuboot.conf
```kconfig
# Backward compatibility: v3.2 MCUboot on nrf54l15 occupies 80K (0x14000) so
# slot0 starts at 0x14000. The boards/nrf54l15dk_nrf54l15_cpuapp_larger_mcuboot
# .overlay pins that layout via devicetree; the current MCUboot binary (~68K)
# still fits in the 80K boot partition.

# disable fprotect (to allow boot with bigger MCUboot)
CONFIG_FPROTECT=n
# MCUboot requires a large stack size, otherwise an MPU fault will occur
CONFIG_MAIN_STACK_SIZE=16384

# Enable flash operations
CONFIG_FLASH=y

CONFIG_BOOT_MAX_IMG_SECTORS=256

CONFIG_MULTITHREADING=y

CONFIG_LOG=y
CONFIG_LOG_MODE_MINIMAL=y
CONFIG_LOG_DEFAULT_LEVEL=0
CONFIG_MCUBOOT_LOG_LEVEL_INF=y
# Decrease footprint by ~4 KB in comparison to CBPRINTF_COMPLETE=y
CONFIG_CBPRINTF_NANO=y
# Use minimal C library instead of the Picolib
CONFIG_MINIMAL_LIBC=y

CONFIG_FW_INFO_FIRMWARE_VERSION=2

# NCS boot banner
CONFIG_NCS_APPLICATION_BOOT_BANNER_STRING="MCUboot"
```

## tests/subsys/bootloader/backward_compatibility/v3.2/smp_svr/testcase.yaml
```yaml
common:
  sysbuild: true
  build_only: true
  tags:
    - mcuboot
    - ci_tests_subsys_bootloader

tests:
  # BC-aware configuration for the smp_svr sample on nRF54H20 (Direct-XIP
  # with revert). Restores the v3.2 merged-slot CID values and partition node
  # shape expected by the v3.2 bootchain.
  mcuboot.backward_compatibility.smp_svr.bt.nrf54h20dk.direct_xip_withrevert:
    extra_args:
      - FILE_SUFFIX="merged_slot"
      - EXTRA_CONF_FILE="extra-bt.conf"
      - SB_CONFIG_MCUBOOT_MODE_DIRECT_XIP_WITH_REVERT=y
      - mcuboot_CONFIG_MULTITHREADING=y
    platform_allow:
      - nrf54h20dk/nrf54h20/cpuapp

  # BC-aware configuration for the smp_svr sample (serial recovery) on
  # nRF52840, nRF5340, nRF54L15 and nRF54H20. The larger_mcuboot overlays pin
  # each platform's released v3.2 flash map (boot region + slot0 offset) via
  # devicetree so the signed application lands where the v3.2 MCUboot on the
  # device boots it.
  mcuboot.backward_compatibility.smp_svr.serial_recovery:
    extra_args:
      - SB_CONFIG_BOOTLOADER_MCUBOOT=y
      - mcuboot_CONFIG_MCUBOOT_SERIAL=y
      - mcuboot_CONFIG_UART_CONSOLE=n
      - mcuboot_CONFIG_MCUBOOT_INDICATION_LED=y
      - mcuboot_CONFIG_BOOT_SERIAL_NO_APPLICATION=y
      - FILE_SUFFIX=larger_mcuboot
    platform_allow:
      - nrf52840dk/nrf52840
      - nrf5340dk/nrf5340/cpuapp
      - nrf54l15dk/nrf54l15/cpuapp
      - nrf54h20dk@0.9.0/nrf54h20/cpuapp

  # BC-aware configuration for the smp_svr sample on nRF54H20 (ext_flash,
  # two-image build). The memory-map/bootchain overlays re-pin the v3.2 update
  # slot geometry in external flash so the image lands where v3.2 MCUboot
  # expects.
  mcuboot.backward_compatibility.smp_svr.bt.nrf54h20dk.ext_flash:
    extra_args:
      - FILE_SUFFIX="ext_flash"
      - EXTRA_CONF_FILE="extra-bt.conf"
      - mcuboot_CONFIG_MULTITHREADING=y
      - mcuboot_CONFIG_BOOT_IMG_HASH_DIRECTLY_ON_STORAGE=n
      - mcuboot_CONFIG_BOOT_MAX_IMG_SECTORS_AUTO=n
      - mcuboot_CONFIG_BOOT_MAX_IMG_SECTORS=512
      - mcuboot_CONFIG_FLASH_MSPI_NOR_LAYOUT_PAGE_SIZE=4096
      - SB_CONFIG_NETCORE_IPC_RADIO=y
      - SB_CONFIG_NETCORE_IPC_RADIO_BT_HCI_IPC=y
      - CONFIG_MCUMGR_GRP_IMG_ALLOW_CONFIRM_NON_ACTIVE_IMAGE_ANY=y
    platform_allow:
      - nrf54h20dk/nrf54h20/cpuapp

  # BC-aware configuration for the smp_svr sample on nRF54L15 (swap-using
  # -move). boards/nrf54l15dk_nrf54l15_cpuapp_bt.overlay re-pins the v3.2 slot0
  # layout so the primary-slot trailer stays where the v3.2 MCUboot expects it.
  mcuboot.backward_compatibility.smp_svr.bt.nrf54l15:
    extra_args:
      - FILE_SUFFIX=bt
      - EXTRA_CONF_FILE="extra-bt.conf"
      - SB_CONFIG_MCUBOOT_MODE_SWAP_USING_MOVE=y
    platform_allow:
      - nrf54l15dk/nrf54l15/cpuapp

  # BC-aware configuration for the smp_svr sample on nRF54L15 (swap-using
  # -move, secondary slot in external flash). Same primary-slot trailer-offset
  # issue as the internal-flash config; the ext_flash overlay re-pins the v3.2
  # geometry.
  mcuboot.backward_compatibility.smp_svr.bt.nrf54l15dk.ext_flash:
    extra_args:
      - FILE_SUFFIX=ext_flash
      - EXTRA_CONF_FILE="extra-bt.conf"
      - SB_CONFIG_MCUBOOT_MODE_SWAP_USING_MOVE=y
    platform_allow:
      - nrf54l15dk/nrf54l15/cpuapp
      - nrf54l15dk/nrf54l10/cpuapp

  # BC-aware configuration for the smp_svr sample on nRF52840dk (swap
  # -using-move). boards/nrf52840dk_nrf52840_bt.overlay re-pins the v3.2 slot0
  # layout (folding the mcuboot_pad into the start of slot0) so the primary-
  # slot trailer stays where the v3.2 MCUboot expects it.
  mcuboot.backward_compatibility.smp_svr.bt.nrf52840dk:
    extra_args:
      - FILE_SUFFIX=bt
      - EXTRA_CONF_FILE="extra-bt.conf"
      - SB_CONFIG_MCUBOOT_MODE_SWAP_USING_MOVE=y
    platform_allow:
      - nrf52840dk/nrf52840
```

## tests/subsys/bootloader/backward_compatibility/v3.2/smp_svr_mini_boot/Kconfig.sysbuild
```kconfig
#
# Copyright (c) 2026 Nordic Semiconductor ASA
#
# SPDX-License-Identifier: LicenseRef-Nordic-5-Clause
#

config MCUBOOT_SIGNATURE_USING_KMU
	default y if SOC_SERIES_NRF54L && !SOC_NRF54LS05B

config MCUBOOT_GENERATE_DEFAULT_KEY_FILE
	default y if SOC_SERIES_NRF54L && !SOC_NRF54LS05B

choice BOOT_SIGNATURE_TYPE
	default BOOT_SIGNATURE_TYPE_ECDSA_P256 if SOC_NRF54LS05B
	default BOOT_SIGNATURE_TYPE_ED25519 if !SOC_NRF54LS05B
endchoice

config BOOT_SIGNATURE_TYPE_PURE
	default y if !SOC_NRF54LS05B

choice MCUBOOT_MODE
	default MCUBOOT_MODE_DIRECT_XIP if SOC_NRF54LS05B
endchoice

config NRF_DEFAULT_IPC_RADIO
	default y if SOC_SERIES_NRF54H

config NETCORE_IPC_RADIO_BT_HCI_IPC
	default y if SOC_SERIES_NRF54H

config MCUBOOT_IMAGES_ROM_END_OFFSET_AUTO
	default "ipc_radio;ipc_radio_secondary_app" if MCUBOOT_SIGN_MERGED_BINARY

# NOTE: Backward compatibility with NCS v3.2.
# The original sample disables the Partition Manager, which makes the
# Direct-XIP variant image be generated by the upstream Zephyr mechanism and
# named "smp_svr_mini_boot_slot1_variant". NCS v3.2 builds the variant through
# the NCS Partition Manager flow, which keeps the legacy image name
# "mcuboot_secondary_app". Leaving the Partition Manager enabled here restores
# that legacy naming so the update image is consumed by the system test as in
# NCS v3.2.

source "share/sysbuild/Kconfig"
```

## tests/subsys/bootloader/backward_compatibility/v3.2/smp_svr_mini_boot/testcase.yaml
```yaml
common:
  sysbuild: true
  build_only: true
  tags:
    - mcuboot
    - ci_tests_subsys_bootloader

tests:
  # BC-aware configuration for the smp_svr_mini_boot sample on nRF54L15,
  # Direct-XIP update image (second-slot variant). The board overlays pin the
  # released NCS v3.2.0 flash map (slots 0x8000/0x68800, size 0x60800) via an
  # RRAM erase-block-size override, since current-dev's DTS migration would
  # shift the primary-slot trailer and break confirmation.
  mcuboot.backward_compatibility.smp_svr_mini_boot:
    extra_args:
      - SB_CONFIG_MCUBOOT_MODE_DIRECT_XIP=y
    platform_allow:
      - nrf54l15dk/nrf54l15/cpuapp

  # BC-aware configuration for the smp_svr_mini_boot sample on nRF54L15,
  # swap-using-move update image (single application image, no variant).
  mcuboot.backward_compatibility.smp_svr_mini_boot.swap_move:
    extra_args:
      - SB_CONFIG_MCUBOOT_MODE_SWAP_USING_MOVE=y
    extra_configs:
      - CONFIG_MCUMGR_GRP_IMG_ALLOW_CONFIRM_NON_ACTIVE_IMAGE_ANY=y
    platform_allow:
      - nrf54l15dk/nrf54l15/cpuapp
```

## tests/subsys/bootloader/bl_storage/testcase.yaml
```yaml
tests:
  bootloader.bl_storage:
    sysbuild: true
    platform_allow:
      - nrf5340dk/nrf5340/cpuapp
      - nrf9151dk/nrf9151
      - nrf9160dk/nrf9160
      - nrf9161dk/nrf9161
    integration_platforms:
      - nrf5340dk/nrf5340/cpuapp
      - nrf9151dk/nrf9151
      - nrf9160dk/nrf9160
      - nrf9161dk/nrf9161
    tags: b0 sysbuild
    harness: console
    harness_config:
      type: multi_line
      ordered: true
      regex:
        - "Rebooting. Should fail to validate because of monotonic counter."
        - "Firmware version \\(10\\) is smaller than monotonic counter \\(11\\)."
        - "Failed to validate, permanently invalidating!"
        - "No bootable image found\\. Aborting boot\\."
```

## tests/subsys/bootloader/bl_validation/testcase.yaml
```yaml
tests:
  bootloader.bl_validation:
    sysbuild: true
    platform_allow:
      - nrf52833dk/nrf52833
      - nrf52840dk/nrf52840
      - nrf52dk/nrf52832
      - nrf5340dk/nrf5340/cpuapp
      - nrf9151dk/nrf9151
      - nrf9160dk/nrf9160
      - nrf9161dk/nrf9161
    integration_platforms:
      - nrf52833dk/nrf52833
      - nrf52840dk/nrf52840
      - nrf52dk/nrf52832
      - nrf5340dk/nrf5340/cpuapp
      - nrf9151dk/nrf9151
      - nrf9160dk/nrf9160
      - nrf9161dk/nrf9161
    tags: b0 bl_validation sysbuild
```

## tests/subsys/bootloader/bl_validation_ff_key/Kconfig
```kconfig
#
# Copyright (c) 2021 Nordic Semiconductor ASA
#
# SPDX-License-Identifier: LicenseRef-Nordic-5-Clause
#

config SB_DEBUG_NO_VERIFY_HASHES
	bool
	default y

source "Kconfig.zephyr"
```

## tests/subsys/bootloader/bl_validation_ff_key/Kconfig.sysbuild
```kconfig
#
# Copyright (c) 2024 Nordic Semiconductor ASA
#
# SPDX-License-Identifier: LicenseRef-Nordic-5-Clause
#

config SECURE_BOOT_DEBUG_NO_VERIFY_HASHES
	bool
	default y

config SECURE_BOOT_PUBLIC_KEY_FILES
	default "$(ZEPHYR_NRF_MODULE_DIR)/tests/subsys/bootloader/bl_validation_ff_key/ff_pub.pem"

source "${ZEPHYR_BASE}/share/sysbuild/Kconfig"
```

## tests/subsys/bootloader/bl_validation_ff_key/testcase.yaml
```yaml
tests:
  bootloader.bl_validation.ff_key:
    sysbuild: true
    platform_allow:
      - nrf52840dk/nrf52840
      - nrf52dk/nrf52832
      - nrf5340dk/nrf5340/cpuapp
      - nrf9151dk/nrf9151
      - nrf9160dk/nrf9160
      - nrf9161dk/nrf9161
    integration_platforms:
      - nrf52840dk/nrf52840
      - nrf52dk/nrf52832
      - nrf5340dk/nrf5340/cpuapp
      - nrf9151dk/nrf9151
      - nrf9160dk/nrf9160
      - nrf9161dk/nrf9161
    tags: b0 bl_validation ff_key sysbuild
    harness: console
    harness_config:
      type: multi_line
      ordered: true
      regex:
        - "A public key contains 0xFFFF, which is unsupported"
        - "Failed to validate, permanently invalidating!"
        - "No bootable image found. Aborting boot."
```

## tests/subsys/bootloader/bl_validation_neg/testcase.yaml
```yaml
tests:
  bootloader.bl_validation.negative:
    sysbuild: true
    platform_allow:
      - nrf5340dk/nrf5340/cpuapp
      - nrf9151dk/nrf9151
      - nrf9160dk/nrf9160
      - nrf9161dk/nrf9161
    integration_platforms:
      - nrf5340dk/nrf5340/cpuapp
      - nrf9151dk/nrf9151
      - nrf9160dk/nrf9160
      - nrf9161dk/nrf9161
    tags: b0 bl_validation negative bl_validation_negative sysbuild
    harness: console
    harness_config:
      type: multi_line
      ordered: true
      regex:
        - "Running TESTSUITE test_bl_validation_neg"
        - "Rebooting. Should fail to validate slot 1."
        - "Attempting to boot slot 1."
        - "Firmware info doesn't point to itself."
        - "Failed to validate, permanently invalidating!"
        - "Attempting to boot slot 0."
        - "PASS - test_validation_neg1"
        - "Rebooting. Should fail to validate because of invalid public keys."
        - "Attempting to boot slot 0."
        - "Key 0 has been invalidated, try next."
        - "Key 1 has been invalidated, try next."
        - "Key 2 has been invalidated, try next."
        - "Failed to validate signature."
        - "Failed to validate, permanently invalidating!"
        - "No bootable image found. Aborting boot."
  bootloader.bl_validation.negative.nrf52:
    sysbuild: true
    platform_allow:
      - nrf52840dk/nrf52840
      - nrf52dk/nrf52832
    integration_platforms:
      - nrf52840dk/nrf52840
      - nrf52dk/nrf52832
    tags: b0 bl_validation negative bl_validation_negative sysbuild
    harness: console
    harness_config:
      type: multi_line
      ordered: true
      regex:
        - "Running TESTSUITE test_bl_validation_neg"
        - "Rebooting. Should fail to validate slot 1."
        - "Attempting to boot slot 1."
        - "Firmware info doesn't point to itself."
        - "Failed to validate, permanently invalidating!"
        - "Attempting to boot slot 0."
        - "PASS - test_validation_neg1"
        - "PROJECT EXECUTION SUCCESSFUL"
```

## tests/subsys/bootloader/bl_validation_unittest/testcase.yaml
```yaml
tests:
  bootloader.bl_validation.unittest:
    sysbuild: true
    platform_allow:
      - native_sim
    integration_platforms:
      - native_sim
    tags:
      - b0
      - bl_validation
      - unittest
      - sysbuild
      - ci_tests_subsys_bootloader
```

## tests/subsys/bootloader/boot_chains/sysbuild/mcuboot/boards/nrf54lc10dk_nrf54lc10a_cpuapp_b0_mcuboot.conf
```kconfig
#
# Copyright (c) 2026 Nordic Semiconductor ASA
#
# SPDX-License-Identifier: LicenseRef-Nordic-5-Clause
#

CONFIG_BOOT_WATCHDOG_FEED=y
CONFIG_BOOT_WATCHDOG_FEED_NRFX_WDT=y
```

## tests/subsys/bootloader/boot_chains/sysbuild/mcuboot/boards/nrf9151dk_nrf9151_mcuboot.conf
```kconfig
# The MCUboot partition size (0xc000) is not supported with FPROTECT.
CONFIG_FPROTECT=n
```

## tests/subsys/bootloader/boot_lock_kmu_keys/testcase.yaml
```yaml
common:
  sysbuild: true
  harness: pytest
  harness_config:
    pytest_root:
      - "../upgrade/pytest/test_common_provision.py::test_passes_after_provisioning_all_keys"
  platform_allow:
    - nrf54l15dk/nrf54l15/cpuapp
    - nrf54lv10dk/nrf54lv10a/cpuapp
    - nrf54lm20dk/nrf54lm20a/cpuapp
  integration_platforms:
    - nrf54l15dk/nrf54l15/cpuapp
    - nrf54lm20dk/nrf54lm20a/cpuapp
  tags:
    - pytest
    - kmu
    - ci_tests_subsys_bootloader

tests:
  boot.kmu_keys_lock.smoke_test: {}

  boot.mcuboot.kmu_keys_locked:
    extra_args:
      - SB_CONFIG_BOOTLOADER_MCUBOOT=y
      - SB_CONFIG_MCUBOOT_SIGNATURE_USING_KMU=y
      - mcuboot_CONFIG_BOOT_SIGNATURE_KMU_SLOTS=3
    tags:
      - mcuboot

  boot.b0.kmu_keys_locked:
    extra_args:
      - SB_CONFIG_SECURE_BOOT_APPCORE=y
    tags:
      - b0

  boot.b0.mcuboot.kmu_keys_locked:
    extra_args:
      - SB_CONFIG_SECURE_BOOT_APPCORE=y
      - SB_CONFIG_BOOTLOADER_MCUBOOT=y
      - SB_CONFIG_MCUBOOT_SIGNATURE_USING_KMU=y
      - mcuboot_CONFIG_BOOT_SIGNATURE_KMU_SLOTS=3
      - mcuboot_CONFIG_PM_PARTITION_SIZE_MCUBOOT=0xc800
    tags:
      - b0
      - mcuboot
```

## tests/subsys/bootloader/boot_ppi_config_leftovers/testcase.yaml
```yaml
common:
  sysbuild: true
  tags:
    - ci_tests_subsys_bootloader
tests:
  # Objective of these scenarios are verification of bootloader(s)
  # left publish/subscribe register clean for the application.
  bootloader.ppi_config_leftovers.mcuboot:
    platform_allow:
      - nrf5340dk/nrf5340/cpuapp
      - nrf54l15dk/nrf54l15/cpuapp
    integration_platforms:
      - nrf5340dk/nrf5340/cpuapp
    extra_args:
      - SB_CONFIG_BOOTLOADER_MCUBOOT=y
  bootloader.ppi_config_leftovers.nsib:
    platform_allow:
      - nrf5340dk/nrf5340/cpuapp
      - nrf54l15dk/nrf54l15/cpuapp
    integration_platforms:
      - nrf5340dk/nrf5340/cpuapp
    extra_args:
      - SB_CONFIG_SECURE_BOOT_APPCORE=y
      - SB_CONFIG_SECURE_BOOT_GENERATE_DEFAULT_KMU_KEYFILE=y
```

## tests/subsys/bootloader/ib_crypto/testcase.yaml
```yaml
tests:
  bootloader.ib_crypto:
    platform_whitelist: nrf52840_pca10056 nrf52_pca10040 nrf51_pca10028
    tags: bootloader secure_boot
```
