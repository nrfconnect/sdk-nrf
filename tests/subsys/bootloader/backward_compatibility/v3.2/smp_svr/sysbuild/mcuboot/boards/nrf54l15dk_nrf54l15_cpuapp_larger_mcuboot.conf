## tests/subsys/bootloader/ppi_config_leftovers/testcase.yaml
```yaml
tests:
  ppi_config_leftovers.simple:
    sysbuild: true
    platform_allow:
      - nrf5340dk/nrf5340/cpuapp
  ppi_config_leftovers.mcuboot:
    sysbuild: true
    extra_configs:
      - SB_CONFIG_BOOTLOADER_MCUBOOT=y
    platform_allow:
      - nrf5340dk/nrf5340/cpuapp
  ppi_config_leftovers.mcuboot_nsib:
    sysbuild: true
    extra_configs:
      - SB_CONFIG_BOOTLOADER_MCUBOOT=y
      - SB_CONFIG_SECURE_BOOT_APPCORE=y
    platform_allow:
      - nrf5340dk/nrf5340/cpuapp
```

## tests/subsys/bootloader/upgrade/b0_hello_world/Kconfig.sysbuild
```kconfig
#
# Copyright (c) 2026 Nordic Semiconductor ASA
#
# SPDX-License-Identifier: LicenseRef-Nordic-5-Clause
#

if SOC_SERIES_NRF54L

config MCUBOOT_GENERATE_DEFAULT_KMU_KEYFILE
	default y if BOOTLOADER_MCUBOOT && MCUBOOT_SIGNATURE_USING_KMU

config SECURE_BOOT_GENERATE_DEFAULT_KMU_KEYFILE
	default y if SECURE_BOOT_APPCORE

endif

config SECURE_BOOT_SIGNING_KEY_FILE
	default "$(ZEPHYR_MCUBOOT_MODULE_DIR)/root-ed25519.pem" if SECURE_BOOT_SIGNATURE_TYPE_ED25519
	default "$(ZEPHYR_MCUBOOT_MODULE_DIR)/root-ec-p256.pem" if SECURE_BOOT_SIGNATURE_TYPE_ECDSA

source "${ZEPHYR_BASE}/share/sysbuild/Kconfig"
```

## tests/subsys/bootloader/upgrade/ref_smp_svr/Kconfig.sysbuild
```kconfig
#
# Copyright (c) 2024 Nordic Semiconductor
#
# SPDX-License-Identifier: LicenseRef-Nordic-5-Clause
#

if BOARD_NRF5340DK_NRF5340_CPUAPP

config NRF_DEFAULT_EMPTY
	default y

endif

config MCUBOOT_USE_ALL_AVAILABLE_RAM
	default y if BOARD_NRF5340DK_NRF5340_CPUAPP_NS

config SECURE_BOOT_SIGNING_KEY_FILE
	default "$ZEPHYR_BASE/../bootloader/mcuboot/root-ed25519.pem" if SECURE_BOOT_SIGNATURE_TYPE_ED25519
	default "$ZEPHYR_BASE/../bootloader/mcuboot/root-ec-p256.pem" if SECURE_BOOT_SIGNATURE_TYPE_ECDSA

config NRF_DEFAULT_IPC_RADIO
	default y if SOC_SERIES_NRF54H && MCUBOOT_SIGN_MERGED_BINARY

config NETCORE_IPC_RADIO_BT_HCI_IPC
	default y if SOC_SERIES_NRF54H && MCUBOOT_SIGN_MERGED_BINARY

config MCUBOOT_IMAGES_ROM_END_OFFSET_AUTO
	default "ipc_radio;ipc_radio_secondary_app" if MCUBOOT_SIGN_MERGED_BINARY

source "${ZEPHYR_BASE}/share/sysbuild/Kconfig"
```

## tests/subsys/bootloader/upgrade/ref_smp_svr/boards/nrf5340dk_nrf5340_cpuapp_ns.conf
```kconfig
CONFIG_BUILD_WITH_TFM=y
CONFIG_MCUBOOT_USE_ALL_AVAILABLE_RAM=y
CONFIG_TFM_PROFILE_TYPE_MINIMAL=y
```

## tests/subsys/bootloader/upgrade/ref_smp_svr/sysbuild/mcuboot/boards/nrf54h20dk_nrf54h20_cpuapp.conf
```kconfig
CONFIG_PM=n

CONFIG_MAIN_STACK_SIZE=10240

CONFIG_BOOT_SWAP_SAVE_ENCTLV=n
CONFIG_BOOT_ENCRYPT_IMAGE=n

CONFIG_BOOT_UPGRADE_ONLY=n
CONFIG_BOOT_BOOTSTRAP=n

### mbedTLS has its own heap
# CONFIG_HEAP_MEM_POOL_SIZE is not set

### Various Zephyr boards enable features that we don't want.
# CONFIG_BT is not set
# CONFIG_I2C is not set

### Disable malloc arena because we don't need it
CONFIG_COMMON_LIBC_MALLOC_ARENA_SIZE=0

# Configuration which is needed for supporting resume the application execution
# after suspend to RAM (S2RAM) requested by the application.
# MCUboot does not support S2RAM itself, but serves as an immediate actor while waking up
# from suspension.
CONFIG_SOC_EARLY_RESET_HOOK=y

# Ensure that the SPI NOR driver is disabled by default
CONFIG_SPI_NOR=n

# TODO: below are not yet supported and need fixing
CONFIG_FPROTECT=n

CONFIG_BOOT_WATCHDOG_FEED=n

# Power domains forced on by default on boot, no need
# to manage them in bootloader.
CONFIG_POWER_DOMAIN=n
```

## tests/subsys/bootloader/upgrade/ref_smp_svr/sysbuild/mcuboot/boards/nrf54l15dk_nrf54l15_cpuapp_fprotect.conf
```kconfig
CONFIG_FPROTECT=y

CONFIG_MULTITHREADING=n
CONFIG_SPI_NOR=n
CONFIG_BOOT_WATCHDOG_FEED=n
```
