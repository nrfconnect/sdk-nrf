/*
 * Copyright (c) 2026 Nordic Semiconductor ASA
 *
 * SPDX-License-Identifier: LicenseRef-Nordic-5-Clause
 */

/* Give MCUboot the same slot geometry as the application. */

#include "../../../boards/nrf52840dk_nrf52840_bt.overlay"

/ {
	chosen {
		zephyr,code-partition = &boot_partition;
	};
};
