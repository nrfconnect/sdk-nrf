/*
 * Copyright (c) 2026 Nordic Semiconductor ASA
 *
 * SPDX-License-Identifier: LicenseRef-Nordic-5-Clause
 */

#include "../dts_layout.dtsi"

/ {
	chosen {
		zephyr,code-partition = &s0_partition;
	};
};
