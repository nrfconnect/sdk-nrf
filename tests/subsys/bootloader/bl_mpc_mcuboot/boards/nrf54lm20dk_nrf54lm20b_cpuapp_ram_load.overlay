/*
 * Copyright (c) 2026 Nordic Semiconductor ASA
 *
 * SPDX-License-Identifier: LicenseRef-Nordic-5-Clause
 */

#include "../dts/ram_load_memory_map.dtsi"

/ {
	chosen {
		zephyr,bootloader-info = &boot_info0;
		mcuboot,image-ram = &cpuapp_sram_app_rxm_region;
	};
};
