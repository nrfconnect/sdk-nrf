## CMakeLists.txt
```
#
# Copyright (c) 2020 Nordic Semiconductor ASA
#
# SPDX-License-Identifier: LicenseRef-BSD-5-Clause-Nordic
#

cmake_minimum_required(VERSION 3.8.2)

include($ENV{ZEPHYR_BASE}/../nrf/cmake/boilerplate.cmake)
include($ENV{ZEPHYR_BASE}/cmake/app/boilerplate.cmake NO_POLICY_SCOPE)
project(NONE)

FILE(GLOB app_sources src/*.c)
target_sources(app PRIVATE ${app_sources})
```

## prj.conf
```kconfig
#
# Copyright (c) 2020 Nordic Semiconductor ASA
#
# SPDX-License-Identifier: LicenseRef-BSD-5-Clause-Nordic
#

CONFIG_ZTEST=y
CONFIG_TEST_USERSPACE=n
CONFIG_USERSPACE=n
CONFIG_STDOUT_CONSOLE=n
CONFIG_SECURE_BOOT=y
CONFIG_FW_INFO=y
CONFIG_REBOOT=y
CONFIG_FW_INFO_FIRMWARE_VERSION=10
CONFIG_SECURE_BOOT_PURSE=y
CONFIG_SECURE_BOOT_CRYPTO=y
CONFIG_SB_NUM_MONOTONIC_COUNTERS=6
```

## src/main.c
```c
/*
 * Copyright (c) 2020 Nordic Semiconductor ASA
 *
 * SPDX-License-Identifier: LicenseRef-BSD-5-Clause-Nordic
 */

#include <ztest.h>

#include "bl_purse.h"
#include "power/reboot.h"

void test_monotonic_counter(void)
{
	printk("get_monotonic_counter() = %d\n", get_monotonic_counter());

	zassert_equal(CONFIG_SB_NUM_MONOTONIC_COUNTERS,
		num_monotonic_counter_slots(), NULL);
	zassert_equal(CONFIG_FW_INFO_FIRMWARE_VERSION, get_monotonic_counter(),
		NULL);
	zassert_equal(-EINVAL,
		set_monotonic_counter(CONFIG_FW_INFO_FIRMWARE_VERSION),
		NULL);
	zassert_equal(-EINVAL, set_monotonic_counter(0), NULL);
	zassert_equal(-EINVAL, set_monotonic_counter(0xFFFF), NULL);
	zassert_equal(0,
		set_monotonic_counter(CONFIG_FW_INFO_FIRMWARE_VERSION + 1),
		NULL);
	zassert_equal(CONFIG_FW_INFO_FIRMWARE_VERSION + 1,
		get_monotonic_counter(), NULL);
	printk("Rebooting. Should fail to validated because of "
		"monotonic counter.\n");
	sys_reboot(0);
}

/* The rest of bl_purse's functionality is tested via the bl_validation
 * tests.
 */

void test_main(void)
{
	ztest_test_suite(test_purse,
			 ztest_unit_test(test_monotonic_counter)
	);
	ztest_run_test_suite(test_purse);
}
```
