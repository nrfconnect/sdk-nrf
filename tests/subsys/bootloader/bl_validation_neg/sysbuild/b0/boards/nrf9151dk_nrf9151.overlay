/*
 * Copyright (c) 2026 Nordic Semiconductor ASA
 *
 * SPDX-License-Identifier: LicenseRef-Nordic-5-Clause
 */

#include "../../../boards/nrf9151dk_nrf9151.overlay"

/ {
	chosen {
		zephyr,code-partition = &b0_partition;
	};
};
