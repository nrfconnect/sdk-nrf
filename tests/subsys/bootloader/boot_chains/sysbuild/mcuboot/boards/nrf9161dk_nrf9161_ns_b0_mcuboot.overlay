/*
 * Copyright (c) 2026 Nordic Semiconductor ASA
 *
 * SPDX-License-Identifier: LicenseRef-Nordic-5-Clause
 */

#include "../../../boards/nrf9161dk_nrf9161_ns_b0_mcuboot.overlay"

/ {
	chosen {
		zephyr,code-partition = &s0_partition;
	};
};
