/*
 * Copyright (c) 2026 Nordic Semiconductor ASA
 *
 * SPDX-License-Identifier: LicenseRef-Nordic-5-Clause
 */

#include "../../../boards/nrf54lc10dk_nrf54lc10a_cpuapp_b0_mcuboot.overlay"

/ {
	chosen {
		zephyr,code-partition = &s0_partition;
	};
};
