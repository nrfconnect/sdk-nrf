/*
 * Copyright (c) 2026 Nordic Semiconductor ASA
 *
 * SPDX-License-Identifier: LicenseRef-Nordic-5-Clause
 */

#include "../nrf5340_b0_mcuboot_partitions.dtsi"

/ {
	chosen {
		zephyr,code-partition = &slot0_partition;
	};
};
