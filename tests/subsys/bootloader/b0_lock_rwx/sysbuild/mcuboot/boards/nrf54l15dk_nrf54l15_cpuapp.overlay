/*
 * Copyright (c) 2026 Nordic Semiconductor ASA
 *
 * SPDX-License-Identifier: LicenseRef-Nordic-5-Clause
 */

#define THIS_IS_MCUBOOT_IMAGE

#include "../../../boards/nrf54l15dk_nrf54l15_cpuapp.overlay"
