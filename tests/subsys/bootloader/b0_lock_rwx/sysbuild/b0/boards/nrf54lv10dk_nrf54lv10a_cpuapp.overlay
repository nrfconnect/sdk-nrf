/*
 * Copyright (c) 2026 Nordic Semiconductor ASA
 *
 * SPDX-License-Identifier: LicenseRef-Nordic-5-Clause
 */

#define THIS_IS_B0_IMAGE

#include "../../../boards/nrf54lv10dk_nrf54lv10a_cpuapp.overlay"
