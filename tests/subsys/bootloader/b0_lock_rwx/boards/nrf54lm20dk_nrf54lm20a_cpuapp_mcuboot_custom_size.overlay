/*
 * Copyright (c) 2026 Nordic Semiconductor ASA
 *
 * SPDX-License-Identifier: LicenseRef-Nordic-5-Clause
 */

#include "nrf54lm20dk_nrf54lm20a_cpuapp_mcuboot.overlay"

&boot_partition {
	reg = <0x0 DT_SIZE_K(63)>;
};
