/*
 * Copyright (c) 2026 Nordic Semiconductor ASA
 *
 * SPDX-License-Identifier: LicenseRef-Nordic-5-Clause
 */

ipc0: &cpuapp_cpuflpr_ipc {
	compatible = "zephyr,ipc-icbmsg";
	tx-blocks = <16>;
	rx-blocks = <18>;
	status = "okay";
	unbound = "enable";
};

&cpuflpr_vevif {
	status = "okay";
};
