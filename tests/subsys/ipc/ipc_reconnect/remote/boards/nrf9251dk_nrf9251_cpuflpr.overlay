/*
 * Copyright (c) 2026 Nordic Semiconductor ASA
 *
 * SPDX-License-Identifier: LicenseRef-Nordic-5-Clause
 */

ipc0: &cpuapp_cpuflpr_ipc {
	compatible = "zephyr,ipc-icmsg";
	unbound = "enable";
	/delete-property/ tx-blocks;
	/delete-property/ rx-blocks;
	dcache-alignment = <32>;
	status = "okay";
};

&cpuapp_bellboard {
	status = "okay";
};

&cpuflpr_vevif {
	status = "okay";
};

&uart120 {
	/delete-property/ hw-flow-control;
};
