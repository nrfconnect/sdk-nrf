/*
 * Copyright (c) 2026 Nordic Semiconductor ASA
 *
 * SPDX-License-Identifier: LicenseRef-Nordic-5-Clause
 */

&ipc0 {
	compatible = "zephyr,ipc-icmsg";
	unbound = "enable";
	/delete-property/ tx-blocks;
	/delete-property/ rx-blocks;
};
