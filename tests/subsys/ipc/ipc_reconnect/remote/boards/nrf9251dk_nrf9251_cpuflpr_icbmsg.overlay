/*
 * Copyright (c) 2026 Nordic Semiconductor ASA
 *
 * SPDX-License-Identifier: LicenseRef-Nordic-5-Clause
 */

ipc0: &cpuapp_cpuflpr_ipc {
	compatible = "zephyr,ipc-icbmsg";
	tx-blocks = <18>;
	rx-blocks = <16>;
	status = "okay";
	unbound = "enable";
};

&cpuapp_bellboard {
	status = "okay";
};

&cpuflpr_vevif {
	status = "okay";
};

&uart120 {
	/delete-property/ hw-flow-control;
};
