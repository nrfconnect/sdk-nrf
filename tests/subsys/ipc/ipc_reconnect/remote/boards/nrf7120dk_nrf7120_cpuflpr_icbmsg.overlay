/*
 * Copyright (c) 2026 Nordic Semiconductor ASA
 *
 * SPDX-License-Identifier: LicenseRef-Nordic-5-Clause
 */

#include "nrf7120dk_nrf7120_cpuflpr.overlay"

&ipc0 {
	compatible = "zephyr,ipc-icbmsg";
	tx-blocks = <18>;
	rx-blocks = <16>;
};
