## tests/drivers/can/api_additional/testcase.yaml
```yaml
common:
  tags:
    - drivers
    - can
  depends_on: can

tests:
  drivers.can.api_additional:
    platform_allow:
      - nrf54h20dk/nrf54h20/cpuapp
    integration_platforms:
      - nrf54h20dk/nrf54h20/cpuapp
```

## tests/drivers/can/can_stats_init/testcase.yaml
```yaml
common:
  tags:
    - drivers
    - can
    - ci_tests_drivers_can
  platform_allow:
    - nrf54h20dk/nrf54h20/cpuapp
  integration_platforms:
    - nrf54h20dk/nrf54h20/cpuapp

tests:
  drivers.can.can_stats_init: {}
```

## tests/drivers/clock_control/clock_control_mpsl/testcase.yaml
```yaml
tests:
  drivers.clock_control.clock_control_mpsl:
    tags: drivers
    platform_whitelist: nrf51dk_nrf51422 nrf52dk_nrf52832 nrf52840dk_nrf52840
                        nrf9160dk_nrf9160
```

## tests/drivers/clock_control/clock_pan/testcase.yaml
```yaml
common:
  tags:
    - drivers
    - clock_control
    - ci_tests_zephyr_drivers_clock_control
  platform_allow:
    - nrf54lm20dk/nrf54lm20a/cpuapp
  integration_platforms:
    - nrf54lm20dk/nrf54lm20a/cpuapp

tests:
  drivers.clock.hfclk24m_start: {}
```

## tests/drivers/dect/dect_mdm/integration/Kconfig
```kconfig
#
# Copyright (c) 2026 Nordic Semiconductor ASA
#
# SPDX-License-Identifier: LicenseRef-Nordic-5-Clause
#
# Kconfig for DECT NR+ Integration Tests
# Provides minimal definitions needed for DECT stack compilation without full modem library

# Enable SETTINGS support needed by DECT drivers
config SETTINGS
	bool "Settings subsystem"
	default y
	help
	  Settings support needed by DECT drivers.

config MODEM_CELLULAR
	bool "Modem cellular support"
	default y
	help
	  Modem cellular support needed by DECT L2 sink.
	  When enabled, a mock modem device is provided via boards/native_sim.overlay for testing.

# Define DECT_UTILS_LIB that is selected by DECT drivers
config DECT_UTILS_LIB
	bool "DECT MAC utilities library support"
	default y
	help
	  Mock DECT MAC utilities library configuration for testing.
	  In real builds this would pull in the utilities library.

# Modem shared memory configurations needed by MAC drivers
config NRF_MODEM_LIB_SHMEM_TX_SIZE
	int "Modem shared memory TX size"
	default 12288
	help
	  Mock definition for modem shared memory TX size.
	  Used by MAC driver for validation.

config NRF_MODEM_LIB_SHMEM_RX_SIZE
	int "Modem shared memory RX size"
	default 6144
	help
	  Mock definition for modem shared memory RX size.
	  Used by MAC driver for validation.

config NRF_MODEM_SHMEM_CTRL_SIZE
	hex "Modem shared memory control size"
	default 0x4e8
	help
	  Mock definition for modem shared memory control size.
	  Used by MAC driver for validation.

# Most modem CONFIG values are already defined in the main SDK
# We only need to ensure they have reasonable defaults for testing
# The values will be set in prj.conf

# Logging configuration for test module
module = TEST_DECT_INTEGRATION
module-str = DECT Integration Tests
source "subsys/logging/Kconfig.template.log_config"

source "Kconfig.zephyr"
```

## tests/drivers/flash/common/testcase.yaml
```yaml
common:
  tags:
    - drivers
    - flash
tests:
  drivers.flash.common.sdp:
    platform_allow:
      - nrf54l15dk/nrf54l15/cpuapp
    integration_platforms:
      - nrf54l15dk/nrf54l15/cpuapp
    extra_args:
      - SB_CONFIG_VPR_LAUNCHER=n
      - SB_CONFIG_PARTITION_MANAGER=n
      - SB_CONFIG_SDP=y
      - SB_CONFIG_SDP_MSPI=y
```

## tests/drivers/flash/flash_ipuc/testcase.yaml
```yaml
common:
  tags:
    - drivers
    - flash
    - ci_tests_drivers_flash
tests:
  drivers.flash.flash_ipuc:
    platform_allow:
      - nrf54h20dk/nrf54h20/cpuapp
      - nrf54h20dk/nrf54h20/cpuapp/iron
      - native_sim
      - native_sim/native/64
    integration_platforms:
      - nrf54h20dk/nrf54h20/cpuapp
      - nrf54h20dk/nrf54h20/cpuapp/iron
      - native_sim
      - native_sim/native/64
```

## tests/drivers/flash/flash_rpc/Kconfig
```kconfig
#
# Copyright (c) 2024 Nordic Semiconductor ASA
#
# SPDX-License-Identifier: LicenseRef-Nordic-5-Clause
#

menu "Zephyr Kernel"
source "Kconfig.zephyr"
endmenu

config APP_INCLUDE_REMOTE_IMAGE
	bool "Include remote image as sub image"
	default y
	select PARTITION_MANAGER_ENABLED

config APP_REMOTE_BOARD
	string "The name of the CORE to be used by remote image"
	depends on APP_INCLUDE_REMOTE_IMAGE
```

## tests/drivers/flash/flash_rpc/testcase.yaml
```yaml
common:
  sysbuild: true
  tags:
    - drivers
    - flash
    - ci_tests_drivers_flash
tests:
  drivers.flash.flash_rpc:
    platform_allow: nrf5340dk/nrf5340/cpuapp
    integration_platforms:
      - nrf5340dk/nrf5340/cpuapp
    extra_args:
      SB_CONF_FILE=sysbuild/nrf5340dk_nrf5340_cpunet.conf
```

## tests/drivers/flash/multicore_soc_flash/Kconfig.sysbuild
```kconfig
#
# Copyright (c) 2025 Nordic Semiconductor ASA
#
# SPDX-License-Identifier: LicenseRef-Nordic-5-Clause
#

config PARTITION_MANAGER
	default n if !BOARD_IS_NON_SECURE

config REMOTE_BOARD
	string
	default "$(BOARD)/nrf54h20/cpurad" if SOC_NRF54H20_CPUAPP
	default "$(BOARD)/nrf54h20/cpuapp" if SOC_NRF54H20_CPURAD

source "share/sysbuild/Kconfig"
```

## tests/drivers/flash/multicore_soc_flash/remote/Kconfig
```kconfig
source "Kconfig.zephyr"


config READ_FROM_SOC_FLASH
    bool "Enable reading from SOC flash"
    default y

config WRITE_TO_SOC_FLASH
    bool "Enable writing to SOC flash"
```

## tests/drivers/flash/multicore_soc_flash/testcase.yaml
```yaml
common:
  sysbuild: true
  tags:
    - drivers
    - flash
    - ci_tests_drivers_flash
  platform_allow:
    - nrf54h20dk/nrf54h20/cpuapp
    - nrf54h20dk/nrf54h20/cpurad
  integration_platforms:
    - nrf54h20dk/nrf54h20/cpuapp
    - nrf54h20dk/nrf54h20/cpurad
  harness: console
  harness_config:
    type: multi_line
    regex:
      - "Tests status: PASS"

tests:
  drivers.flash.multicore_soc_flash: {}
```

## tests/drivers/flash/testcase.yaml
```yaml
tests:
  drivers.bt_ll_softdevice.flash:
    platform_allow: nrf52840dk_nrf52840
    tags: nrf52 soc_flash_nrf_ll_softdevice
    extra_args: OVERLAY_CONFIG="conf/nrf52840_flash_sdc.conf"
  drivers.mpsl.flash_sync:
    platform_allow: nrf52840dk_nrf52840
    tags: nrf52 soc_flash_nrf
    extra_args: OVERLAY_CONFIG="conf/nrf52840_flash_mpsl.conf"
```

## tests/drivers/flash_nop_device/testcase.yaml
```yaml
#
# Copyright (c) 2021 Nordic Semiconductor ASA
#
# SPDX-License-Identifier: LicenseRef-Nordic-5-Clause
#
tests:
  drivers.flash.flash_nop_device:
    platform_allow: native_posix
    integration_platforms:
      - native_posix
    tags: driver
  drivers.flash.flash_nop_device.posix_erase_value_0x00:
    extra_args: DTC_OVERLAY_FILE=boards/native_posix_ev_0x00.overlay
    platform_allow: native_posix
    integration_platforms:
      - native_posix
    tags: driver
```

## tests/drivers/flash_patch/testcase.yaml
```yaml
tests:
  flash_patch.flash_patch_off:
    sysbuild: true
    platform_allow: nrf52840dk/nrf52840 nrf52833dk/nrf52833
    integration_platforms:
      - nrf52840dk/nrf52840
      - nrf52833dk/nrf52833
    tags: flash_patch sysbuild
    extra_args: CONFIG_DISABLE_FLASH_PATCH=n
  flash_patch.flash_patch_on:
    sysbuild: true
    platform_allow: nrf52840dk/nrf52840 nrf52833dk/nrf52833
    integration_platforms:
      - nrf52840dk/nrf52840
      - nrf52833dk/nrf52833
    tags: flash_patch sysbuild
```

## tests/drivers/fprotect/storage/testcase.yaml
```yaml
tests:
  lib.fprotect.storage_fprotect:
    platform_allow:
      - nrf54l15dk/nrf54l15/cpuapp
      - nrf54l15dk/nrf54l10/cpuapp
      - nrf54l15dk/nrf54l05/cpuapp
      - nrf54lm20dk/nrf54lm20a/cpuapp
      - nrf54lm20dk/nrf54lm20b/cpuapp
      - nrf54lv10dk/nrf54lv10a/cpuapp
    integration_platforms:
      - nrf54l15dk/nrf54l15/cpuapp
      - nrf54l15dk/nrf54l10/cpuapp
      - nrf54l15dk/nrf54l05/cpuapp
      - nrf54lm20dk/nrf54lm20a/cpuapp
      - nrf54lm20dk/nrf54lm20b/cpuapp
      - nrf54lv10dk/nrf54lv10a/cpuapp
    tags:
      - b0
      - fprotect
      - ci_tests_drivers_fprotect
```

## tests/drivers/gpio/egpio_basic_api/testcase.yaml
```yaml
common:
  tags:
    - drivers
    - gpio
    - ci_tests_drivers_sdp
  depends_on: gpio
  harness: ztest
  harness_config:
    fixture: gpio_loopback
  timeout: 30

tests:
  drivers.egpio.loopback.icmsg:
    min_flash: 64
    platform_allow:
      - nrf54l15dk/nrf54l15/cpuapp
    integration_platforms:
      - nrf54l15dk/nrf54l15/cpuapp
    sysbuild: true
    extra_args: SB_CONFIG_SDP_GPIO_BACKEND_ICMSG=y

  drivers.egpio.loopback.icbmsg:
    min_flash: 64
    platform_allow:
      - nrf54l15dk/nrf54l15/cpuapp
    integration_platforms:
      - nrf54l15dk/nrf54l15/cpuapp
    sysbuild: true
    extra_args: SB_CONFIG_SDP_GPIO_BACKEND_ICBMSG=y

  drivers.egpio.loopback.mbox:
    min_flash: 64
    platform_allow:
      - nrf54l15dk/nrf54l15/cpuapp
    integration_platforms:
      - nrf54l15dk/nrf54l15/cpuapp
    sysbuild: true
    extra_args: SB_CONFIG_SDP_GPIO_BACKEND_MBOX=y
```

## tests/drivers/gpio/egpio_more_loops/testcase.yaml
```yaml
common:
  sysbuild: true
  tags:
    - drivers
    - gpio
    - ci_tests_drivers_sdp
  depends_on: gpio
  min_flash: 64
  harness: ztest
  harness_config:
    fixture: five_gpio_loopbacks
  platform_allow:
    - nrf54l15dk/nrf54l15/cpuapp
  integration_platforms:
    - nrf54l15dk/nrf54l15/cpuapp

tests:
  drivers.egpio.many_loops.icmsg:
    extra_args: SB_CONFIG_SDP_GPIO_BACKEND_ICMSG=y

  drivers.egpio.many_loops.icbmsg:
    extra_args: SB_CONFIG_SDP_GPIO_BACKEND_ICBMSG=y

  drivers.egpio.many_loops.mbox:
    extra_args: SB_CONFIG_SDP_GPIO_BACKEND_MBOX=y
```

## tests/drivers/gpio/gpio_event/testcase.yaml
```yaml
common:
  tags:
    - drivers
    - gpio
    - ci_tests_drivers_gpio
  depends_on: gpio
  harness: ztest
  harness_config:
    fixture: gpio_loopback

tests:
  drivers.gpio.gpio_event:
    platform_allow:
      - nrf54h20dk/nrf54h20/cpuapp
      - nrf54l15dk/nrf54l15/cpuapp
      - nrf54lm20dk/nrf54lm20a/cpuapp
      - nrf54ls05dk/nrf54ls05b/cpuapp
      - nrf54ls05dk@0.0.0/nrf54ls05b/cpuapp
      - nrf54ls05dk@0.2.0/nrf54ls05b/cpuapp
      - nrf54lv10dk/nrf54lv10a/cpuapp
    integration_platforms:
      - nrf54l15dk/nrf54l15/cpuapp
  drivers.gpio.gpio_event.h20_radio:
    harness_config:
      fixture: i2s_loopback # Loopback includes the pin pair needed for that test
    platform_allow:
      - nrf54h20dk/nrf54h20/cpurad
    integration_platforms:
      - nrf54h20dk/nrf54h20/cpurad
```

## tests/drivers/gpio/gpio_more_loops/Kconfig
```kconfig
# Copyright (c) 2024 Nordic Semiconductor ASA
# SPDX-License-Identifier: LicenseRef-Nordic-5-Clause

config TEST_DURATION
	int "Test duration in ms"
	default 8000
	help
	  Test will run for (at least) defined time.
	  This value affects how many times GPIOs will be toggled.

config TEST_CHECK_PULLS
	bool "When enabled, additional check of GPIO pull-up and pull-down is executed."
	default y if BOARD_NRF54H20DK_NRF54H20_CPUAPP

source "Kconfig.zephyr"
```

## tests/drivers/gpio/gpio_more_loops/testcase.yaml
```yaml
common:
  tags:
    - drivers
    - gpio
    - ci_tests_drivers_gpio
  depends_on: gpio
  filter: not CONFIG_COVERAGE
  harness: ztest
  harness_config:
    fixture: gpio_loopback

tests:
  drivers.gpio.gpio_more_loops:
    platform_allow:
      - nrf5340dk/nrf5340/cpuapp
      - nrf5340dk/nrf5340/cpunet
      - nrf54h20dk/nrf54h20/cpuapp
      - nrf54h20dk/nrf54h20/cpuppr
      - nrf54h20dk/nrf54h20/cpuflpr
      - nrf54l15dk/nrf54l15/cpuapp
      - nrf54l15dk/nrf54l15/cpuapp/ns
      - nrf54l15dk/nrf54l15/cpuflpr
      - nrf54lm20dk/nrf54lm20a/cpuapp
      - nrf54lm20dk/nrf54lm20a/cpuflpr
      - nrf54lm20dk/nrf54lm20b/cpuapp
      - nrf54lm20dk/nrf54lm20b/cpuflpr
      - nrf54ls05dk/nrf54ls05a/cpuapp
      - nrf54ls05dk/nrf54ls05b/cpuapp
      - nrf54lv10dk/nrf54lv10a/cpuapp
      - nrf54lc10dk/nrf54lc10a/cpuapp
      - nrf54lv10dk/nrf54lv10a/cpuflpr
      - nrf7120dk/nrf7120/cpuapp
    integration_platforms:
      - nrf54h20dk/nrf54h20/cpuapp
```

## tests/drivers/gpio/gpio_nfct/Kconfig
```kconfig
# Copyright (c) 2025 Nordic Semiconductor ASA
# SPDX-License-Identifier: LicenseRef-Nordic-5-Clause

config TEST_DURATION
	int "Test duration in ms"
	default 4000
	help
	  Test will run for (at least) defined time.
	  This value affects how many times GPIOs will be toggled.

source "Kconfig.zephyr"
```

## tests/drivers/gpio/gpio_nfct/testcase.yaml
```yaml
common:
  tags:
    - drivers
    - gpio
    - ci_tests_drivers_gpio
  depends_on: gpio
  filter: not CONFIG_COVERAGE
  harness: ztest
  harness_config:
    fixture: gpio_loopback

tests:
  drivers.gpio.gpio_nfct:
    platform_allow:
      - nrf54h20dk/nrf54h20/cpuapp
      - nrf54h20dk/nrf54h20/cpurad
      - nrf54h20dk/nrf54h20/cpuppr
      - nrf54l15dk/nrf54l15/cpuapp
      - nrf54lm20dk/nrf54lm20a/cpuapp
      - nrf7120dk/nrf7120/cpuapp
    integration_platforms:
      - nrf54h20dk/nrf54h20/cpuapp
```
