## tests/drivers/spi/spi_latency/testcase.yaml
```yaml
common:
  sysbuild: true
  depends_on: gpio
  harness: ztest
  harness_config:
    fixture: gpio_loopback
  tags:
    - drivers
    - spim
    - ci_tests_drivers_spi

tests:
  drivers.spim_latency_1Mbps:
    platform_allow: &standard_spi_platforms
      - nrf52840dk/nrf52840
      - nrf5340dk/nrf5340/cpuapp
      - nrf54h20dk/nrf54h20/cpuapp
      - nrf54l15dk/nrf54l15/cpuapp
    integration_platforms:
      - nrf54h20dk/nrf54h20/cpuapp
    extra_args:
      - EXTRA_DTC_OVERLAY_FILE="boards/spi_1MHz.overlay"

  drivers.spim_latency_8Mbps:
    platform_allow: *standard_spi_platforms
    integration_platforms:
      - nrf54h20dk/nrf54h20/cpuapp

  drivers.spim_latency_16Mbps:
    platform_allow:
      - nrf54h20dk/nrf54h20/cpuapp
    integration_platforms:
      - nrf54h20dk/nrf54h20/cpuapp
    extra_args:
      - DTC_OVERLAY_FILE="boards/nrf54h20dk_nrf54h20_cpuapp_fast.overlay"
      - CONFIG_MEASUREMENT_REPEATS=200
      - CONFIG_SPI_NRFX_RAM_BUFFER_SIZE=512
```

## tests/drivers/spi/spi_modes/mode3/testcase.yaml
```yaml
tests:
  drivers.spi.spi_mode3:
    depends_on: spi
    tags: drivers spi
    harness: ztest
    harness_config:
      fixture: gpio_spi_loopback
    platform_allow: |
      nrf52840dk/nrf52840 nrf54l15pdk/nrf54l15/cpuapp nrf54h20dk/nrf54h20/cpuapp
      nrf54h20dk/nrf54h20/cpurad
    integration_platforms:
      - nrf52840dk/nrf52840
```

## tests/drivers/spi/spim_clock_control/testcase.yaml
```yaml
common:
  sysbuild: true
  depends_on: gpio
  harness: ztest
  tags:
    - drivers
    - spim
    - ci_tests_drivers_spi

tests:
  drivers.spim_clock_control:
    platform_allow:
      - nrf54h20dk/nrf54h20/cpuapp
    integration_platforms:
      - nrf54h20dk/nrf54h20/cpuapp
    harness_config:
      fixture: gpio_loopback
```

## tests/drivers/spi/spim_mosi_toggles/testcase.yaml
```yaml
common:
  sysbuild: true
  tags:
    - ci_build
    - ci_tests_drivers_spi
  harness: console

tests:

  drivers.spi.spim_mosi_toggles:
    harness_config:
      fixture: hpf_mspi_spi_loopback
      type: multi_line
      ordered: true
      regex:
        - "SPIM MOSI toggling test on"
        - "Test passed"
    platform_allow:
      - nrf54l15dk/nrf54l15/cpuapp
    integration_platforms:
      - nrf54l15dk/nrf54l15/cpuapp

  drivers.spi.spim_mosi_toggles.lm20:
    harness_config:
      fixture: spim_mosi_toggles
      type: multi_line
      ordered: true
      regex:
        - "SPIM MOSI toggling test on"
        - "Test passed"
    platform_allow:
      - nrf54lm20dk/nrf54lm20a/cpuapp
      - nrf54lm20dk/nrf54lm20b/cpuapp
    integration_platforms:
      - nrf54lm20dk/nrf54lm20b/cpuapp

  drivers.spi.spim_mosi_toggles.slow:
    harness_config:
      fixture: gpio_loopback
      type: multi_line
      ordered: true
      regex:
        - "SPIM MOSI toggling test on"
        - "Test passed"
    platform_allow:
      - nrf54ls05dk/nrf54ls05a/cpuapp
      - nrf54ls05dk/nrf54ls05b/cpuapp
      - nrf54lv10dk/nrf54lv10a/cpuapp
    integration_platforms:
      - nrf54lv10dk/nrf54lv10a/cpuapp
```

## tests/drivers/timer/delay_accuracy/Kconfig
```kconfig
#
# Copyright (c) 2026 Nordic Semiconductor ASA
#
# SPDX-License-Identifier: LicenseRef-Nordic-5-Clause
#

config TEST_TOLERANCE_PERCENT
	int "Accepted tolerance in percent"
	default 1
	help
	  When set to the value of 1 then test will pass if difference
	  between actual timer count and expected timer count is less
	  than one percent.

config TEST_TIMER_FREQUENCY_MHZ
	int "Timer frequency in MHz"
	default 4
	help
	  This value must take into account hardware limitations.
	  Calculations are int32_t based and may overflow on devices
	  with low accuracy or high frequency of the timer.

config TEST_START_HFXO
	bool "Start HFXO to increase clock accuracy"
	help
	  When set to 'y', clock source is switched to external crystal oscillator.

source "Kconfig.zephyr"
```

## tests/drivers/timer/delay_accuracy/testcase.yaml
```yaml
common:
  tags:
    - drivers
    - ci_tests_drivers_timer
  harness: ztest
  timeout: 20

tests:
  drivers.timer.delay_accuracy:
    platform_allow: &platform_allow
      - nrf54h20dk/nrf54h20/cpuapp
      - nrf54h20dk/nrf54h20/cpuflpr
      - nrf54h20dk/nrf54h20/cpuppr
      - nrf54h20dk/nrf54h20/cpurad
      - nrf54l15dk/nrf54l05/cpuapp
      - nrf54l15dk/nrf54l10/cpuapp
      - nrf54l15dk/nrf54l15/cpuapp
      - nrf54l15dk/nrf54l15/cpuflpr
      - nrf54lm20dk/nrf54lm20a/cpuapp
      - nrf54lm20dk/nrf54lm20a/cpuflpr
      - nrf54lm20dk/nrf54lm20b/cpuapp
      - nrf54ls05dk/nrf54ls05a/cpuapp
      - nrf54ls05dk/nrf54ls05b/cpuapp
      - nrf54lv10dk/nrf54lv10a/cpuapp
      - nrf54lv10dk/nrf54lv10a/cpuflpr
      - nrf54lc10dk/nrf54lc10a/cpuapp
      - nrf54lc10dk/nrf54lc10a/cpuflpr
      - nrf9251dk/nrf9251/cpuapp
      - nrf9251dk/nrf9251/cpuflpr
      - nrf9251dk/nrf9251/cpuppr
    integration_platforms: &integration_platforms
      - nrf54l15dk/nrf54l15/cpuapp

  drivers.timer.delay_accuracy.hfxo:
    platform_allow: *platform_allow
    integration_platforms: *integration_platforms
    extra_args:
      - CONFIG_TEST_START_HFXO=y
      - CONFIG_TEST_TOLERANCE_PERCENT=1
```

## tests/drivers/timer/grtc_timer_lfrc/testcase.yaml
```yaml
common:
  tags:
    - drivers
    - clock_control
    - ci_tests_drivers_timer
  harness: console
  harness_config:
    fixture: lfclk_at_lfrc
    type: multi_line
    regex:
      - "Tests status: PASS"

tests:
  drivers.timer.grtc_timer_lfrc.nrf54h:
    platform_allow:
      - nrf54h20dk/nrf54h20/cpuapp
      - nrf54h20dk/nrf54h20/cpurad
    integration_platforms:
      - nrf54h20dk/nrf54h20/cpuapp

  drivers.timer.grtc_timer_lfrc.nrf54l:
    platform_allow:
      - nrf54l15dk/nrf54l15/cpuapp
      - nrf54lm20dk/nrf54lm20a/cpuapp
      - nrf54ls05dk/nrf54ls05b/cpuapp
      - nrf54lv10dk/nrf54lv10a/cpuapp
    integration_platforms:
      - nrf54l15dk/nrf54l15/cpuapp
    extra_args:
      - CONFIG_CLOCK_CONTROL_NRF_K32SRC_RC=y
```
