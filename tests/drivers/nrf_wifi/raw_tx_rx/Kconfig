## tests/drivers/nrf_wifi/raw_tx_rx/Kconfig
```kconfig
# Configuration opions for Wi-Fi test

# Copyright (c) 2023 Nordic Semiconductor ASA
# SPDX-License-Identifier: Apache-2.0


source "Kconfig.zephyr"


config NRF_WIFI_RAW_TX_PKT_SAMPLE_CHANNEL
	int "Channel for non-connected Station mode"
	range 1 233
	default 1
	help
	  Specify the Wi-Fi channel for transmitting raw TX packets in non-connected Station mode.
	  The valid channel range is 1 to 233.

config NRF_WIFI_RAW_RX_PKT_TIMEOUT_S
	int "Wi-Fi raw RX packet timeout in seconds"
	default 5000

config RAW_TX_PKT_SAMPLE_RATE_VALUE
	int "MCS index or Data rate value"
	default 0
	help
	  Specify the Wi-Fi data rate value for raw TX packet transmission.
	  The value represents either the data rate in Mbps or Modulation and coding (MCS) index.
	  Note: 5.5Mbps is treated specially as 55 to avoid floating point usage.
	  Legacy: 1, 2, 55, 11, 6, 9, 12, 18, 24, 36, 48, 54
	  MCS index: 0-7

config RAW_TX_PKT_SAMPLE_RATE_FLAGS
	int "Rate flag value"
	range 0 4
	default 1
	help
	  Specify the rate flag value to be used for raw TX packet transmission.
	  Rate Flags:
	  0 - Legacy
	  1 - 11n format
	  2 - VHT format
	  3 - HE_SU
	  4 - HE_ER_SU

config RAW_TX_PKT_SAMPLE_QUEUE_NUM
	int "Queue number"
	default 0
	range 0 4
	help
	  Specify the transmission queue number for raw TX packets.
	  0 - Background
	  1 - Best effort
	  2 - Video
	  3 - Voice
	  4 - Beacon.

config RX_THREAD_STACK_SIZE
	int "Thread Stack Size"
	default 4096
	help
	  This option sets the stack size for the threads used in the sample.

config RAW_TX_RX_TRANSMIT_COUNT
	int "Number of raw packets to transmit and receive"
	default 1
	help
	  This option sets the number of packets to be transmitted and received in loopback mode.

config RAW_TX_TRANSMIT_COUNT
	int "Number of raw packets to burst transmit"
	default 3
	help
	  This option sets the number of packets to be transmitted in burst mode.

config RAW_RX_THROUGHPUT_COUNT
	int "Number of times throughput is calculated per second"
	default 1
	help
	  This option sets the count for the number of times throughput is to be calculated.

config RX_THROUGHPUT_INTERVAL
	int "Interval in milliseconds for each throughput calculation"
	default 50
	help
	  This configuration allows the throughput to be calculated for a specified interval.
	  Set the interval to 1000 milliseconds if 1 sec interval throughput readouts are needed.
	  The number of times througphpt is calculated is throughput count * throughput interval.

config RAW_TX_THROUGHPUT_COUNT
	int "Number of times throughput is calculated per throughput interval"
	default 1
	help
	  This option sets the count for the number of times transmit throughput is to be calculated.

config RAW_TX_THROUGHPUT_INTERVAL
	int "Interval in milliseconds for each throughput calculation"
	default 50
	help
	  This configuration allows the throughput to be calculated for a specified interval.
	  Set the interval to 1000 milliseconds if 1 sec interval throughput readouts are needed.
	  The number of times througphpt is calculated is throughput count * throughput interval.

config RAW_RX_BURST_LOGGING
	bool "enable RX burst logging to see if RX packets are being received"
	help
	  This configuraiton allows RX burst logging enable.

config TX_THREAD_TRANSMIT
	bool "enable for thread based transmit"
	help
	  This configuration allows thread based burst transmission.

config RAW_TX_BURST
	bool "enable RAW TX burst"
	help
	  This configuration allows RAW TX burst transmission ZTEST to be enabled.

config RAW_RX_BURST
	bool "enable RAW RX burst ZTEST"
	help
	  This configuration allows RAW RX burst transmission ZTEST to be enabled.

config RAW_TX_RX_LOOPBACK
	bool "enable loopback TX-RX"
	help
	  This configuration allows RAW TX-RX loopback ZTEST to be enabled.

config RX_LOOPBACK_THREAD
	bool "enable thread based loopback code"
	help
	  This configuration allows thread based Loopback test.

config RAW_TX_PKT_SAMPLE_PAYLOAD_SIZE
	int "Payload size for raw TX packet sample"
	default 1000
	range 1 1500
	help
	  Specify the payload size for the raw TX packet sample.
	  The valid range is from 1 to 1500 bytes.
	  Note: The maximum payload size is limited by the Wi-Fi driver and hardware capabilities.

# add pumping rate configuration
config RAW_TX_PKT_SAMPLE_PUMPING_RATE
	int "Pumping rate for raw TX packet sample (in Mbps)"
	default 1
	range 1 300
	help
	  Specify the pumping rate for the raw TX packet sample in Mbps.
	  The valid range is from 1 Mbps to 10,000 Mbps (10 Gbps).
	  Note: This configuration is used to control the rate at which packets are pumped in the test.
```

## tests/drivers/nrf_wifi/raw_tx_rx/testcase.yaml
```yaml
common:
  depends_on: wifi
  tags:
    - ci_build
    - sysbuild
    - drivers
    - ci_tests_drivers_nrf_wifi
tests:
  sample.nrf7120.raw_tx_rx_packet.tlm:
    sysbuild: true
    build_only: true
    integration_platforms:
      - nrf7120dk/nrf7120/cpuapp
    platform_allow: nrf7120dk/nrf7120/cpuapp
    extra_args:
      - EXTRA_DTC_OVERLAY_FILE="ipc.overlay"
      - EXTRA_CONF_FILE="overlay-nrf71-tlm.conf"
```

## tests/drivers/nrfx_integration_test/testcase.yaml
```yaml
tests:
  nrfx_integration_test.build:
    sysbuild: true
    build_only: true
    filter: CONFIG_HAS_NRFX
    tags: drivers ci_build sysbuild
    platform_allow:
      - nrf52840dk/nrf52840
      - nrf9160dk/nrf9160
      - nrf9160dk/nrf9160/ns
      - nrf5340dk/nrf5340/cpuapp
      - nrf5340dk/nrf5340/cpuapp/ns
      - nrf5340dk/nrf5340/cpunet
      - nrf54l15pdk/nrf54l15/cpuapp
      - nrf54h20dk/nrf54h20/cpuapp
      - nrf54h20dk/nrf54h20/cpurad
    integration_platforms:
      - nrf52840dk/nrf52840
      - nrf9160dk/nrf9160
      - nrf9160dk/nrf9160/ns
      - nrf5340dk/nrf5340/cpuapp
      - nrf5340dk/nrf5340/cpuapp/ns
      - nrf5340dk/nrf5340/cpunet
      - nrf54l15pdk/nrf54l15/cpuapp
      - nrf54h20dk/nrf54h20/cpuapp
      - nrf54h20dk/nrf54h20/cpurad
  nrfx_integration_test.build.bt.softdevice:
    sysbuild: true
    build_only: true
    filter: CONFIG_HAS_NRFX and CONFIG_BT_LL_SOFTDEVICE
    tags: drivers ci_build sysbuild
    extra_configs:
      - CONFIG_NRFX_AND_BT_LL_SOFTDEVICE=y
    platform_allow:
      - nrf52840dk/nrf52840
      - nrf5340dk/nrf5340/cpunet
    integration_platforms:
      - nrf52840dk/nrf52840
      - nrf5340dk/nrf5340/cpunet
  nrfx_integration_test.build.bt.sw_split:
    sysbuild: true
    build_only: true
    filter: CONFIG_HAS_NRFX and CONFIG_BT_LL_SW_SPLIT
    tags: drivers ci_build sysbuild
    extra_configs:
      - CONFIG_NRFX_AND_BT_LL_SW_SPLIT=y
    platform_allow:
      - nrf52840dk/nrf52840
      - nrf5340dk/nrf5340/cpunet
    integration_platforms:
      - nrf52840dk/nrf52840
      - nrf5340dk/nrf5340/cpunet
```

## tests/drivers/ppi_seq/ppi_seq_i2c_spi/testcase.yaml
```yaml
common:
  sysbuild: true
  harness: ztest
  harness_config:
    fixture: gpio_spi_loopback
  tags:
    - drivers
    - spi
    - i2c
    - ci_tests_drivers_ppi_seq
tests:
  drivers.ppi_seq_i2c_spi.i2c:
    depends_on: i2c
    integration_platforms:
      - nrf54lm20dk/nrf54lm20a/cpuapp
    platform_allow:
      - nrf54l15dk/nrf54l15/cpuapp
      - nrf54lm20dk/nrf54lm20a/cpuapp
  drivers.ppi_seq_i2c_spi.spi_timer_trigger:
    depends_on: spi
    extra_args:
      - DTC_OVERLAY_FILE="boards/nrf54lm20dk_nrf54lm20a_cpuapp_spi_timer.overlay"
    integration_platforms:
      - nrf54lm20dk/nrf54lm20a/cpuapp
    platform_allow:
      - nrf54lm20dk/nrf54lm20a/cpuapp
  drivers.ppi_seq_i2c_spi.spi_extra_op:
    depends_on: spi
    extra_args:
      - DTC_OVERLAY_FILE="boards/nrf54lm20dk_nrf54lm20a_cpuapp_spi_timer_extra_op.overlay"
    integration_platforms:
      - nrf54lm20dk/nrf54lm20a/cpuapp
    platform_allow:
      - nrf54lm20dk/nrf54lm20a/cpuapp
  drivers.ppi_seq_i2c_spi.spi_timer_notifier:
    depends_on: spi
    extra_args:
      - DTC_OVERLAY_FILE="boards/nrf54lm20dk_nrf54lm20a_cpuapp_spi_timer_notifier.overlay"
    integration_platforms:
      - nrf54lm20dk/nrf54lm20a/cpuapp
    platform_allow:
      - nrf54lm20dk/nrf54lm20a/cpuapp
  drivers.ppi_seq_i2c_spi.i2c_timer_notifier_counter:
    depends_on: i2c
    extra_args:
      - DTC_OVERLAY_FILE="boards/nrf54lm20dk_nrf54lm20a_cpuapp_i2c_timer_notifier_counter.overlay"
    integration_platforms:
      - nrf54lm20dk/nrf54lm20a/cpuapp
    platform_allow:
      - nrf54lm20dk/nrf54lm20a/cpuapp
  drivers.ppi_seq_i2c_spi.spi_rtc:
    depends_on: spi
    extra_args:
      - DTC_OVERLAY_FILE="boards/nrf54h20dk_nrf54h20_cpuapp_spi_rtc.overlay"
    integration_platforms:
      - nrf54h20dk/nrf54h20/cpuapp
    platform_allow:
      - nrf54h20dk/nrf54h20/cpuapp
```

## tests/drivers/ppi_seq/ppi_seq_with_spi/testcase.yaml
```yaml
tests:
  drivers.ppi_seq.ppi_seq_with_spi:
    depends_on: spi
    tags:
      - drivers
      - spi
      - ci_tests_drivers_ppi_seq
    harness: ztest
    harness_config:
      fixture: gpio_spi_loopback
    integration_platforms:
      - nrf54lm20dk/nrf54lm20a/cpuapp
    platform_allow:
      - nrf54h20dk/nrf54h20/cpuapp
      - nrf54lc10dk/nrf54lc10a/cpuapp
      - nrf54lm20dk/nrf54lm20a/cpuapp
      - nrf54lm20dk/nrf54lm20b/cpuapp
      - nrf54ls05dk/nrf54ls05a/cpuapp
      - nrf54ls05dk/nrf54ls05b/cpuapp
      - nrf54lv10dk/nrf54lv10a/cpuapp
      - nrf9251dk/nrf9251/cpuapp
```

## tests/drivers/pwm/gpio_loopback/boards/nrf54h20dk_nrf54h20_cpuflpr.conf
```kconfig
#
# Copyright (c) 2026 Nordic Semiconductor ASA
#
# SPDX-License-Identifier: LicenseRef-Nordic-5-Clause
#

# nRF54H20 FLPR has no GPIO/GPIOTE interrupts wired to this core. Disable
# interrupt-driven GPIO so the driver uses direct pin control (no GPIOTE130 in
# devicetree, no IRQs) — sufficient for polling in this test.
CONFIG_GPIO_NRFX_INTERRUPT=n

# PWM120 (fast domain) cannot use Kconfig default 200 ms; match cpuapp_fast_p7_0 /
# testcase drivers.pwm.gpio_loopback.cpuflpr so manual `west build` and Twister
# both get a valid prescaler.
CONFIG_TEST_PWM_PERIOD_USEC=10000
```

## tests/drivers/pwm/gpio_loopback/testcase.yaml
```yaml
common:
  tags:
    - pwm
    - drivers
    - ci_tests_drivers_pwm
  depends_on: pwm
  filter: dt_compat_enabled("test-pwm-to-gpio-loopback")
  harness: ztest
  harness_config:
    fixture: gpio_loopback

tests:
  drivers.pwm.gpio_loopback:
    platform_allow:
      - nrf54h20dk/nrf54h20/cpuapp
      - nrf54l15dk/nrf54l15/cpuapp
      - nrf54l15pdk/nrf54l15/cpuapp
    integration_platforms:
      - nrf54h20dk/nrf54h20/cpuapp
      - nrf54l15dk/nrf54l15/cpuapp
      - nrf54l15pdk/nrf54l15/cpuapp
```

## tests/drivers/pwm/pwm_events/testcase.yaml
```yaml
common:
  tags:
    - drivers
    - ci_tests_drivers_pwm
  harness: console
  harness_config:
    type: multi_line
    ordered: true
    regex:
      - "TESTING PWM EVENTS_COMPAREMATCH"
      - "PWM EVENTS_COMPAREMATCH TEST: PASS"
      - "TESTING PWM EVENTS_STOPPED"
      - "PWM EVENTS_STOPPED TEST: PASS"
      - "TESTING PWM EVENTS_PWMPERIODEND"
      - "PWM EVENTS_PWMPERIODEND TEST: PASS"
      - "TESTING PWM EVENTS_LOOPSDONE"
      - "PWM EVENTS_LOOPSDONE TEST: PASS"
  timeout: 20

tests:
  drivers.pwm.pwm_events.nrf54h:
    platform_allow:
      - nrf54h20dk/nrf54h20/cpuapp
    integration_platforms:
      - nrf54h20dk/nrf54h20/cpuapp
    extra_args:
      - CONFIG_NRFX_PWM130=y

  drivers.pwm.pwm_events.nrf54l:
    platform_allow:
      - nrf54l15dk/nrf54l15/cpuapp
    integration_platforms:
      - nrf54l15dk/nrf54l15/cpuapp
    extra_args:
      - CONFIG_NRFX_PWM20=y
```

## tests/drivers/pwm/pwm_instances/testcase.yaml
```yaml
common:
  tags:
    - drivers
    - ci_tests_drivers_pwm
  harness: ztest
  timeout: 20

tests:
  drivers.pwm.pwm_instances:
    platform_allow:
      - nrf54h20dk/nrf54h20/cpuapp
      - nrf54l15dk/nrf54l15/cpuapp
      - nrf54lm20dk/nrf54lm20a/cpuapp
      - nrf54ls05dk@0.0.0/nrf54ls05b/cpuapp
      - nrf54ls05dk/nrf54ls05b/cpuapp
      - nrf7120dk/nrf7120/cpuapp
    integration_platforms:
      - nrf54h20dk/nrf54h20/cpuapp
```

## tests/drivers/rpc_flash/testcase.yaml
```yaml
common:
  tags:
    - drivers
    - flash
tests:
  drivers.rpc_flash:
    platform_allow: nrf5340dk_nrf5340_cpuapp
    integration_platforms:
      - nrf5340dk_nrf5340_cpuapp
```

## tests/drivers/sdp_asm/testcase.yaml
```yaml
common:
  tags:
    - sdp_asm
    - ci_tests_drivers_egpio
  platform_allow:
    - nrf54l15dk/nrf54l15/cpuflpr
  integration_platforms:
    - nrf54l15dk/nrf54l15/cpuflpr

tests:
  drivers.sdp_asm.basic:
    harness: pytest
    harness_config:
      pytest_dut_scope: session
      pytest_root:
        - "pytest/test_sdp_asm.py::test_sdp_asm"
```

## tests/drivers/sensor/multicore_temp/Kconfig.sysbuild
```kconfig
#
# Copyright (c) 2024 Nordic Semiconductor ASA
#
# SPDX-License-Identifier: LicenseRef-Nordic-5-Clause
#

config PARTITION_MANAGER
	default n if !BOARD_IS_NON_SECURE

config REMOTE_BOARD
	string "The board used for remote target"

source "share/sysbuild/Kconfig"
```

## tests/drivers/sensor/multicore_temp/testcase.yaml
```yaml
common:
  sysbuild: true
  tags:
    - drivers
    - sensors
    - ci_tests_drivers_sensor
  filter: dt_nodelabel_enabled("temp_sensor")

tests:
  drivers.sensor.multicore_temp.nrf54h20dk_cpuapp_cpurad:
    platform_allow:
      - nrf54h20dk/nrf54h20/cpuapp
    integration_platforms:
      - nrf54h20dk/nrf54h20/cpuapp
    extra_args:
      SB_CONF_FILE=sysbuild/nrf54h20dk_nrf54h20_cpurad.conf

  drivers.sensor.multicore_temp.nrf54h20dk_cpurad_cpuapp:
    platform_allow:
      - nrf54h20dk/nrf54h20/cpurad
    integration_platforms:
      - nrf54h20dk/nrf54h20/cpurad
    extra_args:
      SB_CONF_FILE=sysbuild/nrf54h20dk_nrf54h20_cpuapp.conf
```

## tests/drivers/spi/spi_controller_peripheral/testcase.yaml
```yaml
common:
  # depends_on: spi
  tags:
    - drivers
    - spi
    - ci_tests_drivers_spi
  harness: ztest
  harness_config:
    fixture: gpio_spi_loopback
  platform_allow:
    - nrf54l20pdk/nrf54l20/cpuapp
  integration_platforms:
    - nrf54l20pdk/nrf54l20/cpuapp

tests:
  nrf.extended.drivers.spi.spi_mode0:
    extra_configs:
      - CONFIG_TESTED_SPI_MODE=0
    extra_args: EXTRA_DTC_OVERLAY_FILE="boards/250khz.overlay"

  nrf.extended.drivers.spi.spi_mode1:
    extra_configs:
      - CONFIG_TESTED_SPI_MODE=1
    extra_args: EXTRA_DTC_OVERLAY_FILE="boards/500khz.overlay"

  nrf.extended.drivers.spi.spi_mode2:
    extra_configs:
      - CONFIG_TESTED_SPI_MODE=2
    extra_args: EXTRA_DTC_OVERLAY_FILE="boards/1mhz.overlay"

  nrf.extended.drivers.spi.spi_mode3:
    extra_configs:
      - CONFIG_TESTED_SPI_MODE=3
    extra_args: EXTRA_DTC_OVERLAY_FILE="boards/2mhz.overlay"

  nrf.extended.drivers.spi.spi_4MHz:
    extra_configs:
      - CONFIG_TESTED_SPI_MODE=2
    extra_args: EXTRA_DTC_OVERLAY_FILE="boards/4mhz.overlay"

  nrf.extended.drivers.spi.spi_8MHz:
    extra_configs:
      - CONFIG_TESTED_SPI_MODE=1
    extra_args: EXTRA_DTC_OVERLAY_FILE="boards/8mhz.overlay"

  nrf.extended.drivers.spi.pm_runtime:
    extra_configs:
      - CONFIG_PM_DEVICE=y
      - CONFIG_PM_DEVICE_RUNTIME=y
```

## tests/drivers/spi/spi_error_cases/testcase.yaml
```yaml
common:
  # depends_on: spi
  tags:
    - drivers
    - spi
    - ci_tests_drivers_spi
  harness: ztest
  harness_config:
    fixture: gpio_spi_loopback
tests:
  nrf.extended.drivers.spi.spi_error_cases:
    platform_allow:
      - nrf54l20pdk/nrf54l20/cpuapp
    integration_platforms:
      - nrf54l20pdk/nrf54l20/cpuapp
```

## tests/drivers/spi/spi_latency/boards/nrf54h20dk_nrf54h20_cpuflpr_xip.conf
```kconfig
# Copyright (c) 2026 Nordic Semiconductor ASA
#
# SPDX-License-Identifier: LicenseRef-Nordic-5-Clause

# nRF54H20 FLPR has no GPIO interrupts available
CONFIG_GPIO_NRFX_INTERRUPT=n
CONFIG_NRFX_GPIOTE=y

CONFIG_DK_LIBRARY=n
```
