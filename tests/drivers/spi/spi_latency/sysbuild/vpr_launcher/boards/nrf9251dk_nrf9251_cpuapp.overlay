/*
 * Copyright (c) 2026 Nordic Semiconductor ASA
 *
 * SPDX-License-Identifier: LicenseRef-Nordic-5-Clause
 */

&spi130 {
	status = "reserved";
	interrupt-parent = <&cpuppr_clic>;
};

&timer130 {
	status = "reserved";
	interrupt-parent = <&cpuppr_clic>;
};

&spi120 {
	status = "reserved";
	interrupt-parent = <&cpuflpr_clic>;
};

/delete-node/ &gd25le255e;

&timer120 {
	status = "reserved";
	interrupt-parent = <&cpuflpr_clic>;
};
