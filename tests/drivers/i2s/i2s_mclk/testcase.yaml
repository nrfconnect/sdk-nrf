## tests/drivers/i2s/i2s_samplerate/testcase.yaml
```yaml
common:
  depends_on:
    - i2s
    - gpio
  tags:
    - drivers
    - i2s
    - ci_tests_zephyr_drivers_i2s
  harness: ztest

tests:
  drivers.i2s.samplerate.rc:
    harness_config:
      fixture: gpio_loopback
    platform_allow:
      - nrf5340dk/nrf5340/cpuapp
      - nrf54l15dk/nrf54l15/cpuapp
      - nrf54l15dk/nrf54l15/cpuapp/ns
    integration_platforms:
      - nrf54l15dk/nrf54l15/cpuapp
  # Samplerate has higher accuracy when HFXO is started
  drivers.i2s.samplerate.hfxo:
    harness_config:
      fixture: gpio_loopback
    extra_args:
      - CONFIG_TEST_START_HFXO=y
      - CONFIG_TEST_8000_TOLERANCE=10
      - CONFIG_TEST_16000_TOLERANCE=10
      - CONFIG_TEST_32000_TOLERANCE=10
      - CONFIG_TEST_44100_TOLERANCE=10
      - CONFIG_TEST_48000_TOLERANCE=10
      - CONFIG_TEST_88200_TOLERANCE=15
      - CONFIG_TEST_96000_TOLERANCE=15
    platform_allow:
      - nrf5340dk/nrf5340/cpuapp
      - nrf54l15dk/nrf54l15/cpuapp
      - nrf54l15dk/nrf54l15/cpuapp/ns
    integration_platforms:
      - nrf54l15dk/nrf54l15/cpuapp
  # nrf52840 has divider set with enum instead of formula
  drivers.i2s.samplerate.nrf52840.rc:
    harness_config:
      fixture: gpio_loopback
    extra_args:
      - CONFIG_TEST_8000_DIVIDER=34340864
      - CONFIG_TEST_16000_DIVIDER=68157440
      - CONFIG_TEST_32000_DIVIDER=138412032
      - CONFIG_TEST_44100_DIVIDER=184549376
      - CONFIG_TEST_48000_DIVIDER=201326592
      - CONFIG_TEST_88200_DIVIDER=369098752
      - CONFIG_TEST_96000_DIVIDER=402653184
    platform_allow:
      - nrf52840dk/nrf52840
    integration_platforms:
      - nrf52840dk/nrf52840
  # Samplerate has higher accuracy when HFXO is started
  drivers.i2s.samplerate.nrf52840.hfxo:
    harness_config:
      fixture: gpio_loopback
    extra_args:
      - CONFIG_TEST_START_HFXO=y
      - CONFIG_TEST_8000_TOLERANCE=10
      - CONFIG_TEST_16000_TOLERANCE=10
      - CONFIG_TEST_32000_TOLERANCE=10
      - CONFIG_TEST_44100_TOLERANCE=10
      - CONFIG_TEST_48000_TOLERANCE=10
      - CONFIG_TEST_88200_TOLERANCE=15
      - CONFIG_TEST_96000_TOLERANCE=15
      - CONFIG_TEST_8000_DIVIDER=34340864
      - CONFIG_TEST_16000_DIVIDER=68157440
      - CONFIG_TEST_32000_DIVIDER=138412032
      - CONFIG_TEST_44100_DIVIDER=184549376
      - CONFIG_TEST_48000_DIVIDER=201326592
      - CONFIG_TEST_88200_DIVIDER=369098752
      - CONFIG_TEST_96000_DIVIDER=402653184
    platform_allow:
      - nrf52840dk/nrf52840
    integration_platforms:
      - nrf52840dk/nrf52840
  # nrf54lm20: PCLK32 and internal RC
  drivers.i2s.samplerate.nrf54lm20.pclk32m.rc:
    harness_config:
      fixture: gpio_loopback
    extra_args:
      - CONFIG_TEST_8000_TOLERANCE=80
      - CONFIG_TEST_16000_TOLERANCE=159
      - CONFIG_TEST_32000_TOLERANCE=323
      - CONFIG_TEST_44100_TOLERANCE=435
      - CONFIG_TEST_48000_TOLERANCE=476
      - CONFIG_TEST_88200_TOLERANCE=909
      - CONFIG_TEST_96000_TOLERANCE=1000
    platform_allow:
      - nrf54lm20dk/nrf54lm20a/cpuapp
    integration_platforms:
      - nrf54lm20dk/nrf54lm20a/cpuapp
  # nrf54lm20: PCLK32 and HFXO
  drivers.i2s.samplerate.nrf54lm20.pclk32m.hfxo:
    harness_config:
      fixture: gpio_loopback
    extra_args:
      - CONFIG_TEST_START_HFXO=y
      - CONFIG_TEST_8000_TOLERANCE=10
      - CONFIG_TEST_16000_TOLERANCE=10
      - CONFIG_TEST_32000_TOLERANCE=10
      - CONFIG_TEST_44100_TOLERANCE=10
      - CONFIG_TEST_48000_TOLERANCE=10
      - CONFIG_TEST_88200_TOLERANCE=15
      - CONFIG_TEST_96000_TOLERANCE=15
    platform_allow:
      - nrf54lm20dk/nrf54lm20a/cpuapp
    integration_platforms:
      - nrf54lm20dk/nrf54lm20a/cpuapp
  # nrf54lm20: ACLK and internal RC is not possible. Selecting ACLK automatically starts HFXO.
  # Highter tolerance (than nrf54lm20.aclk.hfxo) results from waiting for HFXO ready.
  drivers.i2s.samplerate.nrf54lm20.aclk.implicit_hfxo:
    harness_config:
      fixture: gpio_loopback
    extra_args:
      - DTC_OVERLAY_FILE="boards/nrf54lm20dk_nrf54lm20a_cpuapp_aclk.overlay"
      - CONFIG_TEST_8000_EXPECTED=7978
      - CONFIG_TEST_16000_EXPECTED=15957
      - CONFIG_TEST_32000_EXPECTED=32608
      - CONFIG_TEST_44100_EXPECTED=44117
      - CONFIG_TEST_48000_EXPECTED=46875
      - CONFIG_TEST_88200_EXPECTED=83333
      - CONFIG_TEST_96000_EXPECTED=93750
      - CONFIG_TEST_8000_TOLERANCE=10
      - CONFIG_TEST_16000_TOLERANCE=10
      - CONFIG_TEST_32000_TOLERANCE=10
      - CONFIG_TEST_44100_TOLERANCE=15
      - CONFIG_TEST_48000_TOLERANCE=20
      - CONFIG_TEST_88200_TOLERANCE=30
      - CONFIG_TEST_96000_TOLERANCE=40
      - CONFIG_TEST_8000_DIVIDER=45568000
      - CONFIG_TEST_16000_DIVIDER=90656768
      - CONFIG_TEST_32000_DIVIDER=179421184
      - CONFIG_TEST_44100_DIVIDER=245329920
      - CONFIG_TEST_48000_DIVIDER=266350592
      - CONFIG_TEST_88200_DIVIDER=477036544
      - CONFIG_TEST_96000_DIVIDER=516685824
    platform_allow:
      - nrf54lm20dk/nrf54lm20a/cpuapp
    integration_platforms:
      - nrf54lm20dk/nrf54lm20a/cpuapp
  # nrf54lm20: ACLK and HFXO
  drivers.i2s.samplerate.nrf54lm20.aclk.hfxo:
    harness_config:
      fixture: gpio_loopback
    extra_args:
      - DTC_OVERLAY_FILE="boards/nrf54lm20dk_nrf54lm20a_cpuapp_aclk.overlay"
      - CONFIG_TEST_START_HFXO=y
      - CONFIG_TEST_8000_EXPECTED=7978
      - CONFIG_TEST_16000_EXPECTED=15957
      - CONFIG_TEST_32000_EXPECTED=32608
      - CONFIG_TEST_44100_EXPECTED=44117
      - CONFIG_TEST_48000_EXPECTED=46875
      - CONFIG_TEST_88200_EXPECTED=83333
      - CONFIG_TEST_96000_EXPECTED=93750
      - CONFIG_TEST_8000_TOLERANCE=10
      - CONFIG_TEST_16000_TOLERANCE=10
      - CONFIG_TEST_32000_TOLERANCE=10
      - CONFIG_TEST_44100_TOLERANCE=10
      - CONFIG_TEST_48000_TOLERANCE=10
      - CONFIG_TEST_88200_TOLERANCE=15
      - CONFIG_TEST_96000_TOLERANCE=15
      - CONFIG_TEST_8000_DIVIDER=45568000
      - CONFIG_TEST_16000_DIVIDER=90656768
      - CONFIG_TEST_32000_DIVIDER=179421184
      - CONFIG_TEST_44100_DIVIDER=245329920
      - CONFIG_TEST_48000_DIVIDER=266350592
      - CONFIG_TEST_88200_DIVIDER=477036544
      - CONFIG_TEST_96000_DIVIDER=516685824
    platform_allow:
      - nrf54lm20dk/nrf54lm20a/cpuapp
    integration_platforms:
      - nrf54lm20dk/nrf54lm20a/cpuapp
  # ACLK allows to obtain more accurate actual samplerate
  # ACLK instead of PCLK results in different divider and expected
  # Selecting ACLK automatically starts HFXO.
  # Highter tolerance (than nrf5340.aclk.hfxo) results from waiting for HFXO ready.
  drivers.i2s.samplerate.nrf5340.aclk.implicit_hfxo:
    harness_config:
      fixture: gpio_loopback
    extra_args:
      - EXTRA_DTC_OVERLAY_FILE="boards/nrf5340dk_nrf5340_cpuapp_aclk.overlay"
      - CONFIG_TEST_8000_EXPECTED=8018
      - CONFIG_TEST_16000_EXPECTED=16036
      - CONFIG_TEST_32000_EXPECTED=32072
      - CONFIG_TEST_44100_EXPECTED=44100
      - CONFIG_TEST_48000_EXPECTED=50400
      - CONFIG_TEST_88200_EXPECTED=88200
      - CONFIG_TEST_96000_EXPECTED=88200
      - CONFIG_TEST_8000_TOLERANCE=10
      - CONFIG_TEST_16000_TOLERANCE=15
      - CONFIG_TEST_32000_TOLERANCE=20
      - CONFIG_TEST_44100_TOLERANCE=25
      - CONFIG_TEST_48000_TOLERANCE=30
      - CONFIG_TEST_88200_TOLERANCE=50
      - CONFIG_TEST_96000_TOLERANCE=60
      - CONFIG_TEST_8000_DIVIDER=96296960
      - CONFIG_TEST_16000_DIVIDER=190464000
      - CONFIG_TEST_32000_DIVIDER=372662272
      - CONFIG_TEST_44100_DIVIDER=505286656
      - CONFIG_TEST_48000_DIVIDER=547127296
      - CONFIG_TEST_88200_DIVIDER=954433536
      - CONFIG_TEST_96000_DIVIDER=1028730880
    platform_allow:
      - nrf5340dk/nrf5340/cpuapp
    integration_platforms:
      - nrf5340dk/nrf5340/cpuapp
  # HFXO started manually at the beginning of main
  drivers.i2s.samplerate.nrf5340.aclk.hfxo:
    harness_config:
      fixture: gpio_loopback
    extra_args:
      - EXTRA_DTC_OVERLAY_FILE="boards/nrf5340dk_nrf5340_cpuapp_aclk.overlay"
      - CONFIG_TEST_START_HFXO=y
      - CONFIG_TEST_8000_EXPECTED=8018
      - CONFIG_TEST_16000_EXPECTED=16036
      - CONFIG_TEST_32000_EXPECTED=32072
      - CONFIG_TEST_44100_EXPECTED=44100
      - CONFIG_TEST_48000_EXPECTED=50400
      - CONFIG_TEST_88200_EXPECTED=88200
      - CONFIG_TEST_96000_EXPECTED=88200
      - CONFIG_TEST_8000_TOLERANCE=10
      - CONFIG_TEST_16000_TOLERANCE=10
      - CONFIG_TEST_32000_TOLERANCE=10
      - CONFIG_TEST_44100_TOLERANCE=10
      - CONFIG_TEST_48000_TOLERANCE=10
      - CONFIG_TEST_88200_TOLERANCE=15
      - CONFIG_TEST_96000_TOLERANCE=15
      - CONFIG_TEST_8000_DIVIDER=96296960
      - CONFIG_TEST_16000_DIVIDER=190464000
      - CONFIG_TEST_32000_DIVIDER=372662272
      - CONFIG_TEST_44100_DIVIDER=505286656
      - CONFIG_TEST_48000_DIVIDER=547127296
      - CONFIG_TEST_88200_DIVIDER=954433536
      - CONFIG_TEST_96000_DIVIDER=1028730880
    platform_allow:
      - nrf5340dk/nrf5340/cpuapp
    integration_platforms:
      - nrf5340dk/nrf5340/cpuapp
  # PCLK is 16M instead of 32M -> different divider and expected values
  drivers.i2s.samplerate.nrf54h.pclk16.rc:
    harness_config:
      fixture: i2s_loopback
    extra_args:
      - CONFIG_TEST_8000_EXPECTED=7936
      - CONFIG_TEST_16000_EXPECTED=16129
      - CONFIG_TEST_32000_EXPECTED=31250
      - CONFIG_TEST_44100_EXPECTED=45454
      - CONFIG_TEST_48000_EXPECTED=50000
      - CONFIG_TEST_88200_EXPECTED=83333
      - CONFIG_TEST_96000_EXPECTED=100000
      - CONFIG_TEST_8000_TOLERANCE=29
      - CONFIG_TEST_16000_TOLERANCE=56
      - CONFIG_TEST_32000_TOLERANCE=102
      - CONFIG_TEST_44100_TOLERANCE=135
      - CONFIG_TEST_48000_TOLERANCE=149
      - CONFIG_TEST_88200_TOLERANCE=240
      - CONFIG_TEST_96000_TOLERANCE=263
      - CONFIG_TEST_8000_DIVIDER=68173824
      - CONFIG_TEST_16000_DIVIDER=135274496
      - CONFIG_TEST_32000_DIVIDER=266350592
      - CONFIG_TEST_44100_DIVIDER=362815488
      - CONFIG_TEST_48000_DIVIDER=393428992
      - CONFIG_TEST_88200_DIVIDER=696221696
      - CONFIG_TEST_96000_DIVIDER=752402432
    platform_allow:
      - nrf54h20dk/nrf54h20/cpuapp
    integration_platforms:
      - nrf54h20dk/nrf54h20/cpuapp
  # ACLK allows to obtain more accurate actual samplerate
  # ACLK instead of PCLK results in different divider and expected
  drivers.i2s.samplerate.nrf54h.aclk.implicit_hfxo:
    harness_config:
      fixture: i2s_loopback
    extra_args:
      - EXTRA_DTC_OVERLAY_FILE="boards/nrf54h20dk_nrf54h20_sck_audiopll.overlay"
      - CONFIG_TEST_8000_EXPECTED=8018
      - CONFIG_TEST_16000_EXPECTED=16036
      - CONFIG_TEST_32000_EXPECTED=32072
      - CONFIG_TEST_44100_EXPECTED=44100
      - CONFIG_TEST_48000_EXPECTED=50400
      - CONFIG_TEST_88200_EXPECTED=88200
      - CONFIG_TEST_96000_EXPECTED=88200
      - CONFIG_TEST_8000_TOLERANCE=11
      - CONFIG_TEST_16000_TOLERANCE=23
      - CONFIG_TEST_32000_TOLERANCE=37
      - CONFIG_TEST_44100_TOLERANCE=49
      - CONFIG_TEST_48000_TOLERANCE=54
      - CONFIG_TEST_88200_TOLERANCE=87
      - CONFIG_TEST_96000_TOLERANCE=87
      - CONFIG_TEST_8000_DIVIDER=96296960
      - CONFIG_TEST_16000_DIVIDER=190464000
      - CONFIG_TEST_32000_DIVIDER=372662272
      - CONFIG_TEST_44100_DIVIDER=505286656
      - CONFIG_TEST_48000_DIVIDER=547127296
      - CONFIG_TEST_88200_DIVIDER=954433536
      - CONFIG_TEST_96000_DIVIDER=1028730880
    platform_allow:
      - nrf54h20dk/nrf54h20/cpuapp
    integration_platforms:
      - nrf54h20dk/nrf54h20/cpuapp
```

## tests/drivers/i2s/tdm_init_latency/Kconfig
```kconfig
#
# Copyright (c) 2025 Nordic Semiconductor ASA
#
# SPDX-License-Identifier: LicenseRef-Nordic-5-Clause
#

config I2S_TEST_ALLOWED_DATA_OFFSET
	int "Allowed offset in received data"
	default 2 if DT_HAS_NORDIC_NRF_I2S_ENABLED || DT_HAS_NORDIC_NRF_TDM_ENABLED
	default 0
	help
	  Maximum allowed offset between sent and received samples. Non-zero
	  value of this option may be needed when GPIO loopback is used.

config TEST_WITH_NRFX_DRIVER
	bool "Test with nrfx driver instead of Zehyr driver"

source "Kconfig.zephyr"
```

## tests/drivers/i2s/tdm_init_latency/testcase.yaml
```yaml
common:
  tags:
    - drivers
    - ci_tests_zephyr_drivers_i2s
  harness: pytest
  harness_config:
    pytest_dut_scope: session

tests:
  drivers.i2s.tdm_init_latency.zephyr_driver:
    platform_allow: &default_platform_allow
      - nrf54lm20dk/nrf54lm20a/cpuapp
      - nrf54h20dk/nrf54h20/cpuapp
    integration_platforms: &default_integration_platform
      - nrf54lm20dk/nrf54lm20a/cpuapp
    extra_configs:
      - CONFIG_I2S=y

  drivers.i2s.tdm_init_latency.zephyr_driver.lfrc:
    platform_allow: &lfrc_platform_allow
      - nrf54lm20dk/nrf54lm20a/cpuapp
    integration_platforms: &lfrc_integration_platform
      - nrf54lm20dk/nrf54lm20a/cpuapp
    extra_configs:
      - CONFIG_I2S=y
      - CONFIG_CLOCK_CONTROL_NRF_K32SRC_RC=y

  drivers.i2s.tdm_init_latency.nrfx_driver:
    platform_allow: *default_platform_allow
    integration_platforms: *default_integration_platform
    extra_configs:
      - CONFIG_NRFX_I2S=y
      - CONFIG_TEST_WITH_NRFX_DRIVER=y

  drivers.i2s.tdm_init_latency.nrfx_driver.lfrc:
    platform_allow: *lfrc_platform_allow
    integration_platforms: *lfrc_integration_platform
    extra_configs:
      - CONFIG_NRFX_I2S=y
      - CONFIG_TEST_WITH_NRFX_DRIVER=y
      - CONFIG_CLOCK_CONTROL_NRF_K32SRC_RC=y
```

## tests/drivers/lpuart/Kconfig
```kconfig
#
# Copyright (c) 2022 Nordic Semiconductor
#
# SPDX-License-Identifier: LicenseRef-Nordic-5-Clause
#

config TEST_LPUART_TIMEOUT
	int "Test timeout (seconds)"
	default 1

config TEST_LPUART_LOOPBACK
	bool "Loopback"

source "Kconfig.zephyr"
```

## tests/drivers/lpuart/boards/nrf5340dk_nrf5340_cpuapp.conf
```kconfig
#
# Copyright (c) 2026 Nordic Semiconductor
#
# SPDX-License-Identifier: LicenseRef-Nordic-5-Clause
#
CONFIG_UART_1_ASYNC=y
CONFIG_UART_1_INTERRUPT_DRIVEN=n
# Do not use interrupt driven API for console UART to not enable RX.
CONFIG_UART_0_INTERRUPT_DRIVEN=n
```

## tests/drivers/lpuart/boards/nrf54lm20dk_nrf54lm20a_cpuapp.conf
```kconfig
#
# Copyright (c) 2024 Nordic Semiconductor
#
# SPDX-License-Identifier: LicenseRef-Nordic-5-Clause
#
CONFIG_UART_21_ASYNC=y
CONFIG_UART_21_INTERRUPT_DRIVEN=n
# Do not use interrupt driven API for console UART to not enable RX.
CONFIG_UART_20_INTERRUPT_DRIVEN=n
```

## tests/drivers/lpuart/boards/nrf9251dk_nrf9251_cpuapp.conf
```kconfig
#
# Copyright (c) 2026 Nordic Semiconductor
#
# SPDX-License-Identifier: LicenseRef-Nordic-5-Clause
#

CONFIG_UART_130_ASYNC=y
CONFIG_UART_130_INTERRUPT_DRIVEN=n
# Do not use interrupt driven API for console UART to not enable RX.
CONFIG_UART_133_INTERRUPT_DRIVEN=n
```
