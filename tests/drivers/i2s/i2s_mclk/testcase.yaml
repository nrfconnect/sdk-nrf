## tests/drivers/i2s/i2s_mclk/testcase.yaml
```yaml
common:
  tags:
    - drivers
    - i2s
    - ci_tests_zephyr_drivers_i2s
  depends_on:
    - i2s
    - gpio
  filter: CONFIG_I2S_TEST_USE_GPIO_LOOPBACK
  harness: ztest

tests:
  drivers.i2s.i2s_mclk.gpio_loopback.2ch:
    harness_config:
      fixture: gpio_loopback
    platform_allow:
      - nrf52840dk/nrf52840
      - nrf54l15dk/nrf54l15/cpuapp
      - nrf54lm20dk/nrf54lm20a/cpuapp
      - nrf7120pdk/nrf7120/cpuapp
    integration_platforms:
      - nrf54lm20dk/nrf54lm20a/cpuapp

  drivers.i2s.i2s_mclk.gpio_loopback.2ch.54h:
    harness_config:
      fixture: i2s_loopback
    platform_allow:
      - nrf54h20dk/nrf54h20/cpuapp
    integration_platforms:
      - nrf54h20dk/nrf54h20/cpuapp

  drivers.i2s.i2s_mclk.gpio_loopback.4ch:
    harness_config:
      fixture: gpio_loopback
    extra_args:
      - CONFIG_I2S_TEST_NUMBER_OF_CHANNELS=4
    platform_allow:
      - nrf54lm20dk/nrf54lm20a/cpuapp
      - nrf7120pdk/nrf7120/cpuapp
    integration_platforms:
      - nrf54lm20dk/nrf54lm20a/cpuapp

  drivers.i2s.i2s_mclk.gpio_loopback.4ch.54h:
    harness_config:
      fixture: i2s_loopback
    extra_args:
      - CONFIG_I2S_TEST_NUMBER_OF_CHANNELS=4
    platform_allow:
      - nrf54h20dk/nrf54h20/cpuapp
    integration_platforms:
      - nrf54h20dk/nrf54h20/cpuapp

  drivers.i2s.i2s_mclk.gpio_loopback.8ch:
    harness_config:
      fixture: gpio_loopback
    extra_args:
      - CONFIG_I2S_TEST_NUMBER_OF_CHANNELS=8
    platform_allow:
      - nrf54lm20dk/nrf54lm20a/cpuapp
      - nrf7120pdk/nrf7120/cpuapp
    integration_platforms:
      - nrf54lm20dk/nrf54lm20a/cpuapp

  drivers.i2s.i2s_mclk.gpio_loopback.8ch.54h:
    harness_config:
      fixture: i2s_loopback
    extra_args:
      - CONFIG_I2S_TEST_NUMBER_OF_CHANNELS=8
    platform_allow:
      - nrf54h20dk/nrf54h20/cpuapp
    integration_platforms:
      - nrf54h20dk/nrf54h20/cpuapp

  drivers.i2s.i2s_mclk.gpio_loopback.2ch.aclk_sck:
    harness_config:
      fixture: gpio_loopback
    platform_allow:
      - nrf7120pdk/nrf7120/cpuapp
    integration_platforms:
      - nrf7120pdk/nrf7120/cpuapp
    extra_args:
      - EXTRA_DTC_OVERLAY_FILE="boards/tdm_sck_audio_auxpll.overlay"

  drivers.i2s.i2s_mclk.gpio_loopback.2ch.aclk_sck.54h:
    harness_config:
      fixture: i2s_loopback
    platform_allow:
      - nrf54h20dk/nrf54h20/cpuapp
    integration_platforms:
      - nrf54h20dk/nrf54h20/cpuapp
    extra_args:
      - EXTRA_DTC_OVERLAY_FILE="boards/tdm_sck_audiopll.overlay"

  drivers.i2s.i2s_mclk.gpio_loopback.2ch.aclk_mck.54h:
    harness_config:
      fixture: i2s_loopback
    extra_args:
      - EXTRA_DTC_OVERLAY_FILE="boards/tdm_mck_audiopll.overlay"
    platform_allow:
      - nrf54h20dk/nrf54h20/cpuapp
    integration_platforms:
      - nrf54h20dk/nrf54h20/cpuapp

  drivers.i2s.i2s_mclk.gpio_loopback.2ch.aclk_mck_sck:
    harness_config:
      fixture: gpio_loopback
    platform_allow:
      - nrf7120pdk/nrf7120/cpuapp
    integration_platforms:
      - nrf7120pdk/nrf7120/cpuapp
    extra_args:
      - EXTRA_DTC_OVERLAY_FILE="boards/tdm_mck_audio_auxpll.overlay
        boards/tdm_sck_audio_auxpll.overlay"

  drivers.i2s.i2s_mclk.gpio_loopback.2ch.aclk_mck_sck.54h:
    harness_config:
      fixture: i2s_loopback
    platform_allow:
      - nrf54h20dk/nrf54h20/cpuapp
    integration_platforms:
      - nrf54h20dk/nrf54h20/cpuapp
    extra_args:
      - EXTRA_DTC_OVERLAY_FILE="boards/tdm_mck_audiopll.overlay boards/tdm_sck_audiopll.overlay"
```

## tests/drivers/i2s/i2s_pan/Kconfig
```kconfig
#
# Copyright (c) 2026 Nordic Semiconductor ASA
#
# SPDX-License-Identifier: LicenseRef-Nordic-5-Clause
#

config TEST_I2S_ALLOWED_DATA_OFFSET
	int "Allowed offset in received data"
	default 2 if DT_HAS_NORDIC_NRF_I2S_ENABLED || DT_HAS_NORDIC_NRF_TDM_ENABLED
	default 0
	help
	  Maximum allowed offset between sent and received samples. Non-zero
	  value of this option may be needed when GPIO loopback is used.

config TEST_WORDS_COUNT
	int "I2S buffer size in bytes"
	default 12
	help
	  Selected value may result in skipping some tests that require
	  specific size of the data buffer.

source "Kconfig.zephyr"
```

## tests/drivers/i2s/i2s_pan/testcase.yaml
```yaml
common:
  tags:
    - drivers
    - ci_tests_zephyr_drivers_i2s
  harness: ztest

tests:
  drivers.i2s.tdm_pan.hmpan_046:
    extra_args:
      - CONFIG_TEST_WORDS_COUNT=11
    platform_allow:
      - nrf54lm20dk/nrf54lm20a/cpuapp
      - nrf54lm20dk/nrf54lm20b/cpuapp
    integration_platforms:
      - nrf54lm20dk/nrf54lm20a/cpuapp
    harness_config:
      fixture: gpio_loopback

  drivers.i2s.tdm_pan.hmpan_046.h20:
    extra_args:
      - CONFIG_TEST_WORDS_COUNT=11
    platform_allow:
      - nrf54h20dk/nrf54h20/cpuapp
    integration_platforms:
      - nrf54h20dk/nrf54h20/cpuapp
    harness_config:
      fixture: i2s_loopback

  drivers.i2s.tdm_pan.hmpan_146:
    platform_allow:
      - nrf54lm20dk/nrf54lm20a/cpuapp
      - nrf54lm20dk/nrf54lm20b/cpuapp
    integration_platforms:
      - nrf54lm20dk/nrf54lm20a/cpuapp
    harness_config:
      fixture: gpio_loopback

  drivers.i2s.tdm_pan.hmpan_146.h20:
    platform_allow:
      - nrf54h20dk/nrf54h20/cpuapp
    integration_platforms:
      - nrf54h20dk/nrf54h20/cpuapp
    harness_config:
      fixture: i2s_loopback
```

## tests/drivers/i2s/i2s_samplerate/Kconfig
```kconfig
#
# Copyright (c) 2025 Nordic Semiconductor ASA
#
# SPDX-License-Identifier: LicenseRef-Nordic-5-Clause
#

mainmenu "I2S Samplerate Test"

config I2S_TEST_8000_SKIP
	bool "Skip testing at 8000 samples per second"
	help
	  When set to 'y', testing at 8000 samples per second will be skipped.

config I2S_TEST_8000_DIVIDER
	int "Expected clock divider value"
	default 34222080
	help
	  I2S driver calculates clock divider value that sets requested samplerate.
	  Test compares if value calculated by the driver matches with this Kconfig.

config I2S_TEST_8000_EXPECTED
	int "Expected samplerate for 8000 Sps"
	default 8000
	help
	  Due to available clock dividers final samplerate may differ from
	  the configured value.

config I2S_TEST_8000_TOLERANCE
	int "Maximal +/- deviation from expected result at 8000 Sps"
	default 37
	help
	  Test is not ideal. Use this Kconfig to set tolerance.

config I2S_TEST_16000_SKIP
	bool "Skip testing at 16000 samples per second"
	help
	  When set to 'y', testing at 16000 samples per second will be skipped.

config I2S_TEST_16000_DIVIDER
	int "Expected clock divider value"
	default 68173824
	help
	  I2S driver calculates clock divider value that sets requested samplerate.
	  Test compares if value calculated by the driver matches with this Kconfig.

config I2S_TEST_16000_EXPECTED
	int "Expected samplerate for 16000 Sps"
	default 15873
	help
	  Due to available clock dividers final samplerate may differ from
	  the configured value.

config I2S_TEST_16000_TOLERANCE
	int "Maximal +/- deviation from expected result at 16000 Sps"
	default 17
	help
	  Test is not ideal. Use this Kconfig to set tolerance.

config I2S_TEST_32000_SKIP
	bool "Skip testing at 32000 samples per second"
	help
	  When set to 'y', testing at 32000 samples per second will be skipped.

config I2S_TEST_32000_DIVIDER
	int "Expected clock divider value"
	default 135274496
	help
	  I2S driver calculates clock divider value that sets requested samplerate.
	  Test compares if value calculated by the driver matches with this Kconfig.

config I2S_TEST_32000_EXPECTED
	int "Expected samplerate for 32000 Sps"
	default 32258
	help
	  Due to available clock dividers final samplerate may differ from
	  the configured value.

config I2S_TEST_32000_TOLERANCE
	int "Maximal +/- deviation from expected result at 32000 Sps"
	default 25
	help
	  Test is not ideal. Use this Kconfig to set tolerance.

config I2S_TEST_44100_SKIP
	bool "Skip testing at 44100 samples per second"
	help
	  When set to 'y', testing at 44100 samples per second will be skipped.

config I2S_TEST_44100_DIVIDER
	int "Expected clock divider value"
	default 185319424
	help
	  I2S driver calculates clock divider value that sets requested samplerate.
	  Test compares if value calculated by the driver matches with this Kconfig.

config I2S_TEST_44100_EXPECTED
	int "Expected samplerate for 44100 Sps"
	default 43478
	help
	  Due to available clock dividers final samplerate may differ from
	  the configured value.

config I2S_TEST_44100_TOLERANCE
	int "Maximal +/- deviation from expected result at 44100 Sps"
	default 31
	help
	  Test is not ideal. Use this Kconfig to set tolerance.

config I2S_TEST_48000_SKIP
	bool "Skip testing at 48000 samples per second"
	help
	  When set to 'y', testing at 48000 samples per second will be skipped.

config I2S_TEST_48000_DIVIDER
	int "Expected clock divider value"
	default 201326592
	help
	  I2S driver calculates clock divider value that sets requested samplerate.
	  Test compares if value calculated by the driver matches with this Kconfig.

config I2S_TEST_48000_EXPECTED
	int "Expected samplerate for 48000 Sps"
	default 47619
	help
	  Due to available clock dividers final samplerate may differ from
	  the configured value.

config I2S_TEST_48000_TOLERANCE
	int "Maximal +/- deviation from expected result at 48000 Sps"
	default 33
	help
	  Test is not ideal. Use this Kconfig to set tolerance.

config I2S_TEST_88200_SKIP
	bool "Skip testing at 88200 samples per second"
	help
	  When set to 'y', testing at 88200 samples per second will be skipped.

config I2S_TEST_88200_DIVIDER
	int "Expected clock divider value"
	default 362815488
	help
	  I2S driver calculates clock divider value that sets requested samplerate.
	  Test compares if value calculated by the driver matches with this Kconfig.

config I2S_TEST_88200_EXPECTED
	int "Expected samplerate for 88200 Sps"
	default 90909
	help
	  Due to available clock dividers final samplerate may differ from
	  the configured value.

config I2S_TEST_88200_TOLERANCE
	int "Maximal +/- deviation from expected result at 88200 Sps"
	default 55
	help
	  Test is not ideal. Use this Kconfig to set tolerance.

config I2S_TEST_96000_SKIP
	bool "Skip testing at 96000 samples per second"
	help
	  When set to 'y', testing at 96000 samples per second will be skipped.

config I2S_TEST_96000_DIVIDER
	int "Expected clock divider value"
	default 393428992
	help
	  I2S driver calculates clock divider value that sets requested samplerate.
	  Test compares if value calculated by the driver matches with this Kconfig.

config I2S_TEST_96000_EXPECTED
	int "Expected samplerate for 96000 Sps"
	default 100000
	help
	  Due to available clock dividers final samplerate may differ from
	  the configured value.

config I2S_TEST_96000_TOLERANCE
	int "Maximal +/- deviation from expected result at 96000 Sps"
	default 60
	help
	  Test is not ideal. Use this Kconfig to set tolerance.

source "Kconfig.zephyr"
```
