## tests/drivers/lpuart/testcase.yaml
```yaml
common:
  tags:
    - lpuart
    - sysbuild
    - ci_tests_drivers_lpuart
  timeout: 30

tests:
  lpuart.loopback_busy_sim:
    sysbuild: true
    platform_allow: nrf9160dk/nrf9160
    integration_platforms:
      - nrf9160dk/nrf9160
    extra_args: DTC_OVERLAY_FILE="boards/nrf9160dk_nrf9160_loopback.overlay"
    extra_configs:
      - CONFIG_TEST_LPUART_LOOPBACK=y
      - CONFIG_TEST_BUSY_SIM=y
    harness: ztest
    harness_config:
      fixture: gpio_loopback
  lpuart.loopback.nrf54l:
    sysbuild: true
    platform_allow:
      - nrf54l15dk/nrf54l05/cpuapp
      - nrf54l15dk/nrf54l10/cpuapp
      - nrf54l15dk/nrf54l15/cpuapp
      - nrf54lm20dk/nrf54lm20a/cpuapp
      - nrf54ls05dk/nrf54ls05b/cpuapp
      - nrf54ls05dk@0.0.0/nrf54ls05b/cpuapp
      - nrf54ls05dk@0.2.0/nrf54ls05b/cpuapp
      - nrf54lv10dk/nrf54lv10a/cpuapp
      - nrf54lv10dk/nrf54lv10a/cpuapp/ns
      - nrf54lv10dk@0.2.0/nrf54lv10a/cpuapp
      - nrf7120dk/nrf7120/cpuapp
    integration_platforms:
      - nrf54l15dk/nrf54l15/cpuapp
    extra_configs:
      - CONFIG_TEST_LPUART_LOOPBACK=y
    harness: ztest
    harness_config:
      fixture: gpio_loopback
  lpuart.loopback.int_driven:
    sysbuild: true
    platform_allow:
      - nrf54l15dk/nrf54l05/cpuapp
      - nrf54l15dk/nrf54l10/cpuapp
      - nrf54l15dk/nrf54l15/cpuapp
      - nrf54lm20dk/nrf54lm20a/cpuapp
      - nrf54ls05dk/nrf54ls05b/cpuapp
      - nrf54ls05dk@0.0.0/nrf54ls05b/cpuapp
      - nrf54ls05dk@0.2.0/nrf54ls05b/cpuapp
      - nrf54lv10dk/nrf54lv10a/cpuapp
      - nrf54lv10dk/nrf54lv10a/cpuapp/ns
      - nrf54lv10dk@0.2.0/nrf54lv10a/cpuapp
      - nrf7120dk/nrf7120/cpuapp
    integration_platforms:
      - nrf54l15dk/nrf54l15/cpuapp
    extra_configs:
      - CONFIG_TEST_LPUART_LOOPBACK=y
      - CONFIG_NRF_SW_LPUART_INT_DRIVEN=y
    harness: ztest
    harness_config:
      fixture: gpio_loopback
  lpuart.loopback.nrf54l.busy_sim:
    sysbuild: true
    platform_allow:
      - nrf54l15dk/nrf54l05/cpuapp
      - nrf54l15dk/nrf54l10/cpuapp
      - nrf54l15dk/nrf54l15/cpuapp
      - nrf54lm20dk/nrf54lm20a/cpuapp
      - nrf54ls05dk/nrf54ls05b/cpuapp
      - nrf54ls05dk@0.0.0/nrf54ls05b/cpuapp
      - nrf54ls05dk@0.2.0/nrf54ls05b/cpuapp
      - nrf54lv10dk/nrf54lv10a/cpuapp
      - nrf54lv10dk/nrf54lv10a/cpuapp/ns
      - nrf54lv10dk@0.2.0/nrf54lv10a/cpuapp
      - nrf7120dk/nrf7120/cpuapp
    integration_platforms:
      - nrf54l15dk/nrf54l15/cpuapp
    extra_configs:
      - CONFIG_TEST_LPUART_LOOPBACK=y
      - CONFIG_TEST_BUSY_SIM=y
    harness: ztest
    harness_config:
      fixture: gpio_loopback
  lpuart.loopback_busy_sim_no_hfxo:
    sysbuild: true
    platform_allow: nrf9160dk/nrf9160
    integration_platforms:
      - nrf9160dk/nrf9160
    extra_args: DTC_OVERLAY_FILE="boards/nrf9160dk_nrf9160_loopback.overlay"
    extra_configs:
      - CONFIG_NRF_SW_LPUART_HFXO_ON_RX=n
      - CONFIG_TEST_LPUART_LOOPBACK=y
      - CONFIG_TEST_BUSY_SIM=y
    harness: ztest
    harness_config:
      fixture: gpio_loopback
  lpuart.loopback:
    sysbuild: true
    platform_allow: nrf9160dk/nrf9160
    integration_platforms:
      - nrf9160dk/nrf9160
    extra_configs:
      - CONFIG_TEST_LPUART_LOOPBACK=y
    extra_args: DTC_OVERLAY_FILE="boards/nrf9160dk_nrf9160_loopback.overlay"
    harness: ztest
    harness_config:
      fixture: gpio_loopback
  lpuart.loopback_no_hfxo:
    sysbuild: true
    platform_allow: nrf9160dk/nrf9160
    integration_platforms:
      - nrf9160dk/nrf9160
    extra_args: DTC_OVERLAY_FILE="boards/nrf9160dk_nrf9160_loopback.overlay"
    extra_configs:
      - CONFIG_NRF_SW_LPUART_HFXO_ON_RX=n
      - CONFIG_TEST_LPUART_LOOPBACK=y
    harness: ztest
    harness_config:
      fixture: gpio_loopback
  lpuart.two_chip_test:
    sysbuild: true
    platform_allow:
      - nrf9160dk/nrf9160
      - nrf9160dk/nrf52840
    integration_platforms:
      - nrf9160dk/nrf9160
      - nrf9160dk/nrf52840
    build_only: true
    extra_configs:
      - CONFIG_TEST_LPUART_TIMEOUT=10
  lpuart.two_chip_test_busy_sim:
    sysbuild: true
    platform_allow:
      - nrf9160dk/nrf9160
      - nrf9160dk/nrf52840
    integration_platforms:
      - nrf9160dk/nrf9160
      - nrf9160dk/nrf52840
    build_only: true
    extra_configs:
      - CONFIG_TEST_LPUART_TIMEOUT=10
      - CONFIG_TEST_BUSY_SIM=y
  lpuart.two_chip_test_debug:
    sysbuild: true
    platform_allow:
      - nrf9160dk/nrf9160
      - nrf9160dk/nrf52840
    integration_platforms:
      - nrf9160dk/nrf9160
      - nrf9160dk/nrf52840
    build_only: true
    extra_args: OVERLAY_CONFIG=dbg.conf
    extra_configs:
      - CONFIG_TEST_LPUART_TIMEOUT=10
  lpuart.user_specific_config:
    sysbuild: true
    platform_allow:
      - nrf54l15dk/nrf54l05/cpuapp
      - nrf54l15dk/nrf54l10/cpuapp
      - nrf54l15dk/nrf54l15/cpuapp
      - nrf54lm20dk/nrf54lm20a/cpuapp
      - nrf54ls05dk/nrf54ls05b/cpuapp
      - nrf54ls05dk@0.0.0/nrf54ls05b/cpuapp
      - nrf54ls05dk@0.2.0/nrf54ls05b/cpuapp
      - nrf54lv10dk/nrf54lv10a/cpuapp
      - nrf54lv10dk/nrf54lv10a/cpuapp/ns
      - nrf54lv10dk@0.2.0/nrf54lv10a/cpuapp
      - nrf7120dk/nrf7120/cpuapp
    integration_platforms:
      - nrf54l15dk/nrf54l15/cpuapp
    extra_configs:
      - CONFIG_UART_INTERRUPT_DRIVEN=y
      - CONFIG_NRF_SW_LPUART_INT_DRIVEN=n
      - CONFIG_TEST_LPUART_LOOPBACK=y
    harness: ztest
    harness_config:
      fixture: gpio_loopback
```

## tests/drivers/mbox/vevif_back_to_back/Kconfig
```kconfig
#
# Copyright (c) 2026 Nordic Semiconductor ASA
#
# SPDX-License-Identifier: LicenseRef-Nordic-5-Clause
#

menu "VEVIF Back-To-Back Reproducer"

choice REPRO_MODE
	prompt "Back-to-back scenario"
	default REPRO_MODE_TASK_BURST

config REPRO_MODE_TASK_BURST
	bool "Host sends two back-to-back notifications"

config REPRO_MODE_REVERSE_BURST
	bool "Remote sends two back-to-back notifications after host kick"

endchoice

config REPRO_ITERATIONS
	int "Number of iterations"
	range 1 100000
	default 200

config REPRO_START_DELAY_MS
	int "Producer startup delay in milliseconds"
	range 0 60000
	default 2000

config REPRO_ITERATION_GAP_MS
	int "Delay between back-to-back pairs in milliseconds"
	range 0 1000
	default 1

config REPRO_OVERALL_TIMEOUT_MS
	int "Consumer timeout in milliseconds"
	range 1 60000
	default 10000

endmenu

source "Kconfig.zephyr"
```

## tests/drivers/mbox/vevif_back_to_back/Kconfig.sysbuild
```kconfig
#
# Copyright (c) 2026 Nordic Semiconductor ASA
#
# SPDX-License-Identifier: LicenseRef-Nordic-5-Clause
#

source "share/sysbuild/Kconfig"

config REMOTE_BOARD
	string "Remote board"
	default "nrf54lm20dk/nrf54lm20a/cpuflpr" if "$(BOARD_TARGET_STRING)" = "NRF54LM20DK_NRF54LM20A_CPUAPP"
	default "nrf54lm20dk/nrf54lm20b/cpuflpr" if "$(BOARD_TARGET_STRING)" = "NRF54LM20DK_NRF54LM20B_CPUAPP"
	default "nrf54h20dk/nrf54h20/cpuflpr" if "$(BOARD_TARGET_STRING)" = "NRF54H20DK_NRF54H20_CPUAPP"
```

## tests/drivers/mbox/vevif_back_to_back/testcase.yaml
```yaml
common:
  sysbuild: true
  tags:
    - mbox
    - vevif
    - multicore
  timeout: 120

tests:
  drivers.mbox.vevif_back_to_back.nrf54lm20b.task:
    platform_allow:
      - nrf54lm20dk/nrf54lm20b/cpuapp
    integration_platforms:
      - nrf54lm20dk/nrf54lm20b/cpuapp
    build_only: true
    extra_args:
      - SB_CONF_FILE=sysbuild/nrf54lm20dk_nrf54lm20b_cpuflpr.conf

  drivers.mbox.vevif_back_to_back.nrf54lm20b.reverse:
    platform_allow:
      - nrf54lm20dk/nrf54lm20b/cpuapp
    integration_platforms:
      - nrf54lm20dk/nrf54lm20b/cpuapp
    extra_args:
      - SB_CONF_FILE=sysbuild/nrf54lm20dk_nrf54lm20b_cpuflpr.conf
      - CONFIG_REPRO_MODE_REVERSE_BURST=y
      - remote_CONFIG_REPRO_MODE_REVERSE_BURST=y
    harness: console
    harness_config:
      type: multi_line
      ordered: true
      regex:
        - "RESULT PASS mode=reverse-burst .*"

  drivers.mbox.vevif_back_to_back.nrf54lm20b.task.reliable:
    platform_allow:
      - nrf54lm20dk/nrf54lm20b/cpuapp
    integration_platforms:
      - nrf54lm20dk/nrf54lm20b/cpuapp
    build_only: true
    extra_args:
      - SB_CONF_FILE=sysbuild/nrf54lm20dk_nrf54lm20b_cpuflpr.conf
      - EXTRA_DTC_OVERLAY_FILE=boards/nrf54lm20dk_nrf54lm20b_cpuapp_reliable.overlay
      - remote_EXTRA_DTC_OVERLAY_FILE=boards/nrf54lm20dk_nrf54lm20b_cpuflpr_reliable.overlay

  drivers.mbox.vevif_back_to_back.nrf54lm20b.reverse.reliable:
    platform_allow:
      - nrf54lm20dk/nrf54lm20b/cpuapp
    integration_platforms:
      - nrf54lm20dk/nrf54lm20b/cpuapp
    extra_args:
      - SB_CONF_FILE=sysbuild/nrf54lm20dk_nrf54lm20b_cpuflpr.conf
      - CONFIG_REPRO_MODE_REVERSE_BURST=y
      - remote_CONFIG_REPRO_MODE_REVERSE_BURST=y
      - EXTRA_DTC_OVERLAY_FILE=boards/nrf54lm20dk_nrf54lm20b_cpuapp_reliable.overlay
      - remote_EXTRA_DTC_OVERLAY_FILE=boards/nrf54lm20dk_nrf54lm20b_cpuflpr_reliable.overlay
    harness: console
    harness_config:
      type: multi_line
      ordered: true
      regex:
        - "RESULT PASS mode=reverse-burst .*"

  drivers.mbox.vevif_back_to_back.nrf54h20.task:
    platform_allow:
      - nrf54h20dk/nrf54h20/cpuapp
    integration_platforms:
      - nrf54h20dk/nrf54h20/cpuapp
    build_only: true
    extra_args:
      - SB_CONF_FILE=sysbuild/nrf54h20dk_nrf54h20_cpuflpr.conf

  drivers.mbox.vevif_back_to_back.nrf54h20.reverse:
    platform_allow:
      - nrf54h20dk/nrf54h20/cpuapp
    integration_platforms:
      - nrf54h20dk/nrf54h20/cpuapp
    extra_args:
      - SB_CONF_FILE=sysbuild/nrf54h20dk_nrf54h20_cpuflpr.conf
      - CONFIG_REPRO_MODE_REVERSE_BURST=y
      - remote_CONFIG_REPRO_MODE_REVERSE_BURST=y
    harness: console
    harness_config:
      type: multi_line
      ordered: true
      regex:
        - "RESULT PASS mode=reverse-burst .*"
```

## tests/drivers/mspi/app_fault_timer/Kconfig
```kconfig
#
# Copyright (c) 2025 Nordic Semiconductor ASA
#
# SPDX-License-Identifier: LicenseRef-Nordic-5-Clause
#

config FLASH
	default y if DT_HAS_JEDEC_MSPI_NOR_ENABLED

config FLASH_PAGE_LAYOUT
	default y if DT_HAS_JEDEC_MSPI_NOR_ENABLED

source "Kconfig.zephyr"
```

## tests/drivers/mspi/app_fault_timer/testcase.yaml
```yaml
common:
  tags:
    - ci_tests_drivers_hpf
    - drivers
    - mspi
  harness: ztest

tests:
  drivers.mspi.hpf_app_fault_timer:
    harness_config:
      fixture: external_flash
    platform_allow:
      - nrf54l15dk/nrf54l15/cpuapp
      - nrf54lm20dk/nrf54lm20a/cpuapp
      - nrf54lm20dk/nrf54lm20b/cpuapp
    integration_platforms:
      - nrf54l15dk/nrf54l15/cpuapp
  drivers.mspi.hpf_app_fault_timer.emul_mspi_dev:
    platform_allow:
      - nrf54lv10dk/nrf54lv10a/cpuapp
    integration_platforms:
      - nrf54lv10dk/nrf54lv10a/cpuapp
    extra_args:
      - EXTRA_DTC_OVERLAY_FILE="boards/emul_device.overlay"
```

## tests/drivers/mspi/error_cases/testcase.yaml
```yaml
common:
  tags:
    - ci_tests_drivers_hpf
    - drivers
    - mspi
    - api

tests:
  drivers.mspi.error_cases.hpf:
    harness: ztest
    platform_allow:
      - nrf54l15dk/nrf54l15/cpuapp
      - nrf54lm20dk/nrf54lm20a/cpuapp
      - nrf54lm20dk/nrf54lm20b/cpuapp
      - nrf54lv10dk/nrf54lv10a/cpuapp
    integration_platforms:
      - nrf54l15dk/nrf54l15/cpuapp
```

## tests/drivers/mspi/mspi_tx_rx_loopback/testcase.yaml
```yaml
common:
  tags:
    - drivers
    - mspi
    - ci_tests_drivers_mspi
  harness: ztest
  harness_config:
    fixture: mspi_tx_rx_loopback

tests:
  drivers.mspi.mspi_tx_rx_loopback:
    platform_allow:
      - nrf7120pdk/nrf7120/cpuapp
    extra_configs:
      - CONFIG_MSPI_DMA=y
```

## tests/drivers/mspi/mspi_with_spis/Kconfig
```kconfig
#
# Copyright (c) 2026 Nordic Semiconductor ASA
#
# SPDX-License-Identifier: LicenseRef-Nordic-5-Clause
#

config TEST_MSPI_DATA_LINES_MAX
	int "Maximum number of MSPI data lines used in the test"
	default 4

source "Kconfig.zephyr"
```

## tests/drivers/mspi/mspi_with_spis/testcase.yaml
```yaml
common:
  tags:
    - drivers
    - mspi
    - ci_tests_drivers_sqspi
  harness: ztest
  harness_config:
    fixture: mspi_spis_loopback

tests:
  drivers.mspi.mspi_with_spis.nrf54h20.sqspi:
    platform_allow:
      - nrf54h20dk/nrf54h20/cpuapp
    integration_platforms:
      - nrf54h20dk/nrf54h20/cpuapp
    extra_args:
      - DTC_OVERLAY_FILE="boards/nrf54h20dk_nrf54h20_cpuapp_sqspi.overlay"
  drivers.mspi.mspi_with_spis.nrf54lv10.hpf:
    platform_allow:
      - nrf54lv10dk/nrf54lv10a/cpuapp
    integration_platforms:
      - nrf54lv10dk/nrf54lv10a/cpuapp
    extra_args:
      - EXTRA_DTC_OVERLAY_FILE="boards/hpf_mspi.overlay"
      - SB_CONFIG_VPR_LAUNCHER=n
      - SB_CONFIG_PARTITION_MANAGER=n
      - SB_CONFIG_HPF=y
      - SB_CONFIG_HPF_MSPI=y
```

## tests/drivers/mspi/trap_handler/testcase.yaml
```yaml
common:
  tags:
    - ci_tests_drivers_hpf
    - drivers
    - mspi
  sysbuild: true
  harness: console
  harness_config:
    type: one_line
    regex:
      - ">>> HPF APP FATAL ERROR"

tests:
  drivers.mspi.hpf_trap_handler.l15:
    harness_config:
      fixture: external_flash
      type: one_line
      regex:
        - ">>> HPF APP FATAL ERROR"
    platform_allow:
      - nrf54l15dk/nrf54l15/cpuapp
    integration_platforms:
      - nrf54l15dk/nrf54l15/cpuapp
    extra_args:
      - EXTRA_DTC_OVERLAY_FILE="./boards/nrf54l15dk_nrf54l15_cpuapp_memory.overlay"
      - hpf_mspi_CONFIG_ASSERT=y
      - hpf_mspi_CONFIG_ASSERT_TEST=y
      - hpf_mspi_EXTRA_DTC_OVERLAY_FILE="${ZEPHYR_NRF_MODULE_DIR}/tests/drivers/mspi/trap_handler/boards/nrf54l15dk_nrf54l15_cpuflpr_memory.overlay"
  drivers.mspi.hpf_trap_handler.lm20:
    platform_allow:
      - nrf54lm20dk/nrf54lm20a/cpuapp
      - nrf54lm20dk/nrf54lm20b/cpuapp
    integration_platforms:
      - nrf54lm20dk/nrf54lm20b/cpuapp
    extra_args:
      - EXTRA_DTC_OVERLAY_FILE="./boards/nrf54lm20dk_nrf54lm20_cpuapp_memory.overlay"
      - hpf_mspi_CONFIG_ASSERT=y
      - hpf_mspi_CONFIG_ASSERT_TEST=y
      - hpf_mspi_EXTRA_DTC_OVERLAY_FILE="${ZEPHYR_NRF_MODULE_DIR}/tests/drivers/mspi/trap_handler/boards/nrf54lm20dk_nrf54lm20_cpuflpr_memory.overlay"
  drivers.mspi.hpf_trap_handler.lv10:
    platform_allow:
      - nrf54lv10dk/nrf54lv10a/cpuapp
    integration_platforms:
      - nrf54lv10dk/nrf54lv10a/cpuapp
    extra_args:
      - EXTRA_DTC_OVERLAY_FILE="./boards/nrf54lv10dk_nrf54lv10a_cpuapp_memory.overlay;./boards/emul_device.overlay"
      - hpf_mspi_CONFIG_ASSERT=y
      - hpf_mspi_CONFIG_ASSERT_TEST=y
      - hpf_mspi_EXTRA_DTC_OVERLAY_FILE="${ZEPHYR_NRF_MODULE_DIR}/tests/drivers/mspi/trap_handler/boards/nrf54lv10dk_nrf54lv10a_cpuflpr_memory.overlay"
```
