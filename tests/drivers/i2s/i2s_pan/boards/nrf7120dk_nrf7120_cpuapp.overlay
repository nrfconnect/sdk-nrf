/* Test requires GPIO loopback:
 * P1.13 - P1.15
 */

&pinctrl {
	tdm_default_test: tdm_default_test {
		group1 {
			psels = <NRF_PSEL(TDM_SCK_M, 1, 4)>,
				<NRF_PSEL(TDM_FSYNC_M, 1, 7)>,
				<NRF_PSEL(TDM_SDOUT, 1, 13)>,
				<NRF_PSEL(TDM_SDIN, 1, 15)>;
		};
	};
};

i2s_dut: &tdm {
	status = "okay";
	pinctrl-0 = <&tdm_default_test>;
	pinctrl-names = "default";
};
