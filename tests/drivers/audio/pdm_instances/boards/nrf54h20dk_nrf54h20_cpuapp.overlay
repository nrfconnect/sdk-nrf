/*
 * Copyright (c) 2025 Nordic Semiconductor ASA
 *
 * SPDX-License-Identifier: LicenseRef-Nordic-5-Clause
 */

/* Test requires loopback between P1.02 and P1.04.
 * For best performance, PDM_CLK shall be on 'Clock pin'.
 */

&pinctrl {
	pdm0_default_test: pdm0_default_test {
		group1 {
			psels = <NRF_PSEL(PDM_CLK, 1, 2)>,
				<NRF_PSEL(PDM_DIN, 1, 4)>;
		};
	};
};

&pdm0 {
	status = "okay";
	pinctrl-0 = <&pdm0_default_test>;
	pinctrl-names = "default";
	clock-source = "PCLK32M";
	memory-regions = <&cpuapp_dma_region>;
};
