## Kconfig
```
#
# Copyright (c) 2020 Nordic Semiconductor ASA
#
# SPDX-License-Identifier: LicenseRef-Nordic-5-Clause
#

# This hidden option is intended to enable (include into compilation) all nrfx
# drivers that are available for the SoC that is the build target.
config NRFX_ALL_DRIVERS
	def_bool y
	depends on HAS_NRFX
	select NRFX_ADC if HAS_HW_NRF_ADC
	select NRFX_CLOCK if HAS_HW_NRF_CLOCK && !CLOCK_CONTROL_MPSL
	select NRFX_COMP if HAS_HW_NRF_COMP
	select NRFX_EGU if HAS_HW_NRF_EGU0 || HAS_HW_NRF_EGU1 || HAS_HW_NRF_EGU2 \
				|| HAS_HW_NRF_EGU3 || HAS_HW_NRF_EGU4 || HAS_HW_NRF_EGU5
	select NRFX_GPIOTE
	select NRFX_GPPI
	select NRFX_IPC if HAS_HW_NRF_IPC
	select NRFX_LPCOMP if HAS_HW_NRF_LPCOMP
	select NRFX_NFCT if HAS_HW_NRF_NFCT
	select NRFX_NVMC if $(dt_has_compat,$(DT_COMPAT_NORDIC_NRF51_FLASH_CONTROLLER)) \
				|| $(dt_has_compat,$(DT_COMPAT_NORDIC_NRF52_FLASH_CONTROLLER)) \
				|| $(dt_has_compat,$(DT_COMPAT_NORDIC_NRF53_FLASH_CONTROLLER)) \
				|| $(dt_has_compat,$(DT_COMPAT_NORDIC_NRF91_FLASH_CONTROLLER))
	select NRFX_POWER if HAS_HW_NRF_POWER
	select NRFX_QSPI if HAS_HW_NRF_QSPI
	select NRFX_RNG if HAS_HW_NRF_RNG
	select NRFX_RTC if $(dt_has_compat,$(DT_COMPAT_NORDIC_NRF_RTC))
	select NRFX_SAADC if HAS_HW_NRF_SAADC
	select NRFX_SPI0 if HAS_HW_NRF_SPI0
	select NRFX_SPI1 if HAS_HW_NRF_SPI1
	select NRFX_SPI2 if HAS_HW_NRF_SPI2
	select NRFX_SYSTICK if CPU_CORTEX_M_HAS_SYSTICK
	select NRFX_TEMP if HAS_HW_NRF_TEMP
	select NRFX_TIMER if HAS_HW_NRF_TIMER0  || HAS_HW_NRF_TIMER1  || HAS_HW_NRF_TIMER2 \
				|| HAS_HW_NRF_TIMER3  || HAS_HW_NRF_TIMER4  || HAS_HW_NRF_TIMER00 \
				|| HAS_HW_NRF_TIMER10 || HAS_HW_NRF_TIMER20 || HAS_HW_NRF_TIMER21 \
				|| HAS_HW_NRF_TIMER22 || HAS_HW_NRF_TIMER23 || HAS_HW_NRF_TIMER24
	select NRFX_TWI0 if HAS_HW_NRF_TWI0
	select NRFX_TWI1 if HAS_HW_NRF_TWI1
	select NRFX_TWIM if HAS_HW_NRF_TWIM0 || HAS_HW_NRF_TWIM20 || HAS_HW_NRF_TWIM130
	select NRFX_TWIS if HAS_HW_NRF_TWIS0 || HAS_HW_NRF_TWIS20 || HAS_HW_NRF_TWIS130
	select NRFX_UART if HAS_HW_NRF_UART0
	select NRFX_USBD if HAS_HW_NRF_USBD
	select NRFX_USBREG if HAS_HW_NRF_USBREG
	select NRFX_PRS_BOX_0

source "Kconfig.zephyr"
```

## prj.conf
```kconfig
#
# Copyright (c) 2020-2023 Nordic Semiconductor ASA
#
# SPDX-License-Identifier: LicenseRef-Nordic-5-Clause
#

CONFIG_ZTEST=y
CONFIG_ASSERT=y
# Prevent compilation of Zephyr I2C and SPI driver shims (enabling of the nrfx
# Kconfig options would cause them to be compiled, even though the corresponding
# DT nodes might be not enabled, and as a result certain static functions in
# those shims might turn out to be defined but not used).
CONFIG_I2C=n
CONFIG_SPI=n
```

## bt_ll_sw_split.overlay
```dts
/ {
	chosen {
		zephyr,bt-hci = &bt_hci_controller;
	};
};

&bt_hci_controller {
	status = "okay";
};

&bt_hci_sdc {
	status = "disabled";
};
```

## src/main.c
```c
/*
 * Copyright (c) 2020 Nordic Semiconductor ASA
 *
 * SPDX-License-Identifier: LicenseRef-Nordic-5-Clause
 */

#include <zephyr/ztest.h>
#include <nrfx.h>

/*
 * The code below is not intended to do anything meaningful. Its only purpose
 * is to use the definitions provided in nrfx_glue.h, to ensure that they are
 * correct and thus nrfx is properly integrated into the environment of Zephyr.
 */

NRFX_STATIC_ASSERT(true);

ZTEST(test_nrfx_integration, test_build)
{
	IRQn_Type dummy_irq_number = (IRQn_Type)0;
	nrfx_atomic_t dummy_atomic_object;
	volatile uint32_t used_resources;
	volatile uint32_t test_val;

	NRFX_ASSERT(true);

	NRFX_IRQ_PRIORITY_SET(dummy_irq_number, 0);
	NRFX_IRQ_ENABLE(dummy_irq_number);
	if (NRFX_IRQ_IS_ENABLED(dummy_irq_number)) {
		NRFX_IRQ_DISABLE(dummy_irq_number);
	}
	NRFX_IRQ_PENDING_SET(dummy_irq_number);
	if (NRFX_IRQ_IS_PENDING(dummy_irq_number)) {
		NRFX_IRQ_PENDING_CLEAR(dummy_irq_number);
	}

	NRFX_CRITICAL_SECTION_ENTER();
	NRFX_CRITICAL_SECTION_EXIT();

	NRFX_DELAY_US(0);

	NRFX_ATOMIC_FETCH_STORE(&dummy_atomic_object, 0);
	NRFX_ATOMIC_FETCH_OR(&dummy_atomic_object, 0);
	NRFX_ATOMIC_FETCH_AND(&dummy_atomic_object, 0);
	NRFX_ATOMIC_FETCH_XOR(&dummy_atomic_object, 0);
	NRFX_ATOMIC_FETCH_ADD(&dummy_atomic_object, 0);
	NRFX_ATOMIC_FETCH_SUB(&dummy_atomic_object, 0);
	NRFX_ATOMIC_CAS(&dummy_atomic_object, 0, 1);

	test_val = NRFX_CLZ(1);
	test_val = NRFX_CTZ(1);

	used_resources = NRFX_DPPI_CHANNELS_USED | NRFX_DPPI_GROUPS_USED |
			 NRFX_PPI_CHANNELS_USED | NRFX_PPI_GROUPS_USED |
			 NRFX_EGUS_USED | NRFX_TIMERS_USED;
}

ZTEST_SUITE(test_nrfx_integration, NULL, NULL, NULL, NULL, NULL);
```
