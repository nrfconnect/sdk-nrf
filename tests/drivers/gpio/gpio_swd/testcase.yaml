## tests/drivers/i2s/i2s_latency/testcase.yaml
```yaml
common:
  tags:
    - drivers
    - ci_tests_zephyr_drivers_i2s

tests:
  drivers.i2s.i2s_latency.sample_width_8bit:
    platform_allow:
      - nrf52840dk/nrf52840
      - nrf5340dk/nrf5340/cpuapp
      - nrf54l15dk/nrf54l15/cpuapp
      - nrf7120dk/nrf7120/cpuapp
    integration_platforms:
      - nrf54l15dk/nrf54l15/cpuapp
    harness: ztest
    harness_config:
      fixture: gpio_loopback
    extra_configs:
      - CONFIG_I2S_SAMPLE_WIDTH_OPTION_8=y
  drivers.i2s.i2s_latency.sample_width_16bit:
    platform_allow:
      - nrf52840dk/nrf52840
      - nrf5340dk/nrf5340/cpuapp
      - nrf54l15dk/nrf54l15/cpuapp
      - nrf7120dk/nrf7120/cpuapp
    integration_platforms:
      - nrf54l15dk/nrf54l15/cpuapp
    harness: ztest
    harness_config:
      fixture: gpio_loopback
    extra_configs:
      - CONFIG_I2S_SAMPLE_WIDTH_OPTION_16=y
  drivers.i2s.i2s_latency.sample_width_32bit:
    platform_allow:
      - nrf5340dk/nrf5340/cpuapp
      - nrf54l15dk/nrf54l15/cpuapp
      - nrf7120dk/nrf7120/cpuapp
    integration_platforms:
      - nrf54l15dk/nrf54l15/cpuapp
    harness: ztest
    harness_config:
      fixture: gpio_loopback
    extra_configs:
      - CONFIG_I2S_SAMPLE_WIDTH_OPTION_32=y
  drivers.i2s.i2s_latency.sample_width_8bit.nrf54h:
    platform_allow:
      - nrf54h20dk/nrf54h20/cpuapp
    integration_platforms:
      - nrf54h20dk/nrf54h20/cpuapp
    harness: ztest
    harness_config:
      fixture: i2s_loopback
    extra_configs:
      - CONFIG_I2S_SAMPLE_WIDTH_OPTION_8=y
  drivers.i2s.i2s_latency.sample_width_16bit.nrf54h:
    platform_allow:
      - nrf54h20dk/nrf54h20/cpuapp
    integration_platforms:
      - nrf54h20dk/nrf54h20/cpuapp
    harness: ztest
    harness_config:
      fixture: i2s_loopback
    extra_configs:
      - CONFIG_I2S_SAMPLE_WIDTH_OPTION_16=y
  drivers.i2s.i2s_latency.sample_width_32bit.nrf54h:
    platform_allow:
      - nrf54h20dk/nrf54h20/cpuapp
    integration_platforms:
      - nrf54h20dk/nrf54h20/cpuapp
    harness: ztest
    harness_config:
      fixture: i2s_loopback
    extra_configs:
      - CONFIG_I2S_SAMPLE_WIDTH_OPTION_32=y
```

## tests/drivers/i2s/i2s_mclk/Kconfig
```kconfig
#
# Copyright (c) 2025 Nordic Semiconductor ASA
#
# SPDX-License-Identifier: LicenseRef-Nordic-5-Clause
#

mainmenu "I2S MCLK Test"

config I2S_TEST_USE_GPIO_LOOPBACK
	bool "Use GPIO loopback"
	default y if DT_HAS_NORDIC_NRF_I2S_ENABLED || DT_HAS_NORDIC_NRF_TDM_ENABLED
	help
	  Use wiring between the data-out and data-in pins for looping back
	  data. This option is intended to be used for devices that do not
	  provide the internal loopback functionality.

config I2S_TEST_ALLOWED_DATA_OFFSET
	int "Allowed offset in received data"
	default 2 if DT_HAS_NORDIC_NRF_I2S_ENABLED || DT_HAS_NORDIC_NRF_TDM_ENABLED
	default 0
	help
	  Maximum allowed offset between sent and received samples. Non-zero
	  value of this option may be needed when GPIO loopback is used.

config I2S_TEST_NUMBER_OF_CHANNELS
	int "Number of audio channels"
	default 2
	help
	  Select number of audio channels. This value affects number of edges
	  observed on TDM_FSYNC_M signal.

config I2S_TEST_SKIP_I2S_DIR_RX
	bool "Skip testing when I2S direction is I2S_DIR_RX"
	help
	  When set to 'y', tests on I2S configured with I2S_DIR_RX
	  will be skipped.

config I2S_TEST_SKIP_I2S_DIR_TX
	bool "Skip testing when I2S direction is I2S_DIR_TX"
	help
	  When set to 'y', tests on I2S configured with I2S_DIR_TX
	  will be skipped.

source "Kconfig.zephyr"
```
