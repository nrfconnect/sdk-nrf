## tests/drivers/gpio/gpio_swd/testcase.yaml
```yaml
common:
  tags:
    - drivers
    - gpio
    - ci_tests_drivers_gpio
  depends_on: gpio
  harness: pytest
  harness_config:
    pytest_root:
      - "pytest/test_swd.py"
    fixture: gpio_loopback

tests:
  drivers.gpio.gpio_swd:
    platform_allow:
      - nrf54l15dk/nrf54l15/cpuapp
      - nrf54ls05dk/nrf54ls05b/cpuapp
      - nrf54ls05dk@0.0.0/nrf54ls05b/cpuapp
    integration_platforms:
      - nrf54ls05dk/nrf54ls05b/cpuapp
```

## tests/drivers/gpio/gpio_times/testcase.yaml
```yaml
common:
  tags:
    - drivers
    - gpio
    - ci_tests_drivers_gpio
  depends_on: gpio
  filter: not CONFIG_COVERAGE
  harness: ztest

tests:
  drivers.gpio.gpio_times:
    platform_allow:
      - nrf54h20dk/nrf54h20/cpuapp
    integration_platforms:
      - nrf54h20dk/nrf54h20/cpuapp
```

## tests/drivers/gpio/hpf_gpio_basic_api/dts/bindings/test-hpf-gpio.yaml
```yaml
#
# Copyright (c) 2024 Nordic Semiconductor ASA
#
# SPDX-License-Identifier: LicenseRef-Nordic-5-Clause
#

description: |
    This binding provides resources required to build and run the
    tests/drivers/gpio/hpf_gpio_basic_api test in Zephyr.

compatible: "test-hpf-gpio"

properties:
  out-gpios:
    type: phandle-array
    required: true
    description: |
      Identity of an HPF GPIO that will be configured as an output.
      This must be on the GPIO instance to which FLPR has access,
      and physically connected to in-gpios.

  in-gpios:
    type: phandle-array
    required: true
    description: |
      Identity of a hardware GPIO that will be configured as an input.
      This must be physically connected to out-gpios.
```

## tests/drivers/gpio/hpf_gpio_basic_api/testcase.yaml
```yaml
common:
  tags:
    - drivers
    - gpio
    - ci_tests_drivers_hpf
  depends_on: gpio
  harness: ztest
  harness_config:
    fixture: gpio_loopback
  platform_allow:
    - nrf54h20dk/nrf54h20/cpuflpr/xip
    - nrf54l15dk/nrf54l15/cpuapp
    - nrf54lm20dk/nrf54lm20a/cpuapp
    - nrf54lv10dk/nrf54lv10a/cpuapp
  integration_platforms:
    - nrf54l15dk/nrf54l15/cpuapp
  sysbuild: true


tests:
  drivers.hpf.gpio.loopback.icmsg:
    min_flash: 64
    timeout: 30
    extra_args: SB_CONFIG_HPF_GPIO_BACKEND_ICMSG=y

  drivers.hpf.gpio.loopback.icbmsg:
    min_flash: 64
    timeout: 80
    extra_args: SB_CONFIG_HPF_GPIO_BACKEND_ICBMSG=y

  drivers.hpf.gpio.loopback.mbox:
    min_flash: 64
    timeout: 30
    extra_args: SB_CONFIG_HPF_GPIO_BACKEND_MBOX=y
```

## tests/drivers/grtc/grtc_clk_output/Kconfig
```kconfig
#
# Copyright (c) 2025 Nordic Semiconductor ASA
#
# SPDX-License-Identifier: LicenseRef-Nordic-5-Clause
#


config TEST_GRTC_FREQUENCY
	int "Expected frequency (Hz) at GRTC output pin"
	default 32768
	help
	  GRTC can output clock signal on dedicated pin.
	  This can be 32768 Hz signal or fast clock which is
	  16 MHz divided by (1..255 * 2).

config TEST_GRTC_TOLERANCE
	int "Amount of additional/missing clock edges"
	default 100
	help
	  Define tolerance for expected number of clock edges
	  counted during 1 second interval.

source "Kconfig.zephyr"
```

## tests/drivers/grtc/grtc_clk_output/testcase.yaml
```yaml
common:
  tags:
    - drivers
    - grtc
    - ci_tests_drivers_grtc
  depends_on:
    - gpio
  harness: ztest

tests:
  drivers.grtc.grtc_clk_out.slow:
    harness_config:
      fixture: grtc_loopback
    platform_allow:
      - nrf54h20dk/nrf54h20/cpuapp
      - nrf54l15dk/nrf54l15/cpuapp
      - nrf54lm20dk/nrf54lm20a/cpuapp
      - nrf54ls05dk/nrf54ls05b/cpuapp
      - nrf54ls05dk@0.0.0/nrf54ls05b/cpuapp
      - nrf54lv10dk/nrf54lv10a/cpuapp
    integration_platforms:
      - nrf54l15dk/nrf54l15/cpuapp

  drivers.grtc.grtc_clk_out.fast:
    harness_config:
      fixture: grtc_loopback
    platform_allow:
      - nrf54h20dk/nrf54h20/cpuapp
      - nrf54l15dk/nrf54l15/cpuapp
      - nrf54lm20dk/nrf54lm20a/cpuapp
      - nrf54ls05dk/nrf54ls05b/cpuapp
      - nrf54ls05dk@0.0.0/nrf54ls05b/cpuapp
      - nrf54lv10dk/nrf54lv10a/cpuapp
    integration_platforms:
      - nrf54l15dk/nrf54l15/cpuapp
    extra_args:
      - FILE_SUFFIX=fast
```

## tests/drivers/grtc/grtc_reset/testcase.yaml
```yaml
common:
  tags:
    - drivers
    - grtc
    - ci_tests_drivers_grtc
  harness: pytest
  timeout: 30

tests:
  drivers.grtc.test_grtc_after_reset_system:
    platform_allow:
      - nrf54l15dk/nrf54l05/cpuapp
      - nrf54l15dk/nrf54l10/cpuapp
      - nrf54l15dk/nrf54l15/cpuapp
      - nrf54lm20dk/nrf54lm20a/cpuapp
      - nrf54lm20dk/nrf54lm20b/cpuapp
      - nrf54ls05dk/nrf54ls05a/cpuapp
      - nrf54ls05dk/nrf54ls05b/cpuapp
      - nrf54lv10dk/nrf54lv10a/cpuapp
    integration_platforms:
      - nrf54l15dk/nrf54l15/cpuapp
    harness_config:
      pytest_root:
        - "pytest/tests.py::test_grtc_after_reset_system"

  drivers.grtc.test_grtc_after_reset_pin:
    platform_allow:
      - nrf54h20dk/nrf54h20/cpuapp
      - nrf54l15dk/nrf54l05/cpuapp
      - nrf54l15dk/nrf54l10/cpuapp
      - nrf54l15dk/nrf54l15/cpuapp
      - nrf54lm20dk/nrf54lm20a/cpuapp
      - nrf54lm20dk/nrf54lm20b/cpuapp
      - nrf54ls05dk/nrf54ls05a/cpuapp
      - nrf54ls05dk/nrf54ls05b/cpuapp
      - nrf54lv10dk/nrf54lv10a/cpuapp
      - nrf9251dk/nrf9251/cpuapp
    integration_platforms:
      - nrf54l15dk/nrf54l15/cpuapp
    harness_config:
      pytest_root:
        - "pytest/tests.py::test_grtc_after_reset_pin"

  drivers.grtc.test_mcuboot_grtc_no_uninit:
    platform_allow:
      - nrf54h20dk/nrf54h20/cpuapp
      - nrf54l15dk/nrf54l05/cpuapp
      - nrf54l15dk/nrf54l10/cpuapp
      - nrf54l15dk/nrf54l15/cpuapp
      - nrf54lm20dk/nrf54lm20a/cpuapp
      - nrf54lm20dk/nrf54lm20b/cpuapp
      - nrf54ls05dk/nrf54ls05a/cpuapp
      - nrf54ls05dk/nrf54ls05b/cpuapp
      - nrf54lv10dk/nrf54lv10a/cpuapp
      - nrf9251dk/nrf9251/cpuapp
    integration_platforms:
      - nrf54l15dk/nrf54l15/cpuapp
    extra_args:
      - SB_CONFIG_BOOTLOADER_MCUBOOT=y
    harness_config:
      pytest_root:
        - "pytest/tests.py::test_mcuboot_grtc_no_uninit"

  drivers.grtc.test_mcuboot_grtc_uninit:
    platform_allow:
      - nrf54h20dk/nrf54h20/cpuapp
      - nrf54l15dk/nrf54l05/cpuapp
      - nrf54l15dk/nrf54l10/cpuapp
      - nrf54l15dk/nrf54l15/cpuapp
      - nrf54lm20dk/nrf54lm20a/cpuapp
      - nrf54lm20dk/nrf54lm20b/cpuapp
      - nrf54ls05dk/nrf54ls05a/cpuapp
      - nrf54ls05dk/nrf54ls05b/cpuapp
      - nrf54lv10dk/nrf54lv10a/cpuapp
      - nrf9251dk/nrf9251/cpuapp
    integration_platforms:
      - nrf54l15dk/nrf54l15/cpuapp
    extra_args:
      - SB_CONFIG_BOOTLOADER_MCUBOOT=y
      - mcuboot_CONFIG_NRF_GRTC_TIMER_STOP_AT_UNINIT=y
      - mcuboot_CONFIG_NRF_GRTC_TIMER_CLEAR_AT_UNINIT=y
    harness_config:
      pytest_root:
        - "pytest/tests.py::test_mcuboot_grtc_uninit"
```

## tests/drivers/i2c/i2c_latency/Kconfig
```kconfig
#
# Copyright (c) 2026 Nordic Semiconductor ASA
#
# SPDX-License-Identifier: LicenseRef-Nordic-5-Clause
#

config TEST_TWI_1MBPS_SUPPORT
	bool "Test with 1Mbps rate - DUT HW dependent"
	default y if SOC_NRF5340
	default y if SOC_NRF54H20
	default y if SOC_NRF9251

source "Kconfig.zephyr"
```

## tests/drivers/i2c/i2c_latency/testcase.yaml
```yaml
common:
  sysbuild: true
  depends_on: gpio
  harness: ztest
  harness_config:
    fixture: gpio_loopback
  tags:
    - drivers
    - i2c
    - ci_tests_zephyr_drivers_i2c
  platform_allow:
    - nrf52840dk/nrf52840
    - nrf5340dk/nrf5340/cpuapp
    - nrf54h20dk/nrf54h20/cpuapp
    - nrf54l15dk/nrf54l15/cpuapp
    - nrf54lc10dk/nrf54lc10a/cpuapp
    - nrf54lm20dk/nrf54lm20a/cpuapp
    - nrf54lm20dk/nrf54lm20b/cpuapp
    - nrf9251dk/nrf9251/cpuapp
  integration_platforms:
    - nrf54h20dk/nrf54h20/cpuapp

tests:
  drivers.i2c.twim_latency: {}
```

## tests/drivers/i2c/twim_instances/testcase.yaml
```yaml
common:
  tags:
    - drivers
    - ci_tests_drivers_i2c
  harness: ztest
  timeout: 150

tests:
  drivers.i2c.twim_instances:
    platform_allow:
      - nrf54h20dk/nrf54h20/cpuapp
      - nrf54h20dk/nrf54h20/cpuppr
      - nrf54l15dk/nrf54l15/cpuapp
      - nrf54lm20dk/nrf54lm20a/cpuapp
      - nrf54ls05dk@0.0.0/nrf54ls05b/cpuapp
      - nrf54ls05dk/nrf54ls05b/cpuapp
      - nrf54lv10dk/nrf54lv10a/cpuapp
      - nrf54lv10dk@0.2.0/nrf54lv10a/cpuapp
    integration_platforms:
      - nrf54h20dk/nrf54h20/cpuapp
```

## tests/drivers/i2s/i2s_buffer/Kconfig
```kconfig
#
# Copyright (c) 2025 Nordic Semiconductor ASA
#
# SPDX-License-Identifier: LicenseRef-Nordic-5-Clause
#

mainmenu "I2S Buffer Test"

config I2S_TEST_ALLOWED_DATA_OFFSET
	int "Allowed offset in received data"
	default 2 if DT_HAS_NORDIC_NRF_I2S_ENABLED
	default 0
	help
	  Maximum allowed offset between sent and received samples.
	  Value is in "full" audio samples.
	  Offset of 1 "full" audio sample is:
	  - 1 byte for mono 8 bit word size.
	  - 2 bytes for stereo 8 bit word size.
	  - 2 bytes for mono 16 bit word size.
	  - 4 bytes for stereo 16 bit word size.
	  - 4 bytes for mono 32 bit word size.
	  - 8 bytes for stereo 32 bit word size.

config I2S_TEST_BUFFER_SIZE
	int "Number of bytes send in one transaction"
	default 16
	help
	  Value has to be a multiple of 8 bytes. Test supports up to 32 bytes.

config I2S_TEST_WORD_SIZE_32_BIT_UNSUPPORTED
	bool "32 bit word size is not supported by the driver"
	help
	  When set to 'y' testing 32 bit word size is skipped.

config I2S_TEST_BLOCK_SIZE_8_UNSUPPORTED
	bool "Block_size of 8 bytes is not supported by the driver"
	default y if DT_HAS_NORDIC_NRF_TDM_ENABLED
	help
	  When set to 'y', test that use 8 bytes of data check if
	  i2s_configure() returns -EINVAL.
	  When set to 'n', test will do the I2S transmission.

source "Kconfig.zephyr"
```

## tests/drivers/i2s/i2s_buffer/testcase.yaml
```yaml
common:
  tags:
    - drivers
    - i2s
    - ci_tests_zephyr_drivers_i2s
  depends_on:
    - i2s
    - gpio
  harness: ztest

tests:
  # buffer of 8 bytes
  drivers.i2s.i2s_buffer.8bytes:
    harness_config:
      fixture: gpio_loopback
    extra_args:
      - CONFIG_I2S_TEST_BUFFER_SIZE=8
    platform_allow:
      - nrf52840dk/nrf52840
      - nrf5340dk/nrf5340/cpuapp
      - nrf54l15dk/nrf54l15/cpuapp
      - nrf54lm20dk/nrf54lm20a/cpuapp
    integration_platforms:
      - nrf54l15dk/nrf54l15/cpuapp
  drivers.i2s.i2s_buffer.8bytes.aclk:
    harness_config:
      fixture: gpio_loopback
    extra_args:
      - EXTRA_DTC_OVERLAY_FILE="boards/nrf5340dk_nrf5340_cpuapp_aclk.overlay"
      - CONFIG_I2S_TEST_BUFFER_SIZE=8
    platform_allow:
      - nrf5340dk/nrf5340/cpuapp
    integration_platforms:
      - nrf5340dk/nrf5340/cpuapp
  drivers.i2s.i2s_buffer.8bytes.nrf54h:
    harness_config:
      fixture: i2s_loopback
    extra_args:
      - CONFIG_I2S_TEST_BUFFER_SIZE=8
    platform_allow:
      - nrf54h20dk/nrf54h20/cpuapp
    integration_platforms:
      - nrf54h20dk/nrf54h20/cpuapp

  # buffer of 16 bytes
  drivers.i2s.i2s_buffer.16bytes:
    harness_config:
      fixture: gpio_loopback
    platform_allow:
      - nrf52840dk/nrf52840
      - nrf5340dk/nrf5340/cpuapp
      - nrf54l15dk/nrf54l15/cpuapp
      - nrf54lm20dk/nrf54lm20a/cpuapp
    integration_platforms:
      - nrf54l15dk/nrf54l15/cpuapp
  drivers.i2s.i2s_buffer.16bytes.aclk:
    harness_config:
      fixture: gpio_loopback
    extra_args:
      - EXTRA_DTC_OVERLAY_FILE="boards/nrf5340dk_nrf5340_cpuapp_aclk.overlay"
    platform_allow:
      - nrf5340dk/nrf5340/cpuapp
    integration_platforms:
      - nrf5340dk/nrf5340/cpuapp
  drivers.i2s.i2s_buffer.16bytes.nrf54h:
    harness_config:
      fixture: i2s_loopback
    platform_allow:
      - nrf54h20dk/nrf54h20/cpuapp
    integration_platforms:
      - nrf54h20dk/nrf54h20/cpuapp

  # buffer of 24 bytes
  drivers.i2s.i2s_buffer.24bytes:
    harness_config:
      fixture: gpio_loopback
    extra_args:
      - CONFIG_I2S_TEST_BUFFER_SIZE=24
    platform_allow:
      - nrf52840dk/nrf52840
      - nrf5340dk/nrf5340/cpuapp
      - nrf54l15dk/nrf54l15/cpuapp
      - nrf54lm20dk/nrf54lm20a/cpuapp
    integration_platforms:
      - nrf54l15dk/nrf54l15/cpuapp
  drivers.i2s.i2s_buffer.24bytes.aclk:
    harness_config:
      fixture: gpio_loopback
    extra_args:
      - EXTRA_DTC_OVERLAY_FILE="boards/nrf5340dk_nrf5340_cpuapp_aclk.overlay"
      - CONFIG_I2S_TEST_BUFFER_SIZE=24
    platform_allow:
      - nrf5340dk/nrf5340/cpuapp
    integration_platforms:
      - nrf5340dk/nrf5340/cpuapp
  drivers.i2s.i2s_buffer.24bytes.nrf54h:
    harness_config:
      fixture: i2s_loopback
    extra_args:
      - CONFIG_I2S_TEST_BUFFER_SIZE=24
    platform_allow:
      - nrf54h20dk/nrf54h20/cpuapp
    integration_platforms:
      - nrf54h20dk/nrf54h20/cpuapp
```

## tests/drivers/i2s/i2s_instances/testcase.yaml
```yaml
common:
  tags:
    - drivers
    - ci_tests_zephyr_drivers_i2s
  harness: ztest
  timeout: 20

tests:
  drivers.i2s.i2s_instances:
    platform_allow:
      - nrf54h20dk/nrf54h20/cpuapp
      - nrf54l15dk/nrf54l15/cpuapp
      - nrf54lm20dk/nrf54lm20a/cpuapp
      - nrf7120pdk/nrf7120/cpuapp
    integration_platforms:
      - nrf54h20dk/nrf54h20/cpuapp
```

## tests/drivers/i2s/i2s_latency/Kconfig
```kconfig
#
# Copyright (c) 2025 Nordic Semiconductor ASA
#
# SPDX-License-Identifier: LicenseRef-Nordic-5-Clause
#

choice TEST_I2S_WORD_SIZE_IN_BITS
	prompt "I2S sample width in bits"
	default TEST_I2S_WORD_SIZE_8_BIT

config TEST_I2S_WORD_SIZE_8_BIT
	bool "8 bit"

config TEST_I2S_WORD_SIZE_16_BIT
	bool "16 bit"

config TEST_I2S_WORD_SIZE_32_BIT
	bool "32 bit"

endchoice

config TEST_I2S_WORD_SIZE
	int
	default 8 if TEST_I2S_WORD_SIZE_8_BIT
	default 16 if TEST_I2S_WORD_SIZE_16_BIT
	default 32 if TEST_I2S_WORD_SIZE_32_BIT

config TEST_I2S_ALLOWED_DATA_OFFSET
	int "Allowed offset in received data"
	default 2 if DT_HAS_NORDIC_NRF_I2S_ENABLED || DT_HAS_NORDIC_NRF_TDM_ENABLED
	default 0
	help
	  Maximum allowed offset between sent and received samples. Non-zero
	  value of this option may be needed when GPIO loopback is used.

source "Kconfig.zephyr"
```
