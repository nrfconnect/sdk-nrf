/* SPDX-License-Identifier: LicenseRef-Nordic-5-Clause */

/ {
	resources {
		compatible = "test-hpf-gpio";
		out-gpios = <&gpio0 6 0>;
		in-gpios = <&gpio0 7 0>;
	};
};

&gpio0 {
	status = "okay";
};

&cpuflpr_code_partition {
	reg = <0xf4000 DT_SIZE_K(64)>;
};
