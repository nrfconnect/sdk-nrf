/*
 * Copyright (c) 2026 Nordic Semiconductor ASA
 *
 * SPDX-License-Identifier: LicenseRef-Nordic-5-Clause
 */

/* Test requires GPIO loopback between P2.00 and P0.06. */

/ {
	resources {
		compatible = "test-hpf-gpio";
		out-gpios = <&hpf_gpio 0 GPIO_ACTIVE_HIGH>;
		in-gpios = <&gpio0 6 GPIO_ACTIVE_HIGH>;
	};
};

&gpiote20 {
	status = "okay";
};

&gpio0 {
	status = "okay";
};
