/*
 * Copyright (c) 2026 Nordic Semiconductor ASA
 *
 * SPDX-License-Identifier: LicenseRef-Nordic-5-Clause
 */

/* Test requires GPIO loopback between P1.22 and P1.16. */

/ {
	resources {
		compatible = "test-hpf-gpio";
		out-gpios = <&hpf_gpio 16 0>;
		in-gpios = <&gpio1 22 0>;
	};
};

&gpiote30 {
	status = "okay";
};

&gpio1 {
	status = "okay";
};
