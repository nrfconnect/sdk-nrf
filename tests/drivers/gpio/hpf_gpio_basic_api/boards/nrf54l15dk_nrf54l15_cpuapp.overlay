/*
 * Copyright (c) 2024 Nordic Semiconductor ASA
 *
 * SPDX-License-Identifier: LicenseRef-Nordic-5-Clause
 */

/ {
	resources {
		compatible = "test-hpf-gpio";
		out-gpios = <&hpf_gpio 10 0>;
		in-gpios = <&gpio1 14 0>;
	};
};

&gpiote20 {
	status = "okay";
};

&gpio1 {
	status = "okay";
};
