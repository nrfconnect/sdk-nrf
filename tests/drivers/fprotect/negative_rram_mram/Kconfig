## tests/drivers/fprotect/negative_rram_mram/Kconfig
```kconfig
mainmenu "Negative RRAM/MRAM fprotect tests"

choice TEST_FPROTECT_NEGATIVE_RRAM_MRAM_GROUP
	prompt "Test group to build"
	default TEST_FPROTECT_NEGATIVE_RRAM_MRAM_BASIC
	help
	  Select which ztest group to include in the image. Twister runs each
	  group as a separate scenario so tests do not depend on execution order
	  across groups.

config TEST_FPROTECT_NEGATIVE_RRAM_MRAM_BASIC
	bool "Basic checks (misaligned address, writable unprotected zones)"

config TEST_FPROTECT_NEGATIVE_RRAM_MRAM_BOUNDARY
	bool "Boundary fault tests (direct store across protection edges)"

config TEST_FPROTECT_NEGATIVE_RRAM_MRAM_FLASH_WRITE
	bool "Flash driver write fault on protected zone"

endchoice

source "Kconfig.zephyr"
```

## tests/drivers/fprotect/positive/testcase.yaml
```yaml
tests:
  drivers.fprotect.positive:
    sysbuild: true
    platform_allow:
      - nrf9160dk/nrf9160
      - nrf5340dk/nrf5340/cpuapp
    integration_platforms:
      - nrf9160dk/nrf9160
      - nrf5340dk/nrf5340/cpuapp
    tags:
      - b0
      - fprotect
      - sysbuild
      - ci_tests_drivers_fprotect
```

## tests/drivers/nrf71_sr_coex/testcase.yaml
```yaml
common:
  depends_on: wifi
  tags:
    - ci_build
    - sysbuild
    - drivers
    - ci_tests_drivers_nrf_wifi
tests:
  drivers.nrf71_sr_coex.build:
    sysbuild: true
    build_only: true
    integration_platforms:
      - nrf7120dk/nrf7120/cpuapp
    platform_allow: nrf7120dk/nrf7120/cpuapp
  drivers.nrf71_sr_coex.build.shell:
    sysbuild: true
    build_only: true
    extra_configs:
      - CONFIG_SHELL=y
      - CONFIG_NRF71_SR_COEX_SHELL=y
      - CONFIG_NRF71_SR_COEX_WAIT_FOR_APP_INIT=y
      - CONFIG_BT_CENTRAL=y
      - CONFIG_NRF71_SR_COEX_BLE_CHAN_MAP=y
    integration_platforms:
      - nrf7120dk/nrf7120/cpuapp
    platform_allow: nrf7120dk/nrf7120/cpuapp
```

## tests/drivers/nrfx_integration_test/Kconfig
```kconfig
#
# Copyright (c) 2020 Nordic Semiconductor ASA
#
# SPDX-License-Identifier: LicenseRef-Nordic-5-Clause
#

# This hidden option is intended to enable (include into compilation) all nrfx
# drivers that are available for the SoC that is the build target.
config NRFX_ALL_DRIVERS
	def_bool y
	depends on HAS_NRFX
	select NRFX_ADC if HAS_HW_NRF_ADC
	select NRFX_CLOCK if HAS_HW_NRF_CLOCK && !CLOCK_CONTROL_MPSL
	select NRFX_COMP if HAS_HW_NRF_COMP
	select NRFX_EGU if HAS_HW_NRF_EGU0 || HAS_HW_NRF_EGU1 || HAS_HW_NRF_EGU2 \
				|| HAS_HW_NRF_EGU3 || HAS_HW_NRF_EGU4 || HAS_HW_NRF_EGU5
	select NRFX_GPIOTE
	select NRFX_GPPI
	select NRFX_IPC if HAS_HW_NRF_IPC
	select NRFX_LPCOMP if HAS_HW_NRF_LPCOMP
	select NRFX_NFCT if HAS_HW_NRF_NFCT
	select NRFX_NVMC if $(dt_has_compat,$(DT_COMPAT_NORDIC_NRF51_FLASH_CONTROLLER)) \
				|| $(dt_has_compat,$(DT_COMPAT_NORDIC_NRF52_FLASH_CONTROLLER)) \
				|| $(dt_has_compat,$(DT_COMPAT_NORDIC_NRF53_FLASH_CONTROLLER)) \
				|| $(dt_has_compat,$(DT_COMPAT_NORDIC_NRF91_FLASH_CONTROLLER))
	select NRFX_POWER if HAS_HW_NRF_POWER
	select NRFX_QSPI if HAS_HW_NRF_QSPI
	select NRFX_RNG if HAS_HW_NRF_RNG
	select NRFX_RTC if $(dt_has_compat,$(DT_COMPAT_NORDIC_NRF_RTC))
	select NRFX_SAADC if HAS_HW_NRF_SAADC
	select NRFX_SPI0 if HAS_HW_NRF_SPI0
	select NRFX_SPI1 if HAS_HW_NRF_SPI1
	select NRFX_SPI2 if HAS_HW_NRF_SPI2
	select NRFX_SYSTICK if CPU_CORTEX_M_HAS_SYSTICK
	select NRFX_TEMP if HAS_HW_NRF_TEMP
	select NRFX_TIMER if HAS_HW_NRF_TIMER0  || HAS_HW_NRF_TIMER1  || HAS_HW_NRF_TIMER2 \
				|| HAS_HW_NRF_TIMER3  || HAS_HW_NRF_TIMER4  || HAS_HW_NRF_TIMER00 \
				|| HAS_HW_NRF_TIMER10 || HAS_HW_NRF_TIMER20 || HAS_HW_NRF_TIMER21 \
				|| HAS_HW_NRF_TIMER22 || HAS_HW_NRF_TIMER23 || HAS_HW_NRF_TIMER24
	select NRFX_TWI0 if HAS_HW_NRF_TWI0
	select NRFX_TWI1 if HAS_HW_NRF_TWI1
	select NRFX_TWIM if HAS_HW_NRF_TWIM0 || HAS_HW_NRF_TWIM20 || HAS_HW_NRF_TWIM130
	select NRFX_TWIS if HAS_HW_NRF_TWIS0 || HAS_HW_NRF_TWIS20 || HAS_HW_NRF_TWIS130
	select NRFX_UART if HAS_HW_NRF_UART0
	select NRFX_USBD if HAS_HW_NRF_USBD
	select NRFX_USBREG if HAS_HW_NRF_USBREG
	select NRFX_PRS_BOX_0

source "Kconfig.zephyr"
```

## tests/drivers/saadct/error_cases/testcase.yaml
```yaml
common:
  tags:
    - drivers
    - saadct
    - ci_tests_drivers_nrf_saadct
  harness: ztest
  platform_allow:
    - nrf54l15dk/nrf54l15/cpuapp
  integration_platforms:
    - nrf54l15dk/nrf54l15/cpuapp

tests:
  drivers.saadct.error_cases: {}
```

## tests/drivers/spi/spi_latency/Kconfig
```kconfig
#
# Copyright (c) 2025 Nordic Semiconductor ASA
#
# SPDX-License-Identifier: LicenseRef-Nordic-5-Clause
#

config TEST_MEASUREMENT_REPEATS
	int "Number of latency measurements repeats"
	default 100

config TEST_MAX_BUFFER_SIZE
	int "Maximum SPI transceive buffer size allocated and tested"
	default 512 if SOC_NRF9251_CPUPPR
	default 512 if SOC_NRF54H20_CPUPPR
	default 2000

config TEST_SPI_LATENCY_BASE_OVERHEAD_US
	int "Base overhead time for SPI latency measurement"
	default 130 if SOC_NRF9251_CPUPPR || SOC_NRF54H20_CPUPPR
	default 90 if SOC_SERIES_NRF52
	default 80 if SOC_NRF5340_CPUAPP
	default 65 if SOC_NRF54LS05B_CPUAPP || SOC_NRF54LS05A_CPUAPP
	default 55

config TEST_SPI_LATENCY_PER_BYTE_OVERHEAD_US
	int "Overhead time per byte for SPI latency measurement"
	default 2 if RISCV_CORE_NORDIC_VPR && XIP
	default 1 if HAS_NORDIC_DMM
	default 0

source "Kconfig.zephyr"
```

## tests/drivers/spi/spim_pan/testcase.yaml
```yaml
common:
  sysbuild: true
  depends_on: gpio
  harness: ztest
  tags:
    - drivers
    - spim
    - ci_tests_drivers_spi

tests:
  drivers.spim_pan:
    platform_allow:
      - nrf54h20dk/nrf54h20/cpuapp
      - nrf54l15dk/nrf54l15/cpuapp
      - nrf54lc10dk/nrf54lc10a/cpuapp
      - nrf54lm20dk/nrf54lm20a/cpuapp
      - nrf54lm20dk/nrf54lm20b/cpuapp
      - nrf54ls05dk/nrf54ls05a/cpuapp
      - nrf54ls05dk/nrf54ls05b/cpuapp
      - nrf54lv10dk/nrf54lv10a/cpuapp
      - nrf7120dk/nrf7120/cpuapp
      - nrf9251dk/nrf9251/cpuapp
    integration_platforms:
      - nrf54l15dk/nrf54l15/cpuapp
    harness_config:
      fixture: gpio_loopback

  drivers.spim_pan.fast:
    platform_allow:
      - nrf54l15dk/nrf54l15/cpuapp
      - nrf54lm20dk/nrf54lm20a/cpuapp
      - nrf54lm20dk/nrf54lm20b/cpuapp
      - nrf7120dk/nrf7120/cpuapp
    integration_platforms:
      - nrf54lm20dk/nrf54lm20b/cpuapp
    extra_args:
      - FILE_SUFFIX=fast
    harness_config:
      fixture: external_flash

  drivers.spim_pan.fast.nrf54h:
    platform_allow:
      - nrf54h20dk/nrf54h20/cpuapp
    integration_platforms:
      - nrf54h20dk/nrf54h20/cpuapp
    extra_args:
      - FILE_SUFFIX=fast
    harness_config:
      fixture: gpio_loopback
```

## tests/drivers/spi/spim_pm_sck_cs/Kconfig
```kconfig
#
# Copyright (c) 2026 Nordic Semiconductor ASA
#
# SPDX-License-Identifier: LicenseRef-Nordic-5-Clause
#

rsource "Kconfig.spi_mode"
rsource "Kconfig.scenario"

source "Kconfig.zephyr"
```

## tests/drivers/spi/spim_pm_sck_cs/Kconfig.scenario
```kconfig
#
# Copyright (c) 2026 Nordic Semiconductor ASA
#
# SPDX-License-Identifier: LicenseRef-Nordic-5-Clause
#

choice TEST_SCENARIO
	prompt "SPI test scenario"
	default TEST_SCENARIO_SYNC
	help
	  Selected by sysbuild from SB_CONFIG_TEST_SCENARIO_*.

config TEST_SCENARIO_SYNC
	bool "Single synchronous transaction"
	help
	  One byte sent with spi_write_dt(). Expected: 1 CS window, 16 SCK edges.

config TEST_SCENARIO_RTIO_QUEUED
	bool "Two queued RTIO transactions"
	select SPI_RTIO if SPI
	help
	  Two independent one-byte RTIO transactions submitted at once, so that
	  the second one is queued in the driver when the first one completes.
	  Expected: 2 CS windows, 16 SCK edges each.

config TEST_SCENARIO_RTIO_CALLBACK
	bool "RTIO transaction submitted from a completion callback"
	select SPI_RTIO if SPI
	help
	  One-byte RTIO transaction chained with a callback that submits
	  another one-byte transaction. Expected: 2 CS windows, 16 SCK edges each.

config TEST_SCENARIO_RTIO_HOLD_ON_CS
	bool "Two queued RTIO transactions, first with SPI_HOLD_ON_CS"
	select SPI_RTIO if SPI
	help
	  Like the queued scenario, but the first transaction keeps CS active.
	  Expected: 1 CS window, 32 SCK edges.

endchoice
```

## tests/drivers/spi/spim_pm_sck_cs/Kconfig.spi_mode
```kconfig
#
# Copyright (c) 2026 Nordic Semiconductor ASA
#
# SPDX-License-Identifier: LicenseRef-Nordic-5-Clause
#

config TEST_SPI_MODE
	int "SPI mode"
	range 0 3
	default 0
	help
	  SPI mode used by the SPIM controlled by the application core:
	  0 - CPOL = 0, CPHA = 0,
	  1 - CPOL = 0, CPHA = 1,
	  2 - CPOL = 1, CPHA = 0,
	  3 - CPOL = 1, CPHA = 1.
	  Value is set by sysbuild from SB_CONFIG_TEST_SPI_MODE.
```

## tests/drivers/spi/spim_pm_sck_cs/Kconfig.sysbuild
```kconfig
#
# Copyright (c) 2026 Nordic Semiconductor ASA
#
# SPDX-License-Identifier: LicenseRef-Nordic-5-Clause
#

if SUPPORT_FLPRCORE

choice FLPRCORE
	default FLPRCORE_TESTAPP

config FLPRCORE_TESTAPP
	bool "testapp image"

endchoice

config FLPRCORE_IMAGE_NAME
	default "testapp" if FLPRCORE_TESTAPP

config FLPRCORE_IMAGE_PATH
	default "$(APP_DIR)/testapp" if FLPRCORE_TESTAPP

endif # SUPPORT_FLPRCORE

config TEST_SPI_MODE
	int "SPI mode"
	range 0 3
	default 0
	help
	  SPI mode used by the SPIM controlled by the application core.
	  Propagated as CONFIG_TEST_SPI_MODE to both the application and FLPR images.

choice TEST_SCENARIO
	prompt "SPI test scenario"
	default TEST_SCENARIO_SYNC
	help
	  Propagated as CONFIG_TEST_SCENARIO_* to both the application
	  and FLPR images.

config TEST_SCENARIO_SYNC
	bool "Single synchronous transaction"

config TEST_SCENARIO_RTIO_QUEUED
	bool "Two queued RTIO transactions"

config TEST_SCENARIO_RTIO_CALLBACK
	bool "RTIO transaction submitted from a completion callback"

config TEST_SCENARIO_RTIO_HOLD_ON_CS
	bool "Two queued RTIO transactions, first with SPI_HOLD_ON_CS"

endchoice

source "share/sysbuild/Kconfig"
```

## tests/drivers/uart/uart_baudrate_test/Kconfig
```kconfig
#
# Copyright (c) 2025 Nordic Semiconductor ASA
#
# SPDX-License-Identifier: LicenseRef-Nordic-5-Clause
#

source "Kconfig.zephyr"

config TEST_PIN_STATE_SAMPLES
	int "Number of GPIO samples captured per transmitted symbol"
	default 32768
	range 1024 262144
	help
	  Size of the buffer holding the sampled state of the loopback pin. The buffer
	  must be large enough to hold one full UART symbol, otherwise the low baudrate
	  tests are skipped. The needed size depends on how fast the CPU can sample the
	  GPIO port, so it scales with the CPU frequency and inversely with the baudrate.

config TEST_ALLOWED_DEVIATION
	int "Allowed deviation (%) for UART timing checks"
	default 5
	range 0 100
	help
	  Maximum allowed deviation (%) from the programmed values for the test to be
	  considered a PASS. For example, if set to 5, the measured period of bit
	  can deviate by up to 5% from the programmed values for the test to pass.
```

## tests/drivers/watchdog/wdt_soft_reset_reconf/Kconfig
```kconfig
#
# Copyright (c) 2026 Nordic Semiconductor ASA
#
# SPDX-License-Identifier: LicenseRef-Nordic-5-Clause
#

choice TEST_VARIANT
	prompt "Select reset type"
	default TEST_SOFTWARE_RESET

config TEST_SOFTWARE_RESET
	bool "Test watchdog behavior after software reset"

config TEST_CPU_LOCKUP_RESET
	bool "Test watchdog behavior after cpu lockup reset"

endchoice

source "Kconfig.zephyr"
```

## tests/lib/nrf_modem_lib/trace_backends/uart_nrfx/dts/bindings/test,uarte-intc.yaml
```yaml
#
# Copyright (c) 2026 Nordic Semiconductor ASA
#
# SPDX-License-Identifier: LicenseRef-Nordic-5-Clause
#

description: Dummy interrupt controller for the UARTE trace backend unit test

compatible: "test,uarte-intc"

include: [base.yaml, interrupt-controller.yaml]

interrupt-cells:
  - irq
  - priority
```

## tests/lib/ram_pwrdn/testcase.yaml
```yaml
tests:
  ram_pwrdn.functionality_test:
    sysbuild: true
    platform_allow: nrf52840dk/nrf52840
    integration_platforms:
      - nrf52840dk/nrf52840
    tags:
      - ram_pwrdn
      - sysbuild
      - ci_tests_lib_ram_pwrdn
  ram_pwrdn.nrf7120_secure:
    sysbuild: true
    platform_allow: nrf7120dk/nrf7120/cpuapp
    integration_platforms:
      - nrf7120dk/nrf7120/cpuapp
    tags:
      - ram_pwrdn
      - sysbuild
      - ci_tests_lib_ram_pwrdn
  ram_pwrdn.nrf7120_tfm:
    sysbuild: true
    platform_allow: nrf7120dk/nrf7120/cpuapp/ns
    integration_platforms:
      - nrf7120dk/nrf7120/cpuapp/ns
    tags:
      - ram_pwrdn
      - sysbuild
      - ci_tests_lib_ram_pwrdn
```

## tests/mocks/nrf_rpc/Kconfig
```kconfig
#
# Copyright (c) 2024 Nordic Semiconductor
#
# SPDX-License-Identifier: LicenseRef-Nordic-5-Clause
#

menuconfig MOCK_NRF_RPC
	bool "Mock library for nRF RPC"

if MOCK_NRF_RPC

choice NRF_RPC_TRANSPORT

config MOCK_NRF_RPC_TRANSPORT
	bool "Mock nRF RPC transport"
	help
	  Mock nRF RPC transport for unit testing.

config MOCK_DECT_RPC_TRANSPORT
	bool "DECT NR+ RPC unit test mock transport"
	help
	  DECT NR+ RPC ztests only: same role as MOCK_NRF_RPC_TRANSPORT with a
	  larger expect queue, optional wildcard slots, and cmd header matching
	  suited to dect_rpc tests (see tests/subsys/net/dect/rpc/common/
	  mock_dect_rpc_transport.c).

endchoice # NRF_RPC_TRANSPORT

config MOCK_NRF_RPC_TR_CB_THREAD_STACK_SIZE
	int "Stack size for the callback thread"
	default 1024

config MOCK_NRF_RPC_TR_CB_THREAD_PRIO
	int "Priority for the callback thread"
	default 5

if MOCK_DECT_RPC_TRANSPORT

config MOCK_DECT_RPC_TR_MAX_EXPECTED_PKTS
	int "Max expect/response pairs for DECT RPC mock transport"
	default 24
	range 5 128

endif # MOCK_DECT_RPC_TRANSPORT

endif # MOCK_NRF_RPC
```

## tests/modules/mcuboot/direct_xip/testcase.yaml
```yaml
tests:
  mcuboot.direct_xip:
    sysbuild: true
    tags:
      - mcuboot
      - direct_xip
      - sysbuild
      - ci_tests_modules_mcuboot
    platform_allow:
      - nrf9160dk/nrf9160
      - nrf52840dk/nrf52840
      - nrf52dk/nrf52832
      - nrf5340dk/nrf5340/cpuapp

  mcuboot.direct_xip.nrf54l:
    sysbuild: true
    tags:
      - mcuboot
      - direct_xip
      - sysbuild
      - ci_tests_modules_mcuboot
    extra_args:
      - FILE_SUFFIX=nrf54l
    platform_allow:
      - nrf54l15dk/nrf54l15/cpuapp
    integration_platforms:
      - nrf54l15dk/nrf54l15/cpuapp
```

## tests/nrf_audio/audio_datapath/Kconfig
```kconfig
#
# SPDX-License-Identifier: LicenseRef-Nordic-5-Clause
#

config AUDIO_DEV
	int
	default 1

config AUDIO_FRAME_DURATION_US
	int
	default 10000

config AUDIO_SAMPLE_RATE_48000_HZ
	bool
	default y

config AUDIO_SAMPLE_RATE_HZ
	int
	default 48000

config AUDIO_BIT_DEPTH_16
	bool
	default y

config AUDIO_BIT_DEPTH_BITS
	int
	default 16

config AUDIO_BIT_DEPTH_OCTETS
	int
	default 2

config AUDIO_INPUT_CHANNELS
	int
	default 1

config AUDIO_OUTPUT_CHANNELS
	int
	default 2

config AUDIO_ENCODE_CHANNELS_MAX
	int
	default 1

config AUDIO_DECODE_CHANNELS_MAX
	int
	default 1

config SW_CODEC_LC3
	bool
	default y

config LC3_BITRATE_MAX
	int
	default 124000

config AUDIO_MIN_PRES_DLY_US
	int
	default 3000

config AUDIO_MAX_PRES_DLY_US
	int
	default 60000

config BT_AUDIO_PRESENTATION_DELAY_US
	int
	default 10000

config FIFO_FRAME_SPLIT_NUM
	int
	default 20

config NRF_AUDIO_TX_LEAD_TIME_TGT_US
	int
	default 2500

config NRF_AUDIO_TX_LEAD_TIME_MIN_US
	int
	default 2000

config BT_BUF_EVT_RX_COUNT
	int
	default 10

config BT_BUF_ACL_TX_COUNT
	int
	default 5

module = AUDIO_DATAPATH
module-str = audio-datapath
source "subsys/logging/Kconfig.template.log_config"

source "Kconfig.zephyr"
```

## tests/nrf_audio/rate_ctrl/Kconfig
```kconfig
#
# Copyright (c) 2026 Nordic Semiconductor ASA
#
# SPDX-License-Identifier: LicenseRef-Nordic-5-Clause
#

module = NRF_AUDIO_MODULE_RATE_CONTROL
module-str = module-rate-control
source "subsys/logging/Kconfig.template.log_config"

source "Kconfig.zephyr"
```
