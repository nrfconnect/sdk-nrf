/*
 * Copyright (c) 2026 Nordic Semiconductor ASA
 *
 * SPDX-License-Identifier: LicenseRef-Nordic-5-Clause
 */

#include "../../../boards/nrf54lv10dk_nrf54lv10a_cpuapp.overlay"

/ {
	chosen {
		zephyr,code-partition = &b0_partition;
	};
};
