## CMakeLists.txt
```
#
# Copyright (c) 2026 Nordic Semiconductor ASA
#
# SPDX-License-Identifier: LicenseRef-Nordic-5-Clause
#
# DECT NR+ Stack Integration Tests with Unity and CMock

cmake_minimum_required(VERSION 3.20.0)

find_package(Zephyr REQUIRED HINTS $ENV{ZEPHYR_BASE})
project(dect_mdm_integration_test)

target_sources(app PRIVATE
    src/main.c
    src/test_dect_integration.c
    src/test_dect_eth_integration.c
    src/test_dect_utils.c
    src/test_dect_sink_uplink.c
    src/mocks/mock_nrf_modem_dect_mac.c
)

target_sources_ifdef(CONFIG_MODEM_CELLULAR app PRIVATE
    src/mocks/mock_modem_device.c
    src/mocks/mock_ppp_net_if.c
)

target_sources_ifdef(CONFIG_NET_L2_ETHERNET app PRIVATE
    src/mocks/mock_eth_net_if.c
)

target_include_directories(app PRIVATE
    ${CMAKE_CURRENT_SOURCE_DIR}/src
    ${CMAKE_CURRENT_SOURCE_DIR}/src/mocks
    ${ZEPHYR_NRFXLIB_MODULE_DIR}/nrf_modem/include
    ${ZEPHYR_NRF_MODULE_DIR}/drivers/dect/dect_mdm
    ${ZEPHYR_NRF_MODULE_DIR}/include/net/dect
    ${ZEPHYR_NRF_MODULE_DIR}/include/net
    ${ZEPHYR_BASE}/include/zephyr/net
    ${ZEPHYR_BASE}/subsys/net/ip
)

target_include_directories(zephyr_interface INTERFACE
    ${ZEPHYR_NRFXLIB_MODULE_DIR}/nrf_modem/include
)

if(CONFIG_MODEM_CELLULAR)
  target_link_options(app PUBLIC
    -Wl,--wrap=net_if_get_first_by_type
    -Wl,--wrap=net_if_start_rs
  )
endif()

if(CONFIG_NET_L2_ETHERNET)
  target_link_options(app PUBLIC
    -Wl,--wrap=net_if_start_rs
    -Wl,--wrap=net_ipv6_send_na
    -Wl,--wrap=net_ipv6_send_ns
  )
endif()
```

## Kconfig
```
#
# Copyright (c) 2026 Nordic Semiconductor ASA
#
# SPDX-License-Identifier: LicenseRef-Nordic-5-Clause
#
# Kconfig for DECT NR+ Integration Tests
# Provides minimal definitions needed for DECT stack compilation without full modem library

# Enable SETTINGS support needed by DECT drivers
config SETTINGS
	bool "Settings subsystem"
	default y
	help
	  Settings support needed by DECT drivers.

config MODEM_CELLULAR
	bool "Modem cellular support"
	default y
	help
	  Modem cellular support needed by DECT L2 sink.
	  When enabled, a mock modem device is provided via boards/native_sim.overlay for testing.

# Define DECT_UTILS_LIB that is selected by DECT drivers
config DECT_UTILS_LIB
	bool "DECT MAC utilities library support"
	default y
	help
	  Mock DECT MAC utilities library configuration for testing.
	  In real builds this would pull in the utilities library.

# Modem shared memory configurations needed by MAC drivers
config NRF_MODEM_LIB_SHMEM_TX_SIZE
	int "Modem shared memory TX size"
	default 12288
	help
	  Mock definition for modem shared memory TX size.
	  Used by MAC driver for validation.

config NRF_MODEM_LIB_SHMEM_RX_SIZE
	int "Modem shared memory RX size"
	default 6144
	help
	  Mock definition for modem shared memory RX size.
	  Used by MAC driver for validation.

config NRF_MODEM_SHMEM_CTRL_SIZE
	hex "Modem shared memory control size"
	default 0x4e8
	help
	  Mock definition for modem shared memory control size.
	  Used by MAC driver for validation.

# Most modem CONFIG values are already defined in the main SDK
# We only need to ensure they have reasonable defaults for testing
# The values will be set in prj.conf

# Logging configuration for test module
module = TEST_DECT_INTEGRATION
module-str = DECT Integration Tests
source "subsys/logging/Kconfig.template.log_config"

source "Kconfig.zephyr"
```

## prj.conf
```kconfig
#
# Copyright (c) 2026 Nordic Semiconductor ASA
#
# SPDX-License-Identifier: LicenseRef-Nordic-5-Clause
#
# DECT NR+ Stack Integration Test Configuration for native_sim
# Tests complete stack from net_mgmt API to mocked libmodem

# Unity Test Framework
CONFIG_UNITY=y

# Code Coverage Support (for native_sim) - focus on DECT stack
# Disabled by default - enable when running coverage measurement
# Twister coverage commands in README enable these when needed
#CONFIG_COVERAGE=y
#CONFIG_COVERAGE_NATIVE_GCOV=y

# Basic configuration for Unity testing on native_sim
CONFIG_TEST=y
CONFIG_ZTEST=n

# System configuration for DECT stack testing
CONFIG_MAIN_STACK_SIZE=8192
CONFIG_SYSTEM_WORKQUEUE_STACK_SIZE=4096

# Networking configuration for DECT integration testing
# Note: CONFIG_NRF_MODEM_LIB is NOT enabled - all modem functions are mocked
CONFIG_NETWORKING=y
CONFIG_NET_NATIVE=y
CONFIG_NET_IPV4=n
CONFIG_NET_IPV6=y
CONFIG_NET_MGMT=y
CONFIG_NET_MGMT_EVENT=y
CONFIG_NET_MGMT_EVENT_INFO=y
# Must be >= largest DECT event (dect_neighbor_list_evt in BUILD_ASSERT; dect_neighbor_info_evt
# is larger). On native_sim (64-bit) alignment makes that 224 bytes; dect_shell on 32-bit nRF91x
# fits in 208. Use 224 so this test passes on native_sim.
CONFIG_NET_MGMT_EVENT_INFO_DEFAULT_DATA_SIZE=224

# DECT L2 layer
CONFIG_NET_L2_DECT=y
CONFIG_NET_CONNECTION_MANAGER=y

# Packet sockets for raw DECT L2 send/receive test
CONFIG_NET_SOCKETS=y
CONFIG_NET_SOCKETS_PACKET=y
CONFIG_NET_SOCKETS_PACKET_DGRAM=y

# Note: Modem library CONFIG values are mocked via compile definitions in CMakeLists.txt

# DECT NR+ specific configurations with full MAC driver stack
CONFIG_DECT=y
CONFIG_DECT_MDM=y
CONFIG_DECT_MDM_DRIVER_NRF=y
CONFIG_DECT_CLUSTER_MAX_CHILD_ASSOCIATION_COUNT=8
CONFIG_NET_IPV6_MAX_NEIGHBORS=12
CONFIG_DECT_MDM_LOG_LEVEL_INF=y
CONFIG_DECT_MDM_DEVICE_NAME="dect_test"
CONFIG_DECT_MDM_NET_IF_NO_AUTO_START=n

# Modem shared memory configuration (defined in Kconfig)

# DECT L2 networking layer
CONFIG_NET_L2_DECT_MGMT=y
CONFIG_NET_L2_DECT_LOG_LEVEL_INF=y
CONFIG_NET_L2_DECT_MGMT_LOG_LEVEL_INF=y
CONFIG_NET_L2_DECT_BR=y

CONFIG_NET_LOG=y

# Suppress informational messages from DECT Bearer layer (like "Ethernet interface found")
CONFIG_NET_L2_DECT_BR_LOG_LEVEL_INF=n
CONFIG_NET_L2_DECT_BR_LOG_LEVEL_WRN=y

# Network management event logging
CONFIG_NET_MGMT_EVENT_LOG_LEVEL_INF=y

# Disable Ethernet L2 layer (not needed for DECT MAC testing)
CONFIG_NET_L2_ETHERNET=n

CONFIG_NET_INTERFACE_NAME=y
CONFIG_NET_INTERFACE_NAME_LEN=15
CONFIG_NET_IF_MAX_IPV6_COUNT=2
# Link-local + ULA + global (+ headroom during prefix changes)
CONFIG_NET_IF_UNICAST_IPV6_ADDR_COUNT=4

# Network buffers
CONFIG_NET_BUF=y
CONFIG_NET_BUF_DATA_SIZE=128
CONFIG_NET_BUF_POOL_USAGE=y
CONFIG_NET_PKT_RX_COUNT=15
CONFIG_NET_BUF_RX_COUNT=30
CONFIG_NET_PKT_TX_COUNT=15
CONFIG_NET_BUF_TX_COUNT=30

# Network stack sizes
CONFIG_NET_TX_STACK_SIZE=2048
CONFIG_NET_RX_STACK_SIZE=2048
CONFIG_NET_MGMT_EVENT_STACK_SIZE=2048
CONFIG_NET_MGMT_EVENT_QUEUE_SIZE=30
CONFIG_NET_MGMT_EVENT_QUEUE_TIMEOUT=5000

# Network context support
CONFIG_NET_CONTEXT_SNDTIMEO=y
CONFIG_NET_CONTEXT_RCVTIMEO=y

# System configuration
CONFIG_SYSTEM_WORKQUEUE_STACK_SIZE=3072
CONFIG_HEAP_MEM_POOL_SIZE=25600

# Logging and debugging
CONFIG_ASSERT=y
CONFIG_LOG=y

# Test module logging (change to DBG to enable debug traces from tests)
CONFIG_TEST_DECT_INTEGRATION_LOG_LEVEL_INF=y
CONFIG_PRINTK=y
CONFIG_LOG_PRINTK=y
CONFIG_LOG_MODE_DEFERRED=y
CONFIG_LOG_DEFAULT_LEVEL=3
CONFIG_ASSERT_MODULE_DEFAULT_LEVEL_VERBOSE=y
CONFIG_RESET_ON_FATAL_ERROR=n

# Enhanced logging for threading visibility
CONFIG_LOG_BUFFER_SIZE=4096
CONFIG_LOG_PROCESS_TRIGGER_THRESHOLD=10
CONFIG_LOG_PROCESS_THREAD_STACK_SIZE=2048
CONFIG_LOG_PROCESS_THREAD_STARTUP_DELAY_MS=0

# Thread debugging support
CONFIG_THREAD_NAME=y

# Kernel options
CONFIG_ENTROPY_GENERATOR=y

# Settings for state persistence
CONFIG_FLASH=y
CONFIG_FLASH_MAP=y
CONFIG_MPU_ALLOW_FLASH_WRITE=y
CONFIG_NVS=y
CONFIG_SETTINGS=y
CONFIG_SETTINGS_NVS=y

# Additional required configurations for DECT stack
CONFIG_NET_STATISTICS=y
CONFIG_NET_STATISTICS_USER_API=y

# Disable antenna and modem info
CONFIG_MODEM_ANTENNA=n
CONFIG_MODEM_INFO=n

# Disable components that require hardware for testing
CONFIG_MBEDTLS=n
```

## eth_sink.conf
```kconfig
#
# Copyright (c) 2026 Nordic Semiconductor ASA
#
# SPDX-License-Identifier: LicenseRef-Nordic-5-Clause
#
# Ethernet sink FT variant (replaces cellular PPP mock uplink).
# Use with Twister: extra_args: EXTRA_CONF_FILE=eth_sink.conf

CONFIG_MODEM_CELLULAR=n

CONFIG_NET_L2_ETHERNET=y
CONFIG_NET_L2_ETHERNET_MGMT=y
CONFIG_ETH_DRIVER=n

CONFIG_NET_IPV6_FORWARDING=y
CONFIG_NET_L2_DECT_MTU=1500

# Subset aligned with nrf/samples/dect/dect_shell/eth_common.conf.
# All ND-proxy / upstream-route sub-Kconfigs are enabled so the eth-only
# tests in test_dect_eth_integration.c actually exercise those paths.
CONFIG_NET_L2_DECT_BR_IPV6_ETH_UPSTREAM_PREFIX_ROUTE=y
CONFIG_NET_L2_DECT_BR_IPV6_ETH_ND_PROXY_PT=y
CONFIG_NET_L2_DECT_BR_IPV6_ETH_ND_PROXY_PT_NS=y
CONFIG_NET_L2_DECT_BR_IPV6_ETH_ND_PROXY_PT_NS_UNICAST_INTERCEPT=y
CONFIG_NET_L2_DECT_BR_IPV6_ETH_ND_PROXY_PT_NS_PRIME=y
CONFIG_NET_L2_DECT_BR_IPV6_ETH_ND_PROXY_PT_NA_UNICAST_REFRESH=y
# Required for test_dect_ft_eth_unsol_na and the NA_UNICAST_REFRESH path.
CONFIG_NET_L2_DECT_BR_UNSOLICITED_NA=y
# 0 ms pacing: tests are deterministic and time-bounded; the runtime pacing
# is not exercised here (see sample overlays for realistic values).
CONFIG_NET_L2_DECT_BR_IPV6_ETH_TX_PACING_MS=0

# ND proxy MLD join for solicited-node group and NPF-based unicast NS
# intercept both required by the eth-only tests.
CONFIG_NET_IPV6_MLD=y
CONFIG_NET_PKT_FILTER=y
CONFIG_NET_PKT_FILTER_IPV6_HOOK=y

CONFIG_NET_IF_IPV6_PREFIX_COUNT=3
CONFIG_NET_IF_MCAST_IPV6_ADDR_COUNT=12
```

## boards/native_sim.overlay
```dts
/*
 * Copyright (c) 2026 Nordic Semiconductor ASA
 *
 * SPDX-License-Identifier: LicenseRef-Nordic-5-Clause
 *
 * Mock modem device for DECT L2 sink tests (CONFIG_MODEM_CELLULAR).
 * Provides DT_ALIAS(modem) so dect_net_l2_sink.c can use DEVICE_DT_GET(DT_ALIAS(modem))
 * without real cellular hardware.
 */

/ {
	aliases {
		modem = &modem_mock;
	};

	modem_mock: modem_mock {
		compatible = "dect,modem-mock";
		status = "okay";
	};
};
```

## src/main.c
```c
/*
 * Copyright (c) 2026 Nordic Semiconductor ASA
 *
 * SPDX-License-Identifier: LicenseRef-Nordic-5-Clause
 */

#include <unity.h>
#include <zephyr/kernel.h>
#include <stdlib.h>
#include <stdio.h>
#ifdef CONFIG_BOARD_NATIVE_SIM
#include "posix_board_if.h"
#endif

/* Include test functions from test_dect_integration.c (failure tests first, then success init) */
extern void test_dect_net_mgmt_invalid_iface_errors(void);
extern void test_dect_configure_callback_failure(void);
extern void test_dect_activation_callback_failure(void);
extern void test_dect_stack_initialization(void);
extern void test_dect_settings_reset_to_defaults(void);
extern void test_dect_scan_request_band1(void);
extern void test_dect_pt_association_request(void);
extern void test_dect_pt_neighbor_list_info_req(void);
extern void test_dect_pt_status_info_req(void);
extern void test_dect_pt_global_address_assign(void);
extern void test_dect_pt_global_address_change(void);
extern void test_dect_pt_global_address_removal(void);
extern void test_dect_pt_association_release(void);
extern void test_dect_pt_conn_mgr_connect(void);
extern void test_dect_pt_conn_mgr_disconnect(void);
extern void test_dect_ft_activate(void);
extern void test_dect_ft_rssi_scan(void);
extern void test_dect_deactivate(void);
extern void test_dect_deactivated_requests_fail(void);
extern void test_dect_ft_configuration(void);
extern void test_dect_pt_complete_workflow(void);
extern void test_dect_ft_cluster_start(void);
extern void test_dect_ft_network_create(void);
extern void test_dect_ft_cluster_reconfigure(void);
extern void test_dect_ft_sink_global_address_assign(void);
extern void test_dect_ft_sink_router_del(void);
extern void test_dect_ft_sink_router_nbr_del(void);
extern void test_dect_ft_cluster_associate_child_with_global_address(void);
extern void test_dect_ft_cluster_associate_child_with_global_address_2(void);
extern void test_dect_ft_sink_global_address_change(void);
extern void test_dect_ft_sckt_packet_rx_tx(void);
extern void test_dect_ft_local_multicast_tx(void);
extern void test_dect_ft_network_remove(void);
extern void test_dect_ft_sink_down(void);
extern void test_dect_ft_conn_mgr_connect(void);
extern void test_dect_ft_conn_mgr_disconnect(void);
extern void test_dect_ft_cluster_info(void);
extern void test_dect_ft_status(void);
extern void test_dect_ft_cluster_stop_returns_enotsup(void);
extern void test_dect_ft_nw_beacon_start(void);
extern void test_dect_ft_nw_beacon_stop(void);
extern void test_dect_ft_cluster_associate_child(void);
extern void test_dect_ft_cluster_associated_icmp_ping(void);
extern void test_dect_ft_cluster_associated_child_dissociates(void);
extern void test_dect_settings_write_scopes_and_reset(void);
extern void test_dect_association_callback_failure(void);
extern void test_dect_association_rejected(void);
#if defined(CONFIG_NET_L2_ETHERNET) && !defined(CONFIG_MODEM_CELLULAR)
extern void test_dect_ft_eth_sink_init(void);
extern void test_dect_ft_eth_upstream_prefix_route(void);
extern void test_dect_ft_eth_cross_l2_route_packet_ll_src(void);
extern void test_dect_ft_eth_cross_l2_forward_unknown_ll_nbr(void);
extern void test_dect_ft_eth_cross_l2_forward_router_nd_pending(void);
extern void test_dect_ft_eth_unsol_na(void);
extern void test_dect_ft_eth_nd_proxy_pt_add(void);
extern void test_dect_ft_eth_nd_proxy_ns_reply(void);
extern void test_dect_ft_eth_nd_proxy_unicast_ns_intercept(void);
#endif

/* Test result tracking structure */
typedef struct {
	const char *function_name;
	bool passed;
} test_result_t;

/* Global test result tracking array (order = run order; failure tests before success init) */
static test_result_t test_results[] = {
	{"test_dect_net_mgmt_invalid_iface_errors", false},
	{"test_dect_configure_callback_failure", false},
	{"test_dect_activation_callback_failure", false},
	{"test_dect_stack_initialization", false},
	{"test_dect_settings_reset_to_defaults", false},
	{"test_dect_scan_request_band1", false},
	{"test_dect_pt_association_request", false},
	{"test_dect_pt_neighbor_list_info_req", false},
	{"test_dect_pt_status_info_req", false},
	{"test_dect_pt_global_address_assign", false},
	{"test_dect_pt_global_address_change", false},
	{"test_dect_pt_global_address_removal", false},
	{"test_dect_pt_association_release", false},
	{"test_dect_association_callback_failure", false},
	{"test_dect_association_rejected", false},
	{"test_dect_deactivate", false},
	{"test_dect_deactivated_requests_fail", false},
	{"test_dect_ft_configuration", false},
	{"test_dect_ft_activate", false},
	{"test_dect_ft_rssi_scan", false},
	{"test_dect_ft_cluster_start", false},
	{"test_dect_ft_cluster_info", false},
	{"test_dect_ft_cluster_stop_returns_enotsup", false},
	{"test_dect_ft_nw_beacon_start", false},
	{"test_dect_ft_nw_beacon_stop", false},
	{"test_dect_ft_cluster_associate_child", false},
	{"test_dect_ft_status", false},
	{"test_dect_ft_cluster_associated_icmp_ping", false},
	{"test_dect_ft_cluster_associated_child_dissociates", false},
	{"test_dect_settings_write_scopes_and_reset", false},
	{"test_dect_deactivate_rerun", false},
	{"test_dect_ft_configuration_rerun", false},
	{"test_dect_ft_activate_rerun", false},
	{"test_dect_ft_network_create", false},
	{"test_dect_ft_cluster_reconfigure", false},
	{"test_dect_ft_sink_global_address_assign", false},
	{"test_dect_ft_sink_router_del", false},
	{"test_dect_ft_sink_router_nbr_del", false},
	{"test_dect_ft_cluster_associate_child_with_global_address", false},
	{"test_dect_ft_cluster_associate_child_with_global_address_2", false},
	{"test_dect_ft_sink_global_address_change", false},
	{"test_dect_ft_sckt_packet_rx_tx", false},
	{"test_dect_ft_local_multicast_tx", false},
	{"test_dect_ft_network_remove", false},
	{"test_dect_ft_sink_down", false},
#if defined(CONFIG_NET_L2_ETHERNET) && !defined(CONFIG_MODEM_CELLULAR)
	{"test_dect_ft_eth_sink_init", false},
	{"test_dect_ft_eth_upstream_prefix_route", false},
	{"test_dect_ft_eth_unsol_na", false},
	{"test_dect_ft_eth_nd_proxy_pt_add", false},
	{"test_dect_ft_eth_cross_l2_route_packet_ll_src", false},
	{"test_dect_ft_eth_cross_l2_forward_unknown_ll_nbr", false},
	{"test_dect_ft_eth_cross_l2_forward_router_nd_pending", false},
	{"test_dect_ft_eth_nd_proxy_ns_reply", false},
	{"test_dect_ft_eth_nd_proxy_unicast_ns_intercept", false},
#endif
	{"test_dect_ft_conn_mgr_connect", false},
	{"test_dect_ft_conn_mgr_disconnect", false},
	{"test_dect_ft_sink_down_before_pt", false},
	{"test_dect_pt_conn_mgr_connect", false},
	{"test_dect_pt_conn_mgr_disconnect", false}
};

#define NUM_TESTS ARRAY_SIZE(test_results)

/**
 * Helper function to run a test and track its result
 */
#define RUN_TEST_AND_TRACK(test_func, test_index)                                                  \
	do {                                                                                       \
		int tests_before = Unity.TestFailures;                                             \
		RUN_TEST(test_func);                                                               \
		test_results[test_index].passed = (Unity.TestFailures == tests_before);            \
	} while (0)

/**
 * Main function - runs all Unity tests
 */
int main(void)
{
	/* Initialize Unity */
	UNITY_BEGIN();

	printk("=== DECT NR+ Simple Integration Tests ===\n");
	printk("Target: native_sim\n");
	printk("Framework: Unity\n");
	printk("Scope: Basic DECT operations with mocked libmodem\n\n");

	/* Run DECT integration tests with result tracking */
	RUN_TEST_AND_TRACK(test_dect_net_mgmt_invalid_iface_errors, 0);
	RUN_TEST_AND_TRACK(test_dect_configure_callback_failure, 1);
	RUN_TEST_AND_TRACK(test_dect_activation_callback_failure, 2);
	RUN_TEST_AND_TRACK(test_dect_stack_initialization, 3);
	RUN_TEST_AND_TRACK(test_dect_settings_reset_to_defaults, 4);
	RUN_TEST_AND_TRACK(test_dect_scan_request_band1, 5);
	RUN_TEST_AND_TRACK(test_dect_pt_association_request, 6);
	RUN_TEST_AND_TRACK(test_dect_pt_neighbor_list_info_req, 7);
	RUN_TEST_AND_TRACK(test_dect_pt_status_info_req, 8);
	RUN_TEST_AND_TRACK(test_dect_pt_global_address_assign, 9);
	RUN_TEST_AND_TRACK(test_dect_pt_global_address_change, 10);
	RUN_TEST_AND_TRACK(test_dect_pt_global_address_removal, 11);
	RUN_TEST_AND_TRACK(test_dect_pt_association_release, 12);
	RUN_TEST_AND_TRACK(test_dect_association_callback_failure, 13);
	RUN_TEST_AND_TRACK(test_dect_association_rejected, 14);
	RUN_TEST_AND_TRACK(test_dect_deactivate, 15);
	RUN_TEST_AND_TRACK(test_dect_deactivated_requests_fail, 16);
	RUN_TEST_AND_TRACK(test_dect_ft_configuration, 17);
	RUN_TEST_AND_TRACK(test_dect_ft_activate, 18);
	RUN_TEST_AND_TRACK(test_dect_ft_rssi_scan, 19);
	RUN_TEST_AND_TRACK(test_dect_ft_cluster_start, 20);
	RUN_TEST_AND_TRACK(test_dect_ft_cluster_info, 21);
	RUN_TEST_AND_TRACK(test_dect_ft_cluster_stop_returns_enotsup, 22);
	RUN_TEST_AND_TRACK(test_dect_ft_nw_beacon_start, 23);
	RUN_TEST_AND_TRACK(test_dect_ft_nw_beacon_stop, 24);
	RUN_TEST_AND_TRACK(test_dect_ft_cluster_associate_child, 25);
	RUN_TEST_AND_TRACK(test_dect_ft_status, 26);
	RUN_TEST_AND_TRACK(test_dect_ft_cluster_associated_icmp_ping, 27);
	RUN_TEST_AND_TRACK(test_dect_ft_cluster_associated_child_dissociates, 28);
	RUN_TEST_AND_TRACK(test_dect_settings_write_scopes_and_reset, 29);
	/* Intentional reruns: same test functions (deactivate, ft_configuration, ft_activate)
	 * run again; results tracked under test_dect_*_rerun names for summary.
	 */
	RUN_TEST_AND_TRACK(test_dect_deactivate, 30);
	RUN_TEST_AND_TRACK(test_dect_ft_configuration, 31);
	RUN_TEST_AND_TRACK(test_dect_ft_activate, 32);
	RUN_TEST_AND_TRACK(test_dect_ft_network_create, 33);
	RUN_TEST_AND_TRACK(test_dect_ft_cluster_reconfigure, 34);
	RUN_TEST_AND_TRACK(test_dect_ft_sink_global_address_assign, 35);
#if defined(CONFIG_NET_L2_ETHERNET) && !defined(CONFIG_MODEM_CELLULAR)
	/* Bring fake eth up early so ND proxy can run when PT gets GUA (tests 38–39). */
	RUN_TEST_AND_TRACK(test_dect_ft_eth_sink_init, 45);
	RUN_TEST_AND_TRACK(test_dect_ft_eth_upstream_prefix_route, 46);
	RUN_TEST_AND_TRACK(test_dect_ft_eth_unsol_na, 47);
#endif
	RUN_TEST_AND_TRACK(test_dect_ft_sink_router_del, 36);
	RUN_TEST_AND_TRACK(test_dect_ft_sink_router_nbr_del, 37);
	RUN_TEST_AND_TRACK(test_dect_ft_cluster_associate_child_with_global_address, 38);
#if defined(CONFIG_NET_L2_ETHERNET) && !defined(CONFIG_MODEM_CELLULAR)
	/* ND proxy pt_add needs free nbr slots; run before second child (39). */
	RUN_TEST_AND_TRACK(test_dect_ft_eth_nd_proxy_pt_add, 48);
	RUN_TEST_AND_TRACK(test_dect_ft_eth_cross_l2_route_packet_ll_src, 49);
	RUN_TEST_AND_TRACK(test_dect_ft_eth_cross_l2_forward_unknown_ll_nbr, 50);
	RUN_TEST_AND_TRACK(test_dect_ft_eth_cross_l2_forward_router_nd_pending, 51);
	RUN_TEST_AND_TRACK(test_dect_ft_eth_nd_proxy_ns_reply, 52);
	RUN_TEST_AND_TRACK(test_dect_ft_eth_nd_proxy_unicast_ns_intercept, 53);
#endif
	RUN_TEST_AND_TRACK(test_dect_ft_cluster_associate_child_with_global_address_2, 39);
	RUN_TEST_AND_TRACK(test_dect_ft_sink_global_address_change, 40);
	RUN_TEST_AND_TRACK(test_dect_ft_sckt_packet_rx_tx, 41);
	RUN_TEST_AND_TRACK(test_dect_ft_local_multicast_tx, 42);
	RUN_TEST_AND_TRACK(test_dect_ft_network_remove, 43);
	RUN_TEST_AND_TRACK(test_dect_ft_sink_down, 44);
#if defined(CONFIG_NET_L2_ETHERNET) && !defined(CONFIG_MODEM_CELLULAR)
	RUN_TEST_AND_TRACK(test_dect_ft_conn_mgr_connect, 54);
	RUN_TEST_AND_TRACK(test_dect_ft_conn_mgr_disconnect, 55);
	/* Rerun sink_down so L2 removes FT global from DECT iface
	 * (NET_EVENT_IF_DOWN → prefix removed);
	 * then PT conn_mgr_connect sees no stale global.
	 */
	RUN_TEST_AND_TRACK(test_dect_ft_sink_down, 56);
	RUN_TEST_AND_TRACK(test_dect_pt_conn_mgr_connect, 57);
	RUN_TEST_AND_TRACK(test_dect_pt_conn_mgr_disconnect, 58);
#else
	RUN_TEST_AND_TRACK(test_dect_ft_conn_mgr_connect, 45);
	RUN_TEST_AND_TRACK(test_dect_ft_conn_mgr_disconnect, 46);
	/* Rerun sink_down so L2 removes FT global from DECT iface
	 * (NET_EVENT_IF_DOWN → prefix removed);
	 * then PT conn_mgr_connect sees no stale global.
	 */
	RUN_TEST_AND_TRACK(test_dect_ft_sink_down, 47);
	RUN_TEST_AND_TRACK(test_dect_pt_conn_mgr_connect, 48);
	RUN_TEST_AND_TRACK(test_dect_pt_conn_mgr_disconnect, 49);
#endif
	/* TODO more tests & coverity */

	/* Capture Unity statistics before UNITY_END() */
	int total_tests = Unity.NumberOfTests;
	int failed_tests = Unity.TestFailures;
	int passed_tests = total_tests - failed_tests;
	int success_rate_int = total_tests > 0 ? (passed_tests * 100) / total_tests : 0;

	/* Complete and report test results */
	int result = UNITY_END();

	/* Print minimal test summary with detailed test case status */
	printk("\n");
	printk("=== DECT NR+ TEST SUMMARY ===\n");
	printk("Tests: %d | Passed: %d | Failed: %d | Rate: %d%%\n", total_tests, passed_tests,
	       failed_tests, success_rate_int);

	printk("\nTEST CASE RESULTS:\n");
	printk("------------------\n");

	/* Print results based on actual test outcomes */
	for (int i = 0; i < NUM_TESTS; i++) {
		if (test_results[i].passed) {
			printk("\033[32m[PASS]\033[0m %-35s\n", test_results[i].function_name);
		} else {
			printk("\033[31m[FAIL]\033[0m %-35s\n", test_results[i].function_name);
		}
	}

	if (result == 0) {
		printk("\n\033[32mALL TESTS PASSED!\033[0m\n");
		printk("\033[32mComplete DECT lifecycle: Init→Reset→Scan→Associate→"
		       "Release→Deactivate→FT config\033[0m\n");
		/* Twister expects this marker for non-ztest Unity apps. */
		printf("PROJECT EXECUTION SUCCESSFUL\n");
	} else {
		printk("\n\033[31mSOME TESTS FAILED!\033[0m\n");
		printk("\033[33mCheck individual test results above for details\033[0m\n");
		printf("PROJECT EXECUTION FAILED\n");
	}
	printk("==============================\n");

	/* Exit automatically for native_sim - prevents hanging after tests complete */
	printk("Tests completed with result: %d\n", result);

#ifdef CONFIG_BOARD_NATIVE_SIM
	/*
	 * Explicitly terminate the native_sim process so Twister does not wait for
	 * its timeout after tests finish. This also flushes coverage data when
	 * CONFIG_COVERAGE is enabled.
	 */
	fflush(stdout);
	fflush(stderr);
	k_msleep(20);
	posix_exit(result);

	/* Should be unreachable: */
	return 1;
#else
	return result;
#endif
}
```

## src/test_dect_sink_uplink.c
```c
/*
 * Copyright (c) 2026 Nordic Semiconductor ASA
 *
 * SPDX-License-Identifier: LicenseRef-Nordic-5-Clause
 */

#include "test_dect_sink_uplink.h"

#include <string.h>
#include <zephyr/kernel.h>
#include <zephyr/net/net_if.h>
#include <zephyr/net/net_ip.h>
#include <zephyr/net/net_mgmt.h>
#include <route_ipv6.h>
#include <ipv6.h>
#include <nbr.h>
#include <net/dect/dect_net_l2.h>

#if defined(CONFIG_MODEM_CELLULAR)
extern struct net_if *dect_test_get_mock_ppp_net_if(void);
extern int dect_test_mock_ppp_ipv6_unicast_used_count(void);
extern void dect_test_mock_ppp_restore_ipv6_unicast(void);
#endif

#if defined(CONFIG_NET_L2_ETHERNET) && !defined(CONFIG_MODEM_CELLULAR)
extern struct net_if *dect_test_get_mock_eth_net_if(void);
extern int dect_test_mock_eth_na_tx_count(void);
extern int dect_test_mock_eth_ns_tx_count(void);
extern int dect_test_mock_eth_tx_total(void);
extern int dect_test_mock_eth_ipv6_unicast_used_count(void);
extern void dect_test_mock_eth_restore_ipv6_unicast(void);
extern bool dect_sink_status_received;
extern struct dect_sink_status_evt received_sink_status_data;
#endif

/* Sink router / prefix fixtures (same as test_dect_integration.c). */
static const uint8_t test_ipv6_addr_sink_router[16] = {
	0x20, 0x01, 0x0d, 0xb8, 0x00, 0x00, 0x00, 0x00,
	0x00, 0x00, 0x00, 0x00, 0x00, 0x00, 0x00, 0x01
};

struct net_if *test_sink_uplink_if(void)
{
#if defined(CONFIG_MODEM_CELLULAR)
	return dect_test_get_mock_ppp_net_if();
#elif defined(CONFIG_NET_L2_ETHERNET)
	return dect_test_get_mock_eth_net_if();
#else
	return NULL;
#endif
}

void test_sink_uplink_set_up(struct net_if *uplink)
{
	if (uplink == NULL) {
		return;
	}

	net_if_flag_set(uplink, NET_IF_UP);
	net_if_flag_set(uplink, NET_IF_RUNNING);
#if defined(CONFIG_NET_L2_ETHERNET) && !defined(CONFIG_MODEM_CELLULAR)
	net_if_flag_set(uplink, NET_IF_LOWER_UP);
#endif
}

void test_mock_sink_notify_prefix_router_nbr(struct net_if *uplink)
{
	test_mock_sink_notify_prefix_router_nbr_nd_pending(uplink);

#if defined(CONFIG_NET_L2_ETHERNET) && !defined(CONFIG_MODEM_CELLULAR)
	if (uplink != NULL) {
		struct in6_addr router_addr;
		struct net_linkaddr ll = {
			.type = NET_LINK_ETHERNET,
			.len = 6,
			.addr = {0x02, 0x00, 0x00, 0x00, 0x00, 0x01},
		};

		memcpy(router_addr.s6_addr, test_ipv6_addr_sink_router,
		       sizeof(router_addr.s6_addr));
		if (net_if_ipv6_router_find_default(uplink, NULL) == NULL) {
			(void)net_if_ipv6_router_add(uplink, &router_addr, true, 7200);
		}
		(void)net_ipv6_nbr_add(uplink, &router_addr, &ll, true,
				       NET_IPV6_NBR_STATE_REACHABLE);
	}
#endif
}

void test_mock_sink_notify_prefix_router_nbr_nd_pending(struct net_if *uplink)
{
	struct net_event_ipv6_prefix prefix_evt = {
		.len = 64,
		.lifetime = 7200,
	};
	struct in6_addr router_addr;
	struct net_event_ipv6_nbr nbr_evt = { .idx = 0 };

	if (uplink == NULL) {
		return;
	}

#if defined(CONFIG_NET_L2_ETHERNET) && !defined(CONFIG_MODEM_CELLULAR)
	/* Real eth sink ifaces need the delegated GUA in the stack unicast table
	 * (PPP mock seeds mock_ppp_ipv6 manually). Mgmt events alone are not enough
	 * for ROUTER_ADD to match prefix and install the upstream /64 route.
	 */
	dect_test_mock_eth_restore_ipv6_unicast();
#endif

	memcpy(prefix_evt.addr.s6_addr, test_ipv6_addr_sink_router,
	       sizeof(test_ipv6_addr_sink_router));
	net_mgmt_event_notify_with_info(NET_EVENT_IPV6_PREFIX_ADD, uplink, &prefix_evt,
					sizeof(prefix_evt));
	k_sleep(K_MSEC(50));

	memcpy(router_addr.s6_addr, test_ipv6_addr_sink_router, sizeof(test_ipv6_addr_sink_router));
	net_mgmt_event_notify_with_info(NET_EVENT_IPV6_ROUTER_ADD, uplink, &router_addr,
					sizeof(router_addr));
	k_sleep(K_MSEC(50));

#if defined(CONFIG_NET_L2_ETHERNET) && !defined(CONFIG_MODEM_CELLULAR)
	if (net_if_ipv6_router_find_default(uplink, NULL) == NULL) {
		(void)net_if_ipv6_router_add(uplink, (struct net_in6_addr *)&router_addr, true,
					     7200);
	}
#endif

	memcpy(nbr_evt.addr.s6_addr, test_ipv6_addr_sink_router,
	       sizeof(test_ipv6_addr_sink_router));
	net_mgmt_event_notify_with_info(NET_EVENT_IPV6_NBR_ADD, uplink, &nbr_evt, sizeof(nbr_evt));
	k_sleep(K_MSEC(50));
}

bool test_sink_seed_incomplete_nbr(struct net_if *iface, const struct in6_addr *addr)
{
	struct net_nbr *nbr;

	if (iface == NULL || addr == NULL) {
		return false;
	}

	nbr = net_ipv6_nbr_add(iface, addr, NULL, false, NET_IPV6_NBR_STATE_INCOMPLETE);

	return nbr != NULL && nbr->idx == NET_NBR_LLADDR_UNKNOWN;
}

int test_sink_uplink_ipv6_unicast_used_count(struct net_if *uplink)
{
#if defined(CONFIG_MODEM_CELLULAR)
	ARG_UNUSED(uplink);
	return dect_test_mock_ppp_ipv6_unicast_used_count();
#elif defined(CONFIG_NET_L2_ETHERNET)
	return dect_test_mock_eth_ipv6_unicast_used_count();
#else
	ARG_UNUSED(uplink);
	return 0;
#endif
}

void test_sink_uplink_restore_ipv6_unicast(struct net_if *uplink)
{
#if defined(CONFIG_MODEM_CELLULAR)
	ARG_UNUSED(uplink);
	dect_test_mock_ppp_restore_ipv6_unicast();
#elif defined(CONFIG_NET_L2_ETHERNET)
	ARG_UNUSED(uplink);
	dect_test_mock_eth_restore_ipv6_unicast();
#else
	ARG_UNUSED(uplink);
#endif
}

#if defined(CONFIG_NET_L2_ETHERNET) && !defined(CONFIG_MODEM_CELLULAR)

void test_eth_sink_bring_connected(struct net_if *eth_if)
{
	struct net_event_ipv6_addr addr_evt;
	bool need_if_up;

	if (eth_if == NULL) {
		return;
	}

	/*
	 * NET_EVENT_IF_UP on an already-up iface makes the sink emit a spurious
	 * DISCONNECTED status and reschedule RS work; skip when flags are set.
	 */
	need_if_up = !net_if_flag_is_set(eth_if, NET_IF_UP);
	if (need_if_up) {
		net_if_flag_set(eth_if, NET_IF_UP);
		net_if_flag_set(eth_if, NET_IF_RUNNING);
		net_mgmt_event_notify(NET_EVENT_IF_UP, eth_if);
		k_sleep(K_MSEC(100));
	} else {
		test_sink_uplink_set_up(eth_if);
	}

	memcpy(addr_evt.addr.s6_addr, test_ipv6_addr_sink_router,
	       sizeof(test_ipv6_addr_sink_router));
	net_mgmt_event_notify_with_info(NET_EVENT_IPV6_ADDR_ADD, eth_if, &addr_evt,
					sizeof(addr_evt));
	k_sleep(K_MSEC(150));
	test_mock_sink_notify_prefix_router_nbr(eth_if);

	/* Allow deferred sysworkq: upstream route, unsolicited NA, ND proxy. */
	k_sleep(K_MSEC(500));
}

bool test_eth_sink_reset_router_nd_pending(struct net_if *eth_if)
{
	struct in6_addr router_addr;
	struct net_nbr *nbr;
	struct net_ipv6_nbr_data *nbr_data;

	if (eth_if == NULL) {
		return false;
	}

	memcpy(router_addr.s6_addr, test_ipv6_addr_sink_router, sizeof(router_addr.s6_addr));
	(void)net_ipv6_nbr_rm(eth_if, &router_addr);
	test_mock_sink_notify_prefix_router_nbr_nd_pending(eth_if);

	nbr = net_ipv6_nbr_lookup(eth_if, &router_addr);
	if (nbr == NULL) {
		/* net_mgmt events alone do not fill nbr cache; RA without SLLAO does. */
		nbr = net_ipv6_nbr_add(eth_if, &router_addr, NULL, true,
				       NET_IPV6_NBR_STATE_INCOMPLETE);
	}
	if (nbr == NULL) {
		return false;
	}

	nbr_data = net_ipv6_nbr_data(nbr);

	return nbr->idx == NET_NBR_LLADDR_UNKNOWN && nbr_data != NULL &&
	       nbr_data->state == NET_IPV6_NBR_STATE_INCOMPLETE;
}

bool test_eth_sink_wait_na_tx(int baseline, int timeout_ms)
{
	for (int elapsed = 0; elapsed < timeout_ms; elapsed += 50) {
		if (dect_test_mock_eth_na_tx_count() > baseline) {
			return true;
		}
		k_sleep(K_MSEC(50));
	}

	return dect_test_mock_eth_na_tx_count() > baseline;
}

bool test_eth_sink_wait_eth_tx(int baseline, int timeout_ms)
{
	for (int elapsed = 0; elapsed < timeout_ms; elapsed += 50) {
		if (dect_test_mock_eth_tx_total() > baseline) {
			return true;
		}
		k_sleep(K_MSEC(50));
	}

	return dect_test_mock_eth_tx_total() > baseline;
}

bool test_eth_sink_wait_na_tx_count(int min_count, int timeout_ms)
{
	for (int elapsed = 0; elapsed < timeout_ms; elapsed += 50) {
		if (dect_test_mock_eth_na_tx_count() >= min_count) {
			return true;
		}
		k_sleep(K_MSEC(50));
	}

	return dect_test_mock_eth_na_tx_count() >= min_count;
}

/*
 * PT association ND proxy cold-start burst (dect_net_l2_ipv6_pt_eth_nd_proxy_add):
 *   1x NS prime, 1x unicast NA (initial), 1x unsolicited NA (multicast).
 */
bool test_eth_sink_wait_pt_add_nd_proxy_burst(int timeout_ms)
{
	for (int elapsed = 0; elapsed < timeout_ms; elapsed += 50) {
		if (dect_test_mock_eth_ns_tx_count() >= 1 &&
		    dect_test_mock_eth_na_tx_count() >= 2 &&
		    dect_test_mock_eth_tx_total() >= 3) {
			return true;
		}
		k_sleep(K_MSEC(50));
	}

	return dect_test_mock_eth_ns_tx_count() >= 1 &&
	       dect_test_mock_eth_na_tx_count() >= 2 &&
	       dect_test_mock_eth_tx_total() >= 3;
}

#endif /* CONFIG_NET_L2_ETHERNET && !CONFIG_MODEM_CELLULAR */
```

## src/test_dect_sink_uplink.h
```c
/*
 * Copyright (c) 2026 Nordic Semiconductor ASA
 *
 * SPDX-License-Identifier: LicenseRef-Nordic-5-Clause
 *
 * Shared sink uplink helpers for PPP (cellular mock) and Ethernet mock variants.
 */

#ifndef TEST_DECT_SINK_UPLINK_H_
#define TEST_DECT_SINK_UPLINK_H_

#include <zephyr/net/net_if.h>
#include <zephyr/sys/util.h>

BUILD_ASSERT(IS_ENABLED(CONFIG_NET_IPV6),
	     "DECT integration tests require CONFIG_NET_IPV6=y");

#if defined(CONFIG_MODEM_CELLULAR) || defined(CONFIG_NET_L2_ETHERNET)
#define DECT_TEST_HAVE_SINK_UPLINK 1
#endif

extern int test_net_if_start_rs_call_count;

/* Shared "primary DECT test iface" pointer, set by main test suite and used by
 * eth-only tests too. Keep declaration here so a rename/type change breaks all
 * users at compile time.
 */
extern struct net_if *test_iface;

struct net_if *test_sink_uplink_if(void);

void test_sink_uplink_set_up(struct net_if *uplink);
void test_mock_sink_notify_prefix_router_nbr(struct net_if *uplink);
void test_mock_sink_notify_prefix_router_nbr_nd_pending(struct net_if *uplink);

bool test_sink_seed_incomplete_nbr(struct net_if *iface, const struct in6_addr *addr);

int test_sink_uplink_ipv6_unicast_used_count(struct net_if *uplink);
void test_sink_uplink_restore_ipv6_unicast(struct net_if *uplink);

#if defined(CONFIG_NET_L2_ETHERNET) && !defined(CONFIG_MODEM_CELLULAR)
extern int dect_test_mock_eth_ns_tx_count(void);
void test_eth_sink_bring_connected(struct net_if *eth_if);
bool test_eth_sink_reset_router_nd_pending(struct net_if *eth_if);
bool test_eth_sink_wait_na_tx(int baseline, int timeout_ms);
bool test_eth_sink_wait_eth_tx(int baseline, int timeout_ms);
bool test_eth_sink_wait_na_tx_count(int min_count, int timeout_ms);
bool test_eth_sink_wait_pt_add_nd_proxy_burst(int timeout_ms);
#endif

#endif /* TEST_DECT_SINK_UPLINK_H_ */
```

## src/test_dect_utils.h
```c
/*
 * Copyright (c) 2026 Nordic Semiconductor ASA
 *
 * SPDX-License-Identifier: LicenseRef-Nordic-5-Clause
 */

/**
 * @file test_dect_utils.h
 * @brief Common test utilities for DECT integration tests
 *
 * Provides reusable test utilities for DECT network operations such as scanning.
 */

#ifndef TEST_DECT_UTILS_H_
#define TEST_DECT_UTILS_H_

#include <zephyr/net/net_if.h>
#include <net/dect/dect_net_l2_mgmt.h>
#include <nrf_modem_dect.h>

#ifdef __cplusplus
extern "C" {
#endif

/**
 * @brief Beacon simulation parameters for network scan utility
 */
struct test_dect_scan_beacon_params {
	uint16_t channel;		  /* Channel number */
	uint16_t transmitter_short_rd_id; /* Short RD ID */
	uint32_t transmitter_long_rd_id;  /* Long RD ID */
	uint16_t network_id;		  /* Network ID */
	int8_t mcs;			  /* MCS index */
	int8_t transmit_power;		  /* Transmit power [0,15] */
	int8_t rssi_2;			  /* RSSI in dBm */
	int8_t snr;			  /* SNR in dB */
};

/**
 * @brief Network scan result structure
 */
struct test_dect_scan_result {
	bool scan_result_received; /* True if NET_EVENT_DECT_SCAN_RESULT was received */
	bool scan_done_received;   /* True if NET_EVENT_DECT_SCAN_DONE was received */
	enum dect_status_values scan_done_status; /* Scan completion status */
	bool beacon_data_valid;			  /* True if beacon data is valid */
	struct dect_scan_result_evt beacon_data;  /* Received beacon data */
};

/**
 * @brief Association response simulation parameters
 */
struct test_dect_association_response_params {
	bool ack_status;		     /* Association accepted */
	uint8_t number_of_flows;	     /* Number of flows to accept */
	uint8_t number_of_rx_harq_processes; /* Number of RX HARQ processes */
	uint8_t max_number_of_harq_re_rx;    /* Max HARQ retransmissions (RX) */
	uint8_t number_of_tx_harq_processes; /* Number of TX HARQ processes */
	uint8_t max_number_of_harq_re_tx;    /* Max HARQ retransmissions (TX) */
};

/**
 * @brief Association result structure
 */
struct test_dect_association_result {
	bool association_changed_received; /* True if NET_EVENT_DECT_ASSOCIATION_CHANGED rcvd */
	bool association_created_received; /* True if DECT_ASSOCIATION_CREATED event received */
	bool association_failed_received;  /* True if association failed */
	struct dect_association_changed_evt association_data; /* Received association evt data */
	bool network_status_received; /* True if NET_EVENT_DECT_NETWORK_STATUS received */
	struct dect_network_status_evt network_status_data; /* Received nw status event data */
};

/**
 * @brief Perform a DECT network scan with optional beacon simulation
 *
 * This utility function performs a network scan operation and optionally simulates
 * beacon reception. It handles the complete scan workflow:
 * 1. Initiates the scan via net_mgmt API
 * 2. Optionally simulates cluster beacon reception
 * 3. Optionally simulates scan completion
 * 4. Returns scan results
 *
 * @param iface Network interface to use for the scan
 * @param scan_params Scan parameters (band, channels, scan time, etc.)
 * @param beacon_params Optional beacon simulation parameters. If NULL, no beacon
 *                      is simulated.
 * @param simulate_completion If true, simulate scan completion callback.
 *                            If false, caller must handle completion separately.
 * @param result Pointer to result structure to populate. Must not be NULL.
 *
 * @return 0 on success (scan request accepted), negative error code on failure
 */
int test_dect_network_scan(struct net_if *iface, const struct dect_scan_params *scan_params,
			   const struct test_dect_scan_beacon_params *beacon_params,
			   bool simulate_completion, struct test_dect_scan_result *result);

/**
 * @brief Perform a DECT association request with optional completion simulation
 *
 * This utility function performs an association operation and optionally simulates
 * association completion and network joined status. It handles the complete
 * association workflow:
 * 1. Initiates the association via net_mgmt API
 * 2. Optionally simulates association operation completion callback
 * 3. Optionally simulates network joined status event
 * 4. Returns association results
 *
 * @param iface Network interface to use for the association
 * @param target_long_rd_id Long RD ID of the target device to associate with
 * @param response_params Optional association response parameters. If NULL, uses
 *                        default successful response parameters.
 * @param simulate_completion If true, simulate association completion callback.
 *                            If false, caller must handle completion separately.
 * @param simulate_network_joined If true, simulate network joined status event
 *                                 after successful association.
 * @param result Pointer to result structure to populate. Must not be NULL.
 *
 * @return 0 on success (association request accepted), negative error code on failure
 */
int test_dect_association_request(
	struct net_if *iface, uint32_t target_long_rd_id,
	const struct test_dect_association_response_params *response_params,
	bool simulate_completion, bool simulate_network_joined,
	struct test_dect_association_result *result);

/**
 * @brief Get DECT status information (synchronous)
 *
 * This utility function performs a synchronous status info request and returns
 * the current DECT stack status. This is a synchronous operation that does not
 * require callback simulation.
 *
 * @param iface Network interface to use for the status request
 * @param status_info Pointer to status info structure to populate. Must not be NULL.
 *
 * @return 0 on success, negative error code on failure
 */
int test_dect_status_info_get(struct net_if *iface, struct dect_status_info *status_info);

/**
 * @brief Association release result structure
 */
struct test_dect_association_release_result {
	bool association_changed_received; /* True if NET_EVENT_DECT_ASSOCIATION_CHANGED rcvd */
	struct dect_association_changed_evt association_data; /* Received ass event data */
	bool network_status_received; /* True if NET_EVENT_DECT_NETWORK_STATUS received */
	struct dect_network_status_evt network_status_data; /* Received nw status event data */
};

/**
 * @brief Perform a DECT association release request with optional completion simulation
 *
 * This utility function performs an association release operation and optionally simulates
 * association release completion and network unjoined status. It handles the complete
 * association release workflow:
 * 1. Initiates the association release via net_mgmt API
 * 2. Optionally simulates association release operation completion callback
 * 3. Optionally simulates network unjoined status event
 * 4. Returns association release results
 *
 * @param iface Network interface to use for the association release
 * @param target_long_rd_id Long RD ID of the target device to release association with
 * @param simulate_completion If true, simulate association release completion callback.
 *                            If false, caller must handle completion separately.
 * @param simulate_network_unjoined If true, simulate network unjoined status event
 *                                   after successful association release.
 * @param result Pointer to result structure to populate. Must not be NULL.
 *
 * @return 0 on success (association release request accepted), negative error code on failure
 */
int test_dect_association_release(struct net_if *iface, uint32_t target_long_rd_id,
				  bool simulate_completion, bool simulate_network_unjoined,
				  struct test_dect_association_release_result *result);

/**
 * @brief Deactivation result structure
 */
struct test_dect_deactivate_result {
	bool deactivate_done_received; /* True if NET_EVENT_DECT_DEACTIVATE_DONE was received */
	enum dect_status_values deactivate_done_status; /* Deactivation completion status */
};

/**
 * @brief Activation result structure
 */
struct test_dect_activate_result {
	bool activate_done_received; /* True if NET_EVENT_DECT_ACTIVATE_DONE was received */
	enum dect_status_values activate_done_status; /* Activation completion status */
	bool configure_called;		 /* True if nrf_modem_dect_control_configure was called */
	bool functional_mode_set_called; /* True if functional mode set API was called */
};

/**
 * @brief Perform a DECT stack activation request
 *
 * This utility function performs a DECT stack activation operation. It handles the
 * activation workflow:
 * 1. Initiates the activation via net_mgmt API
 * 2. Waits for async activation completion event
 * 3. Returns activation results
 *
 * @param iface Network interface to use for the activation
 * @param wait_timeout_ms Timeout in milliseconds to wait for activation completion.
 *                        If 0, uses default timeout (250ms).
 * @param result Pointer to result structure to populate. Must not be NULL.
 *
 * @return 0 on success (activation request accepted), negative error code on failure
 */
int test_dect_perform_activate(struct net_if *iface, uint32_t wait_timeout_ms,
			       struct test_dect_activate_result *result);

/**
 * @brief Perform a DECT stack deactivation request
 *
 * This utility function performs a DECT stack deactivation operation. It handles the
 * deactivation workflow:
 * 1. Initiates the deactivation via net_mgmt API
 * 2. Waits for async deactivation completion event
 * 3. Returns deactivation results
 *
 * @param iface Network interface to use for the deactivation
 * @param wait_timeout_ms Timeout in milliseconds to wait for deactivation completion.
 *                        If 0, uses default timeout (250ms).
 * @param result Pointer to result structure to populate. Must not be NULL.
 *
 * @return 0 on success (deactivation request accepted), negative error code on failure
 */
int test_dect_perform_deactivate(struct net_if *iface, uint32_t wait_timeout_ms,
				 struct test_dect_deactivate_result *result);

/**
 * @brief RSSI scan result structure
 */
struct test_dect_rssi_scan_result {
	bool rssi_scan_result_received; /* True if NET_EVENT_DECT_RSSI_SCAN_RESULT was rcvd */
	bool rssi_scan_done_received;	/* True if NET_EVENT_DECT_RSSI_SCAN_DONE was rcvd */
	enum dect_status_values rssi_scan_done_status;		/* RSSI scan completion status */
	struct dect_rssi_scan_result_evt rssi_scan_result_data; /* Received RSSI scan results */
};

/**
 * @brief Perform a DECT RSSI scan request
 *
 * This utility function performs a DECT RSSI scan operation. It handles the RSSI scan workflow:
 * 1. Initiates the RSSI scan via net_mgmt API
 * 2. Continues even if net_mgmt returns an error, allowing async completion checks
 * 3. Waits for async RSSI scan result notification (rssi_scan_ntf callback)
 * 4. Captures whether NET_EVENT_DECT_RSSI_SCAN_RESULT is received
 * 5. Waits for async RSSI scan completion (rssi_scan op callback)
 * 6. Captures NET_EVENT_DECT_RSSI_SCAN_DONE status in the result structure
 * 7. Returns collected RSSI scan results
 *
 * @param iface Network interface to use for the RSSI scan
 * @param params Pointer to RSSI scan parameters. Must not be NULL.
 * @param wait_timeout_ms Timeout in milliseconds to wait for RSSI scan completion.
 *                        If 0, uses default timeout (500ms).
 * @param result Pointer to result structure to populate. Must not be NULL.
 *
 * @return 0 on completion, negative error code only for invalid input parameters
 */
int test_dect_perform_rssi_scan(struct net_if *iface, struct dect_rssi_scan_params *params,
				uint32_t wait_timeout_ms,
				struct test_dect_rssi_scan_result *result);

/**
 * @brief Cluster configure result structure
 */
struct test_dect_cluster_configure_result {
	bool cluster_configure_called;
};

/**
 * @brief Perform a DECT cluster configure operation
 *
 * This utility function verifies that cluster configure was called and waits for
 * the async callback to complete. The mock automatically simulates the async callback.
 *
 * @param iface Network interface (unused, kept for consistency with other utilities)
 * @param wait_timeout_ms Timeout in milliseconds to wait for cluster configure completion.
 *                        If 0, uses default timeout (200ms).
 * @param result Pointer to result structure to populate. Must not be NULL.
 *
 * @return 0 on success, negative error code on failure
 */
int test_dect_perform_cluster_configure(struct net_if *iface, uint32_t wait_timeout_ms,
					struct test_dect_cluster_configure_result *result);

#ifdef __cplusplus
}
#endif

#endif /* TEST_DECT_UTILS_H_ */
```
