## CMakeLists.txt
```
# SPDX-License-Identifier: LicenseRef-Nordic-5-Clause

cmake_minimum_required(VERSION 3.20.0)

find_package(Zephyr REQUIRED HINTS $ENV{ZEPHYR_BASE})
project(lfclk_accurcy)

target_sources(app PRIVATE src/common.c src/main.c)
```

## Kconfig
```
#
# Copyright (c) 2026 Nordic Semiconductor ASA
#
# SPDX-License-Identifier: LicenseRef-Nordic-5-Clause
#

source "Kconfig.zephyr"

config TEST_NRFX_HF_CLOCK_DRIVER
	bool "Use NRFX HF clock driver in test"
	default y if SOC_NRF54L05
	default y if SOC_NRF54L10
	default y if SOC_NRF54L15
	default y if SOC_NRF54LM20A
	default y if SOC_NRF54LM20B
	default y if SOC_NRF54LS05A
	default y if SOC_NRF54LS05B
	default y if SOC_NRF54LV10A
	default y if SOC_NRF54LC10A
	select NRFX_CLOCK

config TEST_CC_HF_CLOCK_DRIVER
	bool "Use Clock Control HF clock driver in test"
	default y if SOC_NRF54H20
	default y if SOC_NRF9251
	select CLOCK_CONTROL

config TEST_GRTC_TIMER_INTERVAL_US
	int "GRTC interval [us]"
	default 4000

config TEST_DURATION_MS
	int "Test durations [ms]"
	default 10000

config TEST_ABS_TIMIMG_DEVIATION_US
	int "Maximal measured interval deviation in [us]"
	default 1
```

## prj.conf
```kconfig
CONFIG_NRF_GRTC_TIMER=y

CONFIG_NRFX_TIMER=y
CONFIG_NRFX_GPPI=y

CONFIG_LOG=n
CONFIG_PRINTK=y
```

## boards/nrf54h20dk_nrf54h20_cpuapp.overlay
```dts
&grtc {
	owned-channels = <0 4 5 6>;
};

tst_timer: &timer130 {
	status = "okay";
};

&fll16m {
	status = "okay";
};

&lfclk {
	status = "okay";
};
```

## boards/nrf54l15dk_nrf54l15_cpuapp.overlay
```dts
tst_timer: &timer20 {
	status = "okay";
};
```

## boards/nrf54lc10dk_nrf54lc10a_cpuapp.overlay
```dts
/*
 * Copyright (c) 2026 Nordic Semiconductor ASA
 *
 * SPDX-License-Identifier: LicenseRef-Nordic-5-Clause
 */

tst_timer: &timer20 {
	status = "okay";
};
```

## boards/nrf9251dk_nrf9251_cpuapp.overlay
```dts
/*
 * Copyright (c) 2026 Nordic Semiconductor ASA
 *
 * SPDX-License-Identifier: LicenseRef-Nordic-5-Clause
 */

&grtc {
	/delete-property/ child-owned-channels;
	owned-channels = <0 4 5 6>;
	extended-channels = <0>;
};

tst_timer: &timer130 {
	status = "okay";
};

&fll16m {
	status = "okay";
};

&lfclk {
	status = "okay";
};
```

## src/main.c
```c
/*
 * Copyright (c) 2026, Nordic Semiconductor ASA
 *
 * SPDX-License-Identifier: LicenseRef-Nordic-5-Clause
 */

/* Test information
 * This test measures the GRTC timer intervals
 * with universal timer, which is clocked by precise HFCLOCK.
 *
 * GRTC configuration:
 * GRTC timer is supplied from LFCLOCK.
 * GRTC is operating in an interval mode.
 *
 * DPPI connection setup:
 * NRF_GRTC_EVENT_COMPARE_0 -> NRF_TIMER_TASK_CAPTURE0
 *
 * Test timer operation:
 * Timer is supplied from HFCLOCK (HFXO is required).
 * Universal timer works in a timer mode and captures
 * the CC value (in 'test_timer_values') when NRF_GRTC_EVENT_COMPARE_0 event is generated.
 * Therefore the following timer CC values differences (stored in 'grtc_intervals')
 * holds the measured GRTC timer intervals.
 *
 * Test lasts for 'TEST_DURATION_MS'.
 * Within this time up to 'TEST_DURATION_MS / GRTC_TIMER_INTERVAL_US' intervals are measured.
 * Each interval is assesed, intervals outside
 * of the limits (MAXIMAL_ALLOWED_ABS_TIMIMG_DEVIATION_US) are counted.
 * Test is marked as FAILED if there are intervals outside of the limits.
 *
 * The test setup must be executed as early as possible
 * to catch possible LFCLOCK instabilities:
 * for platfroms without System Controller it is possible in the 'EARLY' stage
 * for platform with System Controller it is possible in the 'APPLICATION' stage
 */

#include "common.h"

nrfx_timer_t test_timer = NRFX_TIMER_INSTANCE(DT_REG_ADDR(DT_NODELABEL(tst_timer)));
NRF_GRTC_Type *grtc_reg = (NRF_GRTC_Type *)DT_REG_ADDR(DT_NODELABEL(grtc));

static timers_control tst_timers_control;
static uint32_t interval_counter;
static volatile int setup_status;

uint32_t test_timer_values[TIMER_VALUES_HOLD_BUFFER_SIZE] = {0};
uint32_t grtc_intervals[TIMER_VALUES_HOLD_BUFFER_SIZE] = {0};

int check_timing(void)
{
	uint64_t min_interval = UINT64_MAX;
	uint64_t max_interval = 0;
	uint64_t current_interval;
	int64_t deviation;
	uint32_t total_intervals = 0;
	uint32_t intervals_outside_of_limits = 0;
	int status = 0;

	for (int i = 0; i < TIMER_VALUES_HOLD_BUFFER_SIZE; i++) {
		if (i < TIMER_VALUES_HOLD_BUFFER_SIZE - 1) {
			if ((test_timer_values[i + 1] > 0) && (test_timer_values[i] > 0)) {
				current_interval = (uint64_t)test_timer_values[i + 1] -
						   (uint64_t)test_timer_values[i];
				current_interval *= 1000000LLU;
				current_interval /= TEST_TIMER_FREQUENCY_HZ;
				if (current_interval > max_interval) {
					max_interval = current_interval;
				}
				if (current_interval < min_interval) {
					min_interval = current_interval;
				}
				deviation = (int64_t)(current_interval - GRTC_TIMER_INTERVAL_US);
				if ((deviation >
				     (int64_t)MAXIMAL_ALLOWED_ABS_TIMIMG_DEVIATION_US) ||
				    (deviation <
				     -(int64_t)MAXIMAL_ALLOWED_ABS_TIMIMG_DEVIATION_US)) {
					intervals_outside_of_limits++;
					status = -1;
				}
				grtc_intervals[i] = (uint32_t)current_interval;
				total_intervals++;
			}
		}
	}

	printk("Summary:\n");
	printk("Configured GRTC interval: %u us\n", GRTC_TIMER_INTERVAL_US);
	printk("Measured GRTC intervals (captured with HFCLK clocked timer operating at %d Hz)\n",
	       TEST_TIMER_FREQUENCY_HZ);
	printk("Total measured intervals: %u\n", total_intervals);
	printk("Intervals outside of the limits: %u\n", intervals_outside_of_limits);
	printk("Minimal interval [us]: %llu\n", min_interval);
	printk("Maximal interval [us]: %llu\n", max_interval);

	if (total_intervals == 0) {
		printk("No intervals measured !\n");
		status = -2;
	}

	return status;
}

static void timer_compare_interrupt_handler(int32_t id, uint64_t expire_time, void *user_data)
{
	uint32_t timer_value = nrfx_timer_capture_get(&test_timer, NRF_TIMER_CC_CHANNEL0);

	/* Safety limit, after the required intervals have been captured
	 * the GRTC timer still runs (until stopped), these excessive intervals
	 * could not be collected, as the will go outside
	 * of the intervals buffer bounds
	 */
	if (interval_counter < TIMER_VALUES_HOLD_BUFFER_SIZE) {
		test_timer_values[interval_counter++] = timer_value;
	}
}

int setup_lfclk_accuracy_test(void)
{

	int ret;
	uint64_t compare_value = 0;
	uint32_t interval_ticks = 0;

	ret = configure_hfclock();
	if (ret != 0) {
		printk("HFCLOCK setup failed\n");
		setup_status = -1;
	}

	tst_timers_control.grtc_channel = z_nrf_grtc_timer_ext_chan_alloc();
	if (tst_timers_control.grtc_channel < 0) {
		printk("Failed to allocate GRTC channel, chan=%d\n",
		       tst_timers_control.grtc_channel);
		setup_status = -2;
	}

	tst_timers_control.grtc_compare_event_address =
		nrfx_grtc_event_compare_address_get(tst_timers_control.grtc_channel);
	tst_timers_control.timer_capture_task_address =
		configure_test_timer(&test_timer, TEST_TIMER_FREQUENCY_HZ);

	ret = nrfx_gppi_conn_alloc(tst_timers_control.grtc_compare_event_address,
				   tst_timers_control.timer_capture_task_address,
				   &tst_timers_control.gppi_handle);
	if (ret != 0) {
		printk("GPPI connection allocation failed\n");
		setup_status = -3;
	}
	nrfx_gppi_conn_enable(tst_timers_control.gppi_handle);

	/* GRTC runs at 1MHz */
	interval_ticks = GRTC_TIMER_INTERVAL_US * 1;

	ret = z_nrf_grtc_timer_interval_set(tst_timers_control.grtc_channel, interval_ticks,
					    interval_ticks, timer_compare_interrupt_handler, NULL);
	if (ret != 0) {
		printk("Unexpected error raised when setting timer, err: %d\n", ret);
		setup_status = -4;
	}

	z_nrf_grtc_timer_compare_read(tst_timers_control.grtc_channel, &compare_value);
	if (K_TIMEOUT_EQ(K_TICKS(interval_ticks), K_TICKS(interval_ticks)) == false) {
		printk("Compare register set failed\n");
		setup_status = -5;
	}
	return 0;
}

int main(void)
{
	int ret;

	printk("Test duration: %d ms\n", TEST_DURATION_MS);
	if (setup_status != 0) {
		printk("Setup status = %d\n", setup_status);
		printk("Tests status: SETUP FAIL\n");
		return -1;
	}
	k_msleep(TEST_DURATION_MS);

	z_nrf_grtc_timer_interval_stop(tst_timers_control.grtc_channel);
	z_nrf_grtc_timer_chan_free(tst_timers_control.grtc_channel);

	ret = check_timing();
	if (ret) {
		printk("Tests status: FAIL\n");
	} else {
		printk("Tests status: PASS\n");
	}

	nrfx_gppi_conn_disable(tst_timers_control.gppi_handle);

	nrfx_gppi_conn_free(tst_timers_control.grtc_compare_event_address,
			    tst_timers_control.timer_capture_task_address,
			    tst_timers_control.gppi_handle);
	return 0;
}

#if defined(CONFIG_TEST_NRFX_HF_CLOCK_DRIVER)
SYS_INIT(setup_lfclk_accuracy_test, EARLY, 5);
#else
SYS_INIT(setup_lfclk_accuracy_test, APPLICATION, 2);
#endif
```

## src/common.c
```c
/*
 * Copyright (c) 2026, Nordic Semiconductor ASA
 *
 * SPDX-License-Identifier: LicenseRef-Nordic-5-Clause
 */

#include "common.h"

#if defined(CONFIG_TEST_CC_HF_CLOCK_DRIVER)

const struct nrf_clock_spec fll16m_bypass_mode = {
	.frequency = MHZ(16),
	.accuracy = 30,
	.precision = NRF_CLOCK_CONTROL_PRECISION_DEFAULT,
};

const struct device *const fll16m_dev = DEVICE_DT_GET(DT_NODELABEL(fll16m));

int request_clock_spec(const struct device *clk_dev, const struct nrf_clock_spec *clk_spec)
{
	int ret = 0;
	int res = 0;
	struct onoff_client cli;
	uint32_t rate;

	printk("Clock: %s, requesting frequency=%d, accuracy=%d, precision=%d\n", clk_dev->name,
	       clk_spec->frequency, clk_spec->accuracy, clk_spec->precision);
	sys_notify_init_spinwait(&cli.notify);
	ret = nrf_clock_control_request(clk_dev, clk_spec, &cli);
	if (!(ret >= 0 && ret <= 2)) {
		return -1;
	}
	do {
		ret = sys_notify_fetch_result(&cli.notify, &res);
		k_yield();
	} while (ret == -EAGAIN);
	if (ret != 0) {
		return -2;
	}
	if (res != 0) {
		return -3;
	}
	ret = clock_control_get_rate(clk_dev, NULL, &rate);
	if (ret != -ENOSYS) {
		if (ret != 0) {
			return -4;
		}
		if (rate != clk_spec->frequency) {
			return -5;
		};
		k_busy_wait(REQUEST_SERVING_WAIT_TIME_US);
	}

	return 0;
}
#endif /* CONFIG_TEST_CC_HF_CLOCK_DRIVER */

uint32_t configure_test_timer(nrfx_timer_t *timer, uint32_t timer_frequency_Hz)
{
	uint32_t base_frequency = NRF_TIMER_BASE_FREQUENCY_GET(timer->p_reg);
	nrfx_timer_config_t timer_config = NRFX_TIMER_DEFAULT_CONFIG(timer_frequency_Hz);

	timer_config.bit_width = NRF_TIMER_BIT_WIDTH_32;
	timer_config.mode = NRF_TIMER_MODE_TIMER;

	printk("Timer base frequency: %d Hz\n", base_frequency);
	printk("Timer configured frequency: %d Hz\n", timer_config.frequency);

	if (nrfx_timer_init(timer, &timer_config, NULL) != 0) {
		printk("Timer init failed\n");
		return -1;
	}
	nrfx_timer_enable(timer);

	return nrfx_timer_task_address_get(timer, NRF_TIMER_TASK_CAPTURE0);
}

int configure_hfclock(void)
{
	int ret = 0;
#if defined(CONFIG_TEST_NRFX_HF_CLOCK_DRIVER)
	nrf_clock_hfclk_t clk_src;

	nrfx_clock_start(NRF_CLOCK_DOMAIN_HFCLK);
	if (nrfx_clock_is_running(NRF_CLOCK_DOMAIN_HFCLK, &clk_src) == false) {
		ret = -1;
	}
#else
	ret = request_clock_spec(fll16m_dev, &fll16m_bypass_mode);
#endif /* CONFIG_TEST_NRFX_HF_CLOCK_DRIVER */
	return ret;
}
```

## src/common.h
```c
/*
 * Copyright (c) 2026, Nordic Semiconductor ASA
 *
 * SPDX-License-Identifier: LicenseRef-Nordic-5-Clause
 */

#include <zephyr/kernel.h>
#include <zephyr/drivers/timer/nrf_grtc_timer.h>
#include <zephyr/devicetree/clocks.h>
#include <zephyr/drivers/clock_control/nrf_clock_control.h>
#include <hal/nrf_grtc.h>
#include <nrfx_timer.h>
#include <nrfx_grtc.h>
#include <helpers/nrfx_gppi.h>

#if defined(CONFIG_TEST_NRFX_HF_CLOCK_DRIVER)
#include <nrfx_clock.h>
#endif

#define REQUEST_SERVING_WAIT_TIME_US		10000
#define TEST_DURATION_MS			CONFIG_TEST_DURATION_MS
#define GRTC_TIMER_INTERVAL_US			CONFIG_TEST_GRTC_TIMER_INTERVAL_US
#define TIMER_VALUES_HOLD_BUFFER_SIZE		(TEST_DURATION_MS * 1000) / GRTC_TIMER_INTERVAL_US
#define TEST_TIMER_FREQUENCY_HZ			MHZ(8)
#define MAXIMAL_ALLOWED_ABS_TIMIMG_DEVIATION_US CONFIG_TEST_ABS_TIMIMG_DEVIATION_US

typedef struct {
	nrfx_gppi_handle_t gppi_handle;
	volatile int32_t grtc_channel;
	volatile uint32_t timer_capture_task_address;
	volatile uint32_t grtc_compare_event_address;
} timers_control;

int request_clock_spec(const struct device *clk_dev, const struct nrf_clock_spec *clk_spec);
uint32_t configure_test_timer(nrfx_timer_t *timer, uint32_t timer_frequency_Hz);
int configure_hfclock(void);
```
