/*
 * Copyright (c) 2026 Nordic Semiconductor ASA
 *
 * SPDX-License-Identifier: LicenseRef-Nordic-5-Clause
 */

&grtc {
	/delete-property/ child-owned-channels;
	owned-channels = <0 4 5 6>;
	extended-channels = <0>;
};

tst_timer: &timer130 {
	status = "okay";
};

&fll16m {
	status = "okay";
};

&lfclk {
	status = "okay";
};
