## tests/drivers/timer/lfclk_accuracy/Kconfig
```kconfig
#
# Copyright (c) 2026 Nordic Semiconductor ASA
#
# SPDX-License-Identifier: LicenseRef-Nordic-5-Clause
#

source "Kconfig.zephyr"

config TEST_NRFX_HF_CLOCK_DRIVER
	bool "Use NRFX HF clock driver in test"
	default y if SOC_NRF54L05
	default y if SOC_NRF54L10
	default y if SOC_NRF54L15
	default y if SOC_NRF54LM20A
	default y if SOC_NRF54LM20B
	default y if SOC_NRF54LS05A
	default y if SOC_NRF54LS05B
	default y if SOC_NRF54LV10A
	select NRFX_CLOCK

config TEST_CC_HF_CLOCK_DRIVER
	bool "Use Clock Control HF clock driver in test"
	default y if SOC_NRF54H20
	select CLOCK_CONTROL

config TEST_GRTC_TIMER_INTERVAL_US
	int "GRTC interval [us]"
	default 4000

config TEST_DURATION_MS
	int "Test durations [ms]"
	default 10000

config TEST_ABS_TIMIMG_DEVIATION_US
	int "Maximal measured interval deviation in [us]"
	default 1
```

## tests/drivers/timer/lfclk_accuracy/testcase.yaml
```yaml
common:
  tags:
    - drivers
    - ci_tests_drivers_timer
  harness: console
  harness_config:
    type: multi_line
    regex:
      - "Tests status: PASS"
  timeout: 45

tests:
  drivers.timer.lfclk_accuracy:
    platform_allow:
      - nrf54h20dk/nrf54h20/cpuapp
      - nrf54l15dk/nrf54l05/cpuapp
      - nrf54l15dk/nrf54l10/cpuapp
      - nrf54l15dk/nrf54l15/cpuapp
      - nrf54lm20dk/nrf54lm20a/cpuapp
      - nrf54lm20dk/nrf54lm20b/cpuapp
      - nrf54ls05dk/nrf54ls05a/cpuapp
      - nrf54ls05dk/nrf54ls05b/cpuapp
      - nrf54lv10dk/nrf54lv10a/cpuapp
    integration_platforms:
      - nrf54l15dk/nrf54l15/cpuapp
    extra_args:
      - CONFIG_TEST_GRTC_TIMER_INTERVAL_US=4000
      - CONFIG_TEST_DURATION_MS=20000
      - CONFIG_TEST_ABS_TIMIMG_DEVIATION_US=1

  drivers.timer.lfclk_accuracy.lfrc_nrf54l:
    platform_allow:
      - nrf54l15dk/nrf54l05/cpuapp
      - nrf54l15dk/nrf54l10/cpuapp
      - nrf54l15dk/nrf54l15/cpuapp
      - nrf54lm20dk/nrf54lm20a/cpuapp
      - nrf54lm20dk/nrf54lm20b/cpuapp
      - nrf54ls05dk/nrf54ls05a/cpuapp
      - nrf54ls05dk/nrf54ls05b/cpuapp
      - nrf54lv10dk/nrf54lv10a/cpuapp
    integration_platforms:
      - nrf54l15dk/nrf54l15/cpuapp
    extra_args:
      - CONFIG_CLOCK_CONTROL_NRF_K32SRC_RC=y
      - CONFIG_TEST_GRTC_TIMER_INTERVAL_US=4000
      - CONFIG_TEST_DURATION_MS=20000
      - CONFIG_TEST_ABS_TIMIMG_DEVIATION_US=150

  drivers.timer.lfclk_accuracy.lfrc_nrf54h:
    platform_allow:
      - nrf54h20dk/nrf54h20/cpuapp
    integration_platforms:
      - nrf54h20dk/nrf54h20/cpuapp
    extra_args:
      - CONFIG_TEST_GRTC_TIMER_INTERVAL_US=4000
      - CONFIG_TEST_DURATION_MS=20000
      - CONFIG_TEST_ABS_TIMIMG_DEVIATION_US=3
    harness: console
    harness_config:
      fixture: lfclk_at_lfrc
      type: multi_line
      regex:
        - "Tests status: PASS"
```

## tests/drivers/uart/uart_async_buffer_test/testcase.yaml
```yaml
common:
  tags:
    - drivers
    - uart
    - ci_tests_drivers_uart
  harness: ztest
  harness_config:
    fixture: gpio_loopback
tests:
  drivers.uart.async_buffer_test:
    platform_allow:
      - nrf54h20dk/nrf54h20/cpuapp
      - nrf54l15dk/nrf54l15/cpuapp
      - nrf54l15dk/nrf54l15/cpuflpr
    integration_platforms:
      - nrf54h20dk/nrf54h20/cpuapp
```

## tests/drivers/uart/uart_baudrate_test/testcase.yaml
```yaml
common:
  tags:
    - drivers
    - uart
    - ci_tests_drivers_uart
  harness: ztest
  harness_config:
    fixture: gpio_loopback
  timeout: 30

tests:
  drivers.uart.baudrate_test.uart120:
    platform_allow:
      - nrf54h20dk/nrf54h20/cpuapp
    integration_platforms:
      - nrf54h20dk/nrf54h20/cpuapp
    extra_args:
      - FILE_SUFFIX=uart120
    extra_configs:
      - CONFIG_PM_DEVICE=y
      - CONFIG_PM_DEVICE_RUNTIME=y
      - CONFIG_CLOCK_CONTROL_NRF_HSFLL_GLOBAL_REQ_LOW_FREQ=n
      - CONFIG_NRFS_LOCAL_DOMAIN_DVFS_SCALE_DOWN_AFTER_INIT=n

  drivers.uart.baudrate_test.uart120.fast:
    platform_allow:
      - nrf9251dk/nrf9251/cpuapp
    integration_platforms:
      - nrf9251dk/nrf9251/cpuapp
    extra_args:
      - FILE_SUFFIX=uart120
    extra_configs:
      - CONFIG_PM_DEVICE=y
      - CONFIG_PM_DEVICE_RUNTIME=y
      - CONFIG_CLOCK_CONTROL_NRF_HSFLL_GLOBAL_REQ_LOW_FREQ=n
      - CONFIG_NRFS_LOCAL_DOMAIN_DVFS_SCALE_DOWN_AFTER_INIT=n
    harness_config:
      fixture: uart_fast_loopback

  drivers.uart.baudrate_test.uart130:
    platform_allow:
      - nrf9251dk/nrf9251/cpuapp
    integration_platforms:
      - nrf9251dk/nrf9251/cpuapp
    extra_args:
      - FILE_SUFFIX=uart130

  drivers.uart.baudrate_test.uart135:
    platform_allow:
      - nrf54h20dk/nrf54h20/cpuapp
    integration_platforms:
      - nrf54h20dk/nrf54h20/cpuapp
    extra_args:
      - FILE_SUFFIX=uart135

  drivers.uart.baudrate_test.uart137:
    platform_allow:
      - nrf54h20dk/nrf54h20/cpuapp
    integration_platforms:
      - nrf54h20dk/nrf54h20/cpuapp
    extra_args:
      - FILE_SUFFIX=uart137

  drivers.uart.baudrate_test.uart00:
    platform_allow:
      - nrf54l15dk/nrf54l15/cpuapp
      - nrf7120dk/nrf7120/cpuapp
    integration_platforms:
      - nrf54l15dk/nrf54l15/cpuapp
    extra_args:
      - FILE_SUFFIX=uart00

  drivers.uart.baudrate_test.lm20_uart00:
    platform_allow:
      - nrf54lm20dk/nrf54lm20a/cpuapp
      - nrf54lm20dk/nrf54lm20b/cpuapp
    integration_platforms:
      - nrf54lm20dk/nrf54lm20b/cpuapp
    extra_args:
      - FILE_SUFFIX=uart00
    harness_config:
      fixture: uart_fast_loopback

  drivers.uart.baudrate_test.uart21:
    platform_allow:
      - nrf54l15dk/nrf54l15/cpuapp
      - nrf54lm20dk/nrf54lm20a/cpuapp
      - nrf54lm20dk/nrf54lm20b/cpuapp
      - nrf54ls05dk/nrf54ls05b/cpuapp
      - nrf54lv10dk/nrf54lv10a/cpuapp
      - nrf54lc10dk/nrf54lc10a/cpuapp
      - nrf7120dk/nrf7120/cpuapp
    integration_platforms:
      - nrf54l15dk/nrf54l15/cpuapp
    extra_args:
      - FILE_SUFFIX=uart21

  drivers.uart.baudrate_test.uart22:
    platform_allow:
      - nrf54l15dk/nrf54l15/cpuapp
      - nrf54lm20dk/nrf54lm20a/cpuapp
      - nrf54lm20dk/nrf54lm20b/cpuapp
      - nrf54ls05dk/nrf54ls05b/cpuapp
      - nrf7120dk/nrf7120/cpuapp
    integration_platforms:
      - nrf54l15dk/nrf54l15/cpuapp
    extra_args:
      - FILE_SUFFIX=uart22

  drivers.uart.baudrate_test.uart1:
    platform_allow:
      - nrf5340dk/nrf5340/cpuapp
    integration_platforms:
      - nrf5340dk/nrf5340/cpuapp
    extra_args:
      - FILE_SUFFIX=uart1
```

## tests/drivers/uart/uart_fifo_flush/testcase.yaml
```yaml
common:
  sysbuild: true
  depends_on: gpio
  tags:
    - drivers
    - uart
    - ci_tests_drivers_uart
  harness: ztest
  harness_config:
    fixture: gpio_loopback

tests:
  drivers.uart.uart_fifo_flush:
    platform_allow:
      - nrf52840dk/nrf52840
      - nrf5340dk/nrf5340/cpuapp
      - nrf54h20dk/nrf54h20/cpuapp
      - nrf54h20dk/nrf54h20/cpuflpr
      - nrf54l15dk/nrf54l15/cpuapp
      - nrf54lm20dk/nrf54lm20a/cpuapp
      - nrf54lm20dk/nrf54lm20b/cpuapp
      - nrf54ls05dk/nrf54ls05a/cpuapp
      - nrf54ls05dk/nrf54ls05b/cpuapp
      - nrf54lv10dk/nrf54lv10a/cpuapp
      - nrf9251dk/nrf9251/cpuapp
    integration_platforms:
      - nrf54l15dk/nrf54l15/cpuapp
  drivers.uart.uart_fifo_flush.fast:
    harness_config:
      fixture: uart_fast_loopback
    platform_allow:
      - nrf9251dk/nrf9251/cpuflpr
    integration_platforms:
      - nrf9251dk/nrf9251/cpuflpr
```

## tests/drivers/uart/uart_instances/testcase.yaml
```yaml
common:
  tags:
    - drivers
    - ci_tests_drivers_uart
  harness: ztest
  timeout: 20

tests:
  drivers.uart.uart_instances:
    platform_allow:
      - nrf54h20dk/nrf54h20/cpuapp
      - nrf54l15dk/nrf54l15/cpuapp
      - nrf54lm20pdk/nrf54lm20a/cpuapp
      - nrf54lm20pdk@0.0.0/nrf54lm20a/cpuapp
      - nrf54lm20pdk@0.2.0/nrf54lm20a/cpuapp
      - nrf54lm20pdk@0.2.0.csp/nrf54lm20a/cpuapp
      - nrf54lv10dk/nrf54lv10a/cpuapp
      - nrf54lv10dk@0.0.0/nrf54lv10a/cpuapp
      - nrf54lv10dk@0.2.0/nrf54lv10a/cpuapp
    integration_platforms:
      - nrf54h20dk/nrf54h20/cpuapp
      - nrf54l15dk/nrf54l15/cpuapp
      - nrf54lm20pdk/nrf54lm20a/cpuapp
      - nrf54lv10dk/nrf54lv10a/cpuapp
```

## tests/drivers/uart/uart_latency/testcase.yaml
```yaml
common:
  sysbuild: true
  depends_on: gpio
  harness: ztest
  harness_config:
    fixture: gpio_loopback
  tags:
    - drivers
    - uart
    - ci_tests_drivers_uart
  timeout: 60

tests:
  drivers.uart.uart_latency.async:
    extra_configs:
      - CONFIG_UART_ASYNC_API=y
    platform_allow:
      - nrf52840dk/nrf52840
      - nrf5340dk/nrf5340/cpuapp
      - nrf54h20dk/nrf54h20/cpuapp
      - nrf54h20dk/nrf54h20/cpuflpr/xip
      - nrf54l15dk/nrf54l15/cpuapp
      - nrf54lm20dk/nrf54lm20a/cpuapp
      - nrf54lm20dk/nrf54lm20b/cpuapp
      - nrf54ls05dk/nrf54ls05a/cpuapp
      - nrf54ls05dk/nrf54ls05b/cpuapp
      - nrf54lv10dk/nrf54lv10a/cpuapp
      - nrf9251dk/nrf9251/cpuapp
    integration_platforms:
      - nrf54h20dk/nrf54h20/cpuapp
  drivers.uart.uart_latency.int_driven:
    extra_configs:
      - CONFIG_UART_INTERRUPT_DRIVEN=y
    platform_allow:
      - nrf52840dk/nrf52840
      - nrf5340dk/nrf5340/cpuapp
      - nrf54h20dk/nrf54h20/cpuapp
      - nrf54h20dk/nrf54h20/cpuflpr/xip
      - nrf54l15dk/nrf54l15/cpuapp
      - nrf54lm20dk/nrf54lm20a/cpuapp
      - nrf54lm20dk/nrf54lm20b/cpuapp
      - nrf54ls05dk/nrf54ls05a/cpuapp
      - nrf54ls05dk/nrf54ls05b/cpuapp
      - nrf54lv10dk/nrf54lv10a/cpuapp
      - nrf9251dk/nrf9251/cpuapp
    integration_platforms:
      - nrf54h20dk/nrf54h20/cpuapp
  drivers.uart.uart_latency.poll:
    extra_configs:
      - CONFIG_UART_ASYNC_API=n
      - CONFIG_UART_INTERRUPT_DRIVEN=n
    platform_allow:
      - nrf52840dk/nrf52840
      - nrf5340dk/nrf5340/cpuapp
      - nrf54h20dk/nrf54h20/cpuapp
      - nrf54h20dk/nrf54h20/cpuflpr/xip
      - nrf54l15dk/nrf54l15/cpuapp
      - nrf54lm20dk/nrf54lm20a/cpuapp
      - nrf54lm20dk/nrf54lm20b/cpuapp
      - nrf54ls05dk/nrf54ls05a/cpuapp
      - nrf54ls05dk/nrf54ls05b/cpuapp
      - nrf54lv10dk/nrf54lv10a/cpuapp
      - nrf9251dk/nrf9251/cpuapp
    integration_platforms:
      - nrf54h20dk/nrf54h20/cpuapp

  drivers.uart.uart_latency.async.fast:
    harness_config:
      fixture: uart_fast_loopback
    extra_configs:
      - CONFIG_UART_ASYNC_API=y
    platform_allow:
      - nrf9251dk/nrf9251/cpuflpr/xip
    integration_platforms:
      - nrf9251dk/nrf9251/cpuflpr/xip
  drivers.uart.uart_latency.int_driven.fast:
    harness_config:
      fixture: uart_fast_loopback
    extra_configs:
      - CONFIG_UART_INTERRUPT_DRIVEN=y
    platform_allow:
      - nrf9251dk/nrf9251/cpuflpr/xip
    integration_platforms:
      - nrf9251dk/nrf9251/cpuflpr/xip
  drivers.uart.uart_latency.poll.fast:
    harness_config:
      fixture: uart_fast_loopback
    extra_configs:
      - CONFIG_UART_ASYNC_API=n
      - CONFIG_UART_INTERRUPT_DRIVEN=n
    platform_allow:
      - nrf9251dk/nrf9251/cpuflpr/xip
    integration_platforms:
      - nrf9251dk/nrf9251/cpuflpr/xip
```

## tests/drivers/uart/uart_mix_fifo_poll/testcase.yaml
```yaml
common:
  tags:
    - drivers
    - uart
    - ci_tests_drivers_uart
  depends_on: gpio
  harness: ztest
  platform_allow:
    - nrf54l09pdk/nrf54l09/cpuapp
  integration_platforms:
    - nrf54l09pdk/nrf54l09/cpuapp
  harness_config:
    fixture: uart_loopback
tests:
  nrf.extended.drivers.uart.uart_mix_poll:
    extra_configs:
      - CONFIG_UART_INTERRUPT_DRIVEN=n
      - CONFIG_UART_ASYNC_API=n
      - CONFIG_UART_0_ENHANCED_POLL_OUT=n

  nrf.extended.drivers.uart.uart_mix_poll_fifo:
    extra_configs:
      - CONFIG_UART_INTERRUPT_DRIVEN=y
      - CONFIG_UART_0_INTERRUPT_DRIVEN=y
      - CONFIG_UART_0_ENHANCED_POLL_OUT=n

  nrf.extended.drivers.uart.uart_mix_poll_async_api:
    extra_configs:
      - CONFIG_UART_ASYNC_API=y
      - CONFIG_UART_0_INTERRUPT_DRIVEN=n
      - CONFIG_UART_0_ASYNC=y
      - CONFIG_UART_0_ENHANCED_POLL_OUT=n

  nrf.extended.drivers.uart.uart_mix_poll_async_api_const:
    extra_args: TEST_CONST_BUFFER=1
    extra_configs:
      - CONFIG_UART_ASYNC_API=y
      - CONFIG_UART_0_INTERRUPT_DRIVEN=n
      - CONFIG_UART_0_ASYNC=y
      - CONFIG_UART_0_ENHANCED_POLL_OUT=n
      - CONFIG_UART_0_TX_CACHE_SIZE=2
    tags: bsim_skip_CI # We skip a few tests to save CI time, as they give little extra coverage

  nrf.extended.drivers.uart.uart_mix_poll_with_ppi:
    extra_configs:
      - CONFIG_UART_INTERRUPT_DRIVEN=n
      - CONFIG_UART_ASYNC_API=n
      - CONFIG_UART_0_ENHANCED_POLL_OUT=y
    platform_allow:
      - nrf52840dk/nrf52840
      - nrf5340dk/nrf5340/cpuapp
      - nrf9160dk/nrf9160

  nrf.extended.drivers.uart.uart_mix_poll_fifo_with_ppi:
    extra_configs:
      - CONFIG_UART_INTERRUPT_DRIVEN=y
      - CONFIG_UART_0_INTERRUPT_DRIVEN=y
      - CONFIG_UART_0_ENHANCED_POLL_OUT=y
    platform_allow:
      - nrf52840dk/nrf52840
      - nrf5340dk/nrf5340/cpuapp
      - nrf9160dk/nrf9160

  nrf.extended.drivers.uart.uart_mix_poll_async_api_with_ppi:
    extra_configs:
      - CONFIG_UART_ASYNC_API=y
      - CONFIG_UART_0_INTERRUPT_DRIVEN=n
      - CONFIG_UART_0_ASYNC=y
      - CONFIG_UART_0_ENHANCED_POLL_OUT=y
    platform_allow:
      - nrf52840dk/nrf52840
      - nrf5340dk/nrf5340/cpuapp
      - nrf9160dk/nrf9160
```

## tests/drivers/uart/uart_mixed_modes/Kconfig
```kconfig
#
# Copyright (c) 2025 Nordic Semiconductor ASA
#
# SPDX-License-Identifier: LicenseRef-Nordic-5-Clause
#

source "Kconfig.zephyr"

config TEST_ASYNC_AND_INT
	bool "Async and int mode uart transmission test"

config TEST_ASYNC_AND_POLL
	bool "Async and poll mode uart transmission test"

config TEST_INT_AND_POLL
	bool "Int and poll mode uart transmission test"
```
