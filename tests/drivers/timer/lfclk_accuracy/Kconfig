## tests/drivers/uart/uart_mixed_modes/testcase.yaml
```yaml
common:
  sysbuild: true
  depends_on: gpio
  tags:
    - drivers
    - uart
    - ci_tests_drivers_uart
  harness_config:
    fixture: gpio_loopback

tests:
  drivers.uart.async_int.nrf54h:
    platform_allow:
      - nrf54h20dk/nrf54h20/cpuapp
    integration_platforms:
      - nrf54h20dk/nrf54h20/cpuapp
    extra_args:
      - CONFIG_ASYNC_AND_INT=y
      - CONFIG_UART_ASYNC_API=y
      - CONFIG_UART_INTERRUPT_DRIVEN=y
      - CONFIG_UART_134_INTERRUPT_DRIVEN=n
      - CONFIG_UART_134_ASYNC=y
      - CONFIG_UART_131_INTERRUPT_DRIVEN=y
      - CONFIG_UART_131_ASYNC=n

  drivers.uart.async_poll.nrf54h:
    platform_allow:
      - nrf54h20dk/nrf54h20/cpuapp
    integration_platforms:
      - nrf54h20dk/nrf54h20/cpuapp
    extra_args:
      - CONFIG_ASYNC_AND_POLL=y
      - CONFIG_UART_ASYNC_API=y
      - CONFIG_UART_INTERRUPT_DRIVEN=n
      - CONFIG_UART_134_ASYNC=y
      - CONFIG_UART_131_ASYNC=n

  drivers.uart.int_poll.nrf54h:
    platform_allow:
      - nrf54h20dk/nrf54h20/cpuapp
    integration_platforms:
      - nrf54h20dk/nrf54h20/cpuapp
    extra_args:
      - CONFIG_INT_AND_POLL=y
      - CONFIG_UART_ASYNC_API=n
      - CONFIG_UART_INTERRUPT_DRIVEN=y
      - CONFIG_UART_134_INTERRUPT_DRIVEN=y
      - CONFIG_UART_131_INTERRUPT_DRIVEN=n

  drivers.uart.async_int.nrf54l:
    platform_allow:
      - nrf54l15dk/nrf54l15/cpuapp
      - nrf54lm20dk/nrf54lm20a/cpuapp
    integration_platforms:
      - nrf54l15dk/nrf54l15/cpuapp
    extra_args:
      - CONFIG_ASYNC_AND_INT=y
      - CONFIG_UART_ASYNC_API=y
      - CONFIG_UART_INTERRUPT_DRIVEN=y
      - CONFIG_UART_21_INTERRUPT_DRIVEN=n
      - CONFIG_UART_21_ASYNC=y
      - CONFIG_UART_22_INTERRUPT_DRIVEN=y
      - CONFIG_UART_22_ASYNC=n

  drivers.uart.async_poll.nrf54l:
    platform_allow:
      - nrf54l15dk/nrf54l15/cpuapp
      - nrf54lm20dk/nrf54lm20a/cpuapp
    integration_platforms:
      - nrf54l15dk/nrf54l15/cpuapp
    extra_args:
      - CONFIG_ASYNC_AND_POLL=y
      - CONFIG_UART_ASYNC_API=y
      - CONFIG_UART_INTERRUPT_DRIVEN=n
      - CONFIG_UART_21_ASYNC=y
      - CONFIG_UART_22_ASYNC=n

  drivers.uart.int_poll.nrf54l:
    platform_allow:
      - nrf54l15dk/nrf54l15/cpuapp
      - nrf54lm20dk/nrf54lm20a/cpuapp
    integration_platforms:
      - nrf54l15dk/nrf54l15/cpuapp
    extra_args:
      - CONFIG_INT_AND_POLL=y
      - CONFIG_UART_ASYNC_API=n
      - CONFIG_UART_INTERRUPT_DRIVEN=y
      - CONFIG_UART_21_INTERRUPT_DRIVEN=y
      - CONFIG_UART_22_INTERRUPT_DRIVEN=n
```

## tests/drivers/uart/uart_passtrough/testcase.yaml
```yaml
common:
  sysbuild: true
  depends_on: gpio
  tags:
    - drivers
    - uart
    - ci_tests_drivers_uart
  harness: pytest
  harness_config:
    pytest_dut_scope: session
  platform_allow:
    - nrf54h20dk/nrf54h20/cpuapp
    - nrf54l15dk/nrf54l15/cpuapp
    - nrf54lm20dk/nrf54lm20a/cpuapp
    - nrf54lv10dk/nrf54lv10a/cpuapp
  integration_platforms:
    - nrf54h20dk/nrf54h20/cpuapp

tests:
  drivers.uart_passtrough: {}
```

## tests/drivers/watchdog/uicr_wdtstart/testcase.yaml
```yaml
common:
  tags:
    - drivers
    - ci_tests_drivers_watchdog
  sysbuild: true
  harness: console
  harness_config:
    type: multi_line
    regex:
      - "UICR.WDTSTART test on nrf54h20dk"
      - "RESET_PIN detected"
      - "Watchdog shall fire in"
      - "RESET_WATCHDOG detected"
      - "WATCHDOG was reconfigured"
      - "3: Watchdog was feed"
      - "WATCHDOG was disabled"
      - "Test is completed"
  timeout: 6
  platform_allow:
    - nrf54h20dk/nrf54h20/cpuapp
  integration_platforms:
    - nrf54h20dk/nrf54h20/cpuapp

tests:
  drivers.watchdog.uicr_wdtstart: {}
  drivers.watchdog.uicr_wdtstart.nrf_gswdt:
    extra_args:
      - FILE_SUFFIX=nrf_gswdt
```

## tests/drivers/watchdog/wdt_instances/testcase.yaml
```yaml
common:
  tags:
    - drivers
    - ci_tests_drivers_watchdog
  harness: ztest
  timeout: 20
  extra_args: SNIPPET="test-watchdog"
  filter: dt_compat_enabled("nordic,nrf-wdt")

tests:
  drivers.watchdog.wdt_instances:
    platform_exclude:
      - mps2/an385
      - mps2/an521/cpu0
      - qemu_cortex_m0/nrf51822
```

## tests/drivers/watchdog/wdt_race_condition/Kconfig.sysbuild
```kconfig
#
# Copyright (c) 2025 Nordic Semiconductor ASA
#
# SPDX-License-Identifier: LicenseRef-Nordic-5-Clause
#

source "share/sysbuild/Kconfig"

config SECOND_CORE
	bool "Run code on another core"
	default y if SOC_NRF54H20_CPUAPP
```

## tests/drivers/watchdog/wdt_sleep/testcase.yaml
```yaml
common:
  tags:
    - drivers
    - ci_tests_drivers_watchdog
  sysbuild: true
  harness: console
  harness_config:
    type: multi_line
    ordered: true
    regex:
      - "WDT Sleep test on"
      - "RESET_PIN detected"
      - "Watchdog did not reset the system while sleeping"
      - "Now we'll stay busy without feeding"
      - "RESET_WATCHDOG detected"
      - "Test is completed"
  platform_allow:
    - nrf54h20dk/nrf54h20/cpuapp
  integration_platforms:
    - nrf54h20dk/nrf54h20/cpuapp

tests:
  drivers.watchdog.wdt_sleep: {}
  drivers.watchdog.wdt_sleep.nrf_gswdt:
    extra_args:
      - FILE_SUFFIX=nrf_gswdt
```

## tests/drivers/watchdog/wdt_soft_reset/Kconfig
```kconfig
#
# Copyright (c) 2025 Nordic Semiconductor ASA
#
# SPDX-License-Identifier: LicenseRef-Nordic-5-Clause
#

source "Kconfig.zephyr"

choice TEST_VARIANT
	prompt "Select reset type"
	default TEST_SOFTWARE_RESET

config TEST_SOFTWARE_RESET
	bool "Test watchdog behavior after software reset"

config TEST_CPU_LOCKUP_RESET
	bool "Test watchdog behavior after cpu lockup reset"

endchoice
```

## tests/drivers/watchdog/wdt_soft_reset/testcase.yaml
```yaml
common:
  tags:
    - drivers
    - ci_tests_drivers_watchdog
  harness: console
  timeout: 20

tests:
  drivers.watchdog.soft_reset:
    harness_config:
      type: multi_line
      ordered: true
      regex:
        - "WDT and software reset test on"
        - "RESET_PIN detected"
        - "Trigger Software reset"
        - "RESET_SOFTWARE detected"
        - "wait for WDT"
        - "RESET_WATCHDOG detected"
        - "Test completed"
    platform_allow:
      - nrf52840dk/nrf52840
      - nrf5340dk/nrf5340/cpuapp
      - nrf5340dk/nrf5340/cpunet
      - nrf54l15dk/nrf54l15/cpuapp
      - nrf54lm20dk/nrf54lm20a/cpuapp
      - nrf54ls05dk/nrf54ls05b/cpuapp
      - nrf54lv10dk/nrf54lv10a/cpuapp
    integration_platforms:
      - nrf54l15dk/nrf54l15/cpuapp
      - nrf54lm20dk/nrf54lm20a/cpuapp
      - nrf54ls05dk/nrf54ls05b/cpuapp
      - nrf54lv10dk/nrf54lv10a/cpuapp

  drivers.watchdog.soft_reset.h20:
    harness_config:
      type: multi_line
      ordered: true
      regex:
        - "WDT and software reset test on"
        - "RESET_PIN detected"
        - "Trigger Software reset"
        - "RESET_SOFTWARE detected"
        - "9000: wait for WDT"
        - "Test completed"
    platform_allow:
      - nrf54h20dk/nrf54h20/cpuapp
      - nrf54h20dk/nrf54h20/cpurad
    integration_platforms:
      - nrf54h20dk/nrf54h20/cpuapp

  drivers.watchdog.cpu_lockup_reset:
    extra_configs:
      - CONFIG_TEST_CPU_LOCKUP_RESET=y
    harness_config:
      type: multi_line
      ordered: true
      regex:
        - "WDT and cpu lockup reset test on"
        - "RESET_PIN detected"
        - "Trigger CPU Lockup reset"
        - "RESET_CPU_LOCKUP detected"
        - "wait for WDT"
        - "RESET_WATCHDOG detected"
        - "Test completed"
    platform_allow:
      - nrf52840dk/nrf52840
      - nrf5340dk/nrf5340/cpuapp
      - nrf5340dk/nrf5340/cpunet
      - nrf54l15dk/nrf54l15/cpuapp
      - nrf54lm20dk/nrf54lm20a/cpuapp
      - nrf54ls05dk/nrf54ls05b/cpuapp
      - nrf54lv10dk/nrf54lv10a/cpuapp
    integration_platforms:
      - nrf54l15dk/nrf54l15/cpuapp
      - nrf54lm20dk/nrf54lm20a/cpuapp
      - nrf54ls05dk/nrf54ls05b/cpuapp
      - nrf54lv10dk/nrf54lv10a/cpuapp

  drivers.watchdog.cpu_lockup_reset.h20:
    extra_configs:
      - CONFIG_TEST_CPU_LOCKUP_RESET=y
    harness_config:
      type: multi_line
      ordered: true
      regex:
        - "WDT and cpu lockup reset test on"
        - "RESET_PIN detected"
        - "Trigger CPU Lockup reset"
        - "RESET_CPU_LOCKUP detected"
        - "9000: wait for WDT"
        - "Test completed"
    platform_allow:
      - nrf54h20dk/nrf54h20/cpuapp
      - nrf54h20dk/nrf54h20/cpurad
    integration_platforms:
      - nrf54h20dk/nrf54h20/cpuapp
```

## tests/lib/at_cmd_custom/testcase.yaml
```yaml
tests:
  at_cmd_custom.functionality_test:
    sysbuild: true
    platform_allow: nrf9160dk/nrf9160/ns
    integration_platforms:
      - nrf9160dk/nrf9160/ns
    tags: at_cmd_custom sysbuild
```

## tests/lib/at_cmd_parser/at_cmd_parser/testcase.yaml
```yaml
tests:
  at_cmd_parser.at_cmd_parser:
    platform_whitelist: qemu_cortex_m3 native_posix
    tags: at_cmd_parser
    skip: true
```

## tests/lib/at_cmd_parser/at_params/testcase.yaml
```yaml
tests:
  at_cmd_parser.at_params:
    sysbuild: true
    platform_allow: qemu_cortex_m3 native_posix
    integration_platforms:
      - qemu_cortex_m3
      - native_posix
    tags: at_cmd_parser sysbuild
```

## tests/lib/at_cmd_parser/at_utils/testcase.yaml
```yaml
tests:
  at_cmd_parser.at_utils:
    platform_whitelist: qemu_cortex_m3 native_posix
    tags: at_cmd_parser
```

## tests/lib/at_custom_cmd/testcase.yaml
```yaml
tests:
  at_custom_cmd.functionality_test:
    platform_allow: nrf9160dk_nrf9160_ns
    integration_platforms:
      - nrf9160dk_nrf9160_ns
    tags: at_custom_cmd
```

## tests/lib/at_parser/testcase.yaml
```yaml
tests:
  at_parser.at_parser:
    sysbuild: true
    platform_allow: native_sim
    integration_platforms:
      - native_sim
    tags: at_parser ci_tests_lib_at_parser
```
