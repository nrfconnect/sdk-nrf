/*
 * Copyright (c) 2026 Nordic Semiconductor ASA
 *
 * SPDX-License-Identifier: LicenseRef-Nordic-5-Clause
 */

/ {
	zephyr,user {
		test-saadc-input0 = <NRF_SAADC_AIN6>; /* P1.06 */
		test-saadc-input1 = <NRF_SAADC_AIN5>; /* P1.05 */
	};
};

&timer131 {
	status = "okay";
};

&adc {
	compatible = "nordic,nrf-saadct";
	status = "okay";
	timer-instance = <&timer131>;
	#address-cells = <1>;
	#size-cells = <0>;
};
