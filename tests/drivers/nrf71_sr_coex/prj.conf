## CMakeLists.txt
```
# SPDX-License-Identifier: LicenseRef-Nordic-5-Clause

cmake_minimum_required(VERSION 3.20.0)
find_package(Zephyr REQUIRED HINTS $ENV{ZEPHYR_BASE})
project(nrf71_sr_coex)

target_sources(app PRIVATE src/main.c)
```

## prj.conf
```kconfig
# Copyright (c) 2026 Nordic Semiconductor ASA
#
# SPDX-License-Identifier: LicenseRef-Nordic-5-Clause
#

# Standalone nRF71 short-range coexistence driver under test.
CONFIG_NRF71_SR_COEX_DRIVER=y

# The nRF71 Wi-Fi driver carries the coexistence messaging, and Bluetooth
# is the short-range radio under test.
CONFIG_WIFI=y
CONFIG_WIFI_NM_WPA_SUPPLICANT=y
CONFIG_BT=y

# Entropy required by the Wi-Fi stack.
CONFIG_ENTROPY_GENERATOR=y
CONFIG_TEST_RANDOM_GENERATOR=y

# Networking (Wi-Fi driver build dependency).
CONFIG_NETWORKING=y
CONFIG_NET_L2_ETHERNET=y
CONFIG_NET_L2_ETHERNET_MGMT=y
CONFIG_NET_MGMT=y
CONFIG_NET_MGMT_EVENT=y

CONFIG_NET_PKT_RX_COUNT=16
CONFIG_NET_PKT_TX_COUNT=16
CONFIG_NET_BUF_RX_COUNT=16
CONFIG_NET_BUF_TX_COUNT=16
CONFIG_HEAP_MEM_POOL_SIZE=230000

# IPC transport to the RPU.
CONFIG_IPC_SERVICE_BACKEND_ICMSG_WQ_ENABLE=y
CONFIG_IPC_SERVICE_BACKEND_ICMSG_WQ_STACK_SIZE=5600

# Logging.
CONFIG_LOG=y
CONFIG_NRF71_SR_COEX_DRIVER_LOG_LEVEL_DBG=y

CONFIG_MAIN_STACK_SIZE=5400
```

## boards/nrf7120dk_nrf7120_cpuapp.overlay
```dts
/*
 * Copyright (c) 2026 Nordic Semiconductor ASA
 *
 * SPDX-License-Identifier: LicenseRef-Nordic-5-Clause
 */

/* Enable PSA RNG for entropy */
/ {
	chosen {
		zephyr,entropy = &psa_rng;
	};

	psa_rng: psa-rng {
		compatible = "zephyr,psa-crypto-rng";
		status = "okay";
	};
};
```

## src/main.c
```c
/* main.c - build-only exercise of the nRF71 SR coexistence driver API */

/*
 * Copyright (c) 2026 Nordic Semiconductor ASA
 *
 * SPDX-License-Identifier: LicenseRef-Nordic-5-Clause
 */

#include <zephyr/kernel.h>
#include <zephyr/sys/printk.h>

#include <drivers/nrf71_sr_coex/nrf71_sr_coex_sr.h>

static int test_sr_enable(bool enable)
{
	ARG_UNUSED(enable);

	return 0;
}

static int test_sr_set_priority(const struct nrf71_sr_coex_sr_prio *prio)
{
	ARG_UNUSED(prio);

	return 0;
}

static const struct nrf71_sr_coex_sr_driver_cb test_sr_cb = {
	.enable = test_sr_enable,
	.set_priority = test_sr_set_priority,
};

/*
 * This test builds the standalone nRF71 SR coexistence driver together with the
 * nRF71 Wi-Fi driver and exercises the public API so the driver links against
 * the Wi-Fi FMAC coexistence transport.
 */
int main(void)
{
	(void)nrf71_sr_coex_sr_register(&test_sr_cb);
	(void)nrf71_sr_coex_sr_power_notify(NRF71_SR_COEX_SR_POWERED_UP_READY);
	(void)nrf71_sr_coex_sr_power_notify(NRF71_SR_COEX_SR_PREPARE_POWER_DOWN);

	printk("nRF71 SR coexistence driver built\n");

	return 0;
}
```
