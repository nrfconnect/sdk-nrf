/*
 * Copyright 2026 Nordic Semiconductor ASA
 * SPDX-License-Identifier: LicenseRef-Nordic-5-Clause
 */

/ {
	mbox_reproducer: mbox-reproducer {
		compatible = "vnd,mbox-consumer";
		mboxes = <&cpuflpr_vevif 16>, <&cpuapp_bellboard 14>;
		mbox-names = "rx", "tx";
	};
};

&cpuflpr_vevif {
	status = "okay";
};

&cpuapp_bellboard {
	status = "okay";
};
