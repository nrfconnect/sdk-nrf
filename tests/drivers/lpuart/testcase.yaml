## tests/drivers/lpuart/testcase.yaml
```yaml
common:
  tags:
    - lpuart
    - sysbuild
    - ci_tests_drivers_lpuart
  timeout: 30

tests:
  lpuart.loopback.nrf54l:
    sysbuild: true
    platform_allow:
      - nrf5340dk/nrf5340/cpuapp
      - nrf54l15dk/nrf54l05/cpuapp
      - nrf54l15dk/nrf54l10/cpuapp
      - nrf54l15dk/nrf54l15/cpuapp
      - nrf54lm20dk/nrf54lm20a/cpuapp
      - nrf54lm20dk/nrf54lm20b/cpuapp
      - nrf54ls05dk/nrf54ls05a/cpuapp
      - nrf54ls05dk/nrf54ls05b/cpuapp
      - nrf54lv10dk/nrf54lv10a/cpuapp
      - nrf54lv10dk/nrf54lv10a/cpuapp/ns
      - nrf54lc10dk/nrf54lc10a/cpuapp
      - nrf54lc10dk/nrf54lc10a/cpuapp/ns
      - nrf7120dk/nrf7120/cpuapp
      - nrf7120dk/nrf7120/cpuapp/ns
      - nrf7120dk/nrf7120e/cpuapp
    integration_platforms:
      - nrf54l15dk/nrf54l15/cpuapp
    extra_configs:
      - CONFIG_TEST_LPUART_LOOPBACK=y
    harness: ztest
    harness_config:
      fixture: gpio_loopback
  lpuart.loopback.int_driven:
    sysbuild: true
    platform_allow:
      - nrf54l15dk/nrf54l05/cpuapp
      - nrf54l15dk/nrf54l10/cpuapp
      - nrf54l15dk/nrf54l15/cpuapp
      - nrf54lm20dk/nrf54lm20a/cpuapp
      - nrf54lm20dk/nrf54lm20b/cpuapp
      - nrf54ls05dk/nrf54ls05a/cpuapp
      - nrf54ls05dk/nrf54ls05b/cpuapp
      - nrf54lv10dk/nrf54lv10a/cpuapp
      - nrf54lv10dk/nrf54lv10a/cpuapp/ns
      - nrf54lc10dk/nrf54lc10a/cpuapp
      - nrf54lc10dk/nrf54lc10a/cpuapp/ns
      - nrf7120dk/nrf7120/cpuapp
      - nrf7120dk/nrf7120/cpuapp/ns
      - nrf7120dk/nrf7120e/cpuapp
    integration_platforms:
      - nrf54l15dk/nrf54l15/cpuapp
    extra_configs:
      - CONFIG_TEST_LPUART_LOOPBACK=y
      - CONFIG_NRF_SW_LPUART_INT_DRIVEN=y
    harness: ztest
    harness_config:
      fixture: gpio_loopback
  lpuart.loopback.nrf54l.busy_sim:
    sysbuild: true
    platform_allow:
      - nrf54l15dk/nrf54l05/cpuapp
      - nrf54l15dk/nrf54l10/cpuapp
      - nrf54l15dk/nrf54l15/cpuapp
      - nrf54lm20dk/nrf54lm20a/cpuapp
      - nrf54lm20dk/nrf54lm20b/cpuapp
      - nrf54ls05dk/nrf54ls05a/cpuapp
      - nrf54ls05dk/nrf54ls05b/cpuapp
      - nrf54lv10dk/nrf54lv10a/cpuapp
      - nrf54lv10dk/nrf54lv10a/cpuapp/ns
      - nrf54lc10dk/nrf54lc10a/cpuapp
      - nrf54lc10dk/nrf54lc10a/cpuapp/ns
      - nrf7120dk/nrf7120/cpuapp
      - nrf7120dk/nrf7120/cpuapp/ns
      - nrf7120dk/nrf7120e/cpuapp
    integration_platforms:
      - nrf54l15dk/nrf54l15/cpuapp
    extra_configs:
      - CONFIG_TEST_LPUART_LOOPBACK=y
      - CONFIG_TEST_BUSY_SIM=y
    harness: ztest
    harness_config:
      fixture: gpio_loopback
  lpuart.user_specific_config:
    sysbuild: true
    platform_allow:
      - nrf54l15dk/nrf54l05/cpuapp
      - nrf54l15dk/nrf54l10/cpuapp
      - nrf54l15dk/nrf54l15/cpuapp
      - nrf54lm20dk/nrf54lm20a/cpuapp
      - nrf54lm20dk/nrf54lm20b/cpuapp
      - nrf54ls05dk/nrf54ls05a/cpuapp
      - nrf54ls05dk/nrf54ls05b/cpuapp
      - nrf54lv10dk/nrf54lv10a/cpuapp
      - nrf54lv10dk/nrf54lv10a/cpuapp/ns
      - nrf54lc10dk/nrf54lc10a/cpuapp
      - nrf54lc10dk/nrf54lc10a/cpuapp/ns
      - nrf7120dk/nrf7120/cpuapp
      - nrf7120dk/nrf7120/cpuapp/ns
      - nrf7120dk/nrf7120e/cpuapp
    integration_platforms:
      - nrf54l15dk/nrf54l15/cpuapp
    extra_configs:
      - CONFIG_UART_INTERRUPT_DRIVEN=y
      - CONFIG_NRF_SW_LPUART_INT_DRIVEN=n
      - CONFIG_TEST_LPUART_LOOPBACK=y
    harness: ztest
    harness_config:
      fixture: gpio_loopback
```

## tests/drivers/saadct/gpio_loopback/Kconfig
```kconfig
#
# Copyright (c) 2026 Nordic Semiconductor ASA
#
# SPDX-License-Identifier: LicenseRef-Nordic-5-Clause
#

menu "SAADCT GPIO Loopback Test Settings"

choice TEST_SAADCT_MODE
	prompt "Select SAADCT Mode"
	default TEST_SAADCT_MODE_ONE_SHOT

config TEST_SAADCT_MODE_ONE_SHOT
	bool "One series is captured and the measurement stops automatically"

config TEST_SAADCT_MODE_CONTINUOUS
	bool "Series are captured continuously until saadct_stop is called"

endchoice

config TEST_SAADCT_STOP_IMMEDIATELY
	bool "When set sampling stops immediately and any incomplete series is discarded"
	depends on TEST_SAADCT_MODE_CONTINUOUS

endmenu

source "Kconfig.zephyr"
```

## tests/drivers/spi/spi_latency/Kconfig
```kconfig
#
# Copyright (c) 2025 Nordic Semiconductor ASA
#
# SPDX-License-Identifier: LicenseRef-Nordic-5-Clause
#

config TEST_MEASUREMENT_REPEATS
	int "Number of latency measurements repeats"
	default 100

config TEST_MAX_BUFFER_SIZE
	int "Maximum SPI transceive buffer size allocated and tested"
	default 512 if SOC_NRF9251_CPUPPR
	default 512 if SOC_NRF54H20_CPUPPR
	default 2000

config TEST_SPI_LATENCY_SHORT_XFER_OVERHEAD_US
	int "Short transfer overhead time for SPI latency measurement"
	default 40 if SOC_SERIES_NRF52
	default 23
	help
	  SPI driver takes semaphore after starting the transfer. Timeout is set and context is
	  switched with interrupts locked. If transfer is short (e.g. 1 byte) then it impacts
	  latency as SPI interrupt handling is delayed. Overhead is applied only to single byte
	  transfers.

config TEST_SPI_LATENCY_LONG_XFER_OVERHEAD_US
	int "Long transfer overhead time for SPI latency measurement"
	default 18
	help
	  When transfer is long then Read-only memory is going to low power mode and waking up
	  impacts interrupt handling latency. Overhead is applied only to long transfers as for
	  short (single byte) there is no time to go to sleep and interrupt handling is not delayed.

config TEST_SPI_LATENCY_BASE_OVERHEAD_US
	int "Base overhead time for SPI latency measurement"
	default 130 if SOC_NRF9251_CPUPPR || SOC_NRF54H20_CPUPPR
	default 77 if SOC_SERIES_NRF52
	default 65 if SOC_NRF5340_CPUAPP
	default 50 if SOC_NRF54LS05B_CPUAPP || SOC_NRF54LS05A_CPUAPP
	default 45 if SOC_NRF7120 || SOC_NRF7120E
	default 40

config TEST_SPI_LATENCY_PER_BYTE_OVERHEAD_US
	int "Overhead time per byte for SPI latency measurement"
	default 2 if RISCV_CORE_NORDIC_VPR && XIP
	default 1 if HAS_NORDIC_DMM
	default 0

source "Kconfig.zephyr"
```

## tests/lib/gcf_sms/testcase.yaml
```yaml
tests:
  gcf_sms.functionality_test:
    sysbuild: true
    platform_allow:
      - nrf9151dk/nrf9151/ns
    integration_platforms:
      - nrf9151dk/nrf9151/ns
    tags:
      - gcf_sms
      - sysbuild
      - ci_tests_lib_gcf_sms
```

## tests/lib/hw_unique_key/testcase.yaml
```yaml
tests:
  lib.hw_unique_key:
    sysbuild: true
    platform_allow:
      - nrf9151dk/nrf9151
      - nrf5340dk/nrf5340/cpuapp
      - nrf52840dk/nrf52840
    integration_platforms:
      - nrf9151dk/nrf9151
      - nrf5340dk/nrf5340/cpuapp
      - nrf52840dk/nrf52840
    tags:
      - huk
      - sysbuild
      - ci_tests_lib_hw_unique_key
```

## tests/nrf_audio/audio_datapath/Kconfig
```kconfig
#
# SPDX-License-Identifier: LicenseRef-Nordic-5-Clause
#

config NRF_AUDIO_DEV
	int
	default 1

config NRF_AUDIO_FRAME_DURATION_US
	int
	default 10000

config NRF_AUDIO_SAMPLE_RATE_48000_HZ
	bool
	default y

config NRF_AUDIO_SAMPLE_RATE_HZ
	int
	default 48000

config NRF_AUDIO_BIT_DEPTH_16
	bool
	default y

config NRF_AUDIO_BIT_DEPTH_BITS
	int
	default 16

config NRF_AUDIO_BIT_DEPTH_OCTETS
	int
	default 2

config NRF_AUDIO_INPUT_CHANNELS
	int
	default 1

config NRF_AUDIO_OUTPUT_CHANNELS
	int
	default 2

config NRF_AUDIO_ENCODE_CHANNELS_MAX
	int
	default 1

config NRF_AUDIO_DECODE_CHANNELS_MAX
	int
	default 1

config NRF_AUDIO_MIN_PRES_DLY_US
	int
	default 3000

config NRF_AUDIO_MAX_PRES_DLY_US
	int
	default 60000

config NRF_AUDIO_BT_PRESENTATION_DELAY_US
	int
	default 10000

config NRF_AUDIO_FIFO_FRAME_SPLIT_NUM
	int
	default 20

config NRF_AUDIO_TX_LEAD_TIME_TGT_US
	int
	default 2500

config NRF_AUDIO_TX_LEAD_TIME_MIN_US
	int
	default 2000

config BT_BUF_EVT_RX_COUNT
	int
	default 10

config BT_BUF_ACL_TX_COUNT
	int
	default 5

module = NRF_AUDIO_DATAPATH
module-str = audio-datapath
source "subsys/logging/Kconfig.template.log_config"

source "Kconfig.zephyr"
```

## tests/nrf_audio/sw_codec_g722/Kconfig
```kconfig
#
# SPDX-License-Identifier: LicenseRef-Nordic-5-Clause
#

choice NRF_AUDIO_SW_CODEC_DEFAULT
	default NRF_AUDIO_SW_CODEC_G722

config NRF_AUDIO_SW_CODEC_G722
	bool "g722"

endchoice

choice NRF_AUDIO_SYSTEM_SAMPLE_RATE
	default NRF_AUDIO_SAMPLE_RATE_48000_HZ
endchoice

config NRF_AUDIO_SAMPLE_RATE_HZ
	default 48000

config NRF_AUDIO_BIT_DEPTH_BITS
	default 16

config NRF_AUDIO_BIT_DEPTH_OCTETS
	default 2

config NRF_AUDIO_FRAME_DURATION_US
	default 10000

config NRF_AUDIO_ENCODE_CHANNELS_MAX
	default 2

config NRF_AUDIO_DECODE_CHANNELS_MAX
	default 2

config NRF_AUDIO_INPUT_CHANNELS
	default 2

config NRF_AUDIO_OUTPUT_CHANNELS
	default 2

config NRF_AUDIO_SW_CODEC_SELECT_LOG_LEVEL
	default 3

config NRF_AUDIO_MONO_TO_ALL_RECEIVERS
	default n

source "$(ZEPHYR_NRF_MODULE_DIR)/applications/nrf_audio/src/audio/Kconfig"
source "Kconfig.zephyr"
```

## tests/psa_crypto/Kconfig
```kconfig
#
# Copyright (c) 2026 Nordic Semiconductor ASA
#
# SPDX-License-Identifier: LicenseRef-Nordic-5-Clause
#

configdefault HW_UNIQUE_KEY_WRITE_ON_CRYPTO_INIT
	default y

source "Kconfig.zephyr"
```

## tests/subsys/bluetooth/fast_pair/locator_tag_legacy/Kconfig.dfu
```kconfig
#
# Copyright (c) 2026 Nordic Semiconductor
#
# SPDX-License-Identifier: LicenseRef-Nordic-5-Clause
#

config APP_DFU
	bool "Enable MCUmgr OTA DFU over Bluetooth"
	depends on BT_PERIPHERAL
	depends on BOOTLOADER_MCUBOOT
	select CRC
	select FLASH
	select FLASH_MAP
	select IMG_MANAGER
	select MCUMGR
	select MCUMGR_GRP_IMG
	select MCUMGR_TRANSPORT_BT
	select NET_BUF
	select STREAM_FLASH
	select ZCBOR
	imply IMG_ERASE_PROGRESSIVELY
	imply MCUMGR_GRP_IMG_REJECT_DIRECT_XIP_MISMATCHED_SLOT if \
		MCUBOOT_BOOTLOADER_MODE_DIRECT_XIP || MCUBOOT_BOOTLOADER_MODE_DIRECT_XIP_WITH_REVERT
	imply MCUMGR_GRP_OS
	imply MCUMGR_GRP_OS_BOOTLOADER_INFO
	imply MCUMGR_GRP_OS_MCUMGR_PARAMS
	imply MCUMGR_TRANSPORT_BT_CONN_PARAM_CONTROL
	imply MCUMGR_TRANSPORT_BT_REASSEMBLY
	help
	  Enable support for Device Firmware Update (DFU) over MCUmgr & SMP BT.

if APP_DFU

config MCUMGR_TRANSPORT_BT_DYNAMIC_SVC_REGISTRATION
	default n

# Access to the SMP characteristic is controlled by the application
# using the custom GATT authorization callback.
choice MCUMGR_TRANSPORT_BT_PERM
	default MCUMGR_TRANSPORT_BT_PERM_RW
endchoice

# Extend the Bluetooth buffers and the L2CAP MTU to speed up the DFU transfer.
config BT_L2CAP_TX_MTU
	default 247 if BT_HCI_HOST

config BT_BUF_ACL_TX_SIZE
	default 251

config BT_BUF_ACL_RX_SIZE
	default 251

config BT_CTLR_DATA_LENGTH_MAX
	default 251 if HAS_BT_CTLR

endif # APP_DFU
```

## tests/subsys/bluetooth/mesh/rpl/Kconfig
```kconfig
#
# Copyright (c) 2026 Nordic Semiconductor ASA
#
# SPDX-License-Identifier: LicenseRef-Nordic-5-Clause
#

config TEST_RPL_UNIT_TEST
	bool
	default y

config BT_MESH_CRPL
	depends on TEST_RPL_UNIT_TEST
	default 8

config BT_MESH_RPL_STORE_TIMEOUT
	depends on TEST_RPL_UNIT_TEST
	default 5

choice BT_MESH_RPL_STORAGE_MODE
	prompt "Replay protection list storage mode"
	default BT_MESH_NRF_RPL_STORAGE_MODE_ZMS if TEST_RPL_UNIT_TEST

config BT_MESH_NRF_RPL_STORAGE_MODE_ZMS
	bool "Persistent storage of RPL in Zephyr Memory Storage"
	depends on TEST_RPL_UNIT_TEST

endchoice

config BT_LOG_LEVEL
	depends on TEST_RPL_UNIT_TEST
	default 0 if TEST_RPL_UNIT_TEST

source "Kconfig.zephyr"
```

## tests/subsys/bootloader/backward_compatibility/v2.8/smp_svr/testcase.yaml
```yaml
common:
  sysbuild: true
  build_only: true
  tags:
    - mcuboot
    - ci_tests_subsys_bootloader

tests:
  # BC-aware update configuration for smp_svr over serial (RSA-2048,
  # swap-using-move). boards/nrf54l15dk_nrf54l15_cpuapp_serial.overlay re-pins
  # the released NCS v2.8 slot geometry so the v2.8 MCUboot on the device
  # accepts and confirms the update image.
  mcuboot.backward_compatibility.v2_8.smp_svr.serial.rsa_swap_move:
    extra_args:
      - FILE_SUFFIX=serial
      - SB_CONFIG_BOOT_SIGNATURE_TYPE_RSA=y
      - SB_CONFIG_MCUBOOT_MODE_SWAP_USING_MOVE=y
    platform_allow:
      - nrf54l15dk/nrf54l15/cpuapp

  mcuboot.backward_compatibility.v2_8.smp_svr.serial:
    platform_allow:
      - nrf54l15dk/nrf54l15/cpuapp

  mcuboot.backward_compatibility.v2_8.smp_svr.serial_recovery:
    extra_args:
      - mcuboot_CONFIG_MCUBOOT_SERIAL=y
      - mcuboot_CONFIG_BOOT_SERIAL_ENTRANCE_GPIO=n
      - mcuboot_CONFIG_BOOT_SERIAL_NO_APPLICATION=y
      - mcuboot_CONFIG_UART_CONSOLE=n
    platform_allow:
      - nrf54l15dk/nrf54l15/cpuapp

  mcuboot.backward_compatibility.v2_8.smp_svr.serial_recovery.progressive_erase:
    extra_args:
      - mcuboot_CONFIG_MCUBOOT_SERIAL=y
      - mcuboot_CONFIG_BOOT_SERIAL_ENTRANCE_GPIO=n
      - mcuboot_CONFIG_BOOT_SERIAL_NO_APPLICATION=y
      - mcuboot_CONFIG_BOOT_ERASE_PROGRESSIVELY=y
      - mcuboot_CONFIG_UART_CONSOLE=n
    platform_allow:
      - nrf54l15dk/nrf54l15/cpuapp
```

## tests/subsys/bootloader/backward_compatibility/v2.8/smp_svr_multicore/modules/bc_marker/zephyr/Kconfig
```kconfig
#
# Copyright (c) 2026 Nordic Semiconductor ASA
#
# SPDX-License-Identifier: LicenseRef-Nordic-5-Clause
#

config BC_MARKER
	bool "Print a build identifier at startup"

config BC_MARKER_ID
	int "Build identifier printed by the marker"
	depends on BC_MARKER
	default 0
```
