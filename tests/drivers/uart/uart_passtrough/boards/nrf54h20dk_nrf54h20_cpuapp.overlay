/*
 * Copyright (c) 2025 Nordic Semiconductor ASA
 *
 * SPDX-License-Identifier: LicenseRef-Nordic-5-Clause
 */

/ {
	chosen {
		uart,passthrough = &uart135;
	};
};

&uart135 {
	compatible = "nordic,nrf-uarte";
	current-speed = <115200>;
	status = "okay";
	memory-regions = <&cpuapp_dma_region>;
	hw-flow-control;
};

&uart136 {
	hw-flow-control;
};
