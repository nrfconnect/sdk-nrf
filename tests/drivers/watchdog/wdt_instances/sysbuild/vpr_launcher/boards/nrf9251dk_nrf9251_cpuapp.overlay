/*
 * Copyright (c) 2026 Nordic Semiconductor ASA
 *
 * SPDX-License-Identifier: LicenseRef-Nordic-5-Clause
 */

&wdt131 {
	status = "reserved";
	interrupt-parent = <&cpuppr_clic>;
};

&wdt132 {
	status = "reserved";
	interrupt-parent = <&cpuflpr_clic>;
};
