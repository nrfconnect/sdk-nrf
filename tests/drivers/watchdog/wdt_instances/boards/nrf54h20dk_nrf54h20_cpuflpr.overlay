/*
 * Copyright (c) 2025 Nordic Semiconductor ASA
 *
 * SPDX-License-Identifier: LicenseRef-Nordic-5-Clause
 */

&wdt132 {
	status = "okay";
};

/* Configure uart120: */

&dma_fast_region {
	status = "okay";
};

&uart120 {
	status = "okay";
	memory-regions = <&dma_fast_region>;
	interrupt-parent = <&cpuflpr_clic>;
};
