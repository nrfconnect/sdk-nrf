/*
 * Copyright (c) 2025 Nordic Semiconductor ASA
 *
 * SPDX-License-Identifier: LicenseRef-Nordic-5-Clause
 */

/ {
	aliases {
		test-counter = &timer24;
	};
};

&wdt31 {
	status = "okay";
};

&timer24 {
	status = "okay";
	prescaler = <4>;
};
