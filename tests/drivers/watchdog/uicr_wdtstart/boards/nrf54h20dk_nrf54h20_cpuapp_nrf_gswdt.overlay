/*
 * Copyright (c) 2026 Nordic Semiconductor ASA
 *
 * SPDX-License-Identifier: LicenseRef-Nordic-5-Clause
 */

/ {
	aliases {
		wdt = &cpuapp_gswdt;
	};
};

&cpuapp_gswdt {
	status = "okay";
};

&cpuapp_cpusys_gswdt_mbox {
	status = "okay";
};
