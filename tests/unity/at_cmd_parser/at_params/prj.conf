## CMakeLists.txt
```
#
# Copyright (c) 2019 Nordic Semiconductor
#
# SPDX-License-Identifier: LicenseRef-BSD-5-Clause-Nordic
#

cmake_minimum_required(VERSION 3.13.1)
include($ENV{ZEPHYR_BASE}/cmake/app/boilerplate.cmake NO_POLICY_SCOPE)
project(test_at_params)

# generate runner for the test
test_runner_generate(src/at_params_test.c)

# add test file
target_sources(app PRIVATE src/at_params_test.c)
target_include_directories(app PRIVATE .)
```

## Kconfig
```
#
# Copyright (c) 2019 Nordic Semiconductor ASA
#
# SPDX-License-Identifier: LicenseRef-BSD-5-Clause-Nordic
#

source "Kconfig.zephyr"
```

## sample.yaml
```
sample:
  description: AT params test
  name: at_params_test
tests:
  test_build:
    build_only: true
    build_on_all: true
    platform_whitelist: native_posix
    tags: ci_build
```

## prj.conf
```kconfig
CONFIG_UNITY=y

# To use k_calloc
CONFIG_HEAP_MEM_POOL_SIZE=1024

# Enable the module under test
CONFIG_AT_CMD_PARSER=y
```

## src/at_params_test.c
```c
/*
 * Copyright (c) 2019 Nordic Semiconductor ASA
 *
 * SPDX-License-Identifier: LicenseRef-BSD-5-Clause-Nordic
 */

#include <unity.h>
#include <at_params.h>
#include <errno.h>

#include "kernel/mock_kernel.h"

void setUp(void)
{
	/* Empty. */
}

void test_at_params_list_init_null_param(void)
{
	int err = at_params_list_init(NULL, 0);
	TEST_ASSERT_EQUAL(-EINVAL, err);
}

void test_at_params_list_init_no_mem(void)
{
	const size_t MAX_PARAMS = 4;

	/* Want a null pointer when allocating memory in the at_params module. */
	__wrap_k_calloc_ExpectAndReturn(MAX_PARAMS, sizeof(struct at_param), NULL);

	struct at_param_list list;
	int err = at_params_list_init(&list, MAX_PARAMS);
	TEST_ASSERT_EQUAL(-ENOMEM, err);
}
```

## src/at_params_test.h
```c
/*
 * Copyright (c) 2019 Nordic Semiconductor ASA
 *
 * SPDX-License-Identifier: LicenseRef-BSD-5-Clause-Nordic
 */

#ifndef AT_PARAMS_TEST_H_
#define AT_PARAMS_TEST_H_

#endif /* AT_PARAMS_TEST_H_ */
```
