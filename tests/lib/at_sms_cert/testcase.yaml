## tests/lib/at_sms_cert/testcase.yaml
```yaml
tests:
  at_sms_cert.functionality_test:
    platform_allow: nrf9160dk_nrf9160_ns
    tags: at_sms_cert
```

## tests/lib/contin_array/Kconfig
```kconfig
# Copyright (c) 2022 Nordic Semiconductor ASA
# SPDX-License-Identifier: LicenseRef-Nordic-5-Clause

config BT_BUF_EVT_RX_COUNT
	default 10

config BT_BUF_ACL_TX_COUNT
	default 8

module = CONTIN_ARRAY
module-str = contin-array
source "subsys/logging/Kconfig.template.log_config"

source "Kconfig.zephyr"
```

## tests/lib/contin_array/testcase.yaml
```yaml
tests:
  nrf5340_audio.contin_array_test:
    sysbuild: true
    platform_allow: qemu_cortex_m3
    integration_platforms:
      - qemu_cortex_m3
    tags: contin_array nrf5340_audio_unit_tests sysbuild
```

## tests/lib/data_fifo/testcase.yaml
```yaml
tests:
  nrf5340_audio.data_fifo_test:
    sysbuild: true
    platform_allow: qemu_cortex_m3
    integration_platforms:
      - qemu_cortex_m3
    tags: data_fifo nrf5340_audio_unit_tests sysbuild
```

## tests/lib/date_time/Kconfig
```kconfig
#
# Copyright (c) 2024 Nordic Semiconductor ASA
#
# SPDX-License-Identifier: LicenseRef-Nordic-5-Clause
#

config DATE_TIME_MODEM
	bool "Get date time from the nRF9160 onboard modem"
	#depends on NRF_MODEM_LIB
	depends on LTE_LINK_CONTROL
	default y
	help
	  Redefinition to disable modemlib requirement from the tests as we want to mock it.

config SNTP
	bool "SNTP (Simple Network Time Protocol)"
	#depends on NET_SOCKETS
	help
	  Redefinition to disable SNTP requirement from the tests. This is because we want to
	  disable SNTP, and DATE_TIME_NTP selects it. NET_SOCKETS dependency must also be removed.

menu "Zephyr Kernel"
source "Kconfig.zephyr"
endmenu
```

## tests/lib/date_time/testcase.yaml
```yaml
tests:
  date_time.unit_test:
    sysbuild: true
    platform_allow: native_sim
    integration_platforms:
      - native_sim
    tags: date_time_unity sysbuild ci_tests_lib_date_time_unity
  date_time.unit_test.no_modem_time:
    sysbuild: true
    platform_allow: native_sim
    integration_platforms:
      - native_sim
    extra_configs:
      - CONFIG_DATE_TIME_MODEM=n
    tags: date_time_unity sysbuild ci_tests_lib_date_time_unity
  date_time.unit_test.no_ntp_time:
    sysbuild: true
    platform_allow: native_sim
    integration_platforms:
      - native_sim
    extra_configs:
      - CONFIG_DATE_TIME_NTP=n
    tags: date_time_unity sysbuild ci_tests_lib_date_time_unity
  date_time.unit_test.no_modem_or_ntp_time:
    sysbuild: true
    platform_allow: native_sim
    integration_platforms:
      - native_sim
    extra_configs:
      - CONFIG_DATE_TIME_MODEM=n
      - CONFIG_DATE_TIME_NTP=n
    tags: date_time_unity sysbuild ci_tests_lib_date_time_unity
```

## tests/lib/edge_impulse/testcase.yaml
```yaml
tests:
  edge_impulse.ei_wrapper:
    sysbuild: true
    platform_exclude: native_posix qemu_x86
    platform_allow:
      - nrf52dk/nrf52832
      - nrf52840dk/nrf52840
      - nrf9160dk/nrf9160/ns
      - qemu_cortex_m3
    integration_platforms:
      - nrf52dk/nrf52832
      - nrf52840dk/nrf52840
      - nrf9160dk/nrf9160/ns
      - qemu_cortex_m3
    tags: edge_impulse sysbuild
    timeout: 420
```

## tests/lib/fprotect/testcase.yaml
```yaml
tests:
  lib.fprotect.sys_init_fprotect:
    platform_allow: nrf9160dk_nrf9160 nrf52840dk_nrf52840 nrf52dk_nrf52832
      nrf5340dk_nrf5340_cpuapp
    tags: fprotect
    harness: console
    harness_config:
      type: multi_line
      ordered: true
      regex:
        - "E: ***** BUS FAULT *****"
        - "E:   Precise data bus error"
```

## tests/lib/gcf_sms/testcase.yaml
```yaml
tests:
  gcf_sms.functionality_test:
    sysbuild: true
    platform_allow: nrf9151dk/nrf9151/ns nrf9160dk/nrf9160/ns nrf9161dk/nrf9161/ns
    integration_platforms:
      - nrf9151dk/nrf9151/ns
      - nrf9160dk/nrf9160/ns
      - nrf9161dk/nrf9161/ns
    tags: gcf_sms sysbuild ci_tests_lib_gcf_sms
```

## tests/lib/hw_id/Kconfig
```kconfig
#
# Copyright (c) 2024 Nordic Semiconductor ASA
#
# SPDX-License-Identifier: LicenseRef-Nordic-5-Clause
#

menu "hw_id test config"
	depends on BOARD_NATIVE_POSIX

config HW_ID_OVERRIDE_FILE
	string "Override file"

endmenu

source "Kconfig.zephyr"
```

## tests/lib/hw_id/testcase.yaml
```yaml
tests:
  hw_id.device_id:
    sysbuild: true
    integration_platforms:
      - native_posix
    platform_allow: native_posix
    tags: ci_build sysbuild
    extra_args:
      - CONFIG_HW_ID_OVERRIDE_FILE="kconfig_override_device_id.h"
  hw_id.uuid:
    sysbuild: true
    integration_platforms:
      - native_posix
    platform_allow: native_posix
    tags: ci_build sysbuild
    extra_args:
      - CONFIG_HW_ID_OVERRIDE_FILE="kconfig_override_uuid.h"
  hw_id.imei:
    sysbuild: true
    integration_platforms:
      - native_posix
    platform_allow: native_posix
    tags: ci_build sysbuild
    extra_args:
      - CONFIG_HW_ID_OVERRIDE_FILE="kconfig_override_imei.h"
  hw_id.ble:
    sysbuild: true
    integration_platforms:
      - native_posix
    platform_allow: native_posix
    tags: ci_build sysbuild
    extra_args:
      - CONFIG_HW_ID_OVERRIDE_FILE="kconfig_override_ble.h"
  hw_id.net:
    sysbuild: true
    integration_platforms:
      - native_posix
    platform_allow: native_posix
    tags: ci_build sysbuild
    extra_args:
      - CONFIG_HW_ID_OVERRIDE_FILE="kconfig_override_net.h"
```

## tests/lib/hw_unique_key/testcase.yaml
```yaml
tests:
  lib.hw_unique_key:
    sysbuild: true
    platform_allow: nrf9160dk/nrf9160 nrf5340dk/nrf5340/cpuapp nrf52840dk/nrf52840
    integration_platforms:
      - nrf9160dk/nrf9160
      - nrf5340dk/nrf5340/cpuapp
      - nrf52840dk/nrf52840
    tags: huk sysbuild ci_tests_lib_hw_unique_key
```

## tests/lib/hw_unique_key_tfm/Kconfig
```kconfig
#
# Copyright (c) 2021 Nordic Semiconductor
#
# SPDX-License-Identifier: LicenseRef-Nordic-5-Clause
#

source "Kconfig.zephyr"

config HUK_TEST_BOARD_SNR
	string "Segger ID of the board to flash KMU values to"
	help
	  This must be the same board as will be flashed with west flash
	  later. The flashing of KMU happens during the build stage, so
	  west flash must be called without --erase as to not erase the KMU.
```

## tests/lib/hw_unique_key_tfm/testcase.yaml
```yaml
tests:
  lib.hw_unique_key_tfm:
    sysbuild: true
    platform_allow:
      - nrf9151dk/nrf9151/ns
      - nrf9160dk/nrf9160/ns
      - nrf9161dk/nrf9161/ns
      - nrf5340dk/nrf5340/cpuapp/ns
    integration_platforms:
      - nrf9151dk/nrf9151/ns
      - nrf9160dk/nrf9160/ns
      - nrf9161dk/nrf9161/ns
      - nrf5340dk/nrf5340/cpuapp/ns
    tags: huk sysbuild
    build_only: true
```

## tests/lib/location/Kconfig
```kconfig
#
# Copyright (c) 2022 Nordic Semiconductor ASA
#
# SPDX-License-Identifier: LicenseRef-Nordic-5-Clause
#

config LOCATION_TEST_AGNSS
	bool "USe A-GNSS configuration for Location library tests"
	default y

config LOCATION_METHOD_GNSS
	bool "Internal"
	#depends on NRF_MODEM_LIB
	depends on LTE_LINK_CONTROL
	default y
	help
	  Redefinition to disable modemlib requirement from the tests as we want to mock it.

config LOCATION_METHOD_CELLULAR
	bool "Internal"
	#depends on NRF_MODEM_LIB
	depends on LTE_LINK_CONTROL
	default y
	help
	  Redefinition to disable modemlib requirement from the tests as we want to mock it.

config LOCATION_METHOD_WIFI
	bool "Internal"
	#depends on WIFI
	select NET_MGMT if LOCATION_METHOD_WIFI_NET_MGMT
	select NET_MGMT_EVENT if LOCATION_METHOD_WIFI_NET_MGMT
	select NET_MGMT_EVENT_INFO if LOCATION_METHOD_WIFI_NET_MGMT
	select NET_L2_WIFI_MGMT if LOCATION_METHOD_WIFI_NET_MGMT
	help
	  Redefinition to disable Wi-Fi requirement from the tests as we want to mock it.

config LOCATION_METHOD_WIFI_NET_MGMT
	bool
	default n
	help
	  Used in tests to enable mocking of Wi-Fi.

config LOCATION_REST_CLIENT
	bool
	default n
	help
	  Used in tests to enable mocking of REST client library.

config LOCATION_MODEM_KEY_MGMT
	bool
	default n
	help
	  Used in tests to enable mocking of Modem key management library.

menu "Zephyr Kernel"
source "Kconfig.zephyr"
endmenu
```

## tests/lib/location/sample.yaml
```yaml
sample:
  description: Location Library Unity/Cmock test
  name: location_lib_unity_test
```

## tests/lib/location/testcase.yaml
```yaml
tests:
  unity.location_test:
    sysbuild: true
    tags: location sysbuild
    platform_allow: native_posix
    integration_platforms:
      - native_posix
  unity.location_test.no_agnss:
    sysbuild: true
    tags: location_no_agnss sysbuild
    platform_allow: native_posix
    integration_platforms:
      - native_posix
    extra_configs:
      - CONFIG_LOCATION_TEST_AGNSS=n
  unity.location_test.no_wifi:
    sysbuild: true
    tags: location_no_wifi sysbuild
    platform_allow: native_posix
    integration_platforms:
      - native_posix
    extra_configs:
      - CONFIG_LOCATION_METHOD_WIFI=n
  unity.location_test.service_external:
    sysbuild: true
    tags: location_service_external sysbuild
    platform_allow: native_posix
    integration_platforms:
      - native_posix
    extra_configs:
      - CONFIG_LOCATION_SERVICE_EXTERNAL=y
      - CONFIG_LOCATION_SERVICE_HERE=n
      - CONFIG_LOCATION_SERVICE_HERE_API_KEY=""
  unity.location_test.data_details:
    sysbuild: true
    tags: location_data_details sysbuild
    platform_allow: native_posix
    integration_platforms:
      - native_posix
    extra_configs:
      - CONFIG_LOCATION_DATA_DETAILS=y
```

## tests/lib/lte_lc/boards/qemu_x86.conf
```kconfig
#
# Copyright (c) 2021 Nordic Semiconductor
#
# SPDX-License-Identifier: LicenseRef-Nordic-5-Clause
#

CONFIG_NEWLIB_LIBC=y
CONFIG_FPU=y
CONFIG_SSE=y
```

## tests/lib/lte_lc/testcase.yaml
```yaml
tests:
  lte_lc.functionality_test:
    sysbuild: true
    platform_allow: native_sim
    integration_platforms:
      - native_sim
    tags: lte_lc sysbuild ci_tests_lib_lte_lc
```

## tests/lib/lte_lc_api/testcase.yaml
```yaml
tests:
  lte_lc_api.unit_test:
    sysbuild: true
    tags:
      - lte_lc_api
      - sysbuild
      - ci_tests_lib_lte_lc
    platform_allow: native_sim
    integration_platforms:
      - native_sim
```

## tests/lib/lte_lc_pdn/testcase.yaml
```yaml
tests:
  lte_lc_pdn.unit_test:
    sysbuild: true
    tags:
      - lte_lc
      - pdn
      - sysbuild
      - ci_tests_lib_lte_lc
    platform_allow: native_sim
    integration_platforms:
      - native_sim
```

## tests/lib/modem_battery/testcase.yaml
```yaml
tests:
  modem_battery.unit_test:
    sysbuild: true
    tags:
      - modem_battery
      - sysbuild
      - ci_tests_lib_modem_battery
    platform_allow: native_sim
    integration_platforms:
      - native_sim
```

## tests/lib/modem_info/testcase.yaml
```yaml
tests:
  modem_info.unit_test:
    sysbuild: true
    tags: modem_info sysbuild ci_tests_lib_modem_info
    platform_allow: native_posix
    integration_platforms:
      - native_posix
```

## tests/lib/modem_jwt/testcase.yaml
```yaml
tests:
  unity.modem_jwt:
    sysbuild: true
    platform_allow: qemu_cortex_m3 native_posix
    integration_platforms:
      - qemu_cortex_m3
      - native_posix
    tags: jwt sysbuild
```

## tests/lib/modem_key_mgmt/testcase.yaml
```yaml
tests:
  modem_key_mgmt.unit_test:
    sysbuild: true
    tags:
      - modem_key_mgmt
      - sysbuild
      - ci_tests_lib_modem_key_mgmt
    platform_allow: native_sim
    integration_platforms:
      - native_sim
```
