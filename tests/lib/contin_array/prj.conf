## CMakeLists.txt
```
#
# Copyright (c) 2018 Nordic Semiconductor ASA
#
# SPDX-License-Identifier: LicenseRef-Nordic-5-Clause
#

cmake_minimum_required(VERSION 3.20.0)

find_package(Zephyr REQUIRED HINTS $ENV{ZEPHYR_BASE})
project(contin_array)

FILE(GLOB app_sources src/*.c)
target_sources(app PRIVATE ${app_sources})

target_include_directories(app PRIVATE ./src)

target_compile_options(app
  PRIVATE
  -DCONFIG_BT_BUF_EVT_RX_COUNT=10
  -DCONFIG_BT_BUF_ACL_TX_COUNT=8
  )
```

## Kconfig
```
# Copyright (c) 2022 Nordic Semiconductor ASA
# SPDX-License-Identifier: LicenseRef-Nordic-5-Clause

config BT_BUF_EVT_RX_COUNT
	default 10

config BT_BUF_ACL_TX_COUNT
	default 8

module = CONTIN_ARRAY
module-str = contin-array
source "subsys/logging/Kconfig.template.log_config"

source "Kconfig.zephyr"
```

## prj.conf
```kconfig
CONFIG_ZTEST=y
CONFIG_IRQ_OFFLOAD=y
CONFIG_NET_BUF=y
CONFIG_CONTIN_ARRAY=y
```

## src/main.c
```c
/*
 * Copyright (c) 2018 Nordic Semiconductor ASA
 *
 * SPDX-License-Identifier: LicenseRef-Nordic-5-Clause
 */

#include <zephyr/ztest.h>
#include <errno.h>
#include <zephyr/tc_util.h>
#include <contin_array.h>

ZTEST_SUITE(suite_contin_array, NULL, NULL, NULL, NULL, NULL);
ZTEST_SUITE(suite_contin_array_chan, NULL, NULL, NULL, NULL, NULL);
```

## src/array_test.c
```c
/*
 * Copyright (c) 2025 Nordic Semiconductor ASA
 *
 * SPDX-License-Identifier: LicenseRef-Nordic-5-Clause
 */

#include <zephyr/ztest.h>
#include <errno.h>
#include <zephyr/tc_util.h>
#include <contin_array.h>
#include "array_test_data.h"

ZTEST(suite_contin_array, test_simp_arr_loop)
{
	const uint32_t NUM_ITERATIONS = 200;
	const size_t CONTIN_ARR_SIZE = 97; /* Test with random "uneven" value */
	const uint32_t CONTIN_LAST_VAL_IDX = (CONTIN_ARR_SIZE - 1);
	const size_t const_arr_size = ARRAY_SIZE(test_arr);
	char contin_arr[CONTIN_ARR_SIZE];
	int ret;

	uint8_t contin_first_val;
	uint8_t contin_last_val;
	uint32_t finite_pos = 0;

	for (int i = 0; i < NUM_ITERATIONS; i++) {
		contin_first_val = test_arr[finite_pos];

		ret = contin_array_create(contin_arr, CONTIN_ARR_SIZE, test_arr, const_arr_size,
					  &finite_pos);
		zassert_equal(ret, 0, "contin_array_create did not return zero");

		if (finite_pos) {
			contin_last_val = test_arr[finite_pos - 1];
		} else {
			contin_last_val = test_arr[const_arr_size - 1];
		}

		zassert_equal(contin_arr[0], contin_first_val, "First value is not identical");
		zassert_equal(contin_arr[CONTIN_LAST_VAL_IDX], contin_last_val,
			      "Last value is not identical");
	}
}

/* Test with const array size being shorter than contin array size */
ZTEST(suite_contin_array, test_simp_arr_loop_short)
{
	int ret;
	const uint32_t NUM_ITERATIONS = 200;
	const size_t CONTIN_ARR_SIZE = 97; /* Test with random "uneven" value */
	const uint32_t CONTIN_LAST_VAL_IDX = (CONTIN_ARR_SIZE - 1);
	/* Test with random "uneven" value, shorter than CONTIN_ARR_SIZE */
	const size_t const_arr_size = 44;
	char contin_arr[CONTIN_ARR_SIZE];
	uint8_t contin_first_val;
	uint8_t contin_last_val;
	uint32_t finite_pos = 0;

	for (int i = 0; i < NUM_ITERATIONS; i++) {
		if (finite_pos > (const_arr_size - 1)) {
			contin_first_val = test_arr[0];
		} else {
			contin_first_val = test_arr[finite_pos];
		}

		ret = contin_array_create(contin_arr, CONTIN_ARR_SIZE, test_arr, const_arr_size,
					  &finite_pos);
		zassert_equal(ret, 0, "Contin_array_create did not return zero");

		if (finite_pos) {
			contin_last_val = test_arr[finite_pos - 1];
		} else {
			contin_last_val = test_arr[const_arr_size - 1];
		}

		zassert_equal(contin_arr[0], contin_first_val,
			      "%d: First value is not identical: %d vs %d (%d %d)", i,
			      contin_arr[0], contin_first_val, finite_pos, const_arr_size);
		zassert_equal(contin_arr[CONTIN_LAST_VAL_IDX], contin_last_val,
			      "Last value is not identical");
	}
}
```

## src/array_test_chan.c
```c
/*
 * Copyright (c) 2025 Nordic Semiconductor ASA
 *
 * SPDX-License-Identifier: LicenseRef-Nordic-5-Clause
 */
#include <zephyr/ztest.h>
#include <errno.h>
#include <stdlib.h>
#include <stdio.h>
#include <ctype.h>
#include <zephyr/kernel.h>
#include <zephyr/tc_util.h>
#include <audio_defines.h>
#include <contin_array.h>

#include "array_test_data.h"

static struct audio_metadata test_meta = {.data_coding = PCM,
					  .data_len_us = 10000,
					  .sample_rate_hz = 48000,
					  .bits_per_sample = 16,
					  .carried_bits_per_sample = 16,
					  .bytes_per_location = ARRAY_SIZE(test_arr),
					  .interleaved = CONTIN_TEST_DEINTERLEAVED,
					  .locations = BT_AUDIO_LOCATION_FRONT_LEFT,
					  .ref_ts_us = 0,
					  .data_rx_ts_us = 0,
					  .bad_data = false};

NET_BUF_POOL_FIXED_DEFINE(pool_contin, CONTIN_TEST_POOL_CONTIN_NUM, CONTIN_TEST_POOL_CONTIN_SIZE,
			  (sizeof(struct audio_metadata)), NULL);
NET_BUF_POOL_FIXED_DEFINE(pool_finite, CONTIN_TEST_POOL_FINITE_NUM, ARRAY_SIZE(test_arr),
			  sizeof(struct audio_metadata), NULL);

/* Test continuous array by setting a single channel in the output with the tone */
static void test_contin(uint8_t bits_per_samp, uint8_t carrier_bits, uint8_t contin_locs,
			uint8_t locs_out, bool interleaved, bool filled, size_t iterations)
{
	int ret;
	struct net_buf *pcm_contin;
	struct net_buf *pcm_finite;
	struct audio_metadata *meta_contin;
	struct audio_metadata *meta_finite;
	uint8_t const *pcm_finite_buf = test_arr;
	uint8_t num_loc;
	uint8_t carrier_bytes = carrier_bits / 8;
	uint16_t finite_pos = 0;
	uint16_t finite_start;

	for (size_t i = 0; i < iterations; i++) {
		finite_start = finite_pos;

		pcm_contin = net_buf_alloc(&pool_contin, K_NO_WAIT);

		meta_contin = net_buf_user_data(pcm_contin);
		memcpy(meta_contin, &test_meta, sizeof(struct audio_metadata));
		meta_contin->bits_per_sample = bits_per_samp;
		meta_contin->carried_bits_per_sample = carrier_bits;
		meta_contin->interleaved = interleaved;
		meta_contin->locations = contin_locs;
		num_loc = audio_metadata_num_loc_get(meta_contin);
		meta_contin->bytes_per_location = pcm_contin->size / num_loc;

		if (filled) {
			/* Fill all channels in the net_nuf with a known value for testing that the
			 * function only writes to the required location(s) and no others.
			 */
			memset(pcm_contin->data, CONTIN_TEST_BYTE, pcm_contin->size);
			net_buf_add(pcm_contin, meta_contin->bytes_per_location * num_loc);
		} else {
			memset(pcm_contin->data, 0, pcm_contin->size);
		}

		ret = contin_array_buf_create(pcm_contin, pcm_finite_buf, ARRAY_SIZE(test_arr),
					      locs_out, &finite_pos);
		zassert_equal(ret, 0, "contin_array_buf_create did not return zero: %d", ret);

		validate_contin_array(pcm_contin, pcm_finite_buf, locs_out, finite_start,
				      finite_pos, interleaved, filled);

		net_buf_unref(pcm_contin);
	}

	/* Test with two net_bufs */
	finite_pos = 0;

	pcm_finite = net_buf_alloc(&pool_finite, K_NO_WAIT);
	net_buf_add_mem(pcm_finite, (uint8_t *)test_arr, ARRAY_SIZE(test_arr));

	meta_finite = net_buf_user_data(pcm_finite);
	memcpy(meta_finite, &test_meta, sizeof(struct audio_metadata));
	meta_finite->bits_per_sample = bits_per_samp;
	meta_finite->carried_bits_per_sample = carrier_bits;
	meta_finite->interleaved = interleaved;
	meta_finite->bytes_per_location = ARRAY_SIZE(test_arr);
	meta_finite->locations = BT_AUDIO_LOCATION_MONO_AUDIO;

	for (size_t i = 0; i < iterations; i++) {
		finite_start = finite_pos;

		pcm_contin = net_buf_alloc(&pool_contin, K_NO_WAIT);

		meta_contin = net_buf_user_data(pcm_contin);
		memcpy(meta_contin, &test_meta, sizeof(struct audio_metadata));
		meta_contin->bits_per_sample = bits_per_samp;
		meta_contin->carried_bits_per_sample = carrier_bits;
		carrier_bytes = carrier_bits / 8;
		meta_contin->interleaved = interleaved;
		meta_contin->locations = contin_locs;
		num_loc = audio_metadata_num_loc_get(meta_contin);
		meta_contin->bytes_per_location = pcm_contin->size / num_loc;

		if (filled) {
			/* Fill all channels in the net_nuf with a known value for testing that the
			 * function only writes to the required location(s) and no others.
			 */
			memset(pcm_contin->data, CONTIN_TEST_BYTE, pcm_contin->size);
			net_buf_add(pcm_contin, meta_contin->bytes_per_location * num_loc);
		} else {
			memset(pcm_contin->data, 0, pcm_contin->size);
		}

		ret = contin_array_net_buf_create(pcm_contin, pcm_finite, locs_out, &finite_pos);
		zassert_equal(ret, 0, "contin_array_buf_create did not return zero: %d", ret);

		validate_contin_array(pcm_contin, pcm_finite->data, locs_out, finite_start,
				      finite_pos, interleaved, filled);

		net_buf_unref(pcm_contin);
	}

	net_buf_unref(pcm_finite);
}

/* Test continuous array formation for de-interleaved net_buffers */
ZTEST(suite_contin_array_chan, test_contin_deint_empty_loop)
{
	test_contin(TEST_BITS_8, TEST_BITS_8, BT_AUDIO_LOCATION_MONO_AUDIO,
		    BT_AUDIO_LOCATION_MONO_AUDIO, CONTIN_TEST_DEINTERLEAVED, CONTIN_TEST_NOT_FILLED,
		    100);
	test_contin(TEST_BITS_8, TEST_BITS_8, BT_AUDIO_LOCATION_FRONT_LEFT,
		    BT_AUDIO_LOCATION_FRONT_LEFT, CONTIN_TEST_DEINTERLEAVED, CONTIN_TEST_NOT_FILLED,
		    100);
	test_contin(TEST_BITS_8, TEST_BITS_8, BT_AUDIO_LOCATION_FRONT_RIGHT,
		    BT_AUDIO_LOCATION_FRONT_RIGHT, CONTIN_TEST_DEINTERLEAVED,
		    CONTIN_TEST_NOT_FILLED, 100);
	test_contin(TEST_BITS_8, TEST_BITS_16,
		    BT_AUDIO_LOCATION_FRONT_LEFT | BT_AUDIO_LOCATION_FRONT_RIGHT,
		    BT_AUDIO_LOCATION_FRONT_LEFT | BT_AUDIO_LOCATION_FRONT_RIGHT,
		    CONTIN_TEST_DEINTERLEAVED, CONTIN_TEST_NOT_FILLED, 110);
	test_contin(TEST_BITS_8, TEST_BITS_16,
		    BT_AUDIO_LOCATION_FRONT_LEFT | BT_AUDIO_LOCATION_FRONT_RIGHT |
			    BT_AUDIO_LOCATION_FRONT_CENTER,
		    BT_AUDIO_LOCATION_FRONT_LEFT, CONTIN_TEST_DEINTERLEAVED, CONTIN_TEST_NOT_FILLED,
		    120);
	test_contin(TEST_BITS_16, TEST_BITS_16, BT_AUDIO_LOCATION_FRONT_LEFT,
		    BT_AUDIO_LOCATION_FRONT_LEFT, CONTIN_TEST_DEINTERLEAVED, CONTIN_TEST_NOT_FILLED,
		    100);
	test_contin(TEST_BITS_16, TEST_BITS_16, BT_AUDIO_LOCATION_FRONT_RIGHT,
		    BT_AUDIO_LOCATION_FRONT_RIGHT, CONTIN_TEST_DEINTERLEAVED,
		    CONTIN_TEST_NOT_FILLED, 100);
	test_contin(TEST_BITS_16, TEST_BITS_16,
		    BT_AUDIO_LOCATION_FRONT_LEFT | BT_AUDIO_LOCATION_FRONT_RIGHT |
			    BT_AUDIO_LOCATION_FRONT_CENTER,
		    BT_AUDIO_LOCATION_FRONT_LEFT | BT_AUDIO_LOCATION_FRONT_RIGHT |
			    BT_AUDIO_LOCATION_FRONT_CENTER,
		    CONTIN_TEST_DEINTERLEAVED, CONTIN_TEST_NOT_FILLED, 100);
	test_contin(TEST_BITS_16, TEST_BITS_32,
		    BT_AUDIO_LOCATION_FRONT_LEFT | BT_AUDIO_LOCATION_FRONT_RIGHT,
		    BT_AUDIO_LOCATION_FRONT_LEFT | BT_AUDIO_LOCATION_FRONT_RIGHT,
		    CONTIN_TEST_DEINTERLEAVED, CONTIN_TEST_NOT_FILLED, 110);
	test_contin(TEST_BITS_24, TEST_BITS_32,
		    BT_AUDIO_LOCATION_FRONT_LEFT | BT_AUDIO_LOCATION_FRONT_RIGHT |
			    BT_AUDIO_LOCATION_FRONT_CENTER,
		    BT_AUDIO_LOCATION_FRONT_LEFT | BT_AUDIO_LOCATION_FRONT_RIGHT,
		    CONTIN_TEST_DEINTERLEAVED, CONTIN_TEST_NOT_FILLED, 120);
	test_contin(TEST_BITS_32, TEST_BITS_32,
		    BT_AUDIO_LOCATION_FRONT_LEFT | BT_AUDIO_LOCATION_FRONT_RIGHT,
		    BT_AUDIO_LOCATION_FRONT_LEFT | BT_AUDIO_LOCATION_FRONT_RIGHT,
		    CONTIN_TEST_DEINTERLEAVED, CONTIN_TEST_NOT_FILLED, 120);
}

/* Test continuous array formation for interleaved net_buffers */
ZTEST(suite_contin_array_chan, test_contin_int_empty_loop)
{
	test_contin(TEST_BITS_8, TEST_BITS_8, BT_AUDIO_LOCATION_MONO_AUDIO,
		    BT_AUDIO_LOCATION_MONO_AUDIO, CONTIN_TEST_INTERLEAVED, CONTIN_TEST_NOT_FILLED,
		    100);
	test_contin(TEST_BITS_8, TEST_BITS_8, BT_AUDIO_LOCATION_FRONT_LEFT,
		    BT_AUDIO_LOCATION_FRONT_LEFT, CONTIN_TEST_INTERLEAVED, CONTIN_TEST_NOT_FILLED,
		    100);
	test_contin(TEST_BITS_8, TEST_BITS_8, BT_AUDIO_LOCATION_FRONT_RIGHT,
		    BT_AUDIO_LOCATION_FRONT_RIGHT, CONTIN_TEST_INTERLEAVED, CONTIN_TEST_NOT_FILLED,
		    100);
	test_contin(TEST_BITS_8, TEST_BITS_16,
		    BT_AUDIO_LOCATION_FRONT_LEFT | BT_AUDIO_LOCATION_FRONT_RIGHT,
		    BT_AUDIO_LOCATION_FRONT_LEFT | BT_AUDIO_LOCATION_FRONT_RIGHT,
		    CONTIN_TEST_INTERLEAVED, CONTIN_TEST_NOT_FILLED, 110);
	test_contin(TEST_BITS_8, TEST_BITS_16,
		    BT_AUDIO_LOCATION_FRONT_LEFT | BT_AUDIO_LOCATION_FRONT_RIGHT |
			    BT_AUDIO_LOCATION_FRONT_CENTER,
		    BT_AUDIO_LOCATION_FRONT_LEFT, CONTIN_TEST_INTERLEAVED, CONTIN_TEST_NOT_FILLED,
		    120);
	test_contin(TEST_BITS_16, TEST_BITS_16, BT_AUDIO_LOCATION_FRONT_LEFT,
		    BT_AUDIO_LOCATION_FRONT_LEFT, CONTIN_TEST_INTERLEAVED, CONTIN_TEST_NOT_FILLED,
		    100);
	test_contin(TEST_BITS_16, TEST_BITS_16, BT_AUDIO_LOCATION_FRONT_RIGHT,
		    BT_AUDIO_LOCATION_FRONT_RIGHT, CONTIN_TEST_INTERLEAVED, CONTIN_TEST_NOT_FILLED,
		    100);
	test_contin(TEST_BITS_16, TEST_BITS_16,
		    BT_AUDIO_LOCATION_FRONT_LEFT | BT_AUDIO_LOCATION_FRONT_RIGHT |
			    BT_AUDIO_LOCATION_FRONT_CENTER,
		    BT_AUDIO_LOCATION_FRONT_LEFT | BT_AUDIO_LOCATION_FRONT_RIGHT |
			    BT_AUDIO_LOCATION_FRONT_CENTER,
		    CONTIN_TEST_INTERLEAVED, CONTIN_TEST_NOT_FILLED, 100);
	test_contin(TEST_BITS_16, TEST_BITS_32,
		    BT_AUDIO_LOCATION_FRONT_LEFT | BT_AUDIO_LOCATION_FRONT_RIGHT,
		    BT_AUDIO_LOCATION_FRONT_LEFT | BT_AUDIO_LOCATION_FRONT_RIGHT,
		    CONTIN_TEST_INTERLEAVED, CONTIN_TEST_NOT_FILLED, 110);
	test_contin(TEST_BITS_24, TEST_BITS_32,
		    BT_AUDIO_LOCATION_FRONT_LEFT | BT_AUDIO_LOCATION_FRONT_RIGHT |
			    BT_AUDIO_LOCATION_FRONT_CENTER,
		    BT_AUDIO_LOCATION_FRONT_LEFT | BT_AUDIO_LOCATION_FRONT_RIGHT,
		    CONTIN_TEST_INTERLEAVED, CONTIN_TEST_NOT_FILLED, 120);
	test_contin(TEST_BITS_32, TEST_BITS_32,
		    BT_AUDIO_LOCATION_FRONT_LEFT | BT_AUDIO_LOCATION_FRONT_RIGHT,
		    BT_AUDIO_LOCATION_FRONT_LEFT | BT_AUDIO_LOCATION_FRONT_RIGHT,
		    CONTIN_TEST_INTERLEAVED, CONTIN_TEST_NOT_FILLED, 120);
}

/* Test continuous array formation for de-interleaved net_buffers */
ZTEST(suite_contin_array_chan, test_contin_deint_filled_loop)
{
	test_contin(TEST_BITS_8, TEST_BITS_8, BT_AUDIO_LOCATION_MONO_AUDIO,
		    BT_AUDIO_LOCATION_MONO_AUDIO, CONTIN_TEST_DEINTERLEAVED, CONTIN_TEST_FILLED,
		    100);
	test_contin(TEST_BITS_8, TEST_BITS_8, BT_AUDIO_LOCATION_FRONT_LEFT,
		    BT_AUDIO_LOCATION_FRONT_LEFT, CONTIN_TEST_DEINTERLEAVED, CONTIN_TEST_FILLED,
		    100);
	test_contin(TEST_BITS_8, TEST_BITS_16,
		    BT_AUDIO_LOCATION_FRONT_LEFT | BT_AUDIO_LOCATION_FRONT_RIGHT,
		    BT_AUDIO_LOCATION_FRONT_LEFT | BT_AUDIO_LOCATION_FRONT_RIGHT,
		    CONTIN_TEST_DEINTERLEAVED, CONTIN_TEST_FILLED, 110);
	test_contin(TEST_BITS_8, TEST_BITS_16,
		    BT_AUDIO_LOCATION_FRONT_LEFT | BT_AUDIO_LOCATION_FRONT_RIGHT |
			    BT_AUDIO_LOCATION_FRONT_CENTER,
		    BT_AUDIO_LOCATION_FRONT_LEFT, CONTIN_TEST_DEINTERLEAVED, CONTIN_TEST_FILLED,
		    120);
	test_contin(TEST_BITS_16, TEST_BITS_16, BT_AUDIO_LOCATION_FRONT_LEFT,
		    BT_AUDIO_LOCATION_FRONT_LEFT, CONTIN_TEST_DEINTERLEAVED, CONTIN_TEST_FILLED,
		    100);
	test_contin(TEST_BITS_16, TEST_BITS_16, BT_AUDIO_LOCATION_FRONT_RIGHT,
		    BT_AUDIO_LOCATION_FRONT_RIGHT, CONTIN_TEST_DEINTERLEAVED, CONTIN_TEST_FILLED,
		    100);
	test_contin(TEST_BITS_16, TEST_BITS_16,
		    BT_AUDIO_LOCATION_FRONT_LEFT | BT_AUDIO_LOCATION_FRONT_RIGHT |
			    BT_AUDIO_LOCATION_FRONT_CENTER,
		    BT_AUDIO_LOCATION_FRONT_LEFT | BT_AUDIO_LOCATION_FRONT_RIGHT |
			    BT_AUDIO_LOCATION_FRONT_CENTER,
		    CONTIN_TEST_DEINTERLEAVED, CONTIN_TEST_FILLED, 100);
	test_contin(TEST_BITS_16, TEST_BITS_32,
		    BT_AUDIO_LOCATION_FRONT_LEFT | BT_AUDIO_LOCATION_FRONT_RIGHT,
		    BT_AUDIO_LOCATION_FRONT_LEFT | BT_AUDIO_LOCATION_FRONT_RIGHT,
		    CONTIN_TEST_DEINTERLEAVED, CONTIN_TEST_FILLED, 110);
	test_contin(TEST_BITS_24, TEST_BITS_32,
		    BT_AUDIO_LOCATION_FRONT_LEFT | BT_AUDIO_LOCATION_FRONT_RIGHT |
			    BT_AUDIO_LOCATION_FRONT_CENTER,
		    BT_AUDIO_LOCATION_FRONT_LEFT | BT_AUDIO_LOCATION_FRONT_RIGHT,
		    CONTIN_TEST_DEINTERLEAVED, CONTIN_TEST_FILLED, 120);
	test_contin(TEST_BITS_32, TEST_BITS_32,
		    BT_AUDIO_LOCATION_FRONT_LEFT | BT_AUDIO_LOCATION_FRONT_RIGHT,
		    BT_AUDIO_LOCATION_FRONT_LEFT | BT_AUDIO_LOCATION_FRONT_RIGHT,
		    CONTIN_TEST_DEINTERLEAVED, CONTIN_TEST_FILLED, 120);
}

/* Test continuous array formation for interleaved net_buffers */
ZTEST(suite_contin_array_chan, test_contin_int_filled_loop)
{
	test_contin(TEST_BITS_8, TEST_BITS_8, BT_AUDIO_LOCATION_MONO_AUDIO,
		    BT_AUDIO_LOCATION_MONO_AUDIO, CONTIN_TEST_INTERLEAVED, CONTIN_TEST_FILLED, 100);
	test_contin(TEST_BITS_8, TEST_BITS_8, BT_AUDIO_LOCATION_FRONT_LEFT,
		    BT_AUDIO_LOCATION_FRONT_LEFT, CONTIN_TEST_INTERLEAVED, CONTIN_TEST_FILLED, 100);
	test_contin(TEST_BITS_8, TEST_BITS_16,
		    BT_AUDIO_LOCATION_FRONT_LEFT | BT_AUDIO_LOCATION_FRONT_RIGHT,
		    BT_AUDIO_LOCATION_FRONT_LEFT | BT_AUDIO_LOCATION_FRONT_RIGHT,
		    CONTIN_TEST_INTERLEAVED, CONTIN_TEST_FILLED, 110);
	test_contin(TEST_BITS_8, TEST_BITS_16,
		    BT_AUDIO_LOCATION_FRONT_LEFT | BT_AUDIO_LOCATION_FRONT_RIGHT |
			    BT_AUDIO_LOCATION_FRONT_CENTER,
		    BT_AUDIO_LOCATION_FRONT_LEFT, CONTIN_TEST_INTERLEAVED, CONTIN_TEST_FILLED, 120);
	test_contin(TEST_BITS_16, TEST_BITS_16, BT_AUDIO_LOCATION_FRONT_LEFT,
		    BT_AUDIO_LOCATION_FRONT_LEFT, CONTIN_TEST_INTERLEAVED, CONTIN_TEST_FILLED, 100);
	test_contin(TEST_BITS_16, TEST_BITS_16, BT_AUDIO_LOCATION_FRONT_RIGHT,
		    BT_AUDIO_LOCATION_FRONT_RIGHT, CONTIN_TEST_INTERLEAVED, CONTIN_TEST_FILLED,
		    100);
	test_contin(TEST_BITS_16, TEST_BITS_16,
		    BT_AUDIO_LOCATION_FRONT_LEFT | BT_AUDIO_LOCATION_FRONT_RIGHT |
			    BT_AUDIO_LOCATION_FRONT_CENTER,
		    BT_AUDIO_LOCATION_FRONT_LEFT | BT_AUDIO_LOCATION_FRONT_RIGHT |
			    BT_AUDIO_LOCATION_FRONT_CENTER,
		    CONTIN_TEST_INTERLEAVED, CONTIN_TEST_FILLED, 100);
	test_contin(TEST_BITS_16, TEST_BITS_32,
		    BT_AUDIO_LOCATION_FRONT_LEFT | BT_AUDIO_LOCATION_FRONT_RIGHT,
		    BT_AUDIO_LOCATION_FRONT_LEFT | BT_AUDIO_LOCATION_FRONT_RIGHT,
		    CONTIN_TEST_INTERLEAVED, CONTIN_TEST_FILLED, 110);
	test_contin(TEST_BITS_24, TEST_BITS_32,
		    BT_AUDIO_LOCATION_FRONT_LEFT | BT_AUDIO_LOCATION_FRONT_RIGHT |
			    BT_AUDIO_LOCATION_FRONT_CENTER,
		    BT_AUDIO_LOCATION_FRONT_LEFT | BT_AUDIO_LOCATION_FRONT_RIGHT,
		    CONTIN_TEST_INTERLEAVED, CONTIN_TEST_FILLED, 120);
	test_contin(TEST_BITS_32, TEST_BITS_32,
		    BT_AUDIO_LOCATION_FRONT_LEFT | BT_AUDIO_LOCATION_FRONT_RIGHT,
		    BT_AUDIO_LOCATION_FRONT_LEFT | BT_AUDIO_LOCATION_FRONT_RIGHT,
		    CONTIN_TEST_INTERLEAVED, CONTIN_TEST_FILLED, 120);
}
```

## src/array_test_chan_api.c
```c
/*
 * Copyright (c) 2025 Nordic Semiconductor ASA
 *
 * SPDX-License-Identifier: LicenseRef-Nordic-5-Clause
 */
#include <zephyr/ztest.h>
#include <errno.h>
#include <stdlib.h>
#include <stdio.h>
#include <ctype.h>
#include <zephyr/kernel.h>
#include <zephyr/tc_util.h>
#include <audio_defines.h>
#include <contin_array.h>

#include "array_test_data.h"

static struct audio_metadata test_meta = {.data_coding = PCM,
					  .data_len_us = 10000,
					  .sample_rate_hz = 48000,
					  .bits_per_sample = 16,
					  .carried_bits_per_sample = 16,
					  .bytes_per_location = sizeof(test_arr),
					  .interleaved = CONTIN_TEST_DEINTERLEAVED,
					  .locations = BT_AUDIO_LOCATION_FRONT_LEFT,
					  .ref_ts_us = 0,
					  .data_rx_ts_us = 0,
					  .bad_data = false};

NET_BUF_POOL_FIXED_DEFINE(pool_contin, CONTIN_TEST_POOL_CONTIN_NUM, CONTIN_TEST_POOL_CONTIN_SIZE,
			  (sizeof(struct audio_metadata)), NULL);
NET_BUF_POOL_FIXED_DEFINE(pool_finite, CONTIN_TEST_POOL_FINITE_NUM, sizeof(test_arr),
			  sizeof(struct audio_metadata), NULL);

/* Test parameter validation */
ZTEST(suite_contin_array_chan, test_contin_buf_api)
{
	int ret;
	struct net_buf *pcm_contin = NULL;
	uint8_t *pcm_finite = (uint8_t *)test_arr;
	struct audio_metadata *meta_contin;
	uint16_t finite_pos = 0;
	uint8_t locs_out = 0x00000011;

	pcm_contin = net_buf_alloc(&pool_contin, K_NO_WAIT);

	meta_contin = net_buf_user_data(pcm_contin);
	memcpy(meta_contin, &test_meta, sizeof(struct audio_metadata));

	/* Test for pcm_contin pointer NULL */
	net_buf_add(pcm_contin, pcm_contin->size);
	ret = contin_array_buf_create(NULL, pcm_finite, sizeof(test_arr), locs_out, &finite_pos);
	zassert_equal(ret, -ENXIO, "Failed to recognize NULL pointer: %d", ret);

	/* Test for pcm_finite buffer pointer NULL */
	ret = contin_array_buf_create(pcm_contin, NULL, sizeof(test_arr), locs_out, &finite_pos);
	zassert_equal(ret, -ENXIO, "Failed to recognize NULL pointer: %d", ret);

	/* Test for pcm_finite buffer pointer NULL */
	ret = contin_array_buf_create(pcm_contin, pcm_finite, sizeof(test_arr), locs_out, NULL);
	zassert_equal(ret, -ENXIO, "Failed to recognize NULL pointer: %d", ret);

	/* Test for pcm_finite buffer size 0 */
	ret = contin_array_buf_create(pcm_contin, pcm_finite, 0, locs_out, &finite_pos);
	zassert_equal(ret, -EPERM, "Failed to recognize buffer size is zero: %d", ret);

	/* Test for out of range finite_pos */
	finite_pos = sizeof(test_arr) + 1;
	ret = contin_array_buf_create(pcm_contin, pcm_finite, sizeof(test_arr), locs_out,
				      &finite_pos);
	zassert_equal(ret, -EPERM, "Failed to recognize out of range finite_pos: %d", ret);

	/* Test for locations zero (mono) */
	ret = contin_array_buf_create(pcm_contin, pcm_finite, sizeof(test_arr),
				      BT_AUDIO_LOCATION_MONO_AUDIO, &finite_pos);
	zassert_equal(ret, -EPERM, "Failed to recognize channel out of range: %d", ret);

	/* Test for no channel in locations */
	ret = contin_array_buf_create(pcm_contin, pcm_finite, sizeof(test_arr), 10, &finite_pos);
	zassert_equal(ret, -EPERM, "Failed to recognize channel out of range: %d", ret);

	/* Test for invalid locations in the continuous buffer */
	meta_contin->locations = BT_AUDIO_LOCATION_MONO_AUDIO;
	ret = contin_array_buf_create(pcm_contin, pcm_finite, sizeof(test_arr),
				      BT_AUDIO_LOCATION_FRONT_LEFT, &finite_pos);
	zassert_equal(ret, -EPERM, "Failed to recognize channel not present: %d", ret);

	/* Test for invalid locations in the continuous buffer */
	meta_contin->locations = BT_AUDIO_LOCATION_FRONT_RIGHT;
	ret = contin_array_buf_create(pcm_contin, pcm_finite, sizeof(test_arr),
				      BT_AUDIO_LOCATION_FRONT_LEFT, &finite_pos);
	zassert_equal(ret, -EPERM, "Failed to recognize channel not present: %d", ret);

	/* Test for pcm_contin size 0 */
	memcpy(meta_contin, &test_meta, sizeof(struct audio_metadata));
	pcm_contin->size = 0;
	ret = contin_array_buf_create(pcm_contin, pcm_finite, sizeof(test_arr), locs_out,
				      &finite_pos);
	zassert_equal(ret, -EPERM, "Failed to recognize data size of 0: %d", ret);

	net_buf_unref(pcm_contin);
}

/* Test parameter validation */
ZTEST(suite_contin_array_chan, test_contin_net_buf_api)
{
	int ret;
	struct net_buf *pcm_contin = NULL;
	struct net_buf *pcm_finite = NULL;
	struct audio_metadata *meta_contin;
	struct audio_metadata *meta_finite;
	uint16_t finite_pos = 0;
	uint32_t locs_out = BT_AUDIO_LOCATION_FRONT_LEFT;

	pcm_contin = net_buf_alloc(&pool_contin, K_NO_WAIT);
	pcm_finite = net_buf_alloc(&pool_finite, K_NO_WAIT);
	net_buf_add(pcm_contin, pcm_contin->size);
	net_buf_add(pcm_finite, pcm_finite->size);

	meta_contin = net_buf_user_data(pcm_contin);
	meta_finite = net_buf_user_data(pcm_finite);
	memcpy(meta_contin, &test_meta, sizeof(struct audio_metadata));
	memcpy(meta_finite, &test_meta, sizeof(struct audio_metadata));

	/* Test for pcm_finite pointer NULL */
	ret = contin_array_net_buf_create(pcm_contin, NULL, locs_out, &finite_pos);
	zassert_equal(ret, -ENXIO, "Failed to recognize NULL pointer: %d", ret);

	/* Test meta_contin sample rate */
	finite_pos = 0;
	meta_contin->sample_rate_hz = 8000;
	ret = contin_array_net_buf_create(pcm_contin, pcm_finite, locs_out, &finite_pos);
	zassert_equal(ret, -EINVAL, "Failed to detect sample rate difference: %d", ret);

	/* Test meta_finite sample rate */
	memcpy(meta_contin, &test_meta, sizeof(struct audio_metadata));
	meta_finite->sample_rate_hz = 8000;
	ret = contin_array_net_buf_create(pcm_contin, pcm_finite, locs_out, &finite_pos);
	zassert_equal(ret, -EINVAL, "Failed to detect sample rate difference: %d", ret);

	/* Test meta_contin bits_per_sample */
	pcm_contin->size = CONTIN_TEST_POOL_CONTIN_SIZE;
	meta_contin->bits_per_sample = 8;
	ret = contin_array_net_buf_create(pcm_contin, pcm_finite, locs_out, &finite_pos);
	zassert_equal(ret, -EINVAL, "Failed to detect bits per sample difference: %d", ret);

	/* Test meta_contin bits_per_sample */
	memcpy(meta_contin, &test_meta, sizeof(struct audio_metadata));
	meta_contin->bits_per_sample = 32;
	ret = contin_array_net_buf_create(pcm_contin, pcm_finite, locs_out, &finite_pos);
	zassert_equal(ret, -EINVAL, "Failed to detect bits per sample difference: %d", ret);

	/* Test meta_contin carried_bits_per_sample */
	memcpy(meta_contin, &test_meta, sizeof(struct audio_metadata));
	meta_contin->carried_bits_per_sample = 8;
	ret = contin_array_net_buf_create(pcm_contin, pcm_finite, locs_out, &finite_pos);
	zassert_equal(ret, -EINVAL, "Failed to detect carrier bits per sample difference: %d", ret);

	/* Test meta_contin carried_bits_per_sample */
	memcpy(meta_contin, &test_meta, sizeof(struct audio_metadata));
	meta_contin->carried_bits_per_sample = 32;
	ret = contin_array_net_buf_create(pcm_contin, pcm_finite, locs_out, &finite_pos);
	zassert_equal(ret, -EINVAL, "Failed to detect carrier bits per sample difference: %d", ret);

	/* Test meta_finite bits_per_sample */
	memcpy(meta_contin, &test_meta, sizeof(struct audio_metadata));
	meta_finite->bits_per_sample = 8;
	ret = contin_array_net_buf_create(pcm_contin, pcm_finite, locs_out, &finite_pos);
	zassert_equal(ret, -EINVAL, "Failed to detect bits per sample difference: %d", ret);

	/* Test meta_finite bits_per_sample */
	memcpy(meta_finite, &test_meta, sizeof(struct audio_metadata));
	meta_finite->bits_per_sample = 32;
	ret = contin_array_net_buf_create(pcm_contin, pcm_finite, locs_out, &finite_pos);
	zassert_equal(ret, -EINVAL, "Failed to detect bits per sample difference: %d", ret);

	/* Test meta_finite carried_bits_per_sample */
	memcpy(meta_finite, &test_meta, sizeof(struct audio_metadata));
	meta_finite->carried_bits_per_sample = 8;
	ret = contin_array_net_buf_create(pcm_contin, pcm_finite, locs_out, &finite_pos);
	zassert_equal(ret, -EINVAL, "Failed to detect carrier bits per sample difference: %d", ret);

	/* Test meta_finite carried_bits_per_sample */
	memcpy(meta_finite, &test_meta, sizeof(struct audio_metadata));
	meta_finite->carried_bits_per_sample = 32;
	ret = contin_array_net_buf_create(pcm_contin, pcm_finite, locs_out, &finite_pos);
	zassert_equal(ret, -EINVAL, "Failed to detect carrier bits per sample difference: %d", ret);

	/* Test for pcm_finite len 0 */
	memcpy(meta_finite, &test_meta, sizeof(struct audio_metadata));
	pcm_finite->len = 0;
	ret = contin_array_net_buf_create(pcm_contin, pcm_finite, locs_out, &finite_pos);
	zassert_equal(ret, -EPERM, "Failed to recognize data size of 0: %d", ret);

	net_buf_unref(pcm_contin);
	net_buf_unref(pcm_finite);
}
```

## src/array_test_chan_buf.c
```c
/*
 * Copyright (c) 2024 Nordic Semiconductor ASA
 *
 * SPDX-License-Identifier: LicenseRef-Nordic-5-Clause
 */
#include <zephyr/ztest.h>
#include <errno.h>
#include <stdlib.h>
#include <stdio.h>
#include <ctype.h>
#include <zephyr/kernel.h>
#include <zephyr/tc_util.h>
#include <audio_defines.h>
#include <contin_array.h>

#include "array_test_data.h"

static struct audio_metadata test_meta = {.data_coding = PCM,
					  .data_len_us = 10000,
					  .sample_rate_hz = 48000,
					  .bits_per_sample = 16,
					  .carried_bits_per_sample = 16,
					  .bytes_per_location = CONTIN_TEST_FINITE_DATA_SIZE,
					  .interleaved = false,
					  .locations = 0x00000111,
					  .ref_ts_us = 0,
					  .data_rx_ts_us = 0,
					  .bad_data = false};

NET_BUF_POOL_FIXED_DEFINE(pool_contin, CONTIN_TEST_POOL_CONTIN_NUM, CONTIN_TEST_POOL_CONTIN_SIZE,
			  (sizeof(struct audio_metadata)), NULL);

/* Test parameter validation */
ZTEST(suite_contin_array_chan_buf, test_contin_single_buf_api)
{
	int ret;
	struct net_buf *pcm_contin = NULL;
	uint8_t *pcm_finite = (uint8_t *)test_arr;
	struct audio_metadata *meta_contin;
	uint8_t ch_out = TEST_CHANS_2;
	uint16_t finite_pos = 0;

	pcm_contin = net_buf_alloc(&pool_contin, K_NO_WAIT);

	meta_contin = net_buf_user_data(pcm_contin);
	memcpy(meta_contin, &test_meta, sizeof(struct audio_metadata));

	/* Test for pcm_contin->len == 0 */
	ret = contin_array_single_chan_buf_create(
		pcm_contin, pcm_finite, CONTIN_TEST_POOL_FINITE_SIZE, ch_out, &finite_pos);
	zassert_equal(ret, -EPERM, "Failed to recognize pcm_contin->len == 0: %d", ret);

	/* Test for pcm_contin pointer NULL */
	net_buf_add(pcm_contin, pcm_contin->size);
	ret = contin_array_single_chan_buf_create(NULL, pcm_finite, CONTIN_TEST_POOL_FINITE_SIZE,
						  ch_out, &finite_pos);
	zassert_equal(ret, -ENXIO, "Failed to recognize NULL pointer: %d", ret);

	/* Test for pcm_finite buffer pointer NULL */
	ret = contin_array_single_chan_buf_create(pcm_contin, NULL, CONTIN_TEST_POOL_FINITE_SIZE,
						  ch_out, &finite_pos);
	zassert_equal(ret, -ENXIO, "Failed to recognize NULL pointer: %d", ret);

	/* Test for pcm_finite buffer pointer NULL */
	ret = contin_array_single_chan_buf_create(pcm_contin, pcm_finite,
						  CONTIN_TEST_POOL_FINITE_SIZE, ch_out, NULL);
	zassert_equal(ret, -ENXIO, "Failed to recognize NULL pointer: %d", ret);

	/* Test for pcm_finite buffer size 0 */
	ret = contin_array_single_chan_buf_create(pcm_contin, pcm_finite, 0, ch_out, &finite_pos);
	zassert_equal(ret, -EPERM, "Failed to recognize buffer size is zero: %d", ret);

	/* Test for out of range finite_pos */
	finite_pos = CONTIN_TEST_POOL_FINITE_SIZE + 1;
	ret = contin_array_single_chan_buf_create(
		pcm_contin, pcm_finite, CONTIN_TEST_POOL_FINITE_SIZE, ch_out, &finite_pos);
	zassert_equal(ret, -EPERM, "Failed to recognize out of range finite_pos: %d", ret);

	/* Test for no channel in channels */
	ret = contin_array_single_chan_buf_create(pcm_contin, pcm_finite,
						  CONTIN_TEST_POOL_FINITE_SIZE, 10, &finite_pos);
	zassert_equal(ret, -EPERM, "Failed to recognize channel out of range: %d", ret);

	/* Test for invalid channels in the continuous buffer */
	meta_contin->locations = 0x00000001;
	ret = contin_array_single_chan_buf_create(
		pcm_contin, pcm_finite, CONTIN_TEST_POOL_FINITE_SIZE, ch_out, &finite_pos);
	zassert_equal(ret, -EPERM, "Failed to recognize channel out of range: %d", ret);

	/* Test for pcm_contin size 0 */
	memcpy(meta_contin, &test_meta, sizeof(struct audio_metadata));
	pcm_contin->size = 0;
	ret = contin_array_single_chan_buf_create(
		pcm_contin, pcm_finite, CONTIN_TEST_POOL_FINITE_SIZE, ch_out, &finite_pos);
	zassert_equal(ret, -EPERM, "Failed to recognize data size of 0: %d", ret);

	net_buf_unref(pcm_contin);
}

/* Test parameter validation */
ZTEST(suite_contin_array_chan_buf, test_contin_chans_buf_api)
{
	int ret;
	struct net_buf *pcm_contin = NULL;
	uint8_t *pcm_finite = (uint8_t *)test_arr;
	struct audio_metadata *meta_contin;
	uint16_t finite_pos = 0;

	pcm_contin = net_buf_alloc(&pool_contin, K_NO_WAIT);

	meta_contin = net_buf_user_data(pcm_contin);

	memcpy(meta_contin, &test_meta, sizeof(struct audio_metadata));

	/* Test for pcm_contin pointer NULL */
	ret = contin_array_chans_buf_create(NULL, pcm_finite, CONTIN_TEST_POOL_FINITE_SIZE,
					    &finite_pos);
	zassert_equal(ret, -ENXIO, "Failed to recognize NULL pointer: %d", ret);

	/* Test for pcm_finite buffer pointer NULL */
	ret = contin_array_chans_buf_create(pcm_contin, NULL, CONTIN_TEST_POOL_FINITE_SIZE,
					    &finite_pos);
	zassert_equal(ret, -ENXIO, "Failed to recognize NULL pointer: %d", ret);

	/* Test for pcm_finite buffer pointer NULL */
	ret = contin_array_chans_buf_create(pcm_contin, pcm_finite, CONTIN_TEST_POOL_FINITE_SIZE,
					    NULL);
	zassert_equal(ret, -ENXIO, "Failed to recognize NULL pointer: %d", ret);

	/* Test for pcm_finite buffer size 0 */
	ret = contin_array_chans_buf_create(pcm_contin, pcm_finite, 0, &finite_pos);
	zassert_equal(ret, -EPERM, "Failed to recognize buffer size is zero: %d", ret);

	/* Test for out of range finite_pos */
	finite_pos = CONTIN_TEST_POOL_FINITE_SIZE + 1;
	ret = contin_array_chans_buf_create(pcm_contin, pcm_finite, CONTIN_TEST_POOL_FINITE_SIZE,
					    &finite_pos);
	zassert_equal(ret, -EPERM, "Failed to recognize out of range finite_pos: %d", ret);

	/* Test for pcm_contin size 0 */
	memcpy(meta_contin, &test_meta, sizeof(struct audio_metadata));
	pcm_contin->size = 0;
	ret = contin_array_chans_buf_create(pcm_contin, pcm_finite, CONTIN_TEST_POOL_FINITE_SIZE,
					    &finite_pos);
	zassert_equal(ret, -EPERM, "Failed to recognize data size of 0: %d", ret);

	net_buf_unref(pcm_contin);
}

/* Test continuous array by setting a single channel in the output with the tone */
static void test_contin_single(uint8_t bits_per_samp, uint8_t carrier_bits, uint8_t num_ch,
			       uint8_t ch_out, bool interleaved, size_t iterations)
{
	int ret;
	struct net_buf *pcm_contin;
	struct audio_metadata *meta_contin;
	uint8_t *pcm_finite = (uint8_t *)test_arr;
	uint8_t carrier_bytes;
	uint16_t finite_pos = 0;
	uint16_t finite_start;

	pcm_contin = net_buf_alloc(&pool_contin, K_NO_WAIT);

	meta_contin = net_buf_user_data(pcm_contin);
	memcpy(meta_contin, &test_meta, sizeof(struct audio_metadata));

	meta_contin->bits_per_sample = bits_per_samp;
	meta_contin->carried_bits_per_sample = carrier_bits;
	carrier_bytes = carrier_bits / 8;
	meta_contin->bytes_per_location =
		((pcm_contin->size / num_ch) / carrier_bytes) * carrier_bytes;
	meta_contin->interleaved = interleaved;
	meta_contin->locations = (0x00000001 << num_ch) - 1;

	net_buf_add(pcm_contin, meta_contin->bytes_per_location * num_ch);

	for (size_t i = 0; i < iterations; i++) {
		finite_start = finite_pos;

		memset(pcm_contin->data, CONTIN_TEST_CONTIN_BYTE, pcm_contin->size);

		ret = contin_array_single_chan_buf_create(
			pcm_contin, pcm_finite, CONTIN_TEST_POOL_FINITE_SIZE, ch_out, &finite_pos);
		zassert_equal(ret, 0, "contin_array_chans_buf_create did not return zero: %d", ret);

		validate_contin_single_array(pcm_contin, pcm_finite, num_ch, ch_out, finite_start,
					     finite_pos, interleaved);
	}

	net_buf_unref(pcm_contin);
}

/* Test continuous array set all channels with the tone */
static void test_contin_chans(uint8_t bits_per_samp, uint8_t carrier_bits, uint8_t num_ch,
			      bool interleaved, size_t iterations)
{
	int ret;
	struct net_buf *pcm_contin;
	struct audio_metadata *meta_contin;
	uint8_t *pcm_finite = (uint8_t *)test_arr;
	uint8_t carrier_bytes;
	uint16_t finite_pos = 0;
	uint16_t finite_start;

	pcm_contin = net_buf_alloc(&pool_contin, K_NO_WAIT);

	for (size_t i = 0; i < iterations; i++) {
		finite_start = finite_pos;

		meta_contin = net_buf_user_data(pcm_contin);
		memcpy(meta_contin, &test_meta, sizeof(struct audio_metadata));

		meta_contin->bits_per_sample = bits_per_samp;
		meta_contin->carried_bits_per_sample = carrier_bits;
		carrier_bytes = carrier_bits / 8;
		meta_contin->bytes_per_location =
			((pcm_contin->size / num_ch) / carrier_bytes) * carrier_bytes;
		meta_contin->interleaved = interleaved;
		meta_contin->locations = (0x00000001 << num_ch) - 1;

		memset(pcm_contin->data, CONTIN_TEST_CONTIN_BYTE, pcm_contin->size);

		ret = contin_array_chans_buf_create(pcm_contin, pcm_finite,
						    CONTIN_TEST_POOL_FINITE_SIZE, &finite_pos);
		zassert_equal(ret, 0, "contin_array_chans_buf_create did not return zero: %d", ret);

		validate_contin_chans_array(pcm_contin, pcm_finite, num_ch, finite_start,
					    finite_pos, interleaved);

		net_buf_reset(pcm_contin);
	}

	net_buf_unref(pcm_contin);
}

/* Test continuous array formation for deinterleaved net_buffers */
ZTEST(suite_contin_array_chan_buf, test_contin_single_buf_deint_loop)
{
	test_contin_single(TEST_BITS_8, TEST_BITS_8, TEST_CHANS_1, TEST_CHANS_1, false, 100);
	test_contin_single(TEST_BITS_8, TEST_BITS_16, TEST_CHANS_2, TEST_CHANS_2, false, 110);
	test_contin_single(TEST_BITS_8, TEST_BITS_32, TEST_CHANS_3, TEST_CHANS_2, false, 120);
	test_contin_single(TEST_BITS_16, TEST_BITS_16, TEST_CHANS_1, TEST_CHANS_1, false, 100);
	test_contin_single(TEST_BITS_16, TEST_BITS_32, TEST_CHANS_2, TEST_CHANS_2, false, 110);
	test_contin_single(TEST_BITS_24, TEST_BITS_32, TEST_CHANS_3, TEST_CHANS_2, false, 120);
	test_contin_single(TEST_BITS_32, TEST_BITS_32, TEST_CHANS_2, TEST_CHANS_2, false, 120);
}

/* Test continuous array formation for interleaved net_buffers */
ZTEST(suite_contin_array_chan_buf, test_contin_single_buf_int_loop)
{
	test_contin_single(TEST_BITS_8, TEST_BITS_8, TEST_CHANS_1, TEST_CHANS_1, true, 100);
	test_contin_single(TEST_BITS_8, TEST_BITS_16, TEST_CHANS_2, TEST_CHANS_2, true, 110);
	test_contin_single(TEST_BITS_8, TEST_BITS_32, TEST_CHANS_3, TEST_CHANS_2, true, 120);
	test_contin_single(TEST_BITS_16, TEST_BITS_16, TEST_CHANS_1, TEST_CHANS_1, true, 100);
	test_contin_single(TEST_BITS_16, TEST_BITS_32, TEST_CHANS_2, TEST_CHANS_2, true, 110);
	test_contin_single(TEST_BITS_24, TEST_BITS_32, TEST_CHANS_3, TEST_CHANS_2, true, 120);
	test_contin_single(TEST_BITS_32, TEST_BITS_32, TEST_CHANS_2, TEST_CHANS_2, true, 120);
}

/* Test continuous array formation for deinterleaved net_buffers */
ZTEST(suite_contin_array_chan_buf, test_contin_chans_buf_deint_loop)
{
	test_contin_chans(TEST_BITS_8, TEST_BITS_8, TEST_CHANS_1, false, 100);
	test_contin_chans(TEST_BITS_8, TEST_BITS_16, TEST_CHANS_2, false, 110);
	test_contin_chans(TEST_BITS_8, TEST_BITS_32, TEST_CHANS_3, false, 120);
	test_contin_chans(TEST_BITS_16, TEST_BITS_16, TEST_CHANS_1, false, 100);
	test_contin_chans(TEST_BITS_16, TEST_BITS_32, TEST_CHANS_2, false, 110);
	test_contin_chans(TEST_BITS_24, TEST_BITS_32, TEST_CHANS_2, false, 120);
	test_contin_chans(TEST_BITS_32, TEST_BITS_32, TEST_CHANS_2, false, 120);
}

/* Test continuous array formation for interleaved net_buffers */
ZTEST(suite_contin_array_chan_buf, test_contin_chans_buf_int_loop)
{
	test_contin_chans(TEST_BITS_8, TEST_BITS_8, TEST_CHANS_1, true, 100);
	test_contin_chans(TEST_BITS_8, TEST_BITS_16, TEST_CHANS_2, true, 110);
	test_contin_chans(TEST_BITS_8, TEST_BITS_32, TEST_CHANS_3, true, 120);
	test_contin_chans(TEST_BITS_16, TEST_BITS_16, TEST_CHANS_1, true, 100);
	test_contin_chans(TEST_BITS_16, TEST_BITS_32, TEST_CHANS_2, true, 110);
	test_contin_chans(TEST_BITS_24, TEST_BITS_32, TEST_CHANS_2, true, 120);
	test_contin_chans(TEST_BITS_32, TEST_BITS_32, TEST_CHANS_2, true, 120);
}
```

## src/array_test_data.c
```c
/*
 * Copyright (c) 2025 Nordic Semiconductor ASA
 *
 * SPDX-License-Identifier: LicenseRef-Nordic-5-Clause
 */
#include <array_test_data.h>

#include <zephyr/ztest.h>
#include <errno.h>
#include <stdlib.h>
#include <stdio.h>
#include <ctype.h>
#include <zephyr/kernel.h>
#include <audio_defines.h>

uint8_t const test_arr[] = {
	0x00, 0x01, 0x02, 0x03, 0x04, 0x05, 0x06, 0x07, 0x08, 0x09, 0x0a, 0x0b, 0x0c, 0x0d, 0x0e,
	0x0f, 0x10, 0x11, 0x12, 0x13, 0x14, 0x15, 0x16, 0x17, 0x18, 0x19, 0x1a, 0x1b, 0x1c, 0x1d,
	0x1e, 0x1f, 0x20, 0x21, 0x22, 0x23, 0x24, 0x25, 0x26, 0x27, 0x28, 0x29, 0x2a, 0x2b, 0x2c,
	0x2d, 0x2e, 0x2f, 0x30, 0x31, 0x32, 0x33, 0x34, 0x35, 0x36, 0x37, 0x38, 0x39, 0x3a, 0x3b,
	0x3c, 0x3d, 0x3e, 0x3f, 0x40, 0x41, 0x42, 0x43, 0x44, 0x45, 0x46, 0x47, 0x48, 0x49, 0x4a,
	0x4b, 0x4c, 0x4d, 0x4e, 0x4f, 0x50, 0x51, 0x52, 0x53, 0x54, 0x55, 0x56, 0x57, 0x58, 0x59,
	0x5a, 0x5b, 0x5c, 0x5d, 0x5e, 0x5f, 0x60, 0x61, 0x62, 0x63, 0x64, 0x65, 0x66, 0x67, 0x68,
	0x69, 0x6a, 0x6b, 0x6c, 0x6d, 0x6e, 0x6f, 0x70, 0x71, 0x72, 0x73, 0x74, 0x75, 0x76, 0x77,
	0x78, 0x79, 0x7a, 0x7b, 0x7c, 0x7d, 0x7e, 0x7f, 0x80, 0x81, 0x82, 0x83, 0x84, 0x85, 0x86,
	0x87, 0x88, 0x89, 0x8a, 0x8b, 0x8c, 0x8d, 0x8e, 0x8f, 0x90, 0x91, 0x92, 0x93, 0x94, 0x95,
	0x96, 0x97, 0x98, 0x99, 0x9a, 0x9b, 0x9c, 0x9d, 0x9e, 0x9f, 0xa0, 0xa1, 0xa2, 0xa3, 0xa4,
	0xa5, 0xa6, 0xa7, 0xa8, 0xa9, 0xaa, 0xab, 0xac, 0xad, 0xae, 0xaf, 0xb0, 0xb1, 0xb2, 0xb3,
	0xb4, 0xb5, 0xb6, 0xb7, 0xb8, 0xb9, 0xba, 0xbb, 0xbc, 0xbd, 0xbe, 0xbf, 0xc0, 0xc1, 0xc2,
	0xc3, 0xc4, 0xc5, 0xc6, 0xc7, 0xc8, 0xc9, 0xca, 0xcb, 0xcc, 0xcd, 0xce, 0xcf, 0xd0, 0xd1,
	0xd2, 0xd3, 0xd4, 0xd5, 0xd6, 0xd7, 0xd8, 0xd9, 0xda, 0xdb, 0xdc, 0xdd, 0xde, 0xdf, 0xe0,
	0xe1, 0xe2, 0xe3, 0xe4, 0xe5, 0xe6, 0xe7, 0xe8, 0xe9, 0xea, 0xeb, 0xec, 0xed, 0xee, 0xef,
	0xf0, 0xf1, 0xf2, 0xf3, 0xf4, 0xf5, 0xf6, 0xf7, 0xf8, 0xf9, 0xfa, 0xfb, 0xfc, 0xfd, 0xfe,
	0xff};

void validate_contin_array(struct net_buf const *const pcm_contin, uint8_t const *const pcm_finite,
			   uint32_t locs_out, uint16_t finite_start, uint16_t finite_end,
			   bool interleaved, bool filled)
{
	struct audio_metadata *meta_contin = net_buf_user_data(pcm_contin);
	uint8_t locations = audio_metadata_num_loc_get(meta_contin);
	int8_t test_byte;
	uint16_t channel_step;
	uint16_t frame_step;
	uint16_t contin_end;
	uint16_t bytes_per_sample;
	uint16_t chan_out;
	uint16_t test_chan_out;
	uint32_t contin_locs;

	if (finite_end) {
		finite_end = finite_end - 1;
	} else {
		finite_end = ARRAY_SIZE(test_arr) - 1;
	}

	bytes_per_sample = meta_contin->carried_bits_per_sample / 8;
	if (interleaved) {
		channel_step = bytes_per_sample * (locations - 1);
		contin_end = (locations * meta_contin->bytes_per_location) - channel_step;
		frame_step = bytes_per_sample;
	} else {
		channel_step = 0;
		contin_end = meta_contin->bytes_per_location;
		frame_step = meta_contin->bytes_per_location;
	}

	zassert_equal(pcm_contin->len, meta_contin->bytes_per_location * locations,
		      "Incorrect continuous array length: %d (%d)", pcm_contin->len,
		      meta_contin->bytes_per_location * locations);

	if (meta_contin->locations == 0 && locs_out == 0) {
		locs_out = 0x00000001;
	} else {
		locs_out &= meta_contin->locations;
	}

	chan_out = 0;
	test_chan_out = 0;
	contin_locs = meta_contin->locations;

	while (contin_locs) {
		/* Test if this is a common location between the output and the finite position.
		 * Test if this location/channel is matching the finite buffer.
		 */
		if (contin_locs & locs_out & 0x01) {
			zassert_equal(pcm_contin->data[frame_step * test_chan_out],
				      pcm_finite[finite_start],
				      "First value 0x%x for channel %d is not 0x%x",
				      pcm_contin->data[frame_step * test_chan_out],
				      test_chan_out + 1, pcm_finite[finite_start]);

			zassert_equal(
				pcm_contin->data[(contin_end + (test_chan_out * frame_step)) - 1],
				pcm_finite[finite_end],
				"Last value 0x%x for channel %d is not 0x%x",
				pcm_contin->data[(contin_end + (test_chan_out * frame_step)) - 1],
				test_chan_out + 1, pcm_finite[finite_end]);

			test_chan_out++;
			chan_out++;
		} else if (contin_locs & 0x01) {
			/* Else if this is just a location in the output and we test that the
			 * location/channel has either 0 or the test value.
			 */
			if (filled) {
				test_byte = CONTIN_TEST_BYTE;
			} else {
				test_byte = 0;
			}

			zassert_equal(pcm_contin->data[frame_step * chan_out], test_byte,
				      "First value 0x%x for channel %d is not 0x%x",
				      pcm_contin->data[bytes_per_sample * chan_out], chan_out + 1,
				      test_byte);

			zassert_equal(pcm_contin->data[(contin_end + (chan_out * frame_step)) - 1],
				      test_byte, "Last value 0x%x for channel %d is not 0x%x",
				      pcm_contin->data[(contin_end + (chan_out * frame_step)) - 1],
				      chan_out + 1, test_byte);
			chan_out++;
		}

		contin_locs >>= 1;
		locs_out >>= 1;
	}
}
```

## src/array_test_data.h
```c
/*
 * Copyright (c) 2025 Nordic Semiconductor ASA
 *
 * SPDX-License-Identifier: LicenseRef-Nordic-5-Clause
 */

#include <errno.h>
#include <stdlib.h>
#include <stdio.h>
#include <ctype.h>
#include <zephyr/kernel.h>
#include <zephyr/net_buf.h>
#include <zephyr/bluetooth/audio/audio.h>
#include <audio_defines.h>

#define TEST_BITS_8  8
#define TEST_BITS_16 16
#define TEST_BITS_24 24
#define TEST_BITS_32 32

#define CONTIN_TEST_CONTIN_LOC_MAX   (BT_AUDIO_LOCATION_FRONT_LEFT | BT_AUDIO_LOCATION_FRONT_RIGHT)
#define CONTIN_TEST_CONTIN_DATA_SIZE 300
#define CONTIN_TEST_POOL_CONTIN_NUM  1
#define CONTIN_TEST_POOL_FINITE_NUM  1
#define CONTIN_TEST_POOL_CONTIN_SIZE                                                               \
	(CONTIN_TEST_CONTIN_DATA_SIZE *                                                            \
	 ((CONTIN_TEST_CONTIN_LOC_MAX == BT_AUDIO_LOCATION_MONO_AUDIO                              \
		   ? 1                                                                             \
		   : POPCOUNT(CONTIN_TEST_CONTIN_LOC_MAX))))
#define CONTIN_TEST_SAMPLE_SIZE	 (16)
#define CONTIN_TEST_CARRIER_SIZE (16)
#define CONTIN_TEST_BYTE	 0x1f

#define CONTIN_TEST_INTERLEAVED	  true
#define CONTIN_TEST_DEINTERLEAVED false
#define CONTIN_TEST_FILLED	  true
#define CONTIN_TEST_NOT_FILLED	  false

extern uint8_t const test_arr[256];

void validate_contin_array(struct net_buf const *const pcm_contin, uint8_t const *const pcm_finite,
			   uint32_t locs_out, uint16_t finite_start, uint16_t finite_end,
			   bool interleaved, bool filled);
```
