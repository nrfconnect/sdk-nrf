/* Since the QEMU device tree uses a UART device that does not have
 * tx-pin and rx-pin properties, we override that with this custom peripheral
 * that inherits from nordic,nrf-uarte which has the properties.
 * These properties are used by the unit under test.
 */
/ {
	soc {
		uart1: uart@4000d000 {
			compatible = "nordic,nrf-uarte";
			reg = <0x4000d000 0x4c>;
			clocks = <&sysclk>;
			tx-pin = <2>;
			rx-pin = <3>;
			interrupts = <6 3>;
			status = "okay";
			label = "UART_1";
		};
	};
};
