## tests/lib/modem_trace/modem_trace_rtt/Kconfig
```kconfig
menu "Local sourcing"

source "$(ZEPHYR_NRF_MODULE_DIR)/lib/nrf_modem_lib/Kconfig.modemlib"

endmenu

config HAS_SEGGER_RTT
	bool
	default y
	help
	    This symbol overrides the promptless symbol HAS_SEGGER_RTT because this is needed by
	    the unit test.

source "Kconfig.zephyr"
```

## tests/lib/modem_trace/modem_trace_rtt/testcase.yaml
```yaml
tests:
  lib.modem_trace_rtt:
    platform_allow: qemu_cortex_m3
    integration_platforms:
      - qemu_cortex_m3
    tags: modem_trace
```

## tests/lib/modem_trace/modem_trace_uart/Kconfig
```kconfig
menu "Local sourcing"

source "$(ZEPHYR_NRF_MODULE_DIR)/lib/nrf_modem_lib/Kconfig.modemlib"

endmenu

config NRFX_UARTE1
	bool
	default y
	help
	    This symbol overrides the promptless symbol NRFX_UARTE1 because this is needed by
	    the unit test.

source "Kconfig.zephyr"
```

## tests/lib/modem_trace/modem_trace_uart/testcase.yaml
```yaml
tests:
  lib.modem_trace_uart:
    platform_allow: qemu_cortex_m3
    integration_platforms:
      - qemu_cortex_m3
    tags: modem_trace
```

## tests/lib/nrf_fuel_gauge/testcase.yaml
```yaml
tests:
  unity.nrf_fuel_gauge_no_fpu:
    sysbuild: true
    platform_allow: nrf5340dk/nrf5340/cpuapp nrf52840dk/nrf52840 nrf52dk/nrf52832 nrf52dk/nrf52810
    integration_platforms:
      - nrf5340dk/nrf5340/cpuapp
      - nrf52840dk/nrf52840
      - nrf52dk/nrf52832
      - nrf52dk/nrf52810
    tags: nrf_fuel_gauge sysbuild
    build_only: true
    extra_args: CONFIG_FPU=n
  unity.nrf_fuel_gauge_fpu:
    sysbuild: true
    platform_allow: nrf5340dk/nrf5340/cpuapp nrf52840dk/nrf52840 nrf52dk/nrf52832
    integration_platforms:
      - nrf5340dk/nrf5340/cpuapp
      - nrf52840dk/nrf52840
      - nrf52dk/nrf52832
    tags: nrf_fuel_gauge sysbuild
    build_only: true
    extra_args: CONFIG_FPU=y
  unity.nrf_fuel_gauge_qemu:
    sysbuild: true
    platform_allow: qemu_cortex_m3
    integration_platforms:
      - qemu_cortex_m3
    tags: nrf_fuel_gauge sysbuild
    build_only: false
```

## tests/lib/nrf_modem_lib/lte_connectivity/Kconfig
```kconfig
menu "Local sourcing"

source "$(ZEPHYR_NRF_MODULE_DIR)/lib/nrf_modem_lib/Kconfig.modemlib"
source "$(ZEPHYR_NRF_MODULE_DIR)/lib/nrf_modem_lib/lte_connectivity/Kconfig"

endmenu

source "Kconfig.zephyr"
```

## tests/lib/nrf_modem_lib/lte_connectivity/testcase.yaml
```yaml
tests:
  nrf_modem_lib.lte_connectivity:
    tags: nrf_modem_lib
    platform_allow: native_posix
    integration_platforms:
      - native_posix
```

## tests/lib/nrf_modem_lib/lte_net_if/Kconfig
```kconfig
menu "Local sourcing"

source "$(ZEPHYR_NRF_MODULE_DIR)/lib/nrf_modem_lib/Kconfig.modemlib"
source "$(ZEPHYR_NRF_MODULE_DIR)/lib/nrf_modem_lib/lte_net_if/Kconfig"

endmenu

source "Kconfig.zephyr"
```

## tests/lib/nrf_modem_lib/lte_net_if/testcase.yaml
```yaml
tests:
  nrf_modem_lib.lte_net_if:
    sysbuild: true
    tags: nrf_modem_lib sysbuild ci_tests_lib_nrf_modem_lib
    platform_allow:
      - native_sim
    integration_platforms:
      - native_sim
```

## tests/lib/nrf_modem_lib/nrf91_sockets/testcase.yaml
```yaml
tests:
  unity.nrf91_sockets_test:
    sysbuild: true
    platform_allow: native_sim
    tags: nrf_modem_lib sysbuild ci_tests_lib_nrf_modem_lib
    integration_platforms:
      - native_sim
```

## tests/lib/nrf_modem_lib/nrf9x_sockets/testcase.yaml
```yaml
tests:
  unity.nrf9x_sockets_test:
    sysbuild: true
    tags: nrf_modem_lib sysbuild ci_tests_lib_nrf_modem_lib
    platform_allow:
      - native_sim
    integration_platforms:
      - native_sim
```

## tests/lib/nrf_modem_lib/nrf_modem_lib_trace/Kconfig
```kconfig
menu "Local sourcing"

source "$(ZEPHYR_NRF_MODULE_DIR)/lib/nrf_modem_lib/Kconfig.modemlib"

# Adds NRF_MODEM_LIB_TRACE_BACKEND_NONE to the trace backend choice otherwise UART is chosen by default.
choice NRF_MODEM_LIB_TRACE_BACKEND

config NRF_MODEM_LIB_TRACE_BACKEND_NONE
	bool "No backend (unused)"

endchoice # NRF_MODEM_LIB_TRACE_BACKEND

endmenu

source "Kconfig.zephyr"

module = NRF_MODEM_LIB_TRACE_TEST
module-str = nrf_modem_lib_trace_test
source "subsys/logging/Kconfig.template.log_config"
```

## tests/lib/nrf_modem_lib/nrf_modem_lib_trace/testcase.yaml
```yaml
tests:
  nrf_modem_lib.nrf_modem_lib_trace:
    sysbuild: true
    platform_allow: qemu_cortex_m3
    integration_platforms:
      - qemu_cortex_m3
    tags: nrf_modem_lib modem_trace sysbuild
```

## tests/lib/nrf_modem_lib/trace_backends/flash/testcase.yaml
```yaml
tests:
  trace_backends.flash:
    sysbuild: true
    platform_allow: native_sim
    integration_platforms:
      - native_sim
    tags:
      - nrf_modem_lib
      - modem_trace
      - ci_tests_lib_nrf_modem_lib
```

## tests/lib/nrf_modem_lib/trace_backends/rtt/testcase.yaml
```yaml
tests:
  trace_backends.rtt:
    sysbuild: true
    platform_allow: qemu_cortex_m3
    integration_platforms:
      - qemu_cortex_m3
    tags: nrf_modem_lib modem_trace sysbuild
```

## tests/lib/nrf_modem_lib/trace_backends/uart/testcase.yaml
```yaml
tests:
  trace_backends.uart:
    platform_allow: qemu_cortex_m3
    integration_platforms:
      - qemu_cortex_m3
    tags: nrf_modem_lib modem_trace
```

## tests/lib/ntn/Kconfig
```kconfig
#
# Copyright (c) 2025 Nordic Semiconductor ASA
#
# SPDX-License-Identifier: LicenseRef-Nordic-5-Clause
#

# Redefinition to disable modemlib requirement from the tests as we want to mock it.
config NTN
	default y
	select AT_PARSER
	select AT_MONITOR
	imply CBPRINTF_FP_SUPPORT if LOG

menu "Zephyr Kernel"
source "Kconfig.zephyr"
endmenu
```

## tests/lib/pcm_mix/Kconfig
```kconfig
# Copyright (c) 2022 Nordic Semiconductor ASA
# SPDX-License-Identifier: LicenseRef-Nordic-5-Clause

module = PCM_MIX
module-str = pcm-mix
source "subsys/logging/Kconfig.template.log_config"

source "Kconfig.zephyr"
```

## tests/lib/pcm_stream_channel_modifier/testcase.yaml
```yaml
tests:
  nrf5340_audio.pscm_test:
    sysbuild: true
    platform_allow: qemu_cortex_m3
    integration_platforms:
      - qemu_cortex_m3
    tags: pcm_stream_channel_modifier nrf5340_audio_unit_tests sysbuild
```

## tests/lib/pdn/testcase.yaml
```yaml
tests:
  pdn.unit_test:
    sysbuild: true
    tags:
      - modem_info
      - sysbuild
      - ci_tests_lib_pdn
    platform_allow: native_sim
    integration_platforms:
      - native_sim
```

## tests/lib/ppi_seq/ppi_seq_i2c_spi/testcase.yaml
```yaml
common:
  sysbuild: true
  harness: ztest
  harness_config:
    fixture: gpio_spi_loopback
  tags:
    - drivers
    - spi
    - i2c
    - ci_tests_lib_ppi_seq
tests:
  lib.ppi_seq_i2c_spi.i2c:
    depends_on: i2c
    platform_allow:
      - nrf54l15dk/nrf54l15/cpuapp
      - nrf54lm20dk/nrf54lm20a/cpuapp
  lib.ppi_seq_i2c_spi.spi_timer_trigger:
    depends_on: spi
    extra_args:
      - DTC_OVERLAY_FILE="boards/nrf54lm20dk_nrf54lm20a_cpuapp_spi_timer.overlay"
    platform_allow:
      - nrf54lm20dk/nrf54lm20a/cpuapp
  lib.ppi_seq_i2c_spi.spi_extra_op:
    depends_on: spi
    extra_args:
      - DTC_OVERLAY_FILE="boards/nrf54lm20dk_nrf54lm20a_cpuapp_spi_timer_extra_op.overlay"
    platform_allow:
      - nrf54lm20dk/nrf54lm20a/cpuapp
  lib.ppi_seq_i2c_spi.spi_timer_notifier:
    depends_on: spi
    extra_args:
      - DTC_OVERLAY_FILE="boards/nrf54lm20dk_nrf54lm20a_cpuapp_spi_timer_notifier.overlay"
    platform_allow:
      - nrf54lm20dk/nrf54lm20a/cpuapp
  lib.ppi_seq_i2c_spi.i2c_timer_notifier_counter:
    depends_on: i2c
    extra_args:
      - DTC_OVERLAY_FILE="boards/nrf54lm20dk_nrf54lm20a_cpuapp_i2c_timer_notifier_counter.overlay"
    platform_allow:
      - nrf54lm20dk/nrf54lm20a/cpuapp
  lib.ppi_seq_i2c_spi.spi_rtc:
    depends_on: spi
    extra_args:
      - DTC_OVERLAY_FILE="boards/nrf54h20dk_nrf54h20_cpuapp_spi_rtc.overlay"
    platform_allow:
      - nrf54h20dk/nrf54h20/cpuapp
```

## tests/lib/ppi_seq/ppi_seq_with_spi/testcase.yaml
```yaml
tests:
  lib.ppi_seq.ppi_seq_with_spi:
    depends_on: spi
    tags:
      - drivers
      - spi
      - ci_tests_lib_ppi_seq
    harness: ztest
    harness_config:
      fixture: gpio_spi_loopback
    platform_allow:
      - nrf54lm20dk/nrf54lm20a/cpuapp
      - nrf54h20dk/nrf54h20/cpuapp
```

## tests/lib/qos/testcase.yaml
```yaml
tests:
  unity.qos:
    sysbuild: true
    platform_allow:
      - qemu_cortex_m3
      - native_sim
    integration_platforms:
      - qemu_cortex_m3
      - native_sim
    tags:
      - qos
      - sysbuild
      - ci_tests_lib_qos
```

## tests/lib/sample_rate_conv_naive/testcase.yaml
```yaml
tests:
  nrf5340_audio.tone_test:
    platform_allow: qemu_cortex_m3
    integration_platforms:
      - qemu_cortex_m3
    tags: sample_rate_conv_naive nrf5340_audio_unit_tests
```

## tests/lib/sample_rate_converter/testcase.yaml
```yaml
tests:
  nrf5340_audio.sample_rate_converter:
    sysbuild: true
    platform_allow: qemu_cortex_m3
    integration_platforms:
      - qemu_cortex_m3
    tags: sample_rate_converter nrf5340_audio_unit_tests sysbuild
```
