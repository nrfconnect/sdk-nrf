/*
 * Copyright (c) 2025 Nordic Semiconductor ASA
 *
 * SPDX-License-Identifier: LicenseRef-Nordic-5-Clause
 */

&flash0 {
	partitions {
		compatible = "fixed-partitions";
		#address-cells = <1>;
		#size-cells = <1>;

		/* Keep boot and slot0 so chosen code-partition remains valid */
		/delete-node/ slot1_partition;
		/delete-node/ scratch_partition;
		/delete-node/ storage_partition;

		/* modem_trace partition - matches flash backend without partition manager */
		modem_trace: partition@75000 {
			label = "modem_trace";
			reg = <0x00075000 0x00010000>; /* 64KB */
		};
	};
};
