## tests/lib/sfloat/testcase.yaml
```yaml
tests:
  lib.sfloat:
    sysbuild: true
    platform_allow:
      nrf52dk/nrf52832 nrf52840dk/nrf52840 nrf5340dk/nrf5340/cpuapp
    integration_platforms:
      - nrf52dk/nrf52832
      - nrf52840dk/nrf52840
      - nrf5340dk/nrf5340/cpuapp
    tags: sfloat sysbuild
```

## tests/lib/sms/Kconfig
```kconfig
#
# Copyright (c) 2021 Nordic Semiconductor ASA
#
# SPDX-License-Identifier: LicenseRef-Nordic-5-Clause
#

config AT_NOTIF
	bool "Internal"
	default y
	help
	  Used in tests to enable mocking of AT Command library, i.e., remove
	  dependency from AT Command Notifications library to AT command library

menu "Zephyr Kernel"
source "Kconfig.zephyr"
endmenu
```

## tests/lib/sms/testcase.yaml
```yaml
tests:
  unity.sms_test:
    sysbuild: true
    tags: sms sysbuild ci_tests_lib_sms
    platform_allow: native_sim
    integration_platforms:
      - native_sim
  unity.sms_test.no_status_report:
    sysbuild: true
    tags: sms sysbuild ci_tests_lib_sms
    platform_allow: native_sim
    integration_platforms:
      - native_sim
    extra_configs:
      - CONFIG_SMS_STATUS_REPORT=n
```

## tests/lib/tone/testcase.yaml
```yaml
tests:
  nrf5340_audio.tone_test:
    sysbuild: true
    platform_allow: qemu_cortex_m3
    integration_platforms:
      - qemu_cortex_m3
    tags: tone nrf5340_audio_unit_tests sysbuild
```

## tests/lib/uicc_lwm2m/testcase.yaml
```yaml
tests:
  uicc_lwm2m.unit_test:
    sysbuild: true
    tags: uicc_lwm2m sysbuild ci_tests_lib_uicc_lwm2m
    platform_allow: native_sim
    integration_platforms:
      - native_sim
```

## tests/lib/wifi_kmu/testcase.yaml
```yaml
tests:
  wifi_kmu.secure_only:
    sysbuild: true
    platform_allow:
      - nrf7120dk/nrf7120/cpuapp
    integration_platforms:
      - nrf7120dk/nrf7120/cpuapp
    tags:
      - sysbuild
  wifi_kmu.tfm:
    sysbuild: true
    platform_allow:
      - nrf7120dk/nrf7120/cpuapp
    integration_platforms:
      - nrf7120dk/nrf7120/cpuapp
    tags:
      - sysbuild
```

## tests/mocks/Kconfig
```kconfig
#
# Copyright (c) 2022 Nordic Semiconductor
#
# SPDX-License-Identifier: LicenseRef-Nordic-5-Clause
#

menu "Mocks"

rsource "nrf_modem_at/Kconfig"

endmenu
```

## tests/mocks/nrf_modem_at/Kconfig
```kconfig
#
# Copyright (c) 2022 Nordic Semiconductor
#
# SPDX-License-Identifier: LicenseRef-Nordic-5-Clause
#

menuconfig MOCK_NRF_MODEM_AT
	bool "Custom mock for nrf_modem_at"

if MOCK_NRF_MODEM_AT

config MOCK_NRF_MODEM_AT_PRINTF
	bool "Mock for nrf_modem_at_printf"
	default y
	help
	  Mock for nrf_modem_at_printf.

config MOCK_NRF_MODEM_AT_SCANF
	bool "Mock for nrf_modem_at_scanf"
	default y
	help
	  Mock for nrf_modem_at_scanf.

if MOCK_NRF_MODEM_AT_PRINTF

config MOCK_NRF_MODEM_AT_PRINTF_CALL_COUNT
	int "Maximum number nrf_modem_at_printf calls"
	default 50
	help
	  Maximum number nrf_modem_at_printf calls that can be added before
	  resetting expected calls. Normally resetting is done before each test case.

endif # MOCK_NRF_MODEM_AT_PRINTF

if MOCK_NRF_MODEM_AT_SCANF

config MOCK_NRF_MODEM_AT_SCANF_CALL_COUNT
	int "Maximum number nrf_modem_at_scanf calls"
	default 10
	help
	  Maximum number nrf_modem_at_scanf calls that can be added before
	  resetting expected calls. Normally resetting is done before each test case.

config MOCK_NRF_MODEM_AT_SCANF_VARGS_COUNT
	int "Maximum number nrf_modem_at_scanf variable arguments"
	default 10
	help
	  Maximum number nrf_modem_at_scanf calls that can be added before
	  resetting expected calls.

config MOCK_NRF_MODEM_AT_SCANF_VARGS_STR_SIZE
	int "Maximum size of a string variable in nrf_modem_at_scanf variable arguments"
	default 20
	help
	  Maximum size of a string variable in nrf_modem_at_scanf variable arguments.
	  If you use __mock_nrf_modem_at_scanf_ReturnVarg_string() function
	  with a longer string, you need to increase this value.

endif # MOCK_NRF_MODEM_AT_SCANF

endif # MOCK_NRF_MODEM_AT
```

## tests/modules/cddl_gen/testcase.yaml
```yaml
tests:
  modules.cddl_gen.decode:
    platform_allow: native_posix
    tags: cddl_gen
    build_only: true
```

## tests/modules/lib/cddl-gen/decode/testcase.yaml
```yaml
tests:
  modules.lib.cddl_gen.decode:
    tags: cddl-gen
    platform_allow: native_posix
    integration_platforms:
      - native_posix
```

## tests/modules/lib/cddl-gen/encode/testcase.yaml
```yaml
tests:
  modules.lib.cddl_gen.encode:
    tags: cddl-gen
    platform_allow: native_posix
    integration_platforms:
      - native_posix
```

## tests/modules/lib/cddl-gen/raw_encode/testcase.yaml
```yaml
tests:
  modules.lib.cddl_gen.raw_encode:
    tags: cddl-gen
    platform_allow: native_posix
    integration_platforms:
      - native_posix
```

## tests/modules/lib/cddl-gen/testcase.yaml
```yaml
tests:
  modules.lib.cddl_gen:
    tags: cddl-gen
    integration_platforms:
      - native_posix
```

## tests/modules/lib/zcbor/decode/testcase.yaml
```yaml
tests:
  modules.lib.zcbor.decode:
    sysbuild: true
    tags:
      - zcbor
      - sysbuild
      - ci_tests_modules_lib_zcbor
    platform_allow: native_sim
    integration_platforms:
      - native_sim
```

## tests/modules/lib/zcbor/encode/testcase.yaml
```yaml
tests:
  modules.lib.zcbor.encode:
    sysbuild: true
    tags: zcbor sysbuild ci_tests_modules_lib_zcbor
    platform_allow: native_posix
    integration_platforms:
      - native_posix
```

## tests/modules/lib/zcbor/raw_encode/testcase.yaml
```yaml
tests:
  modules.lib.zcbor.raw_encode:
    sysbuild: true
    tags: zcbor sysbuild ci_tests_modules_lib_zcbor
    platform_allow: native_posix
    integration_platforms:
      - native_posix
```

## tests/modules/mcuboot/direct_xip/Kconfig.sysbuild
```kconfig
#
# Copyright (c) 2026 Nordic Semiconductor
#
# SPDX-License-Identifier: LicenseRef-Nordic-5-Clause
#

config PARTITION_MANAGER
	default n if SOC_SERIES_NRF91

source "$(ZEPHYR_BASE)/share/sysbuild/Kconfig"
```

## tests/modules/mcuboot/external_flash/Kconfig.sysbuild
```kconfig
#
# Copyright (c) 2024 Nordic Semiconductor
#
# SPDX-License-Identifier: LicenseRef-Nordic-5-Clause
#

choice MCUBOOT_MODE
	default MCUBOOT_MODE_OVERWRITE_ONLY if SOC_SERIES_NRF53
endchoice

choice NETCORE
	default NETCORE_EMPTY if SOC_NRF5340_CPUAPP
endchoice

config SECURE_BOOT_NETCORE
	default y if SOC_NRF5340_CPUAPP

config NETCORE_APP_UPDATE
	default y if SOC_NRF5340_CPUAPP

source "share/sysbuild/Kconfig"
```

## tests/modules/mcuboot/external_flash/boards/thingy53_nrf5340_cpuapp.conf
```kconfig
#
# Copyright (c) 2021 Nordic Semiconductor ASA
#
# SPDX-License-Identifier: LicenseRef-Nordic-5-Clause
#

CONFIG_BOARD_ENABLE_CPUNET=y
```

## tests/modules/mcuboot/external_flash/child_image/mcuboot/boards/thingy53_nrf5340_cpuapp.conf
```kconfig
#
# Copyright (c) 2021 Nordic Semiconductor ASA
#
# SPDX-License-Identifier: LicenseRef-Nordic-5-Clause
#

# MCUBoot serial
CONFIG_GPIO=y
CONFIG_BOOT_SERIAL_CDC_ACM=y
CONFIG_BOOT_SERIAL_DETECT_PORT="GPIO_1"
CONFIG_BOOT_SERIAL_DETECT_PIN=13

# USB
CONFIG_USB=y
CONFIG_USB_DEVICE_MANUFACTURER="Nordic Semiconductor ASA"
CONFIG_USB_DEVICE_PRODUCT="Bootloader Thingy:53"
CONFIG_USB_DEVICE_VID=0x1915
CONFIG_USB_DEVICE_PID=0x5300
CONFIG_USB_CDC_ACM=y

# Decrease memory footprint
CONFIG_SPI=n
CONFIG_I2C=n
CONFIG_UART_NRFX=n

# The following configurations are required to support simultaneous multi image update
CONFIG_PCD_APP=y
CONFIG_UPDATEABLE_IMAGE_NUMBER=2
CONFIG_FLASH_SIMULATOR=y
CONFIG_FLASH_SIMULATOR_DOUBLE_WRITES=y
CONFIG_FLASH_SIMULATOR_STATS=n
CONFIG_BOOT_UPGRADE_ONLY=y

# Increase the size of MCUboot to fit debug build with USB drivers
CONFIG_PM_PARTITION_SIZE_MCUBOOT=0x20000
```

## tests/modules/mcuboot/external_flash/sysbuild/mcuboot/boards/nrf5340dk_nrf5340_cpuapp.conf
```kconfig
#
# Copyright (c) 2021 Nordic Semiconductor ASA
#
# SPDX-License-Identifier: LicenseRef-Nordic-5-Clause
#


# The following configurations are required to support simultaneous multi image update
CONFIG_PCD_APP=y
CONFIG_UPDATEABLE_IMAGE_NUMBER=2
CONFIG_FLASH_SIMULATOR=y
CONFIG_FLASH_SIMULATOR_DOUBLE_WRITES=y
CONFIG_FLASH_SIMULATOR_STATS=n
CONFIG_BOOT_UPGRADE_ONLY=y

CONFIG_SIZE_OPTIMIZATIONS=y
```

## tests/modules/mcuboot/external_flash/sysbuild/mcuboot/boards/thingy53_nrf5340_cpuapp.conf
```kconfig
#
# Copyright (c) 2021 Nordic Semiconductor ASA
#
# SPDX-License-Identifier: LicenseRef-Nordic-5-Clause
#

# MCUBoot serial
CONFIG_GPIO=y
CONFIG_BOOT_SERIAL_CDC_ACM=y

# USB
CONFIG_USB_DEVICE_STACK=y
CONFIG_USB_DEVICE_REMOTE_WAKEUP=n
CONFIG_USB_DEVICE_MANUFACTURER="Nordic Semiconductor ASA"
CONFIG_USB_DEVICE_PRODUCT="Bootloader Thingy:53"
CONFIG_USB_DEVICE_VID=0x1915
CONFIG_USB_DEVICE_PID=0x5300
CONFIG_USB_CDC_ACM=y

# Decrease memory footprint
CONFIG_SPI=n
CONFIG_I2C=n
CONFIG_UART_NRFX=n

# The following configurations are required to support simultaneous multi image update
CONFIG_PCD_APP=y
CONFIG_UPDATEABLE_IMAGE_NUMBER=2
CONFIG_FLASH_SIMULATOR=y
CONFIG_FLASH_SIMULATOR_DOUBLE_WRITES=y
CONFIG_FLASH_SIMULATOR_STATS=n
CONFIG_BOOT_UPGRADE_ONLY=y
```

## tests/modules/mcuboot/external_flash/testcase.yaml
```yaml
tests:
  mcuboot.external_flash:
    sysbuild: true
    extra_configs:
      - CONFIG_CLOCK_CONTROL_NRF=n
    platform_allow:
      - nrf52840dk/nrf52840
      - nrf5340dk/nrf5340/cpuapp
      - thingy53/nrf5340/cpuapp
    tags:
      - mcuboot
      - external_flash
      - sysbuild
      - ci_tests_modules_mcuboot
    integration_platforms:
      - nrf52840dk/nrf52840
      - nrf5340dk/nrf5340/cpuapp
      - thingy53/nrf5340/cpuapp

  mcuboot.external_flash.legacy:
    sysbuild: true
    extra_configs:
      - CONFIG_CLOCK_CONTROL_NRF=y
    platform_allow:
      - nrf52840dk/nrf52840
      - nrf5340dk/nrf5340/cpuapp
      - thingy53/nrf5340/cpuapp
    tags:
      - mcuboot
      - external_flash
      - sysbuild
      - ci_tests_modules_mcuboot
    integration_platforms:
      - nrf52840dk/nrf52840
      - nrf5340dk/nrf5340/cpuapp
      - thingy53/nrf5340/cpuapp
```

## tests/modules/mcuboot/key-locking/testcase.yaml
```yaml
tests:
  mcuboot.key_locking:
    sysbuild: true
    tags:
      - mcuboot
      - sysbuild
      - kmu
      - key_locking
      - psa
      - cracen
      - ci_tests_modules_mcuboot
    extra_args:
      # Provision the automatically when running on CI
      - SB_CONFIG_MCUBOOT_GENERATE_DEFAULT_KMU_KEYFILE=y
    platform_allow:
      - nrf54l15dk/nrf54l15/cpuapp
    integration_platforms:
      - nrf54l15dk/nrf54l15/cpuapp
```
