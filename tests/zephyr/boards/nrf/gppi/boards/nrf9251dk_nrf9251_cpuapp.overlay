/*
 * Copyright (c) 2026 Nordic Semiconductor ASA
 *
 * SPDX-License-Identifier: LicenseRef-Nordic-5-Clause
 */

dut_timer0: &timer130 {
	status = "reserved";
};

dut_timer1: &timer131 {
	status = "reserved";
};

dut_timer2: &timer132 {
	status = "reserved";
};

&pdm0 {
	status = "reserved";
};
