/*
 * Copyright (c) 2026 Nordic Semiconductor ASA
 *
 * SPDX-License-Identifier: LicenseRef-Nordic-5-Clause
 */

#include "nrf9251dk_nrf9251_cpuapp.overlay"

&uart130 {
	memory-regions = <&cpuppr_dma_region>;
};

&uart120 {
	/delete-property/ memory-regions;
};
