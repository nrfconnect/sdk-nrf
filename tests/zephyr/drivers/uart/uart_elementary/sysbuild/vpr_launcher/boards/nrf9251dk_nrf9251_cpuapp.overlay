/*
 * Copyright (c) 2026 Nordic Semiconductor ASA
 *
 * SPDX-License-Identifier: LicenseRef-Nordic-5-Clause
 */

&uart130 {
	status = "reserved";
	interrupt-parent = <&cpuppr_clic>;
};

&uart131 {
	status = "reserved";
	interrupt-parent = <&cpuppr_clic>;
};

&uart120 {
	status = "reserved";
	interrupt-parent = <&cpuflpr_clic>;
};
