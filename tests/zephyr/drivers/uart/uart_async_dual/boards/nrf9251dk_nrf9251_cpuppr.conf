## tests/zephyr/drivers/uart/uart_errors/testcase.yaml
```yaml
common:
  tags:
    - drivers
    - uart
    - ci_tests_zephyr_drivers_uart
  depends_on: gpio
  harness: ztest
  harness_config:
    fixture: gpio_loopback
  timeout: 30
  platform_allow:
    - nrf54ls05dk/nrf54ls05b/cpuapp
    - nrf54ls05dk@0.0.0/nrf54ls05b/cpuapp
    - nrf54ls05dk@0.2.0/nrf54ls05b/cpuapp
    - nrf54lv10dk/nrf54lv10a/cpuapp
    - nrf54lv10dk@0.2.0/nrf54lv10a/cpuapp
    - nrf7120dk/nrf7120/cpuapp
  integration_platforms:
    - nrf54ls05dk/nrf54ls05b/cpuapp
tests:
  nrf.extended.drivers.uart.uart_errors.int_driven:
    filter: CONFIG_SERIAL_SUPPORT_INTERRUPT

  nrf.extended.drivers.uart.uart_errors.async:
    filter: CONFIG_SERIAL_SUPPORT_ASYNC
    extra_configs:
      - CONFIG_UART_ASYNC_API=y
      - CONFIG_UART_INTERRUPT_DRIVEN=n
      - CONFIG_PM_DEVICE=n
```

## tests/zephyr/drivers/uart/uart_mix_fifo_poll/testcase.yaml
```yaml
common:
  tags:
    - drivers
    - uart
    - ci_tests_drivers_uart
  depends_on: gpio
  harness: ztest
  platform_allow:
    - nrf54ls05dk/nrf54ls05b/cpuapp
    - nrf54ls05dk@0.0.0/nrf54ls05b/cpuapp
    - nrf54ls05dk@0.2.0/nrf54ls05b/cpuapp
    - nrf54lv10dk/nrf54lv10a/cpuapp
    - nrf54lv10dk@0.2.0/nrf54lv10a/cpuapp
    - nrf7120dk/nrf7120/cpuapp
  integration_platforms:
    - nrf54ls05dk/nrf54ls05b/cpuapp
  harness_config:
    fixture: uart_loopback
  timeout: 45
tests:
  nrf.extended.drivers.uart.uart_mix_poll:
    extra_configs:
      - CONFIG_UART_INTERRUPT_DRIVEN=n
      - CONFIG_UART_ASYNC_API=n

  nrf.extended.drivers.uart.uart_mix_poll_fifo:
    extra_configs:
      - CONFIG_UART_INTERRUPT_DRIVEN=y

  nrf.extended.drivers.uart.uart_mix_poll_async_api:
    extra_configs:
      - CONFIG_UART_ASYNC_API=y

  nrf.extended.drivers.uart.uart_mix_poll_async_api_const:
    extra_args: TEST_CONST_BUFFER=1
    extra_configs:
      - CONFIG_UART_ASYNC_API=y
```

## tests/zephyr/drivers/uart/uart_pm/testcase.yaml
```yaml
common:
  tags:
    - drivers
    - uart
    - ci_tests_drivers_uart
  harness: ztest
  platform_allow:
    - nrf54ls05dk/nrf54ls05b/cpuapp
    - nrf54ls05dk@0.0.0/nrf54ls05b/cpuapp
    - nrf54ls05dk@0.2.0/nrf54ls05b/cpuapp
    - nrf54lv10dk/nrf54lv10a/cpuapp
    - nrf54lv10dk@0.2.0/nrf54lv10a/cpuapp
    - nrf7120dk/nrf7120/cpuapp
  harness_config:
    fixture: gpio_loopback
  depends_on: gpio
  integration_platforms:
    - nrf54ls05dk/nrf54ls05b/cpuapp
  timeout: 30
tests:
  nrf.extended.drivers.uart.pm:
    extra_configs:
      - CONFIG_UART_INTERRUPT_DRIVEN=n
      - CONFIG_UART_ASYNC_API=n
      - CONFIG_UART_0_ENHANCED_POLL_OUT=n

  nrf.extended.drivers.uart.pm.int_driven:
    extra_configs:
      - CONFIG_UART_INTERRUPT_DRIVEN=y
      - CONFIG_UART_0_INTERRUPT_DRIVEN=y
      - CONFIG_UART_ASYNC_API=n
      - CONFIG_UART_0_ENHANCED_POLL_OUT=n

  nrf.extended.drivers.uart.pm.async:
    extra_configs:
      - CONFIG_UART_INTERRUPT_DRIVEN=n
      - CONFIG_UART_ASYNC_API=y
      - CONFIG_UART_0_ASYNC=y
      - CONFIG_UART_0_NRF_HW_ASYNC=y
      - CONFIG_UART_0_NRF_HW_ASYNC_TIMER=2
      - CONFIG_NRFX_TIMER=y
      - CONFIG_UART_0_ENHANCED_POLL_OUT=n
```

## tests/zephyr/drivers/watchdog/wdt_basic_api/testcase.yaml
```yaml
common:
  tags:
    - drivers
    - watchdog
    - ci_tests_zephyr_drivers_watchdog
  timeout: 30
tests:
  nrf.extended.drivers.watchdog:
    platform_allow:
      - nrf54ls05dk/nrf54ls05b/cpuapp
      - nrf54ls05dk@0.0.0/nrf54ls05b/cpuapp
      - nrf54ls05dk@0.2.0/nrf54ls05b/cpuapp
      - nrf54lv10dk/nrf54lv10a/cpuapp
      - nrf54lv10dk/nrf54lv10a/cpuapp/ns
      - nrf54lv10dk/nrf54lv10a/cpuflpr
      - nrf54lv10dk@0.2.0/nrf54lv10a/cpuapp
      - nrf54lv10dk@0.2.0/nrf54lv10a/cpuflpr
    integration_platforms:
      - nrf54ls05dk/nrf54ls05b/cpuapp
```

## tests/zephyr/drivers/watchdog/wdt_error_cases/dts/bindings/test-wdt-error-cases.yaml
```yaml
description: |
    This binding provides resources required to build and run the
    tests/drivers/watchdog/wdt_error_cases test in Zephyr.

compatible: "test-wdt-error_cases"

properties:
  opt-pause-in-sleep:
    type: boolean
    description: |
      If true, the watchdog timer will be paused when the CPU is in sleep mode.
      This is useful to prevent the watchdog from triggering during low-power
      states.
  opt-pause-halted-by-dbg:
    type: boolean
    description: |
      If true, the watchdog timer will be paused when the CPU is halted by a
      debugger. This allows the watchdog to be used during debugging without
      triggering a reset.
  test-wdt-max-window:
    type: int
    description: |
      The maximum window size for the watchdog timer.
```

## tests/zephyr/drivers/watchdog/wdt_error_cases/testcase.yaml
```yaml
common:
  tags:
    - drivers
    - watchdog
    - ci_tests_zephyr_drivers_watchdog
  # depends_on: watchdog
  harness: ztest
  timeout: 30

tests:
  nrf.extended.drivers.watchdog.wdt_error_cases:
    platform_allow:
      - nrf54ls05dk/nrf54ls05b/cpuapp
      - nrf54ls05dk@0.0.0/nrf54ls05b/cpuapp
      - nrf54ls05dk@0.2.0/nrf54ls05b/cpuapp
      - nrf54lv10dk/nrf54lv10a/cpuapp
      - nrf54lv10dk@0.2.0/nrf54lv10a/cpuapp
    integration_platforms:
      - nrf54lv10dk/nrf54lv10a/cpuapp
```

## tests/zephyr/drivers/watchdog/wdt_variables/testcase.yaml
```yaml
common:
  timeout: 10
  tags:
    - drivers
    - watchdog
    - ci_tests_zephyr_drivers_watchdog
  harness: console
  harness_config:
    type: one_line
    regex:
      - "Test completed successfully"

tests:
  nrf.extended.drivers.watchdog.wdt_variables.default:
    platform_allow:
      - nrf54ls05dk@0.0.0/nrf54ls05b/cpuapp
      - nrf54ls05dk/nrf54ls05b/cpuapp
      - nrf54lv10dk/nrf54lv10a/cpuapp
      - nrf54lv10dk/nrf54lv10a/cpuflpr
      - nrf54lv10dk@0.2.0/nrf54lv10a/cpuapp
      - nrf54lv10dk@0.2.0/nrf54lv10a/cpuflpr
    integration_platforms:
      - nrf54ls05dk/nrf54ls05b/cpuapp
```

## tests/zephyr/kernel/timer/timer_behavior/testcase.yaml
```yaml
tests:
  nrf.extended.kernel.timer.timer:
    tags:
      - kernel
      - timer
      - ci_tests_zephyr_kernel_timer_timer_behavior
    platform_allow:
      - nrf54ls05dk/nrf54ls05a/cpuapp
      - nrf54ls05dk/nrf54ls05b/cpuapp
      - nrf54lv10dk/nrf54lv10a/cpuapp
      - nrf54lc10dk/nrf54lc10a/cpuapp
      - nrf54lv10dk/nrf54lv10a/cpuapp/ns
    integration_platforms:
      - nrf54ls05dk/nrf54ls05b/cpuapp
    timeout: 45
```

## tests/zephyr/modules/tf-m/regression/boards/nrf5340dk_nrf5340_cpuapp_ns.conf
```kconfig
# Copyright (c) 2026 Nordic Semiconductor ASA
#
# SPDX-License-Identifier: LicenseRef-Nordic-5-Clause

# TF-M needs more flash to fit when CONFIG_PSA_CRYPTO_DRIVER_CC3XX=y
CONFIG_PM_PARTITION_SIZE_TFM=0x48000

# NCSDK-38968: Attestation tests don't work

#CONFIG_TFM_PARTITION_INITIAL_ATTESTATION=y

# Initial Attestation service requires provisioning
#CONFIG_TFM_NRF_PROVISIONING=y
#CONFIG_NRF_APPROTECT_LOCK=y
#CONFIG_NRF_SECURE_APPROTECT_LOCK=y
#CONFIG_IDENTITY_KEY_TFM=y
```

## tests/zephyr/modules/tf-m/regression/boards/nrf54l15dk_nrf54l15_cpuapp_ns.conf
```kconfig
# Copyright (c) 2024 Nordic Semiconductor ASA
#
# SPDX-License-Identifier: LicenseRef-Nordic-5-Clause

# NCSDK-27603
CONFIG_TFM_PARTITION_INITIAL_ATTESTATION=n
CONFIG_TFM_NRF_PROVISIONING=n
```

## tests/zephyr/modules/tf-m/regression/boards/nrf54lm20dk_nrf54lm20b_cpuapp_ns.conf
```kconfig
#
# Copyright (c) 2026 Nordic Semiconductor ASA
#
# SPDX-License-Identifier: LicenseRef-Nordic-5-Clause
#

# NCSDK-22598: Attestation support for nRF54LM20B is not implemented yet
# So disable it for now
CONFIG_TFM_PARTITION_INITIAL_ATTESTATION=n
CONFIG_TFM_NRF_PROVISIONING=n
```

## tests/zephyr/modules/tf-m/regression/boards/nrf7120dk_nrf7120_cpuapp_ns.conf
```kconfig
# Copyright (c) 2025 Nordic Semiconductor ASA
#
# SPDX-License-Identifier: LicenseRef-Nordic-5-Clause

# WZN-7352: Attestation support for nRF7120 is not implemented yet
CONFIG_TFM_PARTITION_INITIAL_ATTESTATION=n
CONFIG_TFM_NRF_PROVISIONING=n
```

## tests/zephyr/modules/tf-m/regression/boards/nrf9151dk_nrf9151_ns.conf
```kconfig
# Copyright (c) 2026 Nordic Semiconductor ASA
#
# SPDX-License-Identifier: LicenseRef-Nordic-5-Clause

CONFIG_TFM_PARTITION_INITIAL_ATTESTATION=y

# Initial Attestation service requires provisioning
CONFIG_TFM_NRF_PROVISIONING=y
CONFIG_NRF_APPROTECT_LOCK=y
CONFIG_NRF_SECURE_APPROTECT_LOCK=y
CONFIG_IDENTITY_KEY_TFM=y
```

## tests/zephyr/modules/tf-m/regression/testcase.yaml
```yaml
common:
  tags:
    - tfm
    - ci_tests_tfm
    - sysbuild
  modules:
    - tf-m-tests
  harness: console
  harness_config:
    type: multi_line
    ordered: true
    regex:
      # There's an ANSI escape code between has and  PASSED: \x1b[32m (green color). The log file
      # strips ANSI sequences, which is why it looks clean there. But harness.handle() receives
      # the raw line with ANSI codes — so has PASSED never matches as a literal string.
      - "Test suite 'PSA protected storage NS interface tests.*' has.*PASSED"
      - "Test suite 'PSA internal trusted storage NS interface tests.*' has.*PASSED"
      - "Test suite 'Crypto non-secure interface test.*' has.*PASSED"
      - "Test suite 'Platform Service Non-Secure interface tests.*' has.*PASSED"
  extra_args:
    - EXTRA_CONF_FILE=${ZEPHYR_BASE}/tests/modules/tf-m/regression/prj.conf

tests:
  nrf.extended.tf-m.regression.ipc.lvl1:
    tags:
      - tfm_lvl1
    extra_args:
      - CONFIG_TFM_IPC=y
      - CONFIG_TFM_ISOLATION_LEVEL=1
    timeout: 200
    platform_allow:
      - nrf5340dk/nrf5340/cpuapp/ns
      - nrf54l15dk/nrf54l15/cpuapp/ns
      - nrf7120dk/nrf7120/cpuapp/ns
      - nrf9151dk/nrf9151/ns
      - nrf9160dk/nrf9160/ns
      - nrf9161dk/nrf9161/ns
    integration_platforms:
      - nrf5340dk/nrf5340/cpuapp/ns
      - nrf54l15dk/nrf54l15/cpuapp/ns
      - nrf7120dk/nrf7120/cpuapp/ns
      - nrf9151dk/nrf9151/ns
  nrf.extended.tf-m.regression.ipc.lvl2.cc3xx:
    tags:
      - tfm_lvl2
    extra_args:
      - CONFIG_PSA_CRYPTO_DRIVER_CC3XX=y
      - CONFIG_PSA_CRYPTO_DRIVER_OBERON=n
    timeout: 200
    platform_allow:
      - nrf5340dk/nrf5340/cpuapp/ns
      - nrf9151dk/nrf9151/ns
      - nrf9160dk/nrf9160/ns
      - nrf9161dk/nrf9161/ns
    integration_platforms:
      - nrf5340dk/nrf5340/cpuapp/ns
      - nrf9151dk/nrf9151/ns
  nrf.extended.tf-m.regression.ipc.lvl2.oberon:
    tags:
      - tfm_lvl2
    extra_args:
      - CONFIG_PSA_CRYPTO_DRIVER_CC3XX=n
      - CONFIG_PSA_CRYPTO_DRIVER_OBERON=y
    timeout: 200
    platform_allow:
      - nrf5340dk/nrf5340/cpuapp/ns
      - nrf9151dk/nrf9151/ns
      - nrf9160dk/nrf9160/ns
      - nrf9161dk/nrf9161/ns
    integration_platforms:
      - nrf5340dk/nrf5340/cpuapp/ns
      - nrf9151dk/nrf9151/ns
  nrf.extended.tf-m.regression.ipc.lvl2.cc3xx.oberon:
    tags:
      - tfm_lvl2
    extra_args:
      - CONFIG_PSA_CRYPTO_DRIVER_CC3XX=y
      - CONFIG_PSA_CRYPTO_DRIVER_OBERON=y
    timeout: 200
    platform_allow:
      - nrf5340dk/nrf5340/cpuapp/ns
      - nrf9151dk/nrf9151/ns
      - nrf9160dk/nrf9160/ns
      - nrf9161dk/nrf9161/ns
    integration_platforms:
      - nrf5340dk/nrf5340/cpuapp/ns
      - nrf9151dk/nrf9151/ns
  nrf.extended.tf-m.regression.ipc.lvl2.cracen:
    tags:
      - tfm_lvl2
    extra_args:
      - CONFIG_PSA_CRYPTO_DRIVER_CRACEN=y
      - CONFIG_PSA_CRYPTO_DRIVER_OBERON=n
    timeout: 200
    platform_allow:
      - nrf54l15dk/nrf54l15/cpuapp/ns
      - nrf7120dk/nrf7120/cpuapp/ns
    integration_platforms:
      - nrf54l15dk/nrf54l15/cpuapp/ns
      - nrf7120dk/nrf7120/cpuapp/ns
  nrf.extended.tf-m.regression.sfn:
    tags:
      - tfm_lvl1
    extra_args:
      - CONFIG_TFM_SFN=y
      - CONFIG_TFM_ISOLATION_LEVEL=1
    timeout: 200
    platform_allow:
      - nrf5340dk/nrf5340/cpuapp/ns
      - nrf54l15dk/nrf54l15/cpuapp/ns
      - nrf7120dk/nrf7120/cpuapp/ns
      - nrf9151dk/nrf9151/ns
      - nrf9160dk/nrf9160/ns
      - nrf9161dk/nrf9161/ns
    integration_platforms:
      - nrf5340dk/nrf5340/cpuapp/ns
      - nrf54l15dk/nrf54l15/cpuapp/ns
      - nrf7120dk/nrf7120/cpuapp/ns
      - nrf9151dk/nrf9151/ns
  nrf.extended.tf-m.regression.fp.hardabi:
    tags:
      - tfm_fp
    extra_args:
      - CONFIG_FPU=y
      - CONFIG_FP_HARDABI=y
    platform_allow:
      - nrf5340dk/nrf5340/cpuapp/ns
      - nrf54l15dk/nrf54l15/cpuapp/ns
      - nrf7120dk/nrf7120/cpuapp/ns
      - nrf9151dk/nrf9151/ns
      - nrf9160dk/nrf9160/ns
      - nrf9161dk/nrf9161/ns
    integration_platforms:
      - nrf5340dk/nrf5340/cpuapp/ns
      - nrf54l15dk/nrf54l15/cpuapp/ns
      - nrf7120dk/nrf7120/cpuapp/ns
      - nrf9151dk/nrf9151/ns
```

## tests/zephyr/samples/sensor/qdec/sample.yaml
```yaml
sample:
  description: Usage quadrature decoder sensor
  name: qdec_sensor
common:
  tags:
    - sensors
    - ci_tests_zephyr_sample_sensor
  timeout: 5
  harness: console

tests:
  sample.sensor.nrf_qdec_sensor.nrf7120pdk.extended:
    platform_allow:
      - nrf7120pdk/nrf7120/cpuapp
    integration_platforms:
      - nrf7120pdk/nrf7120/cpuapp
    harness_config:
      fixture: gpio_loopback
      type: multi_line
      ordered: true
      regex:
        - "Quadrature decoder sensor test"
        - "Position = -[45678]\\d degrees"
```

## tests/zephyr/subsys/sd/mmc/testcase.yaml
```yaml
tests:
  sd.mmc.semmc:
    tags:
      - drivers
      - sdhc
      - ci_tests_subsys_sd
    harness: ztest
    harness_config:
      fixture: semmc
    filter: dt_alias_exists("sdhc0") and dt_compat_enabled("nordic,nrf-semmc")
    platform_allow:
      - nrf54h20dk/nrf54h20/cpuapp
      - nrf54l15dk/nrf54l15/cpuapp
    integration_platforms:
      - nrf54h20dk/nrf54h20/cpuapp
      - nrf54l15dk/nrf54l15/cpuapp
```
