/*
 * Copyright (c) 2026 Nordic Semiconductor ASA
 *
 * SPDX-License-Identifier: LicenseRef-Nordic-5-Clause
 */

&spi120 {
	status = "okay";
};

&dma_fast_region {
	status = "okay";
};

&gd25le255e {
	status = "okay";
};

&gpio5 {
	status = "okay";
};
