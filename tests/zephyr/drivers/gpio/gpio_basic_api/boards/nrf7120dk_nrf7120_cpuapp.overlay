/*
 * Copyright (c) 2025 Nordic Semiconductor ASA
 *
 * SPDX-License-Identifier: LicenseRef-Nordic-5-Clause
 */

/ {
	resources {
		compatible = "test-gpio-basic-api";
		out-gpios = <&gpio1 12 0>;
		in-gpios = <&gpio1 11 0>;
	};
};

&gpiote20 {
	status = "okay";
};

&gpio1 {
	status = "okay";
};
