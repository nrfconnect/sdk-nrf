/*
 * Copyright (c) 2026 Nordic Semiconductor ASA
 *
 * SPDX-License-Identifier: LicenseRef-Nordic-5-Clause
 */

/*
 * Test requires loopback P1.12 to VDDIO
 * (same as nRF54LV10 DK; see nrf54lv10dk_nrf54lv10a_cpuapp.overlay).
 */

/ {
	zephyr,user {
		io-channels = <&adc 0>;
		reference-mv = <1300>;
		expected-accuracy = <64>;
	};
};

&adc {
	#address-cells = <1>;
	#size-cells = <0>;
	status = "okay";

	channel@0 {
		reg = <0>;
		zephyr,gain = "ADC_GAIN_1";
		zephyr,reference = "ADC_REF_INTERNAL";
		zephyr,acquisition-time = <ADC_ACQ_TIME_DEFAULT>;
		zephyr,input-positive = <NRF_SAADC_AIN7>;
		zephyr,resolution = <14>;
	};
};
