/*
 * Copyright (c) 2026 Nordic Semiconductor ASA
 *
 * SPDX-License-Identifier: LicenseRef-Nordic-5-Clause
 */

/ {
	aliases {
		adc = &adc;
	};
};

&adc {
	memory-regions = <&cpuapp_dma_region>;
	status = "okay";
};
