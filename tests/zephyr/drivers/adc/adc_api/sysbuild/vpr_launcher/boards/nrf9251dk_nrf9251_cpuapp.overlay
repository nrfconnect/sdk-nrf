/*
 * Copyright (c) 2026 Nordic Semiconductor ASA
 *
 * SPDX-License-Identifier: LicenseRef-Nordic-5-Clause
 */

#include "../../../boards/nrf9251dk_nrf9251_common.dtsi"

&adc {
	status = "reserved";
	interrupt-parent = <&cpuppr_clic>;
};
