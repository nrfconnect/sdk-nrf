## tests/zephyr/drivers/i2s/i2s_speed/testcase.yaml
```yaml
common:
  tags:
    - drivers
    - i2s
    - ci_tests_zephyr_drivers_i2s
  filter: CONFIG_I2S_TEST_USE_GPIO_LOOPBACK
  harness: ztest

tests:
  nrf.extended.drivers.i2s.i2s_speed.gpio_loopback.54h.audiopll:
    harness_config:
      fixture: i2s_loopback
    platform_allow:
      - nrf54h20dk/nrf54h20/cpuapp
    integration_platforms:
      - nrf54h20dk/nrf54h20/cpuapp
    extra_args:
      - EXTRA_DTC_OVERLAY_FILE="boards/tdm_audiopll.overlay"
  nrf.extended.drivers.i2s_speed.gpio_loopback.nrf71:
    harness_config:
      fixture: i2s_loopback
    platform_allow:
      - nrf7120dk/nrf7120/cpuapp
    integration_platforms:
      - nrf7120dk/nrf7120/cpuapp
```

## tests/zephyr/drivers/mbox/mbox_error_cases/sample.yaml
```yaml
sample:
  name: MBOX IPC negative test cases
common:
  tags:
    - drivers
    - mbox
    - ci_tests_zephyr_drivers_mbox
  harness: ztest
tests:
  nrf.extended.tests.drivers.mbox_error_cases.nrf54l:
    platform_allow:
      - nrf54lv10dk/nrf54lv10a/cpuapp
      - nrf54lc10dk/nrf54lc10a/cpuapp
    integration_platforms:
      - nrf54lv10dk/nrf54lv10a/cpuapp
      - nrf54lc10dk/nrf54lc10a/cpuapp
    extra_args: SNIPPET=nordic-flpr
```

## tests/zephyr/drivers/mspi/api/testcase.yaml
```yaml
# Copyright (c) 2025 Nordic Semiconductor ASA
#
# SPDX-License-Identifier: LicenseRef-Nordic-5-Clause
#
common:
  tags:
    - drivers
    - mspi
    - ci_tests_drivers_hpf
tests:
  nrf.extended.drivers.mspi.api.hpf:
    platform_allow:
      - nrf54l15dk/nrf54l15/cpuapp
    integration_platforms:
      - nrf54l15dk/nrf54l15/cpuapp
```

## tests/zephyr/drivers/mspi/controller_peripheral/Kconfig
```kconfig
# Copyright (c) 2025 Nordic Semiconductor ASA
#
# SPDX-License-Identifier: LicenseRef-Nordic-5-Clause
#

config TESTED_SPI_MODE
	int "SPI mode"
	default 0
	help
	  SPI mode value (clock polarity and phase) used in the test.
	  0: CPOL 0 (Active high), CPHA 0 (leading)
	  1: CPOL 0 (Active high), CPHA 1 (trailing)
	  2: CPOL 1 (Active low), CPHA 0 (leading)
	  3: CPOL 1 (Active low), CPHA 1 (trailing)

config TESTED_SPI_FREQUENCY
	int "SPI frequency"
	default 1000000
	help
	  SPI frequency used in the test, in Hz.

source "Kconfig.zephyr"
```

## tests/zephyr/drivers/mspi/controller_peripheral/testcase.yaml
```yaml
# Copyright (c) 2025 Nordic Semiconductor ASA
#
# SPDX-License-Identifier: LicenseRef-Nordic-5-Clause
#

common:
  depends_on: spi
  tags:
    - drivers
    - spi
    - mspi
    - ci_tests_drivers_hpf
  harness: ztest
  harness_config:
    fixture: hpf_mspi_spi_loopback
  platform_allow:
    - nrf54l15dk/nrf54l15/cpuapp
  integration_platforms:
    - nrf54l15dk/nrf54l15/cpuapp

tests:
  drivers.mspi.spi_mode0:
    extra_configs:
      - CONFIG_TESTED_SPI_MODE=0
      - CONFIG_TESTED_SPI_FREQUENCY=250000
    extra_args: EXTRA_DTC_OVERLAY_FILE="boards/nrf54l15dk_spis.overlay"

  drivers.mspi.spi_mode3:
    extra_configs:
      - CONFIG_TESTED_SPI_MODE=3
      - CONFIG_TESTED_SPI_FREQUENCY=250000
    extra_args: EXTRA_DTC_OVERLAY_FILE="boards/nrf54l15dk_spis.overlay"

  drivers.mspi.spi_mode0_4MHz:
    extra_configs:
      - CONFIG_TESTED_SPI_MODE=0
      - CONFIG_TESTED_SPI_FREQUENCY=4000000
    extra_args: EXTRA_DTC_OVERLAY_FILE="boards/nrf54l15dk_spis.overlay"

  drivers.mspi.spi_mode3_4MHz:
    extra_configs:
      - CONFIG_TESTED_SPI_MODE=3
      - CONFIG_TESTED_SPI_FREQUENCY=4000000
    extra_args: EXTRA_DTC_OVERLAY_FILE="boards/nrf54l15dk_spis.overlay"
```

## tests/zephyr/drivers/mspi/flash/testcase.yaml
```yaml
# Copyright (c) 2026 Nordic Semiconductor ASA
#
# SPDX-License-Identifier: LicenseRef-Nordic-5-Clause
#
common:
  tags:
    - drivers
    - mspi
    - ci_tests_drivers_hpf
    - flash
  harness: ztest
  harness_config:
    fixture: external_flash
tests:
  nrf.extended.drivers.mspi.flash.hpf:
    platform_allow:
      - nrf54lm20dk/nrf54lm20a/cpuapp
      - nrf54lm20dk/nrf54lm20b/cpuapp
    integration_platforms:
      - nrf54lm20dk/nrf54lm20a/cpuapp
    extra_args:
      - EXTRA_DTC_OVERLAY_FILE="boards/hpf_mspi.overlay"
```

## tests/zephyr/drivers/pwm/pwm_api/testcase.yaml
```yaml
tests:
  nrf.extended.drivers.pwm.pwm_api:
    tags:
      - drivers
      - pwm
      - ci_tests_zephyr_drivers_pwm
    filter: dt_alias_exists("pwm-test")
    depends_on: pwm
    platform_allow:
      - nrf54ls05dk/nrf54ls05b/cpuapp
    integration_platforms:
      - nrf54ls05dk/nrf54ls05b/cpuapp
```

## tests/zephyr/drivers/pwm/pwm_gpio_loopback/testcase.yaml
```yaml
common:
  depends_on: pwm
  tags:
    - drivers
    - pwm
    - ci_tests_zephyr_drivers_pwm
  harness: ztest
  harness_config:
    fixture: gpio_loopback
tests:
  nrf.extended.drivers.pwm.gpio_loopback.nrf:
    platform_allow:
      - nrf54ls05dk/nrf54ls05b/cpuapp
      - nrf54ls05dk@0.0.0/nrf54ls05b/cpuapp
      - nrf54ls05dk@0.2.0/nrf54ls05b/cpuapp
      - nrf7120dk/nrf7120/cpuapp
    integration_platforms:
      - nrf54ls05dk/nrf54ls05b/cpuapp
```

## tests/zephyr/drivers/retained_mem/api/testcase.yaml
```yaml
tests:
  nrf.extended.drivers.retained_mem.api.ram:
    platform_allow:
      - nrf54ls05dk/nrf54ls05b/cpuapp
      - nrf54ls05dk@0.0.0/nrf54ls05b/cpuapp
      - nrf54ls05dk@0.2.0/nrf54ls05b/cpuapp
      - nrf54lv10dk/nrf54lv10a/cpuapp
      - nrf54lv10dk@0.2.0/nrf54lv10a/cpuapp
    integration_platforms:
      - nrf54ls05dk/nrf54ls05b/cpuapp
    tags:
      - drivers
      - retained_mem
      - ci_tests_zephyr_drivers_retained_mem
    timeout: 30
```

## tests/zephyr/drivers/sensor/temp_sensor/testcase.yaml
```yaml
tests:
  nrf.extended.drivers.sensor.temp_sensor:
    tags:
      - drivers
      - sensors
      - ci_tests_zephyr_drivers_sensors
    filter: dt_nodelabel_enabled("temp_sensor")
    platform_allow:
      - nrf54ls05dk@0.0.0/nrf54ls05b/cpuapp
      - nrf54ls05dk/nrf54ls05b/cpuapp
      - nrf54lv10dk/nrf54lv10a/cpuapp
      - nrf54lv10dk@0.2.0/nrf54lv10a/cpuapp
      - nrf54lv10dk/nrf54lv10a/cpuapp/ns
      - nrf7120pdk/nrf7120/cpuapp
    integration_platforms:
      - nrf54ls05dk/nrf54ls05b/cpuapp
```

## tests/zephyr/drivers/spi/dt_spec/testcase.yaml
```yaml
tests:
  nrf.extended.drivers.spi.dt_spec:
    tags:
      - drivers
      - spi
      - ci_tests_zephyr_drivers_spi
    platform_allow:
      - nrf54ls05dk/nrf54ls05a/cpuapp
      - nrf54ls05dk/nrf54ls05b/cpuapp
      - nrf54lv10dk/nrf54lv10a/cpuapp
      - nrf54lc10dk/nrf54lc10a/cpuapp
    integration_platforms:
      - nrf54ls05dk/nrf54ls05b/cpuapp
```

## tests/zephyr/drivers/spi/spi_error_cases/testcase.yaml
```yaml
common:
  # depends_on: spi
  tags:
    - drivers
    - spi
    - ci_tests_zephyr_drivers_spi
  harness: ztest
  harness_config:
    fixture: gpio_spi_loopback
  timeout: 30
tests:
  nrf.extended.drivers.spi.spi_error_cases:
    platform_allow:
      - nrf54ls05dk@0.0.0/nrf54ls05b/cpuapp
      - nrf54ls05dk/nrf54ls05b/cpuapp
      - nrf54lv10dk/nrf54lv10a/cpuapp
      - nrf54lv10dk@0.2.0/nrf54lv10a/cpuapp
      - nrf7120dk/nrf7120/cpuapp
    integration_platforms:
      - nrf54ls05dk/nrf54ls05b/cpuapp
```

## tests/zephyr/drivers/spi/spi_loopback/dts/bindings/test-spi-loopback-fast.yaml
```yaml
description: |
    This binding provides resources required to build and run the
    tests/drivers/spi/spi_loopback test in Zephyr.

compatible: "test-spi-loopback-fast"

include: [spi-device.yaml]
```

## tests/zephyr/drivers/spi/spi_loopback/dts/bindings/test-spi-loopback-slow.yaml
```yaml
description: |
    This binding provides resources required to build and run the
    tests/drivers/spi/spi_loopback test in Zephyr.

compatible: "test-spi-loopback-slow"

include: [spi-device.yaml]
```

## tests/zephyr/drivers/spi/spi_loopback/testcase.yaml
```yaml
common:
  # depends_on: spi
  tags:
    - drivers
    - spi
    - dma
    - ci_tests_zephyr_drivers_spi
  filter: dt_compat_enabled("test-spi-loopback-slow") and
          dt_compat_enabled("test-spi-loopback-fast")
  harness: ztest
  harness_config:
    fixture: spi_loopback
  timeout: 15

tests:
  nrf.extended.drivers.spi.loopback:
    platform_allow:
      - nrf54ls05dk@0.0.0/nrf54ls05b/cpuapp
      - nrf54ls05dk/nrf54ls05b/cpuapp
      - nrf54lv10dk/nrf54lv10a/cpuapp
      - nrf54lv10dk@0.2.0/nrf54lv10a/cpuapp
      - nrf54lv10dk/nrf54lv10a/cpuapp/ns
      - nrf7120pdk/nrf7120/cpuapp
    integration_platforms:
      - nrf54ls05dk/nrf54ls05b/cpuapp
  nrf.extended.drivers.spi.nrf_pm_runtime:
    extra_configs:
      - CONFIG_PM_DEVICE=y
      - CONFIG_PM_DEVICE_RUNTIME=y
    platform_allow:
      - nrf54ls05dk@0.0.0/nrf54ls05b/cpuapp
      - nrf54ls05dk/nrf54ls05b/cpuapp
      - nrf54lv10dk/nrf54lv10a/cpuapp
      - nrf54lv10dk@0.2.0/nrf54lv10a/cpuapp
      - nrf54lv10dk/nrf54lv10a/cpuapp/ns
      - nrf7120pdk/nrf7120/cpuapp
    integration_platforms:
      - nrf54ls05dk/nrf54ls05b/cpuapp
```

## tests/zephyr/drivers/timer/nrf_grtc_timer/testcase.yaml
```yaml
common:
  tags:
    - drivers
    - ci_tests_zephyr_drivers_timer
  platform_allow:
    - nrf54ls05dk/nrf54ls05b/cpuapp
    - nrf54ls05dk@0.0.0/nrf54ls05b/cpuapp
    - nrf54lv10dk/nrf54lv10a/cpuapp
    - nrf54lv10dk@0.2.0/nrf54lv10a/cpuapp
    - nrf54lv10dk/nrf54lv10a/cpuflpr
    - nrf54lv10dk@0.2.0/nrf54lv10a/cpuflpr
    - nrf7120dk/nrf7120/cpuapp
  integration_platforms:
    - nrf54ls05dk/nrf54ls05b/cpuapp
  timeout: 45
tests:
  nrf.extended.drivers.timer.nrf_grtc_timer: {}
  nrf.extended.drivers.timer.nrf_grtc_timer.no_assert:
    extra_configs:
      - CONFIG_ASSERT=n
```

## tests/zephyr/drivers/uart/uart_async_api/testcase.yaml
```yaml
common:
  tags:
    - drivers
    - uart
    - ci_tests_zephyr_drivers_uart
  timeout: 30
tests:
  nrf.extended.drivers.uart.async_api:
    platform_allow:
      - nrf54ls05dk@0.0.0/nrf54ls05b/cpuapp
      - nrf54ls05dk/nrf54ls05b/cpuapp
      - nrf54lv10dk/nrf54lv10a/cpuapp
      - nrf54lv10dk@0.2.0/nrf54lv10a/cpuapp
      - nrf7120pdk/nrf7120/cpuapp
    integration_platforms:
      - nrf54ls05dk/nrf54ls05b/cpuapp
      - nrf54lv10dk/nrf54lv10a/cpuapp
      - nrf7120pdk/nrf7120/cpuapp
    filter: CONFIG_SERIAL_SUPPORT_ASYNC and not CONFIG_UART_MCUX_LPUART
    harness: ztest
    harness_config:
      fixture: gpio_loopback
    depends_on: gpio
  nrf.extended.drivers.uart.async_api.rtt:
    platform_allow:
      - nrf54ls05dk@0.0.0/nrf54ls05b/cpuapp
      - nrf54ls05dk/nrf54ls05b/cpuapp
      - nrf54lv10dk/nrf54lv10a/cpuapp
      - nrf54lv10dk@0.2.0/nrf54lv10a/cpuapp
      - nrf7120pdk/nrf7120/cpuapp
    integration_platforms:
      - nrf54ls05dk/nrf54ls05b/cpuapp
      - nrf54lv10dk/nrf54lv10a/cpuapp
      - nrf7120pdk/nrf7120/cpuapp
    filter: CONFIG_SERIAL_SUPPORT_ASYNC and CONFIG_HAS_SEGGER_RTT
      and not CONFIG_UART_MCUX_LPUART and not CONFIG_UART_MCUX_FLEXCOMM
    extra_args: |
      DTC_OVERLAY_FILE=${ZEPHYR_BASE}/tests/drivers/uart/uart_async_api/boards/segger_rtt.overlay
    extra_configs:
      - CONFIG_USE_SEGGER_RTT=y
      - CONFIG_UART_RTT=y
    build_only: true
```
