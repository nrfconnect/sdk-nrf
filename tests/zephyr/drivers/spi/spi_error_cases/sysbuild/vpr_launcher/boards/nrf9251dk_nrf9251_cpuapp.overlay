/*
 * Copyright (c) 2026 Nordic Semiconductor ASA
 *
 * SPDX-License-Identifier: LicenseRef-Nordic-5-Clause
 */

#include "../../../boards/nrf9251dk_nrf9251_cpuapp.overlay"

&spi130 {
	status = "reserved";
	interrupt-parent = <&cpuppr_clic>;
};

&dut_spis {
	status = "reserved";
	interrupt-parent = <&cpuppr_clic>;
};
