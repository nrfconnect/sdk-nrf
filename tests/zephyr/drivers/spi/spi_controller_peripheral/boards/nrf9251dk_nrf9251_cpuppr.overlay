/*
 * Copyright (c) 2026 Nordic Semiconductor ASA
 *
 * SPDX-License-Identifier: LicenseRef-Nordic-5-Clause
 */

#include "nrf9251dk_nrf9251_cpuapp.overlay"

&spi130 {
	/delete-property/ memory-regions;
};

&dut_spis {
	/delete-property/ memory-regions;
};
