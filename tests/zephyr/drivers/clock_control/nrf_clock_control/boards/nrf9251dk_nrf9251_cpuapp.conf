## tests/zephyr/drivers/clock_control/nrf_clock_control/testcase.yaml
```yaml
tests:
  nrf.extended.drivers.clock.nrf_clock_control:
    tags:
      - drivers
      - clock_control
      - ci_tests_zephyr_drivers_clock_control
    platform_allow:
      - nrf7120dk/nrf7120/cpuapp
```

## tests/zephyr/drivers/clock_control/nrf_lf_clock_start/testcase.yaml
```yaml
common:
  tags:
    - drivers
    - clock_control
    - ci_tests_zephyr_drivers_clock_control
  platform_allow:
    - nrf54ls05dk/nrf54ls05b/cpuapp
    - nrf54ls05dk@0.0.0/nrf54ls05b/cpuapp
    - nrf54lv10dk/nrf54lv10a/cpuapp
    - nrf54lv10dk@0.2.0/nrf54lv10a/cpuapp
    - nrf54lv10dk/nrf54lv10a/cpuapp/ns
    - nrf7120pdk/nrf7120/cpuapp
  integration_platforms:
    - nrf54ls05dk/nrf54ls05b/cpuapp
  timeout: 30

tests:
  nrf.extended.drivers.clock.nrf_lf_clock_start_xtal_stable:
    extra_configs:
      - CONFIG_SYSTEM_CLOCK_WAIT_FOR_STABILITY=y
      - CONFIG_CLOCK_CONTROL_NRF_K32SRC_XTAL=y

  nrf.extended.drivers.clock.nrf_lf_clock_start_xtal_available:
    extra_configs:
      - CONFIG_SYSTEM_CLOCK_WAIT_FOR_AVAILABILITY=y
      - CONFIG_CLOCK_CONTROL_NRF_K32SRC_XTAL=y

  nrf.extended.drivers.clock.nrf_lf_clock_start_xtal_no_wait:
    extra_configs:
      - CONFIG_SYSTEM_CLOCK_NO_WAIT=y
      - CONFIG_CLOCK_CONTROL_NRF_K32SRC_XTAL=y

  nrf.extended.drivers.clock.nrf_lf_clock_start_rc_stable:
    extra_configs:
      - CONFIG_SYSTEM_CLOCK_WAIT_FOR_STABILITY=y
      - CONFIG_CLOCK_CONTROL_NRF_K32SRC_RC=y

  nrf.extended.drivers.clock.nrf_lf_clock_start_rc_available:
    extra_configs:
      - CONFIG_SYSTEM_CLOCK_WAIT_FOR_AVAILABILITY=y
      - CONFIG_CLOCK_CONTROL_NRF_K32SRC_RC=y

  nrf.extended.drivers.clock.nrf_lf_clock_start_rc_no_wait:
    extra_configs:
      - CONFIG_SYSTEM_CLOCK_NO_WAIT=y
      - CONFIG_CLOCK_CONTROL_NRF_K32SRC_RC=y

  nrf.extended.drivers.clock.nrf_lf_clock_start_synth_stable:
    extra_configs:
      - CONFIG_SYSTEM_CLOCK_WAIT_FOR_STABILITY=y
      - CONFIG_CLOCK_CONTROL_NRF_K32SRC_SYNTH=y

  nrf.extended.drivers.clock.nrf_lf_clock_start_synth_available:
    extra_configs:
      - CONFIG_SYSTEM_CLOCK_WAIT_FOR_AVAILABILITY=y
      - CONFIG_CLOCK_CONTROL_NRF_K32SRC_SYNTH=y

  nrf.extended.drivers.clock.nrf_lf_clock_start_synth_no_wait:
    extra_configs:
      - CONFIG_SYSTEM_CLOCK_NO_WAIT=y
      - CONFIG_CLOCK_CONTROL_NRF_K32SRC_SYNTH=y
```

## tests/zephyr/drivers/clock_control/onoff/testcase.yaml
```yaml
tests:
  nrf.extended.drivers.clock.clock_control_onoff:
    tags:
      - drivers
      - clock_control
      - ci_tests_zephyr_drivers_clock_control
    platform_allow:
      - nrf54ls05dk/nrf54ls05a/cpuapp
      - nrf54ls05dk/nrf54ls05b/cpuapp
      - nrf54lv10dk/nrf54lv10a/cpuapp
      - nrf54lc10dk/nrf54lc10a/cpuapp
      - nrf54lv10dk/nrf54lv10a/cpuapp/ns
    integration_platforms:
      - nrf54ls05dk/nrf54ls05b/cpuapp
    timeout: 30
```

## tests/zephyr/drivers/comparator/gpio_loopback/testcase.yaml
```yaml
common:
  harness_config:
    fixture: gpio_loopback
  tags:
    - drivers
    - comparator
    - ci_tests_zephyr_drivers_comparator
  platform_allow:
    - nrf54lv10dk/nrf54lv10a/cpuapp
    - nrf54lv10dk@0.2.0/nrf54lv10a/cpuapp
    - nrf54lv10dk/nrf54lv10a/cpuapp/ns
    - nrf7120pdk/nrf7120/cpuapp
  integration_platforms:
    - nrf54lv10dk/nrf54lv10a/cpuapp
    - nrf7120pdk/nrf7120/cpuapp
tests:
  nrf.extended.drivers.comparator.gpio_loopback.nrf_comp:
    extra_args:
      - FILE_SUFFIX="nrf_comp"
  nrf.extended.drivers.comparator.gpio_loopback.nrf_lpcomp:
    extra_args:
      - FILE_SUFFIX="nrf_lpcomp"
```

## tests/zephyr/drivers/counter/counter_basic_api/testcase.yaml
```yaml
tests:
  nrf.extended.drivers.counter.basic_api:
    tags:
      - drivers
      - counter
      - ci_tests_zephyr_drivers_counter
    depends_on: counter
    platform_allow:
      - nrf54ls05dk/nrf54ls05a/cpuapp
      - nrf54ls05dk/nrf54ls05b/cpuapp
      - nrf54lv10dk/nrf54lv10a/cpuapp
      - nrf54lv10dk/nrf54lv10a/cpuapp/ns
      - nrf54lv10dk/nrf54lv10a/cpuflpr
      - nrf9251dk/nrf9251/cpuapp
      - nrf9251dk/nrf9251/cpuflpr/xip
      - nrf9251dk/nrf9251/cpuppr
    integration_platforms:
      - nrf54ls05dk/nrf54ls05b/cpuapp
    timeout: 30
```

## tests/zephyr/drivers/counter/counter_nrf_rtc/fixed_top/testcase.yaml
```yaml
tests:
  nrf.extended.drivers.counter.nrf_rtc:
    tags:
      - drivers
      - counter
      - ci_tests_zephyr_drivers_counter
    depends_on: counter
    platform_allow:
      - nrf9251dk/nrf9251/cpuapp
      - nrf9251dk/nrf9251/cpuppr
    integration_platforms:
      - nrf9251dk/nrf9251/cpuapp
```

## tests/zephyr/drivers/flash/common/testcase.yaml
```yaml
common:
  tags:
    - drivers
    - flash
    - ci_tests_drivers_hpf
  harness: ztest
  harness_config:
    fixture: external_flash
tests:
  nrf.extended.drivers.flash.common.hpf.quad:
    platform_allow:
      - nrf54l15dk/nrf54l15/cpuapp
    integration_platforms:
      - nrf54l15dk/nrf54l15/cpuapp
    extra_args:
      - SB_CONFIG_HPF=y
      - SB_CONFIG_HPF_MSPI=y
  nrf.extended.drivers.flash.common.hpf.single:
    platform_allow:
      - nrf54l15dk/nrf54l15/cpuapp
    integration_platforms:
      - nrf54l15dk/nrf54l15/cpuapp
    extra_args:
      - EXTRA_DTC_OVERLAY_FILE="single.overlay"
      - SB_CONFIG_HPF=y
      - SB_CONFIG_HPF_MSPI=y
  nrf.extended.drivers.flash.common.sqspi:
    platform_allow:
      - nrf54l15dk/nrf54l15/cpuapp
    integration_platforms:
      - nrf54l15dk/nrf54l15/cpuapp
    extra_args:
      - DTC_OVERLAY_FILE="boards/nrf54l15dk_nrf54l15_cpuapp_sqspi.overlay"
  nrf.extended.drivers.flash.common.mramc:
    platform_allow:
      - nrf7120dk/nrf7120/cpuapp
    integration_platforms:
      - nrf7120dk/nrf7120/cpuapp
```

## tests/zephyr/drivers/flash/negative_tests_nrf7120/testcase.yaml
```yaml
common:
  tags:
    - drivers
    - flash
    - ci_tests_zephyr_drivers_flash_negative_tests
tests:
  nrf.extended.drivers.flash.negative_tests_nrf7120.mramc:
    platform_allow:
      - nrf7120dk/nrf7120/cpuapp
    integration_platforms:
      - nrf7120dk/nrf7120/cpuapp
```

## tests/zephyr/drivers/gpio/gpio_basic_api/testcase.yaml
```yaml
common:
  tags:
    - drivers
    - gpio
    - ci_tests_zephyr_drivers_gpio
  depends_on: gpio
  harness: ztest
  harness_config:
    fixture: gpio_loopback

tests:
  nrf.extended.drivers.gpio.2pin:
    platform_allow:
      - nrf54ls05dk/nrf54ls05a/cpuapp
      - nrf54ls05dk/nrf54ls05b/cpuapp
      - nrf54lv10dk/nrf54lv10a/cpuapp
      - nrf54lc10dk/nrf54lc10a/cpuapp
    integration_platforms:
      - nrf54ls05dk/nrf54ls05b/cpuapp
```

## tests/zephyr/drivers/gpio/gpio_get_direction/boards/nrf54h20dk_nrf54h20_cpuflpr.conf
```kconfig
# Copyright (c) 2026 Nordic Semiconductor ASA
# SPDX-License-Identifier: LicenseRef-Nordic-5-Clause

# FLPR does not support GPIO interrupts. Disabling interrupt support removes
# the driver's dependency on the (disabled-by-default) GPIOTE130 peripheral,
CONFIG_GPIO_NRFX_INTERRUPT=n
```

## tests/zephyr/drivers/gpio/gpio_get_direction/testcase.yaml
```yaml
tests:
  nrf.extended.drivers.gpio.get_direction:
    tags:
      - drivers
      - gpio
      - ci_tests_zephyr_drivers_gpio
    harness: ztest
    platform_allow:
      - nrf9251dk/nrf9251/cpuppr
      - nrf54lc10dk/nrf54lc10a/cpuapp
    integration_platforms:
      - nrf9251dk/nrf9251/cpuppr
```

## tests/zephyr/drivers/gpio/gpio_hogs/testcase.yaml
```yaml
common:
  tags:
    - drivers
    - gpio
    - ci_tests_zephyr_drivers_gpio
  depends_on: gpio
  harness: ztest
  harness_config:
    fixture: gpio_loopback

tests:
  nrf.extended.drivers.gpio.hogs:
    platform_allow:
      - nrf9251dk/nrf9251/cpuapp
      - nrf9251dk/nrf9251/cpuppr
    integration_platforms:
      - nrf9251dk/nrf9251/cpuapp
```

## tests/zephyr/drivers/gpio/gpio_nrf/testcase.yaml
```yaml
common:
  tags:
    - drivers
    - gpio
    - ci_tests_zephyr_drivers_gpio
  depends_on: gpio
  harness: ztest
tests:
  nrf.extended.drivers.gpio.gpio_nrf:
    platform_allow:
      - nrf9251dk/nrf9251/cpuppr
    integration_platforms:
      - nrf9251dk/nrf9251/cpuppr
```

## tests/zephyr/drivers/i2c/i2c_bme688/Kconfig
```kconfig
#
# Copyright (c) 2025 Nordic Semiconductor ASA
#
# SPDX-License-Identifier: LicenseRef-Nordic-5-Clause
#

source "tests/drivers/i2c/i2c_bme688/Kconfig"
```

## tests/zephyr/drivers/i2c/i2c_bme688/testcase.yaml
```yaml
common:
  tags:
    - drivers
    - i2c
    - ci_tests_zephyr_drivers_i2c_i2c_bme688
  depends_on: i2c
  harness: ztest
tests:
  nrf.extended.drivers.i2c.bme688_nrf54l:
    filter: not CONFIG_COVERAGE
    harness_config:
      fixture: pca63565
    extra_args:
      - SHIELD=pca63565
      - SB_CONFIG_VPR_LAUNCHER=y
      - vpr_launcher_DTC_OVERLAY_FILE="${ZEPHYR_NRF_MODULE_DIR}/boards/shields/pca63565/boards/nrf54l_vpr_launcher.overlay"
    platform_allow:
      - nrf54l15dk/nrf54l15/cpuapp
      - nrf54l15dk/nrf54l15/cpuflpr
      - nrf54lm20dk/nrf54lm20a/cpuapp
      - nrf54lm20dk/nrf54lm20a/cpuflpr

  nrf.extended.drivers.i2c.bme688_nrf54l_fast_speed:
    filter: not CONFIG_COVERAGE
    harness_config:
      fixture: pca63565
    extra_args:
      - SHIELD=pca63565
      - SB_CONFIG_VPR_LAUNCHER=y
      - vpr_launcher_DTC_OVERLAY_FILE="${ZEPHYR_NRF_MODULE_DIR}/boards/shields/pca63565/boards/nrf54l_vpr_launcher.overlay"
      - CONFIG_TEST_I2C_SPEED=2
    platform_allow:
      - nrf54l15dk/nrf54l15/cpuapp
      - nrf54l15dk/nrf54l15/cpuflpr
      - nrf54lm20dk/nrf54lm20a/cpuapp
      - nrf54lm20dk/nrf54lm20a/cpuflpr

  nrf.extended.drivers.i2c.bme688_nrf54l_coverage:
    filter: CONFIG_COVERAGE
    harness_config:
      fixture: pca63565
    extra_args:
      - SHIELD=pca63565
      - SNIPPET=coverage_support
    platform_allow:
      - nrf54l15dk/nrf54l15/cpuapp
      - nrf54lm20dk/nrf54lm20a/cpuapp

  nrf.extended.drivers.i2c.bme688_nrf54l_coverage_fast_speed:
    filter: CONFIG_COVERAGE
    harness_config:
      fixture: pca63565
    extra_args:
      - SHIELD=pca63565
      - SNIPPET=coverage_support
      - CONFIG_TEST_I2C_SPEED=2
    platform_allow:
      - nrf54l15dk/nrf54l15/cpuapp
      - nrf54lm20dk/nrf54lm20a/cpuapp

  nrf.extended.drivers.i2c.bme688_nrf54h:
    filter: not CONFIG_COVERAGE
    harness_config:
      fixture: pca63566
    extra_args:
      - i2c_bme688_SHIELD=pca63566
      - SB_CONFIG_VPR_LAUNCHER=y
      - vpr_launcher_SHIELD=pca63566_fwd
    platform_allow:
      - nrf54h20dk/nrf54h20/cpuapp
      - nrf54h20dk/nrf54h20/cpuppr

  nrf.extended.drivers.i2c.bme688_nrf54h_fast_speed:
    filter: not CONFIG_COVERAGE
    harness_config:
      fixture: pca63566
    extra_args:
      - i2c_bme688_SHIELD=pca63566
      - SB_CONFIG_VPR_LAUNCHER=y
      - vpr_launcher_SHIELD=pca63566_fwd
      - CONFIG_TEST_I2C_SPEED=2
    platform_allow:
      - nrf54h20dk/nrf54h20/cpuapp
      - nrf54h20dk/nrf54h20/cpuppr

  nrf.extended.drivers.i2c.bme688_nrf54h_fast_plus_speed:
    filter: not CONFIG_COVERAGE
    harness_config:
      fixture: pca63566
    extra_args:
      - i2c_bme688_SHIELD=pca63566
      - SB_CONFIG_VPR_LAUNCHER=y
      - vpr_launcher_SHIELD=pca63566_fwd
      - CONFIG_TEST_I2C_SPEED=3
    platform_allow:
      - nrf54h20dk/nrf54h20/cpuapp
      - nrf54h20dk/nrf54h20/cpuppr

  nrf.extended.drivers.i2c.bme688_nrf54h_coverage:
    filter: CONFIG_COVERAGE
    harness_config:
      fixture: pca63566
    extra_args:
      - SHIELD=pca63566
      - SNIPPET=coverage_support
    platform_allow:
      - nrf54h20dk/nrf54h20/cpuapp

  nrf.extended.drivers.i2c.bme688_nrf54h_coverage_fast_speed:
    filter: CONFIG_COVERAGE
    harness_config:
      fixture: pca63566
    extra_args:
      - SHIELD=pca63566
      - SNIPPET=coverage_support
      - CONFIG_TEST_I2C_SPEED=2
    platform_allow:
      - nrf54h20dk/nrf54h20/cpuapp

  nrf.extended.drivers.i2c.bme688_nrf54h_coverage_fast_plus_speed:
    filter: CONFIG_COVERAGE
    harness_config:
      fixture: pca63566
    extra_args:
      - SHIELD=pca63566
      - SNIPPET=coverage_support
      - CONFIG_TEST_I2C_SPEED=3
    platform_allow:
      - nrf54h20dk/nrf54h20/cpuapp
```

## tests/zephyr/drivers/i2c/i2c_nrfx_twim/testcase.yaml
```yaml
common:
  depends_on: i2c
  tags:
    - drivers
    - i2c
    - ci_tests_zephyr_drivers_i2c_i2c_nrfx_twim
  harness: ztest
  harness_config:
    fixture: i2c_bus_short

tests:
  nrf.extended.drivers.i2c.nrfx_twim_async_api:
    platform_allow:
      - nrf54ls05dk@0.0.0/nrf54ls05b/cpuapp
      - nrf54ls05dk/nrf54ls05b/cpuapp
      - nrf54lv10dk/nrf54lv10a/cpuapp
      - nrf7120dk/nrf7120/cpuapp
    integration_platforms:
      - nrf54ls05dk/nrf54ls05b/cpuapp
```

## tests/zephyr/drivers/i2c/i2c_target_api/testcase.yaml
```yaml
common:
  # depends_on: i2c
  tags:
    - drivers
    - i2c
    - ci_tests_zephyr_drivers_i2c
  harness: ztest
  harness_config:
    fixture: i2c_bus_short

tests:
  nrf.extended.drivers.i2c.target_api.single_role:
    platform_allow:
      - nrf54ls05dk@0.0.0/nrf54ls05b/cpuapp
      - nrf54ls05dk/nrf54ls05b/cpuapp
      - nrf54lv10dk/nrf54lv10a/cpuapp
      - nrf54lv10dk@0.2.0/nrf54lv10a/cpuapp
      - nrf54lv10dk/nrf54lv10a/cpuapp/ns
      - nrf7120pdk/nrf7120/cpuapp
    integration_platforms:
      - nrf54ls05dk/nrf54ls05b/cpuapp
```

## tests/zephyr/drivers/i2s/i2s_additional/testcase.yaml
```yaml
common:
  tags:
    - drivers
    - i2s
    - ci_tests_zephyr_drivers_i2s
  depends_on:
    - i2s
    - gpio
  filter: CONFIG_I2S_TEST_USE_GPIO_LOOPBACK
  harness: ztest

tests:
  nrf.extended.drivers.i2s.additional.gpio_loopback:
    harness_config:
      fixture: gpio_loopback
    depends_on:
      - future_target
  nrf.extended.drivers.i2s.additional.gpio_loopback.nrf71:
    harness_config:
      fixture: i2s_loopback
    platform_allow:
      - nrf7120dk/nrf7120/cpuapp
    integration_platforms:
      - nrf7120dk/nrf7120/cpuapp
```

## tests/zephyr/drivers/i2s/i2s_api/testcase.yaml
```yaml
common:
  tags:
    - drivers
    - i2s
    - ci_tests_zephyr_drivers_i2s
  filter: CONFIG_I2S_TEST_USE_GPIO_LOOPBACK
  harness: ztest

tests:
  nrf.extended.drivers.i2s.i2s_api.gpio_loopback.54h:
    harness_config:
      fixture: i2s_loopback
    platform_allow:
      - nrf54h20dk/nrf54h20/cpuapp
    integration_platforms:
      - nrf54h20dk/nrf54h20/cpuapp

  nrf.extended.drivers.i2s_api.gpio_loopback.54l:
    harness_config:
      fixture: gpio_loopback
    platform_allow:
      - nrf54lm20apdk/nrf54lm20a/cpuapp
      - nrf54lm20apdk@0.2.0/nrf54lm20a/cpuapp
    integration_platforms:
      - nrf54lm20apdk/nrf54lm20a/cpuapp

  nrf.extended.drivers.i2s.i2s_api.gpio_loopback.54h.audiopll:
    harness_config:
      fixture: i2s_loopback
    platform_allow:
      - nrf54h20dk/nrf54h20/cpuapp
    integration_platforms:
      - nrf54h20dk/nrf54h20/cpuapp
    extra_args:
      - EXTRA_DTC_OVERLAY_FILE="boards/tdm_audiopll.overlay"
```
