/*
 * Copyright 2026 Nordic Semiconductor ASA
 * SPDX-License-Identifier: LicenseRef-Nordic-5-Clause
 */

/ {
	mbox-consumer {
		compatible = "vnd,mbox-consumer";
		mboxes = <&cpuapp_bellboard 18>, <&cpuapp_bellboard 32>,
			 <&cpuppr_vevif 15>, <&cpuppr_vevif 32>;
		mbox-names = "remote_valid", "remote_incorrect",
			     "local_valid", "local_incorrect";
	};
};

&cpuapp_bellboard {
	status = "okay";
};

&cpuppr_vevif {
	status = "okay";
};
