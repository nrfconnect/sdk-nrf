/*
 * Copyright (c) 2026 Nordic Semiconductor ASA
 *
 * SPDX-License-Identifier: LicenseRef-Nordic-5-Clause
 */

/* The test requires a loopback between P1.12 and P2.01. Additionally SB18 needs to be shorted. */

/ {
	zephyr,user {
		test-gpios = <&gpio1 12 0>;
	};

	aliases {
		test-timer = &timer21;
	};
};

&timer21 {
	status = "reserved";
};
