/*
 * Copyright (c) 2026 Nordic Semiconductor ASA
 *
 * SPDX-License-Identifier: LicenseRef-Nordic-5-Clause
 */

/* The test requires a loopback between P1.16 and P1.22. */

/ {
	zephyr,user {
		test-gpios = <&gpio1 22 0>;
	};

	aliases {
		test-timer = &timer21;
	};
};

&timer21 {
	status = "reserved";
};
