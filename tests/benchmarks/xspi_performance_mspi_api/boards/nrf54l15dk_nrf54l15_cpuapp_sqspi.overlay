/*
 * Copyright (c) 2026 Nordic Semiconductor ASA
 *
 * SPDX-License-Identifier: LicenseRef-Nordic-5-Clause
 */

#define SP_RAM_REG_ADDR 0x2003c000
#define SP_RAM_UNIT_ADDR 2003c000

#include "nrf54l_sqspi.dtsi"

/* No loopbacks requird, overlay assumes CONFIG_TEST_BENCHMARK_SCK_DELAY=n. */

/ {
	aliases {
		test-timer = &timer21;
	};
};

&timer21 {
	status = "reserved";
};
