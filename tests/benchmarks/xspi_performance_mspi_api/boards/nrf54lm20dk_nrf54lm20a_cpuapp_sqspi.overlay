/*
 * Copyright (c) 2026 Nordic Semiconductor ASA
 *
 * SPDX-License-Identifier: LicenseRef-Nordic-5-Clause
 */

#define SP_RAM_REG_ADDR 0x2003c000
#define SP_RAM_UNIT_ADDR 2003c000

#include "nrf54l_sqspi.dtsi"

/* The test requires a loopback between P1.10 and P2.01. */

/ {
	zephyr,user {
		test-gpios = <&gpio1 10 0>;
	};

	aliases {
		test-timer = &timer21;
	};
};

&timer21 {
	status = "reserved";
};
