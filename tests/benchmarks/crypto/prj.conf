## CMakeLists.txt
```
#
# Copyright (c) 2026 Nordic Semiconductor ASA
#
# SPDX-License-Identifier: LicenseRef-Nordic-5-Clause
#

cmake_minimum_required(VERSION 3.20.0)

find_package(Zephyr REQUIRED HINTS $ENV{ZEPHYR_BASE})

project(crypto_benchmarks)

target_include_directories(app PRIVATE src)

target_sources(app PRIVATE
        src/main.c
        src/runner.c
        src/suites.c)

if(CONFIG_CRYPTO_BENCHMARKS_PSA_CIPHER)
        add_subdirectory(src/suites/psa_cipher)
endif()
if(CONFIG_CRYPTO_BENCHMARKS_PSA_AEAD)
        add_subdirectory(src/suites/psa_aead)
endif()
if(CONFIG_CRYPTO_BENCHMARKS_PSA_HASH)
        add_subdirectory(src/suites/psa_hash)
endif()
if(CONFIG_CRYPTO_BENCHMARKS_PSA_XOF)
        add_subdirectory(src/suites/psa_xof)
endif()
if(CONFIG_CRYPTO_BENCHMARKS_PSA_MAC)
        add_subdirectory(src/suites/psa_mac)
endif()
if(CONFIG_CRYPTO_BENCHMARKS_PSA_KEY_DERIVATION)
        add_subdirectory(src/suites/psa_key_derivation)
endif()
if(CONFIG_CRYPTO_BENCHMARKS_PSA_KEY_AGREEMENT)
        add_subdirectory(src/suites/psa_key_agreement)
endif()
if(CONFIG_CRYPTO_BENCHMARKS_PSA_SIGNATURE)
        add_subdirectory(src/suites/psa_signature)
endif()
if(CONFIG_CRYPTO_BENCHMARKS_PSA_ASYMMETRIC_ENCRYPTION)
        add_subdirectory(src/suites/psa_asymmetric_encryption)
endif()
if(CONFIG_CRYPTO_BENCHMARKS_PSA_PAKE)
        add_subdirectory(src/suites/psa_pake)
endif()
if(CONFIG_CRYPTO_BENCHMARKS_PSA_KEY_WRAP)
        add_subdirectory(src/suites/psa_key_wrap)
endif()
if(CONFIG_CRYPTO_BENCHMARKS_PSA_RNG)
        add_subdirectory(src/suites/psa_rng)
endif()
```

## Kconfig
```
#
# Copyright (c) 2026 Nordic Semiconductor ASA
#
# SPDX-License-Identifier: LicenseRef-Nordic-5-Clause
#

menu "Crypto benchmarks"

choice CRYPTO_BENCHMARKS_OUTPUT_FORMAT
	prompt "Operation summary format"
	default CRYPTO_BENCHMARKS_OUTPUT_TEXT

config CRYPTO_BENCHMARKS_OUTPUT_TEXT
	bool "Human-readable table"
	help
	  One log line per operation, aligned into a table.

config CRYPTO_BENCHMARKS_OUTPUT_JSON
	bool "JSON, for machine consumption"
	help
	  One JSON document, printed with printk() so it can be cut out of a serial
	  capture that also holds log output. Every operation carries the name of
	  the src/suites folder it came from, so a consumer can group the results
	  by cryptographic family.

endchoice

config CRYPTO_BENCHMARKS_OP_STACK_SIZE
	int "Stack size of the operation threads"
	default 32768
	help
	  Size of the single stack that every operation thread reuses. The
	  operations run one at a time, so this is sized for the most demanding
	  one rather than for the sum of them.

config CRYPTO_BENCHMARKS_OP_TIMEOUT_MS
	int "Time to wait for an operation to finish, in milliseconds"
	default 5000
	help
	  An operation thread does not log, so one that faults or wedges cannot
	  report it. If it has not finished within this time the runner records
	  it as failed and carries on.

config CRYPTO_BENCHMARKS_MEASURE_TIME
	bool "Measure the time of each operation"
	default y
	select TIMING_FUNCTIONS
	help
	  Time each operation at CPU cycle resolution. When disabled, the report
	  carries no elapsed time.

config CRYPTO_BENCHMARKS_MEASURE_STACK
	bool "Measure the peak stack usage of each operation"
	default y
	select INIT_STACKS
	select THREAD_STACK_INFO
	help
	  Report the stack watermark of each operation. INIT_STACKS makes every
	  k_thread_create() re-poison the shared operation stack, so each
	  operation is measured from a clean slate. When disabled, the report
	  carries no stack usage.

config CRYPTO_BENCHMARKS_PSA_CIPHER
	bool "PSA cipher tests"
	default y
	select PSA_WANT_ALG_CBC_NO_PADDING
	select PSA_WANT_ALG_CBC_PKCS7
	select PSA_WANT_ALG_CTR
	select PSA_WANT_ALG_ECB_NO_PADDING
	select PSA_WANT_ALG_STREAM_CIPHER
	select PSA_WANT_KEY_TYPE_AES
	select PSA_WANT_KEY_TYPE_CHACHA20

config CRYPTO_BENCHMARKS_PSA_AEAD
	bool "PSA AEAD tests"
	default y
	select PSA_WANT_ALG_CCM
	select PSA_WANT_ALG_GCM
	select PSA_WANT_ALG_CHACHA20_POLY1305
	select PSA_WANT_KEY_TYPE_AES
	select PSA_WANT_KEY_TYPE_CHACHA20

config CRYPTO_BENCHMARKS_PSA_HASH
	bool "PSA hash tests"
	default y
	select PSA_WANT_ALG_SHA_1
	select PSA_WANT_ALG_SHA_224
	select PSA_WANT_ALG_SHA_256
	select PSA_WANT_ALG_SHA_384
	select PSA_WANT_ALG_SHA_512
	select PSA_WANT_ALG_SHA3_224
	select PSA_WANT_ALG_SHA3_256
	select PSA_WANT_ALG_SHA3_384
	select PSA_WANT_ALG_SHA3_512

config CRYPTO_BENCHMARKS_PSA_XOF
	bool "PSA XOF tests"
	default y
	select PSA_WANT_ALG_SHAKE256_512
	select PSA_WANT_ALG_SHAKE128
	select PSA_WANT_ALG_SHAKE256

config CRYPTO_BENCHMARKS_PSA_MAC
	bool "PSA MAC tests"
	default y
	select PSA_WANT_ALG_HMAC
	select PSA_WANT_ALG_CMAC
	select PSA_WANT_ALG_SHA_1
	select PSA_WANT_ALG_SHA_224
	select PSA_WANT_ALG_SHA_256
	select PSA_WANT_ALG_SHA_384
	select PSA_WANT_ALG_SHA_512
	select PSA_WANT_KEY_TYPE_HMAC
	select PSA_WANT_KEY_TYPE_AES

config CRYPTO_BENCHMARKS_PSA_KEY_DERIVATION
	bool "PSA key derivation tests"
	default y
	select PSA_WANT_ALG_HKDF
	select PSA_WANT_ALG_PBKDF2_HMAC
	select PSA_WANT_ALG_TLS12_PRF
	select PSA_WANT_ALG_TLS12_PSK_TO_MS
	select PSA_WANT_ALG_HMAC
	select PSA_WANT_ALG_SHA_256
	select PSA_WANT_KEY_TYPE_DERIVE
	select PSA_WANT_KEY_TYPE_PASSWORD

config CRYPTO_BENCHMARKS_PSA_KEY_AGREEMENT
	bool "PSA key agreement tests"
	default y
	select PSA_WANT_ALG_ECDH
	select PSA_WANT_KEY_TYPE_ECC_KEY_PAIR_GENERATE
	select PSA_WANT_KEY_TYPE_ECC_KEY_PAIR_IMPORT
	select PSA_WANT_KEY_TYPE_ECC_KEY_PAIR_EXPORT
	select PSA_WANT_KEY_TYPE_ECC_PUBLIC_KEY
	select PSA_WANT_ECC_BRAINPOOL_P_R1_256
	select PSA_WANT_ECC_BRAINPOOL_P_R1_384
	select PSA_WANT_ECC_BRAINPOOL_P_R1_512
	select PSA_WANT_ECC_MONTGOMERY_255
	select PSA_WANT_ECC_MONTGOMERY_448
	select PSA_WANT_ECC_SECP_K1_256
	select PSA_WANT_ECC_SECP_R1_224
	select PSA_WANT_ECC_SECP_R1_256
	select PSA_WANT_ECC_SECP_R1_384
	select PSA_WANT_ECC_SECP_R1_521

config CRYPTO_BENCHMARKS_PSA_SIGNATURE
	bool "PSA signature tests"
	default y
	select PSA_WANT_ALG_ECDSA
	select PSA_WANT_ALG_PURE_EDDSA
	select PSA_WANT_ALG_RSA_PKCS1V15_SIGN
	select PSA_WANT_ALG_RSA_PSS
	select PSA_WANT_ALG_ML_DSA
	# Only the public key type: Cracen has no ML-DSA key pair support at all,
	# so the suite imports a known-answer public key and verifies with it.
	select PSA_WANT_KEY_TYPE_ML_DSA_PUBLIC_KEY
	select PSA_WANT_ML_DSA_KEY_SIZE_65
	# Cracen builds ML-DSA out of these.
	select PSA_WANT_ALG_SHAKE128
	select PSA_WANT_ALG_SHA_1
	select PSA_WANT_ALG_SHA_224
	select PSA_WANT_ALG_SHA_256
	select PSA_WANT_ALG_SHA_384
	select PSA_WANT_ALG_SHA_512
	select PSA_WANT_ALG_SHAKE256
	select PSA_WANT_KEY_TYPE_ECC_KEY_PAIR_GENERATE
	select PSA_WANT_KEY_TYPE_RSA_KEY_PAIR_IMPORT
	select PSA_WANT_ECC_BRAINPOOL_P_R1_256
	select PSA_WANT_ECC_BRAINPOOL_P_R1_384
	select PSA_WANT_ECC_BRAINPOOL_P_R1_512
	select PSA_WANT_ECC_SECP_K1_256
	select PSA_WANT_ECC_SECP_R1_224
	select PSA_WANT_ECC_SECP_R1_256
	select PSA_WANT_ECC_SECP_R1_384
	select PSA_WANT_ECC_SECP_R1_521
	select PSA_WANT_ECC_TWISTED_EDWARDS_255
	select PSA_WANT_RSA_KEY_SIZE_4096
	select PSA_WANT_RSA_KEY_SIZE_2048

config CRYPTO_BENCHMARKS_PSA_ASYMMETRIC_ENCRYPTION
	bool "PSA asymmetric encryption tests"
	default y
	select PSA_WANT_ALG_RSA_OAEP
	select PSA_WANT_ALG_RSA_PKCS1V15_CRYPT
	select PSA_WANT_ALG_SHA_256
	select PSA_WANT_KEY_TYPE_RSA_KEY_PAIR_IMPORT
	select PSA_WANT_RSA_KEY_SIZE_2048

config CRYPTO_BENCHMARKS_PSA_PAKE
	bool "PSA PAKE tests"
	default y
	# EC J-PAKE, the same set as samples/crypto/ecjpake.
	select PSA_WANT_ALG_JPAKE
	select PSA_WANT_ALG_TLS12_ECJPAKE_TO_PMS
	select PSA_WANT_ALG_SHA_256
	select PSA_WANT_KEY_TYPE_PASSWORD
	select PSA_WANT_KEY_TYPE_DERIVE
	select PSA_WANT_KEY_TYPE_ECC_PUBLIC_KEY
	select PSA_WANT_ECC_SECP_R1_256
	# SPAKE2+, the same set as samples/crypto/spake2p. Both sides import a
	# half of a registration record, so the key pair and the public key type
	# are both needed, and HKDF turns the agreed secret into bytes.
	select PSA_WANT_ALG_SPAKE2P_HMAC
	select PSA_WANT_KEY_TYPE_SPAKE2P_KEY_PAIR_IMPORT
	select PSA_WANT_KEY_TYPE_SPAKE2P_PUBLIC_KEY
	select PSA_WANT_ALG_HKDF
	select PSA_WANT_ALG_HMAC
	# SRP-6. Cracen's implementation is hardwired to SHA-512 over the
	# 3072-bit MODP group, so SHA-512 is not optional here. The client
	# derives its private key with the SRP password hash rather than
	# importing one, and the server imports the verifier as a public key.
	select PSA_WANT_ALG_SRP_6
	select PSA_WANT_ALG_SRP_PASSWORD_HASH
	select PSA_WANT_ALG_SHA_512
	select PSA_WANT_KEY_TYPE_SRP_KEY_PAIR_DERIVE
	select PSA_WANT_KEY_TYPE_SRP_PUBLIC_KEY

config CRYPTO_BENCHMARKS_PSA_KEY_WRAP
	bool "PSA key wrap tests"
	default y
	select PSA_WANT_ALG_AES_KW
	select PSA_WANT_ALG_AES_KWP
	select PSA_WANT_ALG_ECB_NO_PADDING
	select PSA_WANT_KEY_TYPE_AES

config CRYPTO_BENCHMARKS_PSA_RNG
	bool "PSA RNG tests"
	default y
	select PSA_WANT_GENERATE_RANDOM

endmenu

source "Kconfig.zephyr"
```

## sample.yaml
```
sample:
  description: |
    This sample demonstrates the PSA Crypto API operations of the individual
    crypto samples in one application, split into key setup, single-part and
    multipart stages, with one thread per operation.
  name: Crypto benchmarks
common:
  sysbuild: true
  tags:
    - introduction
    - psa
    - sysbuild
    - ci_samples_crypto
    - crypto
  harness: console
  harness_config:
    type: multi_line
    regex:
      - ".*Example finished successfully!.*"
tests:
  sample.crypto.crypto_benchmarks.cc3xx:
    tags:
      - cc3xx
    platform_allow:
      - nrf5340dk/nrf5340/cpuapp/ns
      - nrf5340dk/nrf5340/cpuapp
      - nrf9160dk/nrf9160/ns
      - nrf9160dk/nrf9160
      - nrf52840dk/nrf52840
      - nrf9161dk/nrf9161
      - nrf9161dk/nrf9161/ns
      - nrf9151dk/nrf9151
      - nrf9151dk/nrf9151/ns
    integration_platforms:
      - nrf5340dk/nrf5340/cpuapp/ns
      - nrf5340dk/nrf5340/cpuapp
      - nrf9160dk/nrf9160/ns
      - nrf9160dk/nrf9160
      - nrf52840dk/nrf52840
      - nrf9161dk/nrf9161
      - nrf9161dk/nrf9161/ns
      - nrf9151dk/nrf9151
      - nrf9151dk/nrf9151/ns
  sample.crypto.crypto_benchmarks.cracen:
    tags:
      - cracen
    platform_allow:
      - nrf54l15dk/nrf54l15/cpuapp
      - nrf54l15dk/nrf54l15/cpuapp/ns
      - nrf54l15dk/nrf54l10/cpuapp
      - nrf54l15dk/nrf54l10/cpuapp/ns
      - nrf54l15dk/nrf54l05/cpuapp
      - nrf54ls05dk/nrf54ls05a/cpuapp
      - nrf54ls05dk/nrf54ls05b/cpuapp
      - nrf54lm20dk/nrf54lm20a/cpuapp
      - nrf54lm20dk/nrf54lm20a/cpuapp/ns
      - nrf54lm20dk/nrf54lm20b/cpuapp
      - nrf54lm20dk/nrf54lm20b/cpuapp/ns
      - nrf54lv10dk/nrf54lv10a/cpuapp
      - nrf54lv10dk/nrf54lv10a/cpuapp/ns
      - nrf54lc10dk/nrf54lc10a/cpuapp
      - nrf54lc10dk/nrf54lc10a/cpuapp/ns
      - nrf7120dk/nrf7120/cpuapp
      - nrf7120dk/nrf7120/cpuapp/ns
    integration_platforms:
      - nrf54l15dk/nrf54l15/cpuapp
      - nrf54l15dk/nrf54l15/cpuapp/ns
      - nrf54l15dk/nrf54l10/cpuapp
      - nrf54l15dk/nrf54l10/cpuapp/ns
      - nrf54l15dk/nrf54l05/cpuapp
      - nrf54ls05dk/nrf54ls05a/cpuapp
      - nrf54ls05dk/nrf54ls05b/cpuapp
      - nrf54lm20dk/nrf54lm20a/cpuapp
      - nrf54lm20dk/nrf54lm20a/cpuapp/ns
      - nrf54lm20dk/nrf54lm20b/cpuapp
      - nrf54lm20dk/nrf54lm20b/cpuapp/ns
      - nrf54lv10dk/nrf54lv10a/cpuapp
      - nrf54lv10dk/nrf54lv10a/cpuapp/ns
      - nrf54lc10dk/nrf54lc10a/cpuapp
      - nrf54lc10dk/nrf54lc10a/cpuapp/ns
      - nrf7120dk/nrf7120/cpuapp
      - nrf7120dk/nrf7120/cpuapp/ns
  sample.crypto.crypto_benchmarks.cracen.json:
    tags:
      - cracen
    extra_configs:
      - CONFIG_CRYPTO_BENCHMARKS_OUTPUT_JSON=y
    platform_allow:
      - nrf54l15dk/nrf54l15/cpuapp
    integration_platforms:
      - nrf54l15dk/nrf54l15/cpuapp
  sample.crypto.crypto_benchmarks.cracen.crypto_service:
    tags:
      - cracen
    platform_allow:
      - nrf54h20dk/nrf54h20/cpuapp
    integration_platforms:
      - nrf54h20dk/nrf54h20/cpuapp
```

## prj.conf
```kconfig
#
# Copyright (c) 2026 Nordic Semiconductor ASA
#
# SPDX-License-Identifier: LicenseRef-Nordic-5-Clause
#
# The Zephyr CMSIS emulation assumes that ticks are ms, currently
CONFIG_SYS_CLOCK_TICKS_PER_SEC=1000

CONFIG_MAIN_STACK_SIZE=4096
CONFIG_HEAP_MEM_POOL_SIZE=4096

# Enable logging. All of the output comes from the runner thread: the operation
# threads are silent by design.
CONFIG_CONSOLE=y
CONFIG_LOG=y
CONFIG_LOG_MODE_IMMEDIATE=y

# Thread names identify an operation in the summary and in a fault message.
# Long enough for
# "<alg>/<keydesc>/<stage>/<operation>".
CONFIG_THREAD_NAME=y
CONFIG_THREAD_MAX_NAME_LEN=128

# What is measured per operation: CONFIG_CRYPTO_BENCHMARKS_MEASURE_TIME and
# CONFIG_CRYPTO_BENCHMARKS_MEASURE_STACK, both on by default.

# An operation that overflows its stack cannot report it. Make that a fault
# attributed to the named thread rather than silent corruption.
CONFIG_HW_STACK_PROTECTION=y

# Enable cryptographic features
CONFIG_PSA_CRYPTO=y
CONFIG_PSA_WANT_GENERATE_RANDOM=y

# Mbed TLS heap configuration
CONFIG_MBEDTLS_ENABLE_HEAP=y
CONFIG_MBEDTLS_HEAP_SIZE=8192

CONFIG_BOOT_BANNER=n
CONFIG_NCS_BOOT_BANNER=n

CONFIG_PSA_CRYPTO_DRIVER_OBERON=n
```

## src/main.c
```c
/*
 * Copyright (c) 2026 Nordic Semiconductor ASA
 *
 * SPDX-License-Identifier: LicenseRef-Nordic-5-Clause
 */

#include "crypto_benchmarks.h"

#include <zephyr/timing/timing.h>

LOG_MODULE_REGISTER(crypto_benchmarks, LOG_LEVEL_DBG);

int main(void)
{
	psa_status_t status;

#if defined(CONFIG_CRYPTO_BENCHMARKS_MEASURE_TIME)
	timing_init();
#endif

	status = psa_crypto_init();
	if (status != PSA_SUCCESS) {
		LOG_ERR("psa_crypto_init failed! (Error: %d)", status);
		LOG_INF(APP_ERROR_MESSAGE);
		return APP_ERROR;
	}

	for (size_t i = 0; i < suite_group_cnt; i++) {
		const struct suite_group *group = &suite_groups[i];

		for (size_t j = 0; j < group->suite_cnt; j++) {
			run_suite(group, group->suites[j]);
		}
	}

	report_summary();

	if (failure_count() != 0) {
		return APP_ERROR;
	}

	return APP_SUCCESS;
}
```

## src/crypto_benchmarks.h
```c
/*
 * Copyright (c) 2026 Nordic Semiconductor ASA
 *
 * SPDX-License-Identifier: LicenseRef-Nordic-5-Clause
 */

#ifndef CRYPTO_BENCHMARKS_H__
#define CRYPTO_BENCHMARKS_H__

#include <zephyr/kernel.h>
#include <zephyr/logging/log.h>
#include <zephyr/sys/util.h>
#include <psa/crypto.h>
#include <psa/crypto_extra.h>

#define APP_SUCCESS	    (0)
#define APP_ERROR	    (-1)
#define APP_SUCCESS_MESSAGE "Benchmark finished successfully!"
#define APP_ERROR_MESSAGE   "Benchmark exited with error!"

/*
 * Message length every suite runs its algorithm over. One value for all, so
 * figures compare across algorithms; raising it costs RAM in every suite.
 *
 * Asserted at build time where it matters: the cipher suite needs a multiple of
 * the AES block for its no-padding modes, and the asymmetric encryption suite
 * no more than an RSA-2048 OAEP message carries.
 */
#define TEXT_SIZE 64

/*
 * Every multipart operation feeds its input in exactly two updates, so that
 * multipart rows compare across algorithms: a differing number of update calls
 * would move both figures for reasons unrelated to the algorithm. An operation
 * consuming a ciphertext rather than the message splits that in two instead.
 */
#define TEXT_HALF_SIZE (TEXT_SIZE / 2)

BUILD_ASSERT(TEXT_SIZE % 2 == 0, "TEXT_SIZE must be even to split into two updates");

/*
 * One operation: the body of one thread.
 *
 * fn must not log -- the thread's time and stack have to belong to the PSA
 * calls alone; check results in the suite's check instead. Returning
 * PSA_ERROR_NOT_SUPPORTED marks the operation skipped rather than failed.
 */
struct op {
	/** Last field of the thread name, for example "encrypt". */
	const char *name;
	psa_status_t (*fn)(const void *context);
	const void *context;
	/**
	 * Optional setup the row is not measuring: the far side of an exchange, a
	 * peer's key, a secret to compare against. Runs in its own thread, so its
	 * time and stack stay out of the operation's figures. An error fails the
	 * operation unmeasured; PSA_ERROR_NOT_SUPPORTED skips it.
	 */
	psa_status_t (*prepare)(const void *context);
};

/** One stage of a suite. A suite that leaves a stage out has none. */
struct stage {
	const struct op *ops;
	size_t op_cnt;
};

/**
 * Everything one algorithm demonstrates. An omitted stage does not apply to it:
 * SHA-256 has no key setup, RNG no multipart form.
 */
struct suite {
	/** First field of the thread name, for example "aes_cbc". */
	const char *alg;
	/** Optional second field of the thread name, for example "aes128". */
	const char *keydesc;
	/** Test data supplied to the suite's shared operations. */
	const void *context;

	struct stage keysetup;
	struct stage singlepart;
	struct stage multipart;

	/** Verifies what the operations produced; 0 on success. Runs on the runner. */
	int (*check)(void);
	void (*cleanup)(void);
};

/**
 * The suites of one src/suites/<name> folder, the family results are grouped by.
 * Named once per folder, so the grouping tracks the source tree.
 */
struct suite_group {
	/** Name of the folder under src/suites, for example "psa_cipher". */
	const char *name;
	const struct suite *const *suites;
	size_t suite_cnt;
};

/** Runs every stage of a suite, one thread per operation. */
void run_suite(const struct suite_group *group, const struct suite *suite);

/** Reports the per-operation results and timings, in the configured format. */
void report_summary(void);

/** Number of operations, and reports, that did not succeed. */
size_t failure_count(void);

/** Suite registry, in suites.c. */
extern const struct suite_group suite_groups[];
extern const size_t suite_group_cnt;

#endif /* CRYPTO_BENCHMARKS_H__ */
```

## src/runner.c
```c
/*
 * Copyright (c) 2026 Nordic Semiconductor ASA
 *
 * SPDX-License-Identifier: LicenseRef-Nordic-5-Clause
 */

/*
 * Runs a suite's operations, one thread per operation.
 *
 * All threading, timing and reporting lives here, so suite code carries no
 * instrumentation and a thread's cycles and stack are its operation's alone.
 */

#include "crypto_benchmarks.h"

#include <zephyr/sys/printk.h>
#include <zephyr/timing/timing.h>

LOG_MODULE_DECLARE(crypto_benchmarks);

/* Above the logging thread, so a deferred flush cannot land in a timed run. */
#define OP_THREAD_PRIO 1

#define MAX_RECORDS 512

/* Fits "alg/keydesc/stage/op" without paying for CONFIG_THREAD_MAX_NAME_LEN. */
#define REPORT_NAME_LEN 64

/* One stack for all operations, which run one at a time. Reuse does not blur
 * the figures: k_thread_create() re-poisons it via CONFIG_INIT_STACKS.
 */
static K_THREAD_STACK_DEFINE(op_stack, CONFIG_CRYPTO_BENCHMARKS_OP_STACK_SIZE);
static struct k_thread op_thread;

static K_SEM_DEFINE(op_completed, 0, 1);
static K_SEM_DEFINE(op_released, 0, 1);

static struct {
	const struct op *op;
	const void *context;
	psa_status_t status;
	uint64_t elapsed_ns;
} current;

/* Parts kept apart so the JSON report can emit them as separate fields. All are
 * string literals from the suite tables, which outlive the run.
 */
static struct {
	const char *group;
	const char *alg;
	const char *keydesc;
	const char *stage;
	const char *op;
	psa_status_t status;
	uint64_t elapsed_ns;
	size_t stack_used;
	bool stack_usage_valid;
} records[MAX_RECORDS];

static size_t record_cnt;
static size_t operation_cnt;
static size_t dropped_record_cnt;
static size_t failure_cnt;
static size_t skipped_cnt;

static const void *op_context(void)
{
	return current.op->context != NULL ? current.op->context : current.context;
}

static void prepare_entry(void *p1, void *p2, void *p3)
{
	ARG_UNUSED(p1);
	ARG_UNUSED(p2);
	ARG_UNUSED(p3);

	current.status = current.op->prepare(op_context());
}

/* Own thread, so prepare's time falls outside the timed region and its stack
 * peak cannot be mistaken for the operation's.
 */
static psa_status_t run_prepare(const char *op_name)
{
	char name[CONFIG_THREAD_MAX_NAME_LEN];
	k_tid_t tid;
	int name_length;

	if (current.op->prepare == NULL) {
		return PSA_SUCCESS;
	}

	current.status = PSA_ERROR_GENERIC_ERROR;

	/* Named apart, so a fault in setup is not read as one in the measured op. */
	name_length = snprintk(name, sizeof(name), "%s/prepare", op_name);
	if (name_length < 0 || name_length >= (int)sizeof(name)) {
		LOG_WRN("prepare name truncated: %s", name);
	}

	tid = k_thread_create(&op_thread, op_stack, K_THREAD_STACK_SIZEOF(op_stack), prepare_entry,
			      NULL, NULL, NULL, OP_THREAD_PRIO, 0, K_FOREVER);
	(void)k_thread_name_set(tid, name);
	k_thread_start(tid);

	if (k_thread_join(tid, K_MSEC(CONFIG_CRYPTO_BENCHMARKS_OP_TIMEOUT_MS)) != 0) {
		LOG_ERR("%s: did not finish within %d ms", name,
			CONFIG_CRYPTO_BENCHMARKS_OP_TIMEOUT_MS);
		k_thread_abort(tid);
		(void)k_thread_join(tid, K_FOREVER);

		return PSA_ERROR_COMMUNICATION_FAILURE;
	}

	return current.status;
}

static void op_entry(void *p1, void *p2, void *p3)
{
	ARG_UNUSED(p1);
	ARG_UNUSED(p2);
	ARG_UNUSED(p3);

#if defined(CONFIG_CRYPTO_BENCHMARKS_MEASURE_TIME)
	timing_t start;
	timing_t end;

	timing_start();

	start = timing_counter_get();
	current.status = current.op->fn(op_context());
	end = timing_counter_get();

	current.elapsed_ns = timing_cycles_to_ns(timing_cycles_get(&start, &end));

	timing_stop();
#else
	current.status = current.op->fn(op_context());
#endif

	/* Park rather than return, so the runner can read the stack while the
	 * thread is alive. These frames sit above the operation's own peak.
	 */
	k_sem_give(&op_completed);
	k_sem_take(&op_released, K_FOREVER);
}

static void record(const struct suite_group *group, const struct suite *suite, const char *stage,
		   const struct op *op, const char *name, psa_status_t status, uint64_t elapsed_ns,
		   size_t stack_used, bool stack_usage_valid)
{
	operation_cnt++;

	/* An unimplemented algorithm is skipped, not failed; the row carries the
	 * status either way.
	 */
	if (status == PSA_ERROR_NOT_SUPPORTED) {
		skipped_cnt++;
	} else if (status != PSA_SUCCESS) {
		failure_cnt++;
	}

	if (record_cnt >= ARRAY_SIZE(records)) {
		dropped_record_cnt++;
		LOG_WRN("operation record dropped: %s", name);
		LOG_WRN("You need to increase the records array size!");
		return;
	}

	records[record_cnt].group = group->name;
	records[record_cnt].alg = suite->alg;
	records[record_cnt].keydesc = suite->keydesc;
	records[record_cnt].stage = stage;
	records[record_cnt].op = op->name;
	records[record_cnt].status = status;
	records[record_cnt].elapsed_ns = elapsed_ns;
	records[record_cnt].stack_used = stack_used;
	records[record_cnt].stack_usage_valid = stack_usage_valid;
	record_cnt++;
}

static psa_status_t run_op(const struct suite_group *group, const struct suite *suite,
			   const char *stage, const struct op *op)
{
	char name[CONFIG_THREAD_MAX_NAME_LEN];
	k_tid_t tid;
	size_t stack_used = 0;
	bool stack_usage_valid = false;
	int name_length;

	if (suite->keydesc != NULL) {
		name_length = snprintk(name, sizeof(name), "%s/%s/%s/%s", suite->alg,
				       suite->keydesc, stage, op->name);
	} else {
		name_length = snprintk(name, sizeof(name), "%s/%s/%s", suite->alg, stage,
				       op->name);
	}
	if (name_length < 0 || name_length >= (int)sizeof(name)) {
		LOG_WRN("operation name truncated: %s", name);
	}

	/* Thread-unsafe by design: one operation runs at a time. */
	current.op = op;
	current.context = suite->context;
	current.status = PSA_ERROR_GENERIC_ERROR;
	current.elapsed_ns = 0;

	/* A prepare failure is recorded against the operation it was setting up. */
	psa_status_t prepared = run_prepare(name);

	if (prepared != PSA_SUCCESS) {
		LOG_WRN("%s: prepare did not succeed (status %d)", name, prepared);
		record(group, suite, stage, op, name, prepared, 0, 0, false);

		return prepared;
	}

	/* Prepare left PSA_SUCCESS here; reset so the timed run must set its own. */
	current.status = PSA_ERROR_GENERIC_ERROR;

	k_sem_reset(&op_completed);
	k_sem_reset(&op_released);

	/* Suspended, so the name is in place before the first instruction runs. */
	tid = k_thread_create(&op_thread, op_stack, K_THREAD_STACK_SIZEOF(op_stack), op_entry,
			      NULL, NULL, NULL, OP_THREAD_PRIO, 0, K_FOREVER);
	(void)k_thread_name_set(tid, name);
	k_thread_start(tid);

	/* An operation thread cannot log, so a wedged one must be timed out. */
	if (k_sem_take(&op_completed, K_MSEC(CONFIG_CRYPTO_BENCHMARKS_OP_TIMEOUT_MS)) != 0) {
		LOG_ERR("%s: did not finish within %d ms", name,
			CONFIG_CRYPTO_BENCHMARKS_OP_TIMEOUT_MS);
		k_thread_abort(tid);
		(void)k_thread_join(tid, K_FOREVER);
		record(group, suite, stage, op, name, PSA_ERROR_COMMUNICATION_FAILURE, 0, 0,
		       false);

		return PSA_ERROR_COMMUNICATION_FAILURE;
	}

#if defined(CONFIG_CRYPTO_BENCHMARKS_MEASURE_STACK)
	/* Still parked, so the peak is readable. */
	size_t unused_stack;

	if (k_thread_stack_space_get(tid, &unused_stack) == 0) {
		stack_used = K_THREAD_STACK_SIZEOF(op_stack) - unused_stack;
		stack_usage_valid = true;
	} else {
		LOG_WRN("%s: stack usage unavailable", name);
	}
#endif

	k_sem_give(&op_released);
	(void)k_thread_join(tid, K_FOREVER);

	record(group, suite, stage, op, name, current.status, current.elapsed_ns, stack_used,
	       stack_usage_valid);

	return current.status;
}

static psa_status_t run_stage(const struct suite_group *group, const struct suite *suite,
			      const char *stage, const struct stage *st)
{
	const char *keydesc = suite->keydesc != NULL ? suite->keydesc : "nokey";

	if (st->op_cnt == 0) {
		return PSA_SUCCESS;
	}

	for (size_t i = 0; i < st->op_cnt; i++) {
		psa_status_t status = run_op(group, suite, stage, &st->ops[i]);

		if (status != PSA_SUCCESS) {
			LOG_WRN("%s/%s: skipping the rest of the %s stage", suite->alg, keydesc,
				stage);
			return status;
		}
	}

	return PSA_SUCCESS;
}

void run_suite(const struct suite_group *group, const struct suite *suite)
{
	psa_status_t status;

	/* Only key setup gates the rest; the two stages are independent. */
	status = run_stage(group, suite, "keysetup", &suite->keysetup);
	if (status != PSA_SUCCESS) {
		goto cleanup_with_error;
	}

	status = run_stage(group, suite, "single", &suite->singlepart);
	if (status != PSA_SUCCESS) {
		goto cleanup_with_error;
	}

	status = run_stage(group, suite, "multi", &suite->multipart);
	if (status != PSA_SUCCESS) {
		goto cleanup_with_error;
	}

	if (suite->check != NULL && suite->check() != APP_SUCCESS) {
		failure_cnt++;
		goto cleanup;
	}

	goto cleanup;

cleanup_with_error:
	/* Skips were already counted per operation; only real errors count here. */
	if (status != PSA_ERROR_NOT_SUPPORTED) {
		failure_cnt++;
	}
cleanup:
	if (suite->cleanup != NULL) {
		suite->cleanup();
	}
}

size_t failure_count(void)
{
	return failure_cnt;
}

/* Split so neither formatter needs a 64-bit conversion. */
static void split_elapsed(size_t i, uint32_t *us, uint32_t *ns)
{
	*us = (uint32_t)(records[i].elapsed_ns / 1000U);
	*ns = (uint32_t)(records[i].elapsed_ns % 1000U);
}

#ifdef CONFIG_CRYPTO_BENCHMARKS_OUTPUT_JSON

/*
 * printk() rather than LOG, whose prefix would leave the document unparsable,
 * and streamed a record at a time because it outgrows any buffer here. Name
 * parts are the sample's own [a-z0-9_] literals, so none needs escaping.
 */
void report_summary(void)
{

	/* The counts come first, so that a truncated capture still yields them. */
	printk("{\"summary\":{\"operations\":%zu,\"skipped\":%zu,\"failed\":%zu,"
	       "\"dropped_records\":%zu},\n",
	       operation_cnt, skipped_cnt, failure_cnt, dropped_record_cnt);
	printk("\"operations\":[\n");

	for (size_t i = 0; i < record_cnt; i++) {
		uint32_t us;
		uint32_t ns;

		split_elapsed(i, &us, &ns);

		printk("%s{\"group\":\"%s\",\"alg\":\"%s\",", i == 0 ? "" : ",\n",
		       records[i].group, records[i].alg);

		/* Null, not a placeholder, so it does not read as a measurement. */
		if (records[i].keydesc != NULL) {
			printk("\"keydesc\":\"%s\",", records[i].keydesc);
		} else {
			printk("\"keydesc\":null,");
		}

		printk("\"stage\":\"%s\",\"op\":\"%s\",\"status\":%d,", records[i].stage,
		       records[i].op, (int)records[i].status);

		if (IS_ENABLED(CONFIG_CRYPTO_BENCHMARKS_MEASURE_TIME)) {
			printk("\"elapsed_us\":%u.%03u,", us, ns);
		} else {
			printk("\"elapsed_us\":null,");
		}

		if (records[i].stack_usage_valid) {
			printk("\"stack_used\":%zu}", records[i].stack_used);
		} else {
			printk("\"stack_used\":null}");
		}
	}

	printk("\n]}\n");
}

#else /* CONFIG_CRYPTO_BENCHMARKS_OUTPUT_TEXT */

void report_summary(void)
{

	for (size_t i = 0; i < record_cnt; i++) {
		char name[REPORT_NAME_LEN];
		char elapsed[24] = "";
		char stack[32] = "";
		uint32_t us;
		uint32_t ns;

		split_elapsed(i, &us, &ns);

		if (IS_ENABLED(CONFIG_CRYPTO_BENCHMARKS_MEASURE_TIME)) {
			(void)snprintk(elapsed, sizeof(elapsed), "%7u.%03u us  ", us, ns);
		}

		if (!IS_ENABLED(CONFIG_CRYPTO_BENCHMARKS_MEASURE_STACK)) {
			/* Not measured, so nothing to print. */
		} else if (records[i].stack_usage_valid) {
			(void)snprintk(stack, sizeof(stack), ", stack %zu bytes",
				       records[i].stack_used);
		} else {
			(void)snprintk(stack, sizeof(stack), ", stack unavailable");
		}

		if (records[i].keydesc != NULL) {
			(void)snprintk(name, sizeof(name), "%s/%s/%s/%s", records[i].alg,
				       records[i].keydesc, records[i].stage, records[i].op);
		} else {
			(void)snprintk(name, sizeof(name), "%s/%s/%s", records[i].alg,
				       records[i].stage, records[i].op);
		}

		LOG_INF("%-50s %s(status %d%s)", name, elapsed, records[i].status, stack);
	}

	if (dropped_record_cnt != 0) {
		LOG_WRN("%zu operation records were not retained", dropped_record_cnt);
	}

	LOG_INF("=== summary: %zu operations, %zu skipped, %zu failed ===", operation_cnt,
			skipped_cnt, failure_cnt);
}

#endif /* CONFIG_CRYPTO_BENCHMARKS_OUTPUT_JSON */
```

## src/suites.c
```c
/*
 * Copyright (c) 2026 Nordic Semiconductor ASA
 *
 * SPDX-License-Identifier: LicenseRef-Nordic-5-Clause
 */

/*
 * The registry, written out rather than assembled by the linker so that this
 * file reads as what the sample covers. One array per src/suites folder, whose
 * name appears once in suite_groups[] and is what results are grouped by.
 */

#include "crypto_benchmarks.h"
#include "suites/suites.h"

#if defined(CONFIG_CRYPTO_BENCHMARKS_PSA_CIPHER)
static const struct suite *const group_psa_cipher[] = {
	&suite_aes_cbc_128,
	&suite_aes_cbc_192,
	&suite_aes_cbc_256,
	&suite_aes_cbc_pkcs7_128,
	&suite_aes_cbc_pkcs7_192,
	&suite_aes_cbc_pkcs7_256,
	&suite_aes_ctr_128,
	&suite_aes_ctr_192,
	&suite_aes_ctr_256,
	&suite_aes_ecb_128,
	&suite_aes_ecb_192,
	&suite_aes_ecb_256,
	&suite_chacha20,
	&suite_persistent,
};
#endif

#if defined(CONFIG_CRYPTO_BENCHMARKS_PSA_HASH)
static const struct suite *const group_psa_hash[] = {
	&suite_sha1,
	&suite_sha224,
	&suite_sha256,
	&suite_sha384,
	&suite_sha512,
	&suite_sha3_224,
	&suite_sha3_256,
	&suite_sha3_384,
	&suite_sha3_512,
#if defined(CONFIG_CRYPTO_BENCHMARKS_PSA_XOF)
	/* Defined with the hashes, but needs the XOF option's SHAKE support. */
	&suite_shake256_512,
#endif
};
#endif

#if defined(CONFIG_CRYPTO_BENCHMARKS_PSA_XOF)
static const struct suite *const group_psa_xof[] = {
	&suite_shake128,
	&suite_shake256,
};
#endif

#if defined(CONFIG_CRYPTO_BENCHMARKS_PSA_RNG)
static const struct suite *const group_psa_rng[] = {
	&suite_rng,
};
#endif

#if defined(CONFIG_CRYPTO_BENCHMARKS_PSA_AEAD)
static const struct suite *const group_psa_aead[] = {
	&suite_aes_ccm_128,
	&suite_aes_ccm_192,
	&suite_aes_ccm_256,
	&suite_aes_gcm_128,
	&suite_aes_gcm_192,
	&suite_aes_gcm_256,
	&suite_chachapoly,
};
#endif

#if defined(CONFIG_CRYPTO_BENCHMARKS_PSA_MAC)
static const struct suite *const group_psa_mac[] = {
	&suite_hmac_sha1,
	&suite_hmac_sha224,
	&suite_hmac,
	&suite_hmac_sha384,
	&suite_hmac_sha512,
	&suite_cmac,
	&suite_cmac_aes192,
	&suite_cmac_aes256,
};
#endif

#if defined(CONFIG_CRYPTO_BENCHMARKS_PSA_KEY_DERIVATION)
static const struct suite *const group_psa_key_derivation[] = {
	&suite_hkdf,
	&suite_pbkdf2,
	&suite_tls12_prf,
	&suite_tls12_psk_to_ms,
};
#endif

#if defined(CONFIG_CRYPTO_BENCHMARKS_PSA_KEY_WRAP)
static const struct suite *const group_psa_key_wrap[] = {
	&suite_aes_kw_128,
	&suite_aes_kw_192,
	&suite_aes_kw_256,
	&suite_aes_kwp_128,
};
#endif

#if defined(CONFIG_CRYPTO_BENCHMARKS_PSA_KEY_AGREEMENT)
static const struct suite *const group_psa_key_agreement[] = {
	&suite_ecdh_brainpoolp256r1,
	&suite_ecdh_brainpoolp384r1,
	&suite_ecdh_brainpoolp512r1,
	&suite_ecdh_secp224r1,
	&suite_ecdh,
	&suite_ecdh_secp384r1,
	&suite_ecdh_secp521r1,
	&suite_ecdh_x25519,
	&suite_ecdh_x448,
	&suite_ecdh_secp256k1,
};
#endif

#if defined(CONFIG_CRYPTO_BENCHMARKS_PSA_SIGNATURE)
static const struct suite *const group_psa_signature[] = {
	&suite_ecdsa_brainpoolp256r1_sha1,
	&suite_ecdsa_brainpoolp256r1_sha224,
	&suite_ecdsa_brainpoolp256r1_sha256,
	&suite_ecdsa_brainpoolp256r1_sha384,
	&suite_ecdsa_brainpoolp256r1_sha512,
	&suite_ecdsa_brainpoolp384r1_sha1,
	&suite_ecdsa_brainpoolp384r1_sha224,
	&suite_ecdsa_brainpoolp384r1_sha256,
	&suite_ecdsa_brainpoolp384r1_sha384,
	&suite_ecdsa_brainpoolp384r1_sha512,
	&suite_ecdsa_brainpoolp512r1_sha1,
	&suite_ecdsa_brainpoolp512r1_sha224,
	&suite_ecdsa_brainpoolp512r1_sha256,
	&suite_ecdsa_brainpoolp512r1_sha384,
	&suite_ecdsa_brainpoolp512r1_sha512,
	&suite_ecdsa_secp224r1_sha1,
	&suite_ecdsa_secp224r1_sha224,
	&suite_ecdsa_secp224r1_sha256,
	&suite_ecdsa_secp224r1_sha384,
	&suite_ecdsa_secp224r1_sha512,
	&suite_ecdsa,
	&suite_ecdsa_secp256r1_sha1,
	&suite_ecdsa_secp256r1_sha224,
	&suite_ecdsa_secp256r1_sha384,
	&suite_ecdsa_secp256r1_sha512,
	&suite_ecdsa_secp384r1_sha1,
	&suite_ecdsa_secp384r1_sha224,
	&suite_ecdsa_secp384r1_sha256,
	&suite_ecdsa_secp384r1_sha384,
	&suite_ecdsa_secp384r1_sha512,
	&suite_ecdsa_secp521r1_sha1,
	&suite_ecdsa_secp521r1_sha224,
	&suite_ecdsa_secp521r1_sha256,
	&suite_ecdsa_secp521r1_sha384,
	&suite_ecdsa_secp521r1_sha512,
	&suite_ecdsa_secp256k1_sha1,
	&suite_ecdsa_secp256k1_sha224,
	&suite_ecdsa_secp256k1_sha256,
	&suite_ecdsa_secp256k1_sha384,
	&suite_ecdsa_secp256k1_sha512,
	&suite_eddsa,
	&suite_rsa,
	&suite_rsa_pss,
	&suite_ml_dsa_65,
};
#endif

#if defined(CONFIG_CRYPTO_BENCHMARKS_PSA_ASYMMETRIC_ENCRYPTION)
static const struct suite *const group_psa_asymmetric_encryption[] = {
	&suite_rsa_oaep,
	&suite_rsa_pkcs1v15_crypt,
};
#endif

#if defined(CONFIG_CRYPTO_BENCHMARKS_PSA_PAKE)
static const struct suite *const group_psa_pake[] = {
	&suite_ecjpake,
	&suite_spake2p,
	&suite_srp6,
};
#endif

/* One token names both the array and the group, so they cannot drift apart. The
 * group_ prefix avoids the PSA namespace: psa_key_agreement() is a PSA function.
 */
#define SUITE_GROUP(_folder) {#_folder, group_##_folder, ARRAY_SIZE(group_##_folder)}

const struct suite_group suite_groups[] = {
#if defined(CONFIG_CRYPTO_BENCHMARKS_PSA_CIPHER)
	SUITE_GROUP(psa_cipher),
#endif
#if defined(CONFIG_CRYPTO_BENCHMARKS_PSA_HASH)
	SUITE_GROUP(psa_hash),
#endif
#if defined(CONFIG_CRYPTO_BENCHMARKS_PSA_XOF)
	SUITE_GROUP(psa_xof),
#endif
#if defined(CONFIG_CRYPTO_BENCHMARKS_PSA_RNG)
	SUITE_GROUP(psa_rng),
#endif
#if defined(CONFIG_CRYPTO_BENCHMARKS_PSA_AEAD)
	SUITE_GROUP(psa_aead),
#endif
#if defined(CONFIG_CRYPTO_BENCHMARKS_PSA_MAC)
	SUITE_GROUP(psa_mac),
#endif
#if defined(CONFIG_CRYPTO_BENCHMARKS_PSA_KEY_DERIVATION)
	SUITE_GROUP(psa_key_derivation),
#endif
#if defined(CONFIG_CRYPTO_BENCHMARKS_PSA_KEY_WRAP)
	SUITE_GROUP(psa_key_wrap),
#endif
#if defined(CONFIG_CRYPTO_BENCHMARKS_PSA_KEY_AGREEMENT)
	SUITE_GROUP(psa_key_agreement),
#endif
#if defined(CONFIG_CRYPTO_BENCHMARKS_PSA_SIGNATURE)
	SUITE_GROUP(psa_signature),
#endif
#if defined(CONFIG_CRYPTO_BENCHMARKS_PSA_ASYMMETRIC_ENCRYPTION)
	SUITE_GROUP(psa_asymmetric_encryption),
#endif
#if defined(CONFIG_CRYPTO_BENCHMARKS_PSA_PAKE)
	SUITE_GROUP(psa_pake),
#endif
};

const size_t suite_group_cnt = ARRAY_SIZE(suite_groups);
```
