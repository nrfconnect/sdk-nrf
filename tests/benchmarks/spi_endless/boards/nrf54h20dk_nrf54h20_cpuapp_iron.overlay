/*
 * Copyright (c) 2024 Nordic Semiconductor ASA
 *
 * SPDX-License-Identifier: LicenseRef-Nordic-5-Clause
 */

#include "nrf54h20dk_nrf54h20_common.dtsi"

&spi130 {
	memory-regions = <&cpuapp_dma_region>;
};

&dut_spis {
	memory-regions = <&cpuapp_dma_region>;
};
