/*
 * Copyright (c) 2026 Nordic Semiconductor ASA
 *
 * SPDX-License-Identifier: LicenseRef-Nordic-5-Clause
 */

/ {
	aliases {
		led = &led_custom0;
	};
};

/ {
	leds {
		led_custom0: led_custom0 {
			gpios = <&gpio3 0 GPIO_ACTIVE_HIGH>;
			label = "Custom LED due to collision with PCA63565";
		};
	};
};
