/*
 * Copyright (c) 2026 Nordic Semiconductor ASA
 *
 * SPDX-License-Identifier: LicenseRef-Nordic-5-Clause
 */

/* TIMER120, 256MHz */

/ {
	aliases {
		led = &led0;
		counter = &timer120;
	};
};

&timer120 {
	status = "okay";
};
