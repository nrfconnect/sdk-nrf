/*
 * Copyright (c) 2026 Nordic Semiconductor ASA
 *
 * SPDX-License-Identifier: LicenseRef-Nordic-5-Clause
 */

/* TIMER130, 16MHz */

/ {
	aliases {
		led = &led0;
		counter = &timer130;
	};
};

&timer130 {
	status = "okay";
};
