/*
 * Copyright (c) 2026 Nordic Semiconductor ASA
 *
 * SPDX-License-Identifier: LicenseRef-Nordic-5-Clause
 */

/ {
	aliases {
		/delete-property/ led0;
	};
};

&adc {
	status = "reserved";
	interrupt-parent = <&cpuppr_clic>;
};
