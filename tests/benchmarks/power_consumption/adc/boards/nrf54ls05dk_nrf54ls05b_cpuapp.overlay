/ {
	aliases {
		led = &led0;
		/delete-property/ led1;
		adc0 = &adc;
	};
};

/delete-node/ &led1;

&adc {
	#address-cells = <1>;
	#size-cells = <0>;
	status = "okay";

	channel@0 {
		reg = <0>;
		zephyr,gain = "ADC_GAIN_1";
		zephyr,reference = "ADC_REF_INTERNAL";
		zephyr,acquisition-time = <ADC_ACQ_TIME_DEFAULT>;
		zephyr,input-positive = <NRF_SAADC_AIN3>;
		zephyr,resolution = <14>;
	};
};
