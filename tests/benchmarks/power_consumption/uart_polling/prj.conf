## CMakeLists.txt
```
#
# Copyright (c) 2024 Nordic Semiconductor
#
# SPDX-License-Identifier: LicenseRef-Nordic-5-Clause
#

cmake_minimum_required(VERSION 3.13.1)
find_package(Zephyr REQUIRED HINTS $ENV{ZEPHYR_BASE})
zephyr_include_directories(include)

project(uart_polling)

target_sources(app PRIVATE ./../common/main.c)
target_sources(app PRIVATE src/driver_test.c)
```

## prj.conf
```kconfig
# Enable runtime power management for peripheral
CONFIG_PM_DEVICE=y
CONFIG_PM_DEVICE_RUNTIME=y

CONFIG_PM=y
CONFIG_PM_S2RAM=y
CONFIG_POWEROFF=y
CONFIG_PM_S2RAM_CUSTOM_MARKING=y
CONFIG_BOOT_BANNER=n
```

## boards/nrf54h20dk_nrf54h20_cpuapp.overlay
```dts
&uart136 {
	zephyr,pm-device-runtime-auto;
};
```

## boards/nrf54lm20dk_nrf54lm20a_cpuapp.overlay
```dts
/ {
	aliases {
		led = &led0;
	};
};

&uart20 {
};
```

## src/driver_test.c
```c
/*
 * Copyright (c) 2024 Nordic Semiconductor ASA
 *
 * SPDX-License-Identifier: LicenseRef-Nordic-5-Clause
 */

#include <zephyr/drivers/uart.h>
static const struct device *const uart_dev = DEVICE_DT_GET(DT_CHOSEN(zephyr_console));

void thread_definition(void)
{
	while (1) {
		uart_poll_out(uart_dev, 'a');
		uart_poll_out(uart_dev, '\n');
		uart_poll_out(uart_dev, '\r');
	}
}
```
