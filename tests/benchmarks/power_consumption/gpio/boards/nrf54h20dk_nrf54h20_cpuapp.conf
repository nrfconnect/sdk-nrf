## tests/benchmarks/power_consumption/gpio/boards/nrf54h20dk_nrf54h20_cpuapp.conf
```kconfig
# Enable runtime power management for peripheral
CONFIG_PM_DEVICE=y
CONFIG_PM_DEVICE_RUNTIME=y

CONFIG_PM=y
CONFIG_PM_S2RAM=y
CONFIG_POWEROFF=y
CONFIG_SOC_NRF54H20_CPURAD_ENABLE=y
```

## tests/benchmarks/power_consumption/gpio/testcase.yaml
```yaml
common:
  tags:
    - ppk_power_measure
    - ci_tests_benchmarks_current_consumption
tests:
  benchmarks.power_consumption.gpio:
    integration_platforms:
      - nrf54h20dk/nrf54h20/cpuapp
    platform_allow:
      - nrf52840dk/nrf52840
      - nrf5340dk/nrf5340/cpuapp
      - nrf54l15dk/nrf54l15/cpuapp
      - nrf54lm20dk/nrf54lm20a/cpuapp
      - nrf54lv10dk/nrf54lv10a/cpuapp
      - nrf54h20dk/nrf54h20/cpuapp
    harness: pytest
    harness_config:
      fixture: gpio_loopback
      pytest_root:
        - "${CUSTOM_ROOT_TEST_DIR}/test_measure_power_consumption.py::test_thread_suspend_resume_gpio"
```

## tests/benchmarks/power_consumption/hpf_mspi_pm/testcase.yaml
```yaml
common:
  tags:
    - ppk_power_measure
    - ci_tests_benchmarks_current_consumption
  harness: pytest
  harness_config:
    fixture: ppk_power_measure
    pytest_root:
      - "${CUSTOM_ROOT_TEST_DIR}/test_measure_power_consumption.py::test_thread_suspend_resume_flash"

tests:
  benchmarks.power_consumption.hpf_mspi_pm:
    platform_allow:
      - nrf54l15dk/nrf54l15/cpuapp
    integration_platforms:
      - nrf54l15dk/nrf54l15/cpuapp
```

## tests/benchmarks/power_consumption/i2c/Kconfig
```kconfig
#
# Copyright (c) 2025 Nordic Semiconductor ASA
#
# SPDX-License-Identifier: LicenseRef-Nordic-5-Clause
#

config APP_PROVIDE_PM_HOOKS
	bool "Application provides PM hooks"
	default y if SOC_NRF54H20_CPUPPR
	select HAS_PM
	select HAS_POWEROFF

source "Kconfig.zephyr"
```

## tests/benchmarks/power_consumption/i2c/testcase.yaml
```yaml
common:
  tags:
    - ppk_power_measure
    - ci_tests_benchmarks_current_consumption

tests:
  benchmarks.power_consumption.i2c_nrf54l:
    harness: pytest
    integration_platforms:
      - nrf54l15dk/nrf54l15/cpuapp
    platform_allow:
      - nrf54l15dk/nrf54l15/cpuapp
    extra_args:
      - SHIELD=pca63565
    harness_config:
      fixture: pca63565
      pytest_root:
        - "${CUSTOM_ROOT_TEST_DIR}/test_measure_power_consumption.py::test_thread_suspend_resume_i2c_54L"

  benchmarks.power_consumption.i2c_nrf54l.lfrc:
    harness: pytest
    integration_platforms:
      - nrf54l15dk/nrf54l15/cpuapp
    platform_allow:
      - nrf54l15dk/nrf54l15/cpuapp
    extra_args:
      - SHIELD=pca63565
      - CONFIG_CLOCK_CONTROL_NRF_K32SRC_RC=y
    harness_config:
      fixture: pca63565
      pytest_root:
        - "${CUSTOM_ROOT_TEST_DIR}/test_measure_power_consumption.py::test_thread_suspend_resume_i2c_54L"

  benchmarks.power_consumption.i2c_nrf54h:
    harness: pytest
    sysbuild: true
    integration_platforms:
      - nrf54h20dk/nrf54h20/cpuapp
    platform_allow:
      - nrf54h20dk/nrf54h20/cpuapp
      - nrf54h20dk/nrf54h20/cpuppr
    extra_args:
      - SHIELD=pca63566
      - vpr_launcher_SHIELD=pca63566_fwd
    harness_config:
      fixture: pca63566
      pytest_root:
        - "${CUSTOM_ROOT_TEST_DIR}/test_measure_power_consumption.py::test_thread_suspend_resume_i2c_54H"
    timeout: 120
```

## tests/benchmarks/power_consumption/lpcomp/testcase.yaml
```yaml
common:
  tags:
    - ppk_power_measure
    - ci_tests_benchmarks_current_consumption
  harness: pytest

tests:
  benchmarks.power_consumption.lpcomp:
    integration_platforms:
      - nrf54l15dk/nrf54l15/cpuapp
    platform_allow:
      - nrf5340dk/nrf5340/cpuapp
      - nrf54l15dk/nrf54l15/cpuapp
      - nrf54lm20dk/nrf54lm20a/cpuapp
      - nrf54lm20dk/nrf54lm20b/cpuapp
      - nrf54lv10dk/nrf54lv10a/cpuapp
      - nrf54lc10dk/nrf54lc10a/cpuapp
    harness_config:
      fixture: gpio_loopback
      pytest_root:
        - "${CUSTOM_ROOT_TEST_DIR}/test_measure_power_consumption.py::test_thread_suspend_resume_lpcomp"

  benchmarks.power_consumption.lpcomp.ldo:
    integration_platforms:
      - nrf54l15dk/nrf54l15/cpuapp
    platform_allow:
      - nrf5340dk/nrf5340/cpuapp
      - nrf54l15dk/nrf54l15/cpuapp
      - nrf54lm20dk/nrf54lm20a/cpuapp
      - nrf54lm20dk/nrf54lm20b/cpuapp
      - nrf54lv10dk/nrf54lv10a/cpuapp
      - nrf54lc10dk/nrf54lc10a/cpuapp
    required_snippets:
      - nordic-vregmain-ldo
    harness_config:
      fixture: gpio_loopback
      pytest_root:
        - "${CUSTOM_ROOT_TEST_DIR}/test_measure_power_consumption.py::test_thread_suspend_resume_lpcomp_ldo"

  benchmarks.power_consumption.lpcomp.nrf54l_lfrc:
    integration_platforms:
      - nrf54l15dk/nrf54l15/cpuapp
    platform_allow:
      - nrf54l15dk/nrf54l15/cpuapp
      - nrf54lm20dk/nrf54lm20a/cpuapp
      - nrf54lm20dk/nrf54lm20b/cpuapp
      - nrf54lv10dk/nrf54lv10a/cpuapp
      - nrf54lc10dk/nrf54lc10a/cpuapp
    extra_configs:
      - CONFIG_CLOCK_CONTROL_NRF_K32SRC_RC=y
    harness_config:
      fixture: gpio_loopback
      pytest_root:
        - "${CUSTOM_ROOT_TEST_DIR}/test_measure_power_consumption.py::test_thread_suspend_resume_lpcomp"
```

## tests/benchmarks/power_consumption/qdec/Kconfig.sysbuild
```kconfig
#
# Copyright (c) 2023 Nordic Semiconductor ASA
#
# SPDX-License-Identifier: LicenseRef-Nordic-5-Clause
#

source "${ZEPHYR_BASE}/share/sysbuild/Kconfig"

config REMOTE_BOARD
	string "The board used for remote target"
```

## tests/benchmarks/power_consumption/qdec/testcase.yaml
```yaml
common:
  sysbuild: true
  tags:
    - ci_tests_benchmarks_current_consumption
    - ppk_power_measure
    - sensors
  harness: pytest

tests:
  benchmarks.power_consumption.qdec:
    platform_allow:
      - nrf52840dk/nrf52840
      - nrf5340dk/nrf5340/cpuapp
      - nrf54l15dk/nrf54l15/cpuapp
      - nrf54lm20dk/nrf54lm20a/cpuapp
      - nrf54h20dk/nrf54h20/cpuapp
    integration_platforms:
      - nrf54h20dk/nrf54h20/cpuapp
    harness_config:
      fixture: gpio_loopback
      pytest_root:
        - "${CUSTOM_ROOT_TEST_DIR}/test_measure_power_consumption.py::test_thread_suspend_resume_gpio"
```

## tests/benchmarks/power_consumption/spi/Kconfig.sysbuild
```kconfig
#
# Copyright (c) 2024 Nordic Semiconductor ASA
#
# SPDX-License-Identifier: LicenseRef-Nordic-5-Clause
#

config REMOTE_BOARD
	string "The board used for remote target"

source "share/sysbuild/Kconfig"
```

## tests/benchmarks/power_consumption/spi/boards/nrf54h20dk_nrf54h20_cpuapp.conf
```kconfig
#
# Copyright (c) 2025 Nordic Semiconductor ASA
#
# SPDX-License-Identifier: LicenseRef-Nordic-5-Clause
#
CONFIG_PM_S2RAM=y

CONFIG_SOC_NRF54H20_CPURAD_ENABLE=y
```

## tests/benchmarks/power_consumption/spi/testcase.yaml
```yaml
common:
  tags:
    - ppk_power_measure
    - ci_tests_benchmarks_current_consumption

tests:
  benchmarks.power_consumption.spi_nrf54l:
    harness: pytest
    integration_platforms:
      - nrf54l15dk/nrf54l15/cpuapp
    platform_allow:
      - nrf54l15dk/nrf54l15/cpuapp
    extra_args:
      - SHIELD=pca63565
    harness_config:
      fixture: pca63565
      pytest_root:
        - "${CUSTOM_ROOT_TEST_DIR}/test_measure_power_consumption.py::test_thread_suspend_resume_spi_54L"

  benchmarks.power_consumption.spi_nrf54l.low_freq:
    harness: pytest
    integration_platforms:
      - nrf54l15dk/nrf54l15/cpuapp
    platform_allow:
      - nrf54l15dk/nrf54l15/cpuapp
    extra_args:
      - SHIELD=pca63565
      - EXTRA_DTC_OVERLAY_FILE='boards/spi_freq_2MHz.overlay'
    harness_config:
      fixture: pca63565
      pytest_root:
        - "${CUSTOM_ROOT_TEST_DIR}/test_measure_power_consumption.py::test_thread_suspend_resume_spi_54L"

  benchmarks.power_consumption.spi_nrf54h:
    harness: pytest
    sysbuild: true
    integration_platforms:
      - nrf54h20dk/nrf54h20/cpuapp
    platform_allow:
      - nrf54h20dk/nrf54h20/cpuapp
    extra_args:
      - SHIELD=pca63566
    harness_config:
      fixture: pca63566
      pytest_root:
        - "${CUSTOM_ROOT_TEST_DIR}/test_measure_power_consumption.py::test_thread_suspend_resume_spi_54H"

  benchmarks.power_consumption.spi_nrf54h.low_freq:
    harness: pytest
    sysbuild: true
    integration_platforms:
      - nrf54h20dk/nrf54h20/cpuapp
    platform_allow:
      - nrf54h20dk/nrf54h20/cpuapp
    extra_args:
      - SHIELD=pca63566
      - EXTRA_DTC_OVERLAY_FILE='boards/spi_freq_2MHz.overlay'
    harness_config:
      fixture: pca63566
      pytest_root:
        - "${CUSTOM_ROOT_TEST_DIR}/test_measure_power_consumption.py::test_thread_suspend_resume_spi_54H"
```

## tests/benchmarks/power_consumption/temperature_sensor/testcase.yaml
```yaml
common:
  sysbuild: true
  tags:
    - drivers
    - sensors
    - ci_tests_benchmarks_current_consumption
    - ppk_power_measure
  harness: pytest
  harness_config:
    fixture: ppk_power_measure
    pytest_root:
      - "${CUSTOM_ROOT_TEST_DIR}/test_measure_power_consumption.py::test_thread_suspend_resume_gpio"

tests:
  benchmarks.power_consumption.temperature:
    integration_platforms:
      - nrf54h20dk/nrf54h20/cpuapp
    platform_allow:
      - nrf52840dk/nrf52840
      - nrf54h20dk/nrf54h20/cpuapp
      - nrf54l15dk/nrf54l15/cpuapp
      - nrf54lm20dk/nrf54lm20a/cpuapp
      - nrf54ls05dk/nrf54ls05b/cpuapp
      - nrf54lv10dk/nrf54lv10a/cpuapp

  benchmarks.power_consumption.temperature.nrf54l_lfrc:
    integration_platforms:
      - nrf54l15dk/nrf54l15/cpuapp
    platform_allow:
      - nrf54l15dk/nrf54l15/cpuapp
      - nrf54lm20dk/nrf54lm20a/cpuapp
      - nrf54ls05dk/nrf54ls05b/cpuapp
      - nrf54lv10dk/nrf54lv10a/cpuapp
    extra_configs:
      - CONFIG_CLOCK_CONTROL_NRF_K32SRC_RC=y
```

## tests/benchmarks/power_consumption/timer_waiting/testcase.yaml
```yaml
common:
  tags:
    - ppk_power_measure
    - ci_tests_benchmarks_current_consumption
tests:
  benchmarks.power_consumption.timer_waiting_16M_legacy:
    integration_platforms:
      - nrf52840dk/nrf52840
    platform_allow:
      - nrf52840dk/nrf52840
      - nrf5340dk/nrf5340/cpuapp
    harness: pytest
    harness_config:
      fixture: ppk_power_measure
      pytest_root:
        - "${CUSTOM_ROOT_TEST_DIR}/test_measure_power_consumption.py::test_measure_and_data_dump_power_consumption_for_timer_waiting"
  benchmarks.power_consumption.timer_waiting_16M_nrf54l:
    integration_platforms:
      - nrf54l15dk/nrf54l15/cpuapp
    platform_allow:
      - nrf54l15dk/nrf54l15/cpuapp
      - nrf54lm20dk/nrf54lm20a/cpuapp
      - nrf54lv10dk/nrf54lv10a/cpuapp
    extra_args:
      - DTC_OVERLAY_FILE="boards/nrf54l_16M.overlay"
    harness: pytest
    harness_config:
      fixture: ppk_power_measure
      pytest_root:
        - "${CUSTOM_ROOT_TEST_DIR}/test_measure_power_consumption.py::test_measure_and_data_dump_power_consumption_for_timer_waiting"
  benchmarks.power_consumption.timer_waiting_16M_nrf54h:
    sysbuild: true
    integration_platforms:
      - nrf54h20dk/nrf54h20/cpuapp
    platform_allow:
      - nrf54h20dk/nrf54h20/cpuapp
    extra_args:
      - DTC_OVERLAY_FILE="boards/nrf54h20dk_nrf54h20_cpuapp_16M.overlay"
    harness: pytest
    harness_config:
      fixture: ppk_power_measure
      pytest_root:
        - "${CUSTOM_ROOT_TEST_DIR}/test_measure_power_consumption.py::test_measure_and_data_dump_power_consumption_for_timer_waiting"
  benchmarks.power_consumption.timer_waiting_32M_nrf54l:
    integration_platforms:
      - nrf54l15dk/nrf54l15/cpuapp
    platform_allow:
      - nrf54l15dk/nrf54l15/cpuapp
      - nrf54lm20dk/nrf54lm20a/cpuapp
      - nrf54lv10dk/nrf54lv10a/cpuapp
    extra_args:
      - EXTRA_DTC_OVERLAY_FILE="boards/nrf54l_32M.overlay"
    harness: pytest
    harness_config:
      fixture: ppk_power_measure
      pytest_root:
        - "${CUSTOM_ROOT_TEST_DIR}/test_measure_power_consumption.py::test_measure_and_data_dump_power_consumption_for_timer_waiting"
  benchmarks.power_consumption.timer_waiting_128M_nrf54l:
    integration_platforms:
      - nrf54l15dk/nrf54l15/cpuapp
    platform_allow:
      - nrf54l15dk/nrf54l15/cpuapp
      - nrf54lm20dk/nrf54lm20a/cpuapp
      - nrf54lv10dk/nrf54lv10a/cpuapp
    extra_args:
      - EXTRA_DTC_OVERLAY_FILE="boards/nrf54l_128M.overlay"
    harness: pytest
    harness_config:
      fixture: ppk_power_measure
      pytest_root:
        - "${CUSTOM_ROOT_TEST_DIR}/test_measure_power_consumption.py::test_measure_and_data_dump_power_consumption_for_timer_waiting"
  benchmarks.power_consumption.timer_waiting_320M_nrf54h:
    sysbuild: true
    integration_platforms:
      - nrf54h20dk/nrf54h20/cpuapp
    platform_allow:
      - nrf54h20dk/nrf54h20/cpuapp
    extra_args:
      - DTC_OVERLAY_FILE="boards/nrf54h20dk_nrf54h20_cpuapp_320M.overlay"
    harness: pytest
    harness_config:
      fixture: ppk_power_measure
      pytest_root:
        - "${CUSTOM_ROOT_TEST_DIR}/test_measure_power_consumption.py::test_measure_and_data_dump_power_consumption_for_timer_waiting"
```

## tests/benchmarks/power_consumption/uart/testcase.yaml
```yaml
common:
  sysbuild: true
  tags:
    - ppk_power_measure
    - ci_tests_benchmarks_current_consumption
  harness: pytest
  harness_config:
    fixture: ppk_power_measure
    pytest_root:
      - "${CUSTOM_ROOT_TEST_DIR}/test_measure_power_consumption.py::test_thread_suspend_resume_uart"

tests:
  benchmarks.power_consumption.uart.async:
    integration_platforms:
      - nrf54h20dk/nrf54h20/cpuapp
    platform_allow: &pm_uart_platforms
      - nrf52840dk/nrf52840
      - nrf5340dk/nrf5340/cpuapp
      - nrf54l15dk/nrf54l15/cpuapp
      - nrf54lm20dk/nrf54lm20a/cpuapp
      - nrf54lv10dk/nrf54lv10a/cpuapp
      - nrf54h20dk/nrf54h20/cpuapp
    extra_configs:
      - CONFIG_UART_ASYNC_API=y

  benchmarks.power_consumption.uart.interrupt:
    integration_platforms:
      - nrf54h20dk/nrf54h20/cpuapp
    platform_allow: *pm_uart_platforms
    extra_configs:
      - CONFIG_UART_INTERRUPT_DRIVEN=y

  benchmarks.power_consumption.uart.polling:
    integration_platforms:
      - nrf54h20dk/nrf54h20/cpuapp
    platform_allow: *pm_uart_platforms
    extra_configs:
      - CONFIG_UART_ASYNC_API=n
      - CONFIG_UART_INTERRUPT_DRIVEN=n

  benchmarks.power_consumption.uart.async.nrf54l_lfrc:
    integration_platforms:
      - nrf54l15dk/nrf54l15/cpuapp
    platform_allow: &pm_uart_54l_lfrc_platforms
      - nrf54l15dk/nrf54l15/cpuapp
      - nrf54lm20dk/nrf54lm20a/cpuapp
      - nrf54lv10dk/nrf54lv10a/cpuapp
    extra_configs:
      - CONFIG_UART_ASYNC_API=y
      - CONFIG_CLOCK_CONTROL_NRF_K32SRC_RC=y

  benchmarks.power_consumption.uart.interrupt.nrf54l_lfrc:
    integration_platforms:
      - nrf54l15dk/nrf54l15/cpuapp
    platform_allow: *pm_uart_54l_lfrc_platforms
    extra_configs:
      - CONFIG_UART_INTERRUPT_DRIVEN=y
      - CONFIG_CLOCK_CONTROL_NRF_K32SRC_RC=y

  benchmarks.power_consumption.uart.polling.nrf54l_lfrc:
    integration_platforms:
      - nrf54l15dk/nrf54l15/cpuapp
    platform_allow: *pm_uart_54l_lfrc_platforms
    extra_configs:
      - CONFIG_UART_ASYNC_API=n
      - CONFIG_UART_INTERRUPT_DRIVEN=n
      - CONFIG_CLOCK_CONTROL_NRF_K32SRC_RC=y
```
