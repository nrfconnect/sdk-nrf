## tests/benchmarks/power_consumption/uart_interrupt/testcase.yaml
```yaml
common:
  tags:

    - ppk_power_measure
    - ci_tests_benchmarks_current_consumption
tests:
  benchmarks.power_consumption.uart_interrupt_nrf54l:
    integration_platforms:
      - nrf54l15dk/nrf54l15/cpuapp
      - nrf54lm20dk/nrf54lm20a/cpuapp
    platform_allow:
      - nrf54l15dk/nrf54l15/cpuapp
      - nrf54lm20dk/nrf54lm20a/cpuapp
    harness: pytest
    harness_config:
      fixture: ppk_power_measure
      pytest_root:
        - "${CUSTOM_ROOT_TEST_DIR}/test_measure_power_consumption.py::test_thread_suspend_resume_uart_interrupt_54L"
  benchmarks.power_consumption.uart_interrupt_nrf54h:
    sysbuild: true
    integration_platforms:
      - nrf54h20dk/nrf54h20/cpuapp
    platform_allow:
      - nrf54h20dk/nrf54h20/cpuapp
    extra_args:
      - CONFIG_SOC_NRF54H20_CPURAD_ENABLE=y
      - SB_CONF_FILE=sysbuild/nrf54h20dk_nrf54h20_cpurad.conf
    harness: pytest
    harness_config:
      fixture: ppk_power_measure
      pytest_root:
        - "${CUSTOM_ROOT_TEST_DIR}/test_measure_power_consumption.py::test_thread_suspend_resume_uart_interrupt_54H"
```

## tests/benchmarks/power_consumption/uart_polling/testcase.yaml
```yaml
common:
  tags: ppk_power_measure ci_tests_benchmarks_current_consumption

tests:
  benchmarks.power_consumption.uart_poll_nrf54l:
    integration_platforms:
      - nrf54l15dk/nrf54l15/cpuapp
    platform_allow:
      - nrf54l15dk/nrf54l15/cpuapp
    harness: pytest
    harness_config:
      fixture: ppk_power_measure
      pytest_root:
        - "${CUSTOM_ROOT_TEST_DIR}/test_measure_power_consumption.py::test_measure_and_data_dump_placeholder"
  benchmarks.power_consumption.uart_poll_nrf54h:
    integration_platforms:
      - nrf54h20dk/nrf54h20/cpuapp
    platform_allow:
      - nrf54h20dk/nrf54h20/cpuapp
    harness: pytest
    harness_config:
      fixture: ppk_power_measure
      pytest_root:
        - "${CUSTOM_ROOT_TEST_DIR}/test_measure_power_consumption.py::test_measure_and_data_dump_placeholder"
```

## tests/benchmarks/spi_endless/Kconfig
```kconfig
#
# Copyright (c) 2024 Nordic Semiconductor ASA
#
# SPDX-License-Identifier: LicenseRef-Nordic-5-Clause
#

config TESTED_SPI_MODE
	int "SPI mode"
	default 0
	help
		SPI mode value (clock polarity and phase) used in the test.
		0: CPOL 0 (Active high), CPHA 0 (leading)
		1: CPOL 0 (Active high), CPHA 1 (trailing)
		2: CPOL 1 (Active low), CPHA 0 (leading)
		3: CPOL 1 (Active low), CPHA 1 (trailing)

config ROLE_HOST
	int "Change test behaviour depending on Host/Device role"
	default 1
	help
		Change test behaviour.
		0: Device - returns data received previously
		1: Host - generates data, sends it to the Device, confirms that received data is correct

source "Kconfig.zephyr"
```

## tests/benchmarks/spi_endless/testcase.yaml
```yaml
common:
  depends_on: spi
  tags: drivers spi ci_tests_benchmarks_spi_endless
  harness: console
  harness_config:
    fixture: gpio_spi_bridge_two_boards
  build_only: true
  platform_allow:
    - nrf52840dk/nrf52840
    - nrf54l15dk/nrf54l15/cpuapp
    - nrf54h20dk/nrf54h20/cpuapp
  integration_platforms:
    - nrf54l15dk/nrf54l15/cpuapp

tests:
  drivers.spi.spi_endless.host:
    extra_configs:
      - CONFIG_ROLE_HOST=1
      - CONFIG_TESTED_SPI_MODE=1
    extra_args: EXTRA_DTC_OVERLAY_FILE="boards/2mhz.overlay"

  drivers.spi.spi_endless.device:
    extra_configs:
      - CONFIG_ROLE_HOST=0
      - CONFIG_TESTED_SPI_MODE=1
    extra_args: EXTRA_DTC_OVERLAY_FILE="boards/2mhz.overlay"
```

## tests/benchmarks/vpr_context/testcase.yaml
```yaml
common:
  tags:
    - ci_tests_benchmarks_memory

tests:
  benchmarks.vpr_context:
    platform_allow:
      - nrf54l15dk/nrf54l15/cpuflpr
      - nrf54lm20dk/nrf54lm20a/cpuflpr
      - nrf54lm20dk/nrf54lm20b/cpuflpr
      - nrf54lc10dk/nrf54lc10a/cpuflpr
      - nrf54lv10dk/nrf54lv10a/cpuflpr
    integration_platforms:
      - nrf54l15dk/nrf54l15/cpuflpr
    extra_args:
      - vpr_launcher_CONFIG_SERIAL=n
```

## tests/benchmarks/xspi_performance/testcase.yaml
```yaml
common:
  tags:
    - drivers
    - spi
    - ci_tests_benchmarks_spi_performance
    - ppk_power_measure

tests:
  benchmarks.xspi_performance.single.manual:
    build_only: true
    extra_args:
      - FILE_SUFFIX=spi_single
    platform_allow: &spi_single_platform_allow
      - nrf52840dk/nrf52840
      - nrf5340dk/nrf5340/cpuapp
      - nrf54h20dk/nrf54h20/cpuapp
      - nrf54l15dk/nrf54l15/cpuapp
      - nrf54lm20dk/nrf54lm20a/cpuapp
      - nrf54lm20dk/nrf54lm20b/cpuapp
    integration_platforms:
      - nrf54l15dk/nrf54l15/cpuapp

  benchmarks.xspi_performance.hpf_single.manual:
    build_only: true
    extra_args:
      - SB_CONFIG_HPF=y
      - SB_CONFIG_HPF_MSPI=y
      - SB_CONFIG_VPR_LAUNCHER=n
      - EXTRA_DTC_OVERLAY_FILE='boards/nrf54l_hpf_single.overlay'
    platform_allow: &spi_hpf_single_platform_allow
      - nrf54l15dk/nrf54l15/cpuapp
      - nrf54lm20dk/nrf54lm20a/cpuapp
      - nrf54lm20dk/nrf54lm20b/cpuapp
    integration_platforms:
      - nrf54l15dk/nrf54l15/cpuapp

  benchmarks.xspi_performance.quad.manual:
    build_only: true
    platform_allow: &spi_quad_platform_allow
      - nrf52840dk/nrf52840
      - nrf5340dk/nrf5340/cpuapp
    integration_platforms:
      - nrf52840dk/nrf52840
      - nrf5340dk/nrf5340/cpuapp

  benchmarks.xspi_performance.sqspi.manual:
    build_only: true
    extra_args:
      - FILE_SUFFIX=sqspi
    platform_allow: &spi_sqspi_platform_allow
      - nrf54l15dk/nrf54l15/cpuapp
      - nrf54lm20dk/nrf54lm20a/cpuapp
      - nrf54lm20dk/nrf54lm20b/cpuapp
    integration_platforms:
      - nrf54l15dk/nrf54l15/cpuapp

  benchmarks.xspi_performance.hpf_quad.manual:
    build_only: true
    extra_args:
      - SB_CONFIG_HPF=y
      - SB_CONFIG_HPF_MSPI=y
      - SB_CONFIG_VPR_LAUNCHER=n
    platform_allow: &spi_hpf_quad_platform_allow
      - nrf54l15dk/nrf54l15/cpuapp
      - nrf54lm20dk/nrf54lm20a/cpuapp
      - nrf54lm20dk/nrf54lm20b/cpuapp
    integration_platforms:
      - nrf54l15dk/nrf54l15/cpuapp

  benchmarks.xspi_performance.octal.manual:
    build_only: true
    platform_allow:
      - nrf54h20dk/nrf54h20/cpuapp
    integration_platforms:
      - nrf54h20dk/nrf54h20/cpuapp

  benchmarks.xspi_performance.single:
    extra_args:
      - FILE_SUFFIX=spi_single
      - CONFIG_TEST_FIXED_OPERATION_SIZE=y
    platform_allow: *spi_single_platform_allow
    integration_platforms:
      - nrf54l15dk/nrf54l15/cpuapp
    harness: pytest
    harness_config: &spi_perf_harness_cfg
      fixture: ppk_power_measure
      pytest_root:
        - "${CUSTOM_ROOT_TEST_DIR}/test_measure_power_consumption.py::test_measure_xspi_performance"

  benchmarks.xspi_performance.hpf_single:
    extra_args:
      - SB_CONFIG_HPF=y
      - SB_CONFIG_HPF_MSPI=y
      - SB_CONFIG_VPR_LAUNCHER=n
      - EXTRA_DTC_OVERLAY_FILE='boards/nrf54l_hpf_single.overlay'
      - CONFIG_TEST_FIXED_OPERATION_SIZE=y
    platform_allow: *spi_hpf_single_platform_allow
    integration_platforms:
      - nrf54l15dk/nrf54l15/cpuapp
    harness: pytest
    harness_config: *spi_perf_harness_cfg

  benchmarks.xspi_performance.quad:
    extra_args:
      - CONFIG_TEST_FIXED_OPERATION_SIZE=y
    platform_allow: *spi_quad_platform_allow
    integration_platforms:
      - nrf52840dk/nrf52840
      - nrf5340dk/nrf5340/cpuapp
    harness: pytest
    harness_config: *spi_perf_harness_cfg

  benchmarks.xspi_performance.sqspi:
    extra_args:
      - FILE_SUFFIX=sqspi
      - CONFIG_TEST_FIXED_OPERATION_SIZE=y
    platform_allow: *spi_sqspi_platform_allow
    integration_platforms:
      - nrf54l15dk/nrf54l15/cpuapp
    harness: pytest
    harness_config: *spi_perf_harness_cfg

  benchmarks.xspi_performance.hpf_quad:
    extra_args:
      - SB_CONFIG_HPF=y
      - SB_CONFIG_HPF_MSPI=y
      - SB_CONFIG_VPR_LAUNCHER=n
      - CONFIG_TEST_FIXED_OPERATION_SIZE=y
    platform_allow: *spi_hpf_quad_platform_allow
    integration_platforms:
      - nrf54l15dk/nrf54l15/cpuapp
    harness: pytest
    harness_config: *spi_perf_harness_cfg

  benchmarks.xspi_performance.octal:
    extra_args:
      - CONFIG_TEST_FIXED_OPERATION_SIZE=y
    platform_allow:
      - nrf54h20dk/nrf54h20/cpuapp
    integration_platforms:
      - nrf54h20dk/nrf54h20/cpuapp
    harness: pytest
    harness_config: *spi_perf_harness_cfg
```
