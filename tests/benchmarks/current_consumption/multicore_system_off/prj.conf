## CMakeLists.txt
```
cmake_minimum_required(VERSION 3.20.0)

if(NOT nordic-flpr IN_LIST SNIPPET)
  set(SNIPPET nordic-flpr ${SNIPPET} CACHE STRING "" FORCE)
endif()

find_package(Zephyr REQUIRED HINTS $ENV{ZEPHYR_BASE})
project(multicore_system_off)

target_sources(app PRIVATE src/main.c)
```

## Kconfig.sysbuild
```
#
# Copyright (c) 2024 Nordic Semiconductor ASA
#
# SPDX-License-Identifier: LicenseRef-Nordic-5-Clause
#

if SUPPORT_FLPRCORE

choice FLPRCORE
	default FLPRCORE_REMOTE

config FLPRCORE_REMOTE
	bool "remote image"

endchoice

config FLPRCORE_IMAGE_NAME
	default "remote" if FLPRCORE_REMOTE

config FLPRCORE_IMAGE_PATH
	default "$(APP_DIR)/remote" if FLPRCORE_REMOTE

endif # SUPPORT_FLPRCORE

source "share/sysbuild/Kconfig"
```

## prj.conf
```kconfig
CONFIG_PM=y
CONFIG_PM_DEVICE=y
CONFIG_POWEROFF=y
```

## src/main.c
```c
/*
 * Copyright (c) 2024 Nordic Semiconductor ASA
 *
 * SPDX-License-Identifier: LicenseRef-Nordic-5-Clause
 */

#include <stdio.h>
#include <zephyr/kernel.h>
#include <zephyr/sys/poweroff.h>
#include <zephyr/drivers/timer/nrf_grtc_timer.h>
#include <zephyr/pm/device.h>


int main(void)
{
	const struct device *const cons = DEVICE_DT_GET(DT_CHOSEN(zephyr_console));

	printf("Hello world from cpuapp!\n");
	k_sleep(K_SECONDS(1));
	z_nrf_grtc_wakeup_prepare(1 * USEC_PER_SEC);

	printf("Entering system off, waking up in 1s.\n");
	pm_device_action_run(cons, PM_DEVICE_ACTION_SUSPEND);
	sys_poweroff();

	return 0;
}
```
