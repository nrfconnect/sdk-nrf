## CMakeLists.txt
```
#
# Copyright (c) 2026 Nordic Semiconductor ASA
#
# SPDX-License-Identifier: LicenseRef-Nordic-5-Clause
#

cmake_minimum_required(VERSION 3.20.0)

find_package(Zephyr REQUIRED HINTS $ENV{ZEPHYR_BASE})

project(fll16_mode)

target_sources(app PRIVATE src/main.c)
```

## Kconfig.sysbuild
```
#
# Copyright (c) 2026 Nordic Semiconductor ASA
#
# SPDX-License-Identifier: LicenseRef-Nordic-5-Clause
#

config SUPPORT_NETCORE_REMOTE_SLEEP_FOREVER
	bool
	default y if SOC_NRF54H20_CPUAPP

choice NETCORE
	default NETCORE_REMOTE_SLEEP_FOREVER if SUPPORT_NETCORE_REMOTE_SLEEP_FOREVER

config NETCORE_REMOTE_SLEEP_FOREVER
	bool "Remote sleep forever image"

endchoice

if !NETCORE_NONE

config NETCORE_IMAGE_NAME
	default "remote_sleep_forever" if NETCORE_REMOTE_SLEEP_FOREVER

config NETCORE_IMAGE_PATH
	default "$(ZEPHYR_NRF_MODULE_DIR)/tests/benchmarks/power_consumption/common/remote_sleep_forever" if NETCORE_REMOTE_SLEEP_FOREVER

endif # !NETCORE_NONE

source "share/sysbuild/Kconfig"
```

## prj.conf
```kconfig
CONFIG_ASSERT=y
CONFIG_PM=y
```

## boards/nrf54h20dk_nrf54h20_cpuapp.overlay
```dts
/*
 * Copyright (c) 2026 Nordic Semiconductor ASA
 *
 * SPDX-License-Identifier: LicenseRef-Nordic-5-Clause
 */

/ {
	aliases {
		led = &led0;
		/delete-property/ led1;
	};
};

/delete-node/ &led1;
```

## src/main.c
```c
/*
 * Copyright (c) 2026, Nordic Semiconductor ASA
 *
 * SPDX-License-Identifier: LicenseRef-Nordic-5-Clause
 */

#include <soc_lrcconf.h>
#include <zephyr/drivers/gpio.h>

#define FLL16M_MODE_OPEN_LOOP 0
#define FLL16M_MODE_BYPASS    2
#define FLL16M_MODE_LOOP_MASK BIT(0)

const struct gpio_dt_spec led = GPIO_DT_SPEC_GET(DT_ALIAS(led), gpios);

int main(void)
{
	__ASSERT(gpio_is_ready_dt(&led), "GPIO Device not ready");
	__ASSERT(gpio_pin_configure_dt(&led, GPIO_OUTPUT_ACTIVE) == 0,
		 "Could not configure led GPIO");

	soc_lrcconf_poweron_request((sys_snode_t *)NRF_LRCCONF010, NRF_LRCCONF_POWER_MAIN);
	nrf_lrcconf_clock_source_set(
		NRF_LRCCONF010, 0,
		(nrf_lrcconf_clk_src_t)(FLL16M_MODE_BYPASS & FLL16M_MODE_LOOP_MASK), true);
	nrf_lrcconf_task_trigger(NRF_LRCCONF010, NRF_LRCCONF_TASK_CLKSTART_0);

	k_msleep(1000);

	gpio_pin_set_dt(&led, 0);
	nrf_lrcconf_clock_source_set(
		NRF_LRCCONF010, 0,
		(nrf_lrcconf_clk_src_t)(FLL16M_MODE_OPEN_LOOP & FLL16M_MODE_LOOP_MASK), false);
	nrf_lrcconf_task_trigger(NRF_LRCCONF010, NRF_LRCCONF_TASK_CLKSTART_0);

	return 0;
}
```
