#include <zephyr/dt-bindings/comparator/nrf-comp.h>

&gpio1 {
	status = "okay";
};

&comp {
	compatible = "nordic,nrf-lpcomp";
	psel = <NRF_COMP_AIN2>; /* P1.02 */
	refsel = "VDD_4_8";
	status = "okay";
	zephyr,pm-device-runtime-auto;
};
