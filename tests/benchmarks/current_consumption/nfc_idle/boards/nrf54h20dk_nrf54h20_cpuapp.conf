## tests/benchmarks/current_consumption/nfc_idle/testcase.yaml
```yaml
common:
  sysbuild: true
  tags:
    - ci_tests_benchmarks_current_consumption
    - ppk_power_measure
tests:
  benchmarks.current_consumption.nfc_idle:
    platform_allow:
      - nrf52840dk/nrf52840
      - nrf5340dk/nrf5340/cpuapp
      - nrf54l15dk/nrf54l15/cpuapp
      - nrf54lm20dk/nrf54lm20a/cpuapp
      - nrf54h20dk/nrf54h20/cpuapp
    integration_platforms:
      - nrf54h20dk/nrf54h20/cpuapp
    harness: pytest
    harness_config:
      fixture: ppk_power_measure
      pytest_root:
        - "${CUSTOM_ROOT_TEST_DIR}/test_measure_power_consumption.py::test_measure_and_data_dump_power_consumption_nfc_idle"
    timeout: 80
```

## tests/benchmarks/current_consumption/nfc_system_off/testcase.yaml
```yaml
common:
  sysbuild: true
  harness: pytest
  tags:
    - ci_tests_benchmarks_current_consumption
    - ppk_power_measure

tests:
  benchmarks.current_consumption.nfc.system_off:
    platform_allow:
      - nrf54h20dk/nrf54h20/cpuapp
    integration_platforms:
      - nrf54h20dk/nrf54h20/cpuapp
    harness_config:
      fixture: ppk_power_measure
      pytest_root:
        - "${CUSTOM_ROOT_TEST_DIR}/test_measure_power_consumption.py::test_measure_and_data_dump_power_consumption_nfc_idle"
    timeout: 80
```

## tests/benchmarks/current_consumption/rram_low_latency/Kconfig
```kconfig
#
# Copyright (c) 2026 Nordic Semiconductor ASA
#
# SPDX-License-Identifier: LicenseRef-Nordic-5-Clause
#

choice RRAMC_LOW_LATENCY_METHOD
	prompt "Select method that sets RRAMC low latency"
	default RRAMC_POWER_MODE

config RRAMC_POWER_MODE
	bool "RRAMC mode is set to low penalty/high current consumption"

config RRAMC_PPI_WAKEUP
	bool "RRAMC is waken up just before registered event"

endchoice

source "Kconfig.zephyr"
```

## tests/benchmarks/current_consumption/rram_low_latency/sample.yaml
```yaml
common:
  sysbuild: true
  tags:
    - ci_tests_benchmarks_current_consumption
    - ppk_power_measure
  harness: pytest
  harness_config:
    fixture: ppk_power_measure
    pytest_root:
      - "${CUSTOM_ROOT_TEST_DIR}/test_measure_power_consumption.py::test_measure_and_data_dump_rram_low_latency"
  platform_allow:
    - nrf54l15dk/nrf54l15/cpuapp
    - nrf54lm20dk/nrf54lm20a/cpuapp
    - nrf54ls05dk/nrf54ls05b/cpuapp
    - nrf54lv10dk/nrf54lv10a/cpuapp
  integration_platforms:
    - nrf54l15dk/nrf54l15/cpuapp
tests:
  # Set NRF_RRAMC_LP_STANDBY mode
  # this configuration shall have higher power consumption
  # due to RRAM being powered on for all the time
  benchmarks.current_consumption.rram_low_latency.standby_mode: {}
  # use GRTC and DPPI to wakeup RRAM just before expected event
  benchmarks.current_consumption.rram_low_latency.pre_wake:
    extra_configs:
      - CONFIG_RRAMC_PPI_WAKEUP=y
```

## tests/benchmarks/current_consumption/rram_write/testcase.yaml
```yaml
common:
  sysbuild: true
  tags:
    - ci_tests_benchmarks_current_consumption
    - ppk_power_measure
tests:
  benchmarks.current_consumption.rram_write:
    platform_allow:
      - nrf54lv10dk/nrf54lv10a/cpuapp
      - nrf54lv10dk/nrf54lv10a/cpuapp/ns
    integration_platforms:
      - nrf54lv10dk/nrf54lv10a/cpuapp
    extra_args:
      - EXTRA_CONF_FILE=disable_console.conf
    harness: pytest
    harness_config:
      fixture: ppk_power_measure
      pytest_root:
        - "${CUSTOM_ROOT_TEST_DIR}/test_measure_power_consumption.py::test_measure_current_consumption_rram_write"

  benchmarks.current_consumption.rram_write_with_throttling:
    platform_allow:
      - nrf54lv10dk/nrf54lv10a/cpuapp
      - nrf54lv10dk/nrf54lv10a/cpuapp/ns
    integration_platforms:
      - nrf54lv10dk/nrf54lv10a/cpuapp
    extra_args:
      - CONFIG_SOC_FLASH_NRF_THROTTLING=y
      - EXTRA_CONF_FILE=disable_console.conf
    harness: pytest
    harness_config:
      fixture: ppk_power_measure
      pytest_root:
        - "${CUSTOM_ROOT_TEST_DIR}/test_measure_power_consumption.py::test_measure_current_consumption_rram_write_with_throttling"
```

## tests/benchmarks/current_consumption/ship_mode/testcase.yaml
```yaml
common:
  sysbuild: true
  tags:
    - ci_tests_benchmarks_current_consumption
    - ppk_power_measure
tests:
  benchmarks.current_consumption.ship_mode:
    platform_allow:
      - nrf54lv10dk/nrf54lv10a/cpuapp
      - nrf54lv10dk/nrf54lv10a/cpuapp/ns
    integration_platforms:
      - nrf54lv10dk/nrf54lv10a/cpuapp
    extra_args:
      - CONF_FILE="${ZEPHYR_NRF_MODULE_DIR}/samples/zephyr/drivers/regulator/ship_mode/prj.conf"
      - CONFIG_BOOT_DELAY=4000
    harness: pytest
    harness_config:
      fixture: ppk_power_measure
      pytest_root:
        - "${CUSTOM_ROOT_TEST_DIR}/test_measure_power_consumption.py::test_measure_and_data_dump_power_consumption_ship_mode"
    timeout: 80
```

## tests/benchmarks/current_consumption/spis_floating/testcase.yaml
```yaml
common:
  depends_on: spi
  tags:
    - ci_tests_benchmarks_current_consumption
    - ppk_power_measure
  harness: pytest
  harness_config:
    fixture: ppk_power_measure
    pytest_root:
      - "${CUSTOM_ROOT_TEST_DIR}/test_measure_power_consumption.py::test_measure_current_consumption_spis_floating"
  platform_allow:
    - nrf54l15dk/nrf54l15/cpuapp
    - nrf54lm20dk/nrf54lm20a/cpuapp
    - nrf54lm20dk/nrf54lm20b/cpuapp
  integration_platforms:
    - nrf54l15dk/nrf54l15/cpuapp
  platform_exclude:
    - nrf54ls05dk/nrf54ls05a/cpuapp # Device do NOT have low power SPI30
    - nrf54ls05dk/nrf54ls05b/cpuapp # Device do NOT have low power SPI30
    - nrf54lv10dk/nrf54lv10a/cpuapp # Must NOT be powered from 3V
    - nrf54lc10dk/nrf54lc10a/cpuapp # Must NOT be powered from 3V

tests:
  benchmarks.current_consumption.spis_floating: {}
  benchmarks.current_consumption.spis_floating.fix:
    extra_args:
      - FILE_SUFFIX=fix
```
