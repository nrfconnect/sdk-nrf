## tests/benchmarks/current_consumption/uart_pins_pm/testcase.yaml
```yaml
common:
  sysbuild: true
  depends_on: gpio

tests:
  benchmarks.current_consumption.uart_pins_pm:
    tags:
      - ci_build
      - uarte
      - ci_tests_benchmarks_current_consumption
      - ppk_power_measure
    platform_allow:
      - nrf54h20dk/nrf54h20/cpuapp
      - nrf54lm20dk/nrf54lm20a/cpuapp
    integration_platforms:
      - nrf54h20dk/nrf54h20/cpuapp
    harness: pytest
    harness_config:
      fixture: gpio_loopback
      pytest_root:
        - "${CUSTOM_ROOT_TEST_DIR}/test_measure_power_consumption.py::test_measure_and_data_dump_power_consumption_uarte"
```

## tests/benchmarks/current_consumption/uarte_suspend/Kconfig.sysbuild
```kconfig
#
# Copyright (c) 2025 Nordic Semiconductor ASA
#
# SPDX-License-Identifier: LicenseRef-Nordic-5-Clause
#

config REMOTE_BOARD
	string
	default "$(BOARD)/nrf54h20/cpurad" if SOC_NRF54H20_CPUAPP

source "share/sysbuild/Kconfig"
```

## tests/benchmarks/current_consumption/uarte_suspend/testcase.yaml
```yaml
common:
  sysbuild: true
  depends_on: gpio
  tags:
    - ci_build
    - ci_tests_benchmarks_multicore
    - uarte
    - ppk_power_measure
  integration_platforms:
    - nrf54l15dk/nrf54l15/cpuapp
  harness: pytest

tests:
  benchmarks.current_consumption.uarte_suspend:
    platform_allow:
      - nrf52840dk/nrf52840
      - nrf5340dk/nrf5340/cpuapp
      - nrf54h20dk/nrf54h20/cpuapp
      - nrf54l15dk/nrf54l15/cpuapp
      - nrf54lm20dk/nrf54lm20a/cpuapp
      - nrf54lm20dk/nrf54lm20b/cpuapp
      - nrf54ls05dk/nrf54ls05a/cpuapp
      - nrf54ls05dk/nrf54ls05b/cpuapp
      - nrf54lv10dk/nrf54lv10a/cpuapp
      - nrf54lc10dk/nrf54lc10a/cpuapp
    harness_config:
      fixture: gpio_loopback
      pytest_root:
        - "${CUSTOM_ROOT_TEST_DIR}/test_measure_power_consumption.py::test_measure_and_data_dump_power_consumption_uarte"

  benchmarks.current_consumption.uarte_suspend.ldo:
    platform_allow:
      - nrf5340dk/nrf5340/cpuapp
      - nrf54l15dk/nrf54l15/cpuapp
      - nrf54lm20dk/nrf54lm20a/cpuapp
      - nrf54lm20dk/nrf54lm20b/cpuapp
      - nrf54ls05dk/nrf54ls05a/cpuapp
      - nrf54ls05dk/nrf54ls05b/cpuapp
      - nrf54lv10dk/nrf54lv10a/cpuapp
      - nrf54lc10dk/nrf54lc10a/cpuapp
    required_snippets:
      - nordic-vregmain-ldo
    harness_config:
      fixture: gpio_loopback
      pytest_root:
        - "${CUSTOM_ROOT_TEST_DIR}/test_measure_power_consumption.py::test_measure_and_data_dump_power_consumption_uarte_ldo"
```

## tests/benchmarks/early_logging/testcase.yaml
```yaml
common:
  sysbuild: true
  tags:
    - ci_build
    - ci_tests_benchmarks_early_logging
  harness: console
  harness_config:
    type: multi_line
    regex:
      - "Hello World!"

tests:
  benchmarks.early_logging:
    platform_allow:
      - nrf52840dk/nrf52840
      - nrf5340dk/nrf5340/cpuapp
      - nrf54h20dk/nrf54h20/cpuapp
      - nrf54l15dk/nrf54l15/cpuapp
      - nrf54lm20dk/nrf54lm20a/cpuapp
      - nrf54lv10dk/nrf54lv10a/cpuapp
    integration_platforms:
      - nrf54h20dk/nrf54h20/cpuapp
```

## tests/benchmarks/i2c_endless/Kconfig
```kconfig
#
# Copyright (c) 2024 Nordic Semiconductor ASA
#
# SPDX-License-Identifier: LicenseRef-Nordic-5-Clause
#

config ROLE_HOST
	int "Change test behaviour depending on Host/Device role"
	default 1
	help
		Change test behaviour.
		0: Device - returns data received previously
		1: Host - generates data, sends it to the Device, confirms that received data is correct

source "Kconfig.zephyr"
```

## tests/benchmarks/i2c_endless/testcase.yaml
```yaml
common:
  depends_on: i2c
  tags: drivers i2c ci_tests_benchmarks_i2c_endless
  harness: console
  harness_config:
    fixture: gpio_i2c_bridge_two_boards
  build_only: true
  platform_allow:
    - nrf52840dk/nrf52840
    - nrf5340dk/nrf5340/cpuapp
    - nrf54l15dk/nrf54l15/cpuapp
    - nrf54h20dk/nrf54h20/cpuapp
  integration_platforms:
    - nrf54l15dk/nrf54l15/cpuapp

tests:
  boards.nrf.i2c.i2c_endless.host:
    extra_configs:
      - CONFIG_ROLE_HOST=1

  boards.nrf.i2c.i2c_endless.device:
    extra_configs:
      - CONFIG_ROLE_HOST=0
```

## tests/benchmarks/i2s_freq/Kconfig
```kconfig
source "Kconfig.zephyr"

mainmenu "I2S Freq Test"

config I2S_TEST_ALLOWED_DATA_OFFSET
	int "Allowed offset in received data"
	default 2 if DT_HAS_NORDIC_NRF_I2S_ENABLED || DT_HAS_NORDIC_NRF_TDM_ENABLED
	default 0
	help
	  Maximum allowed offset between sent and received samples. Non-zero
	  value of this option may be needed when GPIO loopback is used.

config I2S_TEST_FRAME_CLOCK_MEASUREMENT_GPIO_POLLING
	bool "Measure frame clock frequency using GPIO polling"
	help
	  When set to 'y', a polling gpio will be used for frame clock
	  frequency measurement insted of gpio callback.

config I2S_TEST_FRAME_CLOCK_TOLERANCE_PPM
	int "Allowed tolerance for the frame clock frequency deviation"
	default 1000
	help
	  Maximum allowed tolerance for the frame clock frequency deviation
	  in ppm.

config I2S_TEST_SKIP_SAMPLERATE_8000
	bool "Skip short transfer tests at 8000 samples per second"
	help
	  When set to 'y', short transfer tests at 8000 samples per second
	  will be skipped.

config I2S_TEST_SKIP_SAMPLERATE_16000
	bool "Skip short transfer tests at 16000 samples per second"
	help
	  When set to 'y', short transfer tests at 16000 samples per second
	  will be skipped.

config I2S_TEST_SKIP_SAMPLERATE_32000
	bool "Skip short transfer tests at 32000 samples per second"
	help
	  When set to 'y', short transfer tests at 32000 samples per second
	  will be skipped.

config I2S_TEST_SKIP_SAMPLERATE_44100
	bool "Skip short transfer tests at 44100 samples per second"
	help
	  When set to 'y', short transfer tests at 44100 samples per second
	  will be skipped.

config I2S_TEST_SKIP_SAMPLERATE_48000
	bool "Skip short transfer tests at 48000 samples per second"
	help
	  When set to 'y', short transfer tests at 48000 samples per second
	  will be skipped.

config I2S_TEST_SKIP_SAMPLERATE_88200
	bool "Skip short transfer tests at 88200 samples per second"
	help
	  When set to 'y', short transfer tests at 88200 samples per second
	  will be skipped.

config I2S_TEST_SKIP_SAMPLERATE_96000
	bool "Skip short transfer tests at 96000 samples per second"
	help
	  When set to 'y', short transfer tests at 96000 samples per second
	  will be skipped.
```

## tests/benchmarks/kernel_freq_change/Kconfig
```kconfig
# SPDX-License-Identifier: LicenseRef-Nordic-5-Clause
# Copyright (c) 2025 Nordic Semiconductor ASA

config SYS_CLOCK_TICKS_PER_SEC
	default 16384 if NRF_RTC_TIMER && TICKLESS_KERNEL

source "Kconfig.zephyr"
```

## tests/benchmarks/kernel_freq_change/testcase.yaml
```yaml
common:
  tags:
    - ci_tests_benchmarks_peripheral_load
  harness: ztest

tests:
  benchmarks.kernel_freq_change:
    platform_allow:
      - nrf54h20dk/nrf54h20/cpuapp
      - nrf54h20dk/nrf54h20/cpurad
    integration_platforms:
      - nrf54h20dk/nrf54h20/cpuapp
```

## tests/benchmarks/memory_access/testcase.yaml
```yaml
common:
  tags:
    - ci_tests_benchmarks_memory

tests:
  benchmarks.memory_access:
    platform_allow:
      - nrf54h20dk/nrf54h20/cpuapp
      - nrf54h20dk/nrf54h20/cpurad
      - nrf54h20dk/nrf54h20/cpuppr
      - nrf54h20dk/nrf54h20/cpuflpr
      - nrf54l15dk/nrf54l15/cpuapp
      - nrf54l15dk/nrf54l15/cpuflpr
    integration_platforms:
      - nrf54h20dk/nrf54h20/cpuapp
    harness: console
    harness_config:
      type: one_line
      ordered: true
      regex:
        - "Test PASS"

  benchmarks.memory_access.forbidden:
    platform_allow:
      - nrf54h20dk/nrf54h20/cpuapp
      - nrf54l15dk/nrf54l15/cpuapp
    integration_platforms:
      - nrf54h20dk/nrf54h20/cpuapp
    extra_args:
      - FILE_SUFFIX=forbidden
    harness: console
    harness_config:
      type: one_line
      ordered: true
      regex:
        - "BUS FAULT"
```
