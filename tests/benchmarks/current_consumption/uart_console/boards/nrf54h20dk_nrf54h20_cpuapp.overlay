/*
 * Copyright (c) 2025 Nordic Semiconductor ASA
 *
 * SPDX-License-Identifier: LicenseRef-Nordic-5-Clause
 */

/ {
	aliases {
		led = &led0;
		/delete-property/ led1;
	};
};

&gpio6 {
	status = "disabled";
};

&exmif {
	status = "disabled";
};

/delete-node/ &led1;
