## CMakeLists.txt
```
cmake_minimum_required(VERSION 3.20.0)
find_package(Zephyr REQUIRED HINTS $ENV{ZEPHYR_BASE})
project(early_system_off)

target_sources(app PRIVATE src/main.c)
```

## prj.conf
```kconfig
CONFIG_POWEROFF=y

CONFIG_UART_CONSOLE=n
CONFIG_SERIAL=n
```

## src/main.c
```c
/*
 * Copyright (c) 2026 Nordic Semiconductor ASA
 *
 * SPDX-License-Identifier: LicenseRef-Nordic-5-Clause
 */

#include <zephyr/sys/poweroff.h>

int main(void)
{
	sys_poweroff();

	return 0;
}
```
