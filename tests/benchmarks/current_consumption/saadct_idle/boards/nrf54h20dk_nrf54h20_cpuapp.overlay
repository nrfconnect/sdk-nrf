/*
 * Copyright (c) 2026 Nordic Semiconductor ASA
 *
 * SPDX-License-Identifier: LicenseRef-Nordic-5-Clause
 */

/ {
	aliases {
		led = &led0;
		/delete-property/ led1;
		adc0 = &adc;
	};
};

/delete-node/ &led1;

&timer131 {
	prescaler = <1>;
	status = "okay";
	clocks = <&hfxo>;
};

&adc {
	compatible = "nordic,nrf-saadct";
	status = "okay";
	timer-instance = <&timer131>;
	/* Reserve SAADC to ensure that it is assigned to cpuapp and can be used by nrfx_saadc. */
	#address-cells = <1>;
	#size-cells = <0>;
};
