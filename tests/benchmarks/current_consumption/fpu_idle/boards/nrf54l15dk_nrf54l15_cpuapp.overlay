/*
 * Copyright (c) 2026 Nordic Semiconductor ASA
 *
 * SPDX-License-Identifier: LicenseRef-Nordic-5-Clause
 */

&led0 {
	gpios = <&gpio0 4 GPIO_ACTIVE_HIGH>;
};

&uart20 {
	zephyr,pm-device-runtime-auto;
	disable-rx;
};
