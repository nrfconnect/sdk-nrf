/*
 * Copyright (c) 2026 Nordic Semiconductor ASA
 *
 * SPDX-License-Identifier: LicenseRef-Nordic-5-Clause
 */

/ {
	aliases {
		ppk-sync = &led0;
		/delete-property/ led1;
	};
};

/delete-node/ &led1;

sample_counter: &timer20 {
	status = "okay";
};
