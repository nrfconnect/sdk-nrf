/*
 * Copyright (c) 2026 Nordic Semiconductor ASA
 *
 * SPDX-License-Identifier: LicenseRef-Nordic-5-Clause
 */

#define SP_RAM_REG_ADDR 0x2003c000
#define SP_RAM_UNIT_ADDR 2003c000

#include "nrf54l_sqspi.dtsi"

/ {
	aliases {
		dut-flash = &mx25r64;
	};
};

tst_timer: &timer22 {
	status = "okay";
};
