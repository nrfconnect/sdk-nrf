/*
 * Copyright (c) 2025 Nordic Semiconductor ASA
 *
 * SPDX-License-Identifier: LicenseRef-Nordic-5-Clause
 */

/ {
	aliases {
		led = &button3;
	};
};

&button3 {
	/* Logic is inverted to adapt to measurement methods */
	gpios = <&gpio0 4 GPIO_ACTIVE_HIGH>;
};
