/*
 * Copyright (c) 2025 Nordic Semiconductor ASA
 *
 * SPDX-License-Identifier: LicenseRef-Nordic-5-Clause
 */

/ {
	aliases {
		led = &led0;
	};
};

&led0 {
	/* Logic is inverted to adapt to measurement methods */
	gpios = <&gpio0 28 GPIO_ACTIVE_HIGH>;
};
