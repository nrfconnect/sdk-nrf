## tests/benchmarks/multicore/stm_stress/Kconfig.sysbuild
```kconfig
#
# Copyright (c) 2026 Nordic Semiconductor ASA
#
# SPDX-License-Identifier: LicenseRef-Nordic-5-Clause
#

choice NETCORE

config NETCORE_TESTAPP
	bool "testapp image"

endchoice

if !NETCORE_NONE

config NETCORE_IMAGE_NAME
	default "testapp_cpunet" if NETCORE_TESTAPP

config NETCORE_IMAGE_PATH
	default "${ZEPHYR_NRF_MODULE_DIR}/tests/benchmarks/multicore/stm_stress/testapp" if NETCORE_TESTAPP

endif # !NETCORE_NONE

config PPRCORE_REMOTE_BOARD_TARGET_CPUCLUSTER
	string
	default "cpuppr/xip"

choice PPRCORE

config PPRCORE_TESTAPP
	bool "testapp image"

endchoice

if !PPRCORE_NONE

config PPRCORE_IMAGE_NAME
	default "testapp_cpuppr" if PPRCORE_TESTAPP

config PPRCORE_IMAGE_PATH
	default "${ZEPHYR_NRF_MODULE_DIR}/tests/benchmarks/multicore/stm_stress/testapp" if PPRCORE_TESTAPP

endif # !PPRCORE_NONE

choice FLPRCORE

config FLPRCORE_TESTAPP
	bool "testapp image"

endchoice

if !FLPRCORE_NONE

config FLPRCORE_IMAGE_NAME
	default "testapp_cpuflpr" if FLPRCORE_TESTAPP

config FLPRCORE_IMAGE_PATH
	default "${ZEPHYR_NRF_MODULE_DIR}/tests/benchmarks/multicore/stm_stress/testapp" if FLPRCORE_TESTAPP

endif # !FLPRCORE_NONE

source "share/sysbuild/Kconfig"
```

## tests/benchmarks/multicore/stm_stress/testcase.yaml
```yaml
tests:
  benchmarks.stm_stress.all_cores:
    tags:
      - coresight_stm
      - ci_tests_benchmarks_multicore
    sysbuild: true
    platform_allow:
      - nrf54h20dk/nrf54h20/cpuapp
    integration_platforms:
      - nrf54h20dk/nrf54h20/cpuapp
    required_snippets:
      - nordic-log-stm
    extra_args:
      - SB_CONFIG_NETCORE_TESTAPP=y
      - SB_CONFIG_PPRCORE_TESTAPP=y
      - SB_CONFIG_FLPRCORE_TESTAPP=y
    harness: console
    harness_config:
      type: multi_line
      ordered: false
      regex:
        - ".*CoreSight STM initialized"
        - ".*Stm stress test: 65534"
```

## tests/benchmarks/peripheral_load/Kconfig
```kconfig
source "${ZEPHYR_BASE}/samples/subsys/usb/common/Kconfig.sample_usbd"

source "Kconfig.zephyr"
```

## tests/benchmarks/peripheral_load/sample.yaml
```yaml
sample:
  name: Peripheral stress test

common:
  depends_on:
    - adc
    - gpio
    - i2c
    - spi
    - watchdog
  tags:
    - drivers
    - spi
    - sensors
    - ci_tests_benchmarks_peripheral_load
  harness: console

tests:
  sample.benchmarks.peripheral_stress_test.nrf54h:
    filter: not CONFIG_COVERAGE
    harness_config:
      fixture: pca63566
      type: multi_line
      ordered: false
      regex:
        - ".*Accelerometer thread has completed"
        - ".*ADC thread has completed"
        - ".*BME680 thread has completed"
        - ".*CAN thread has completed"
        - ".*Counter thread has completed"
        - ".*Flash thread has completed"
        - ".*GPIO thread has completed"
        - ".*I2S thread has completed"
        - ".*PWM thread has completed"
        - ".*TEMP thread has completed"
        - ".*Timer thread has completed"
        - ".*WDT thread has completed"
        - ".*CPU load thread has completed"
        - ".*Clock thread has completed"
        - ".*usb_thread: Baudrate 9600"
        - ".*Bluetooth init OK"
        - ".*all \\d{1,} threads have completed"
    extra_args:
      - SHIELD=pca63566
      - SB_CONFIG_NETCORE_IPC_RADIO=y
      - SB_CONFIG_NETCORE_IPC_RADIO_BT_HCI_IPC=y
    platform_allow: nrf54h20dk/nrf54h20/cpuapp
    integration_platforms:
      - nrf54h20dk/nrf54h20/cpuapp

  sample.benchmarks.peripheral_stress_test.nrf54h.pm:
    filter: not CONFIG_COVERAGE
    harness_config:
      fixture: pca63566
      type: multi_line
      ordered: false
      regex:
        - ".*Accelerometer thread has completed"
        - ".*ADC thread has completed"
        - ".*BME680 thread has completed"
        - ".*CAN thread has completed"
        - ".*Counter thread has completed"
        - ".*Flash thread has completed"
        - ".*GPIO thread has completed"
        - ".*I2S thread has completed"
        - ".*PWM thread has completed"
        - ".*TEMP thread has completed"
        - ".*Timer thread has completed"
        - ".*WDT thread has completed"
        - ".*CPU load thread has completed"
        - ".*Clock thread has completed"
        - ".*usb_thread: Baudrate 9600"
        - ".*Bluetooth init OK"
        - ".*all \\d{1,} threads have completed"
    extra_args:
      - SHIELD=pca63566
      - SB_CONFIG_NETCORE_IPC_RADIO=y
      - SB_CONFIG_NETCORE_IPC_RADIO_BT_HCI_IPC=y
      - EXTRA_CONF_FILE=power_management.conf
    platform_allow: nrf54h20dk/nrf54h20/cpuapp
    integration_platforms:
      - nrf54h20dk/nrf54h20/cpuapp

  sample.benchmarks.peripheral_stress_test.nrf54l15:
    filter: not CONFIG_COVERAGE
    harness_config:
      fixture: pca63565
      type: multi_line
      ordered: false
      regex:
        - ".*Accelerometer thread has completed"
        - ".*ADC thread has completed"
        - ".*BME680 thread has completed"
        - ".*Counter thread has completed"
        - ".*Flash thread has completed"
        - ".*GPIO thread has completed"
        - ".*I2S thread has completed"
        - ".*PWM thread has completed"
        - ".*TEMP thread has completed"
        - ".*Timer thread has completed"
        - ".*WDT thread has completed"
        - ".*CPU load thread has completed"
        - ".*Bluetooth init OK"
        - ".*all \\d{1,} threads have completed"
    extra_args:
      - SHIELD=pca63565
      - CONFIG_CAN=n
    platform_allow: nrf54l15dk/nrf54l15/cpuapp
    integration_platforms:
      - nrf54l15dk/nrf54l15/cpuapp

  sample.benchmarks.peripheral_stress_test.nrf54lm20:
    filter: not CONFIG_COVERAGE
    harness_config:
      fixture: pca63565
      type: multi_line
      ordered: false
      regex:
        - ".*Accelerometer thread has completed"
        - ".*ADC thread has completed"
        - ".*BME680 thread has completed"
        - ".*Counter thread has completed"
        - ".*Flash thread has completed"
        - ".*GPIO thread has completed"
        - ".*I2S thread has completed"
        - ".*PWM thread has completed"
        - ".*TEMP thread has completed"
        - ".*Timer thread has completed"
        - ".*WDT thread has completed"
        - ".*CPU load thread has completed"
        - ".*usb_thread: Baudrate 9600"
        - ".*Bluetooth init OK"
        - ".*all \\d{1,} threads have completed"
    extra_args:
      - SHIELD=pca63565
      - CONFIG_CAN=n
    platform_allow:
      - nrf54lm20dk/nrf54lm20a/cpuapp
    integration_platforms:
      - nrf54lm20dk/nrf54lm20a/cpuapp

  sample.benchmarks.peripheral_stress_test.nrf54ls05:
    filter: not CONFIG_COVERAGE
    harness_config:
      type: multi_line
      ordered: false
      regex:
        - ".*ADC thread has completed"
        - ".*Counter thread has completed"
        - ".*GPIO thread has completed"
        - ".*PWM thread has completed"
        - ".*TEMP thread has completed"
        - ".*Timer thread has completed"
        - ".*WDT thread has completed"
        - ".*CPU load thread has completed"
        - ".*all \\d{1,} threads have completed"
    extra_args:
      - CONFIG_CAN=n
      - CONFIG_FLASH=n
      - CONFIG_I2S=n
      - CONFIG_BT=n
    platform_allow:
      - nrf54ls05dk/nrf54ls05b/cpuapp
    integration_platforms:
      - nrf54ls05dk/nrf54ls05b/cpuapp

  sample.benchmarks.peripheral_stress_test.nrf54lv10:
    filter: not CONFIG_COVERAGE
    harness_config:
      type: multi_line
      ordered: false
      regex:
        - ".*ADC thread has completed"
        - ".*Counter thread has completed"
        - ".*GPIO thread has completed"
        - ".*TEMP thread has completed"
        - ".*Timer thread has completed"
        - ".*WDT thread has completed"
        - ".*CPU load thread has completed"
        - ".*Bluetooth init OK"
        - ".*all \\d{1,} threads have completed"
    extra_args:
      - CONFIG_CAN=n
      - CONFIG_FLASH=n
      - CONFIG_I2S=n
      - CONFIG_PWM=n
    platform_allow:
      - nrf54lv10dk/nrf54lv10a/cpuapp
    integration_platforms:
      - nrf54lv10dk/nrf54lv10a/cpuapp
```

## tests/benchmarks/pm_states/Kconfig.sysbuild
```kconfig
#
# Copyright (c) 2025 Nordic Semiconductor ASA
#
# SPDX-License-Identifier: LicenseRef-Nordic-5-Clause
#

config NRF_DEFAULT_EMPTY
	default y

source "$(ZEPHYR_BASE)/share/sysbuild/Kconfig"
```

## tests/benchmarks/pm_states/testcase.yaml
```yaml
tests:
  benchmarks.pm_states:
    sysbuild: true
    platform_allow:
      - nrf54h20dk/nrf54h20/cpuapp
    integration_platforms:
      - nrf54h20dk/nrf54h20/cpuapp
    harness: pytest
    harness_config:
      pytest_root:
        - "${CUSTOM_ROOT_TEST_DIR}/test_measure_power_consumption.py::test_measure_and_data_dump_pm_states"
    tags:
      - ci_tests_benchmarks_current_consumption
      - ppk_power_measure
```

## tests/benchmarks/power_consumption/adc/Kconfig
```kconfig
#
# Copyright (c) 20245 Nordic Semiconductor ASA
#
# SPDX-License-Identifier: LicenseRef-Nordic-5-Clause
#


choice LOCAL_DOMAIN_CLOCK_FREQUENCY_OPTION
	prompt "Local domain clock frequency"
	default LOCAL_DOMAIN_CLOCK_FREQUENCY_OPTION_320MHZ

config LOCAL_DOMAIN_CLOCK_FREQUENCY_OPTION_320MHZ
	bool "320MHz"

config LOCAL_DOMAIN_CLOCK_FREQUENCY_OPTION_128MHZ
	bool "128MHz"

config LOCAL_DOMAIN_CLOCK_FREQUENCY_OPTION_64MHZ
	bool "64MHz"

endchoice

config LOCAL_DOMAIN_CLOCK_FREQUENCY_MHZ
	int
	default 320 if LOCAL_DOMAIN_CLOCK_FREQUENCY_OPTION_320MHZ
	default 128 if LOCAL_DOMAIN_CLOCK_FREQUENCY_OPTION_128MHZ
	default 64 if LOCAL_DOMAIN_CLOCK_FREQUENCY_OPTION_64MHZ

source "Kconfig.zephyr"
```

## tests/benchmarks/power_consumption/adc/testcase.yaml
```yaml
common:
  tags:
    - ppk_power_measure
    - ci_tests_benchmarks_current_consumption
  harness: pytest
  harness_config:
    fixture: ppk_power_measure
    pytest_root:
      - "${CUSTOM_ROOT_TEST_DIR}/test_measure_power_consumption.py::test_thread_suspend_resume_adc"

tests:
  benchmarks.power_consumption.adc:
    integration_platforms:
      - nrf54h20dk/nrf54h20/cpuapp
    platform_allow: &pm_adc_platforms
      - nrf52840dk/nrf52840
      - nrf5340dk/nrf5340/cpuapp
      - nrf54l15dk/nrf54l15/cpuapp
      - nrf54lm20dk/nrf54lm20a/cpuapp
      - nrf54lv10dk/nrf54lv10a/cpuapp
      - nrf54h20dk/nrf54h20/cpuapp
      - nrf54h20dk/nrf54h20/cpuppr

  benchmarks.power_consumption.adc_async:
    integration_platforms:
      - nrf54h20dk/nrf54h20/cpuapp
    platform_allow: *pm_adc_platforms
    extra_configs:
      - CONFIG_ADC_ASYNC=y

  benchmarks.power_consumption.adc.nrf54l_lfrc:
    integration_platforms:
      - nrf54l15dk/nrf54l15/cpuapp
    platform_allow:
      - nrf54l15dk/nrf54l15/cpuapp
      - nrf54lm20dk/nrf54lm20a/cpuapp
      - nrf54lv10dk/nrf54lv10a/cpuapp
    extra_configs:
      - CONFIG_CLOCK_CONTROL_NRF_K32SRC_RC=y
```

## tests/benchmarks/power_consumption/flash/testcase.yaml
```yaml
common:
  tags:
    - ppk_power_measure
    - ci_tests_benchmarks_current_consumption
  harness: pytest
  harness_config:
    fixture: ppk_power_measure
    pytest_root:
      - "${CUSTOM_ROOT_TEST_DIR}/test_measure_power_consumption.py::test_thread_suspend_resume_flash"

tests:
  benchmarks.power_consumption.flash:
    integration_platforms:
      - nrf54h20dk/nrf54h20/cpuapp
    platform_allow:
      - nrf52840dk/nrf52840
      - nrf5340dk/nrf5340/cpuapp
      - nrf54l15dk/nrf54l15/cpuapp
      - nrf54lm20dk/nrf54lm20a/cpuapp
      - nrf54h20dk/nrf54h20/cpuapp

  benchmarks.power_consumption.flash.nrf54l_lfrc:
    integration_platforms:
      - nrf54l15dk/nrf54l15/cpuapp
    platform_allow:
      - nrf54l15dk/nrf54l15/cpuapp
      - nrf54lm20dk/nrf54lm20a/cpuapp
    extra_configs:
      - CONFIG_CLOCK_CONTROL_NRF_K32SRC_RC=y

  benchmarks.power_consumption.flash.hpf_mspi:
    sysbuild: true
    integration_platforms:
      - nrf54l15dk/nrf54l15/cpuapp
    platform_allow:
      - nrf54l15dk/nrf54l15/cpuapp
    extra_args:
      - SB_CONFIG_VPR_LAUNCHER=n
      - SB_CONFIG_PARTITION_MANAGER=n
      - SB_CONFIG_HPF=y
      - SB_CONFIG_HPF_MSPI=y
```
