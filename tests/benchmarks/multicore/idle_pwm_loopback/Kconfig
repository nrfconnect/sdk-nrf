## tests/benchmarks/multicore/idle_spim_loopback/testcase.yaml
```yaml
common:
  sysbuild: true
  tags:
    - ci_build
    - ci_tests_benchmarks_multicore
    - spim

tests:

  #
  # 4 Bytes of data
  #

  benchmarks.multicore.idle_spim_loopback.4_bytes.no_sleep:
    filter: not CONFIG_COVERAGE
    extra_args:
      - idle_spim_loopback_EXTRA_CONF_FILE=enable_logs.conf
    harness: console
    harness_config:
      fixture: spi_loopback
      type: multi_line
      ordered: true
      regex:
        - "Multicore idle_spi_loopback test on"
        - "4 bytes of data exchanged at once"
        - ".*Run 0 - PASS"
        - ".*Run 1 - PASS"
    platform_allow:
      - nrf54h20dk/nrf54h20/cpuapp
    integration_platforms:
      - nrf54h20dk/nrf54h20/cpuapp

  benchmarks.multicore.idle_spim_loopback.4_bytes.idle_retained:
    filter: not CONFIG_COVERAGE
    tags: ppk_power_measure
    extra_args:
      - idle_spim_loopback_CONFIG_TEST_SLEEP_DURATION_MS=500
      - idle_spim_loopback_EXTRA_DTC_OVERLAY_FILE="${ZEPHYR_NRF_MODULE_DIR}/tests/benchmarks/multicore/common/workaround_idle_retained.overlay"
    harness: pytest
    harness_config:
      fixture: spi_loopback
      pytest_root:
        - "${CUSTOM_ROOT_TEST_DIR}/test_measure_power_consumption.py::test_measure_and_data_dump_spim_and_idle"
    platform_allow:
      - nrf54h20dk/nrf54h20/cpuapp
    integration_platforms:
      - nrf54h20dk/nrf54h20/cpuapp

  benchmarks.multicore.idle_spim_loopback.4_bytes.idle:
    filter: not CONFIG_COVERAGE
    tags: ppk_power_measure
    extra_args:
      - idle_spim_loopback_CONFIG_TEST_SLEEP_DURATION_MS=500
      - idle_spim_loopback_EXTRA_DTC_OVERLAY_FILE="${ZEPHYR_NRF_MODULE_DIR}/tests/benchmarks/multicore/common/workaround_idle.overlay"
    harness: pytest
    harness_config:
      fixture: spi_loopback
      pytest_root:
        - "${CUSTOM_ROOT_TEST_DIR}/test_measure_power_consumption.py::test_measure_and_data_dump_spim_and_idle"
    platform_allow:
      - nrf54h20dk/nrf54h20/cpuapp
    integration_platforms:
      - nrf54h20dk/nrf54h20/cpuapp

  benchmarks.multicore.idle_spim_loopback.4_bytes.s2ram:
    filter: not CONFIG_COVERAGE
    tags: ppk_power_measure
    harness: pytest
    harness_config:
      fixture: spi_loopback
      pytest_root:
        - "${CUSTOM_ROOT_TEST_DIR}/test_measure_power_consumption.py::test_measure_and_data_dump_spim_and_s2ram"
    platform_allow:
      - nrf54h20dk/nrf54h20/cpuapp
    integration_platforms:
      - nrf54h20dk/nrf54h20/cpuapp

  benchmarks.multicore.idle_spim_loopback.4_bytes.s2ram.cpuppr:
    filter: not CONFIG_COVERAGE
    tags: ppk_power_measure
    harness: pytest
    harness_config:
      fixture: spi_loopback
      pytest_root:
        - "${CUSTOM_ROOT_TEST_DIR}/test_measure_power_consumption.py::test_measure_and_data_dump_spim_and_s2ram_ppr"
    platform_allow:
      - nrf54h20dk/nrf54h20/cpuppr
    integration_platforms:
      - nrf54h20dk/nrf54h20/cpuppr

  benchmarks.multicore.idle_spim_loopback.4_bytes.no_sleep_fast:
    filter: not CONFIG_COVERAGE
    extra_args:
      - idle_spim_loopback_DTC_OVERLAY_FILE="boards/nrf54h20dk_nrf54h20_cpuapp_fast.overlay"
      - idle_spim_loopback_EXTRA_CONF_FILE=enable_logs.conf
    harness: console
    harness_config:
      fixture: spi_loopback
      type: multi_line
      ordered: true
      regex:
        - "Multicore idle_spi_loopback test on"
        - "4 bytes of data exchanged at once"
        - ".*Run 0 - PASS"
        - ".*Run 1 - PASS"
    platform_allow:
      - nrf54h20dk/nrf54h20/cpuapp
    integration_platforms:
      - nrf54h20dk/nrf54h20/cpuapp

  benchmarks.multicore.idle_spim_loopback.4_bytes.idle_retained_fast:
    filter: not CONFIG_COVERAGE
    tags: ppk_power_measure
    extra_args:
      - idle_spim_loopback_CONFIG_TEST_SLEEP_DURATION_MS=500
      - idle_spim_loopback_DTC_OVERLAY_FILE="boards/nrf54h20dk_nrf54h20_cpuapp_fast.overlay"
      - idle_spim_loopback_EXTRA_DTC_OVERLAY_FILE="${ZEPHYR_NRF_MODULE_DIR}/tests/benchmarks/multicore/common/workaround_idle_retained.overlay"
    harness: pytest
    harness_config:
      fixture: spi_loopback
      pytest_root:
        - "${CUSTOM_ROOT_TEST_DIR}/test_measure_power_consumption.py::test_measure_and_data_dump_spim_and_idle"
    platform_allow:
      - nrf54h20dk/nrf54h20/cpuapp
    integration_platforms:
      - nrf54h20dk/nrf54h20/cpuapp

  benchmarks.multicore.idle_spim_loopback.4_bytes.idle_fast:
    filter: not CONFIG_COVERAGE
    tags: ppk_power_measure
    extra_args:
      - idle_spim_loopback_CONFIG_TEST_SLEEP_DURATION_MS=500
      - idle_spim_loopback_DTC_OVERLAY_FILE="boards/nrf54h20dk_nrf54h20_cpuapp_fast.overlay"
      - idle_spim_loopback_EXTRA_DTC_OVERLAY_FILE="${ZEPHYR_NRF_MODULE_DIR}/tests/benchmarks/multicore/common/workaround_idle.overlay"
    harness: pytest
    harness_config:
      fixture: spi_loopback
      pytest_root:
        - "${CUSTOM_ROOT_TEST_DIR}/test_measure_power_consumption.py::test_measure_and_data_dump_spim_and_idle"
    platform_allow:
      - nrf54h20dk/nrf54h20/cpuapp
    integration_platforms:
      - nrf54h20dk/nrf54h20/cpuapp

  benchmarks.multicore.idle_spim_loopback.4_bytes.idle_fast_slow_pins:
    filter: not CONFIG_COVERAGE
    tags: ppk_power_measure
    extra_args:
      - idle_spim_loopback_CONFIG_TEST_SLEEP_DURATION_MS=500
      - idle_spim_loopback_DTC_OVERLAY_FILE="boards/nrf54h20dk_nrf54h20_cpuapp_fast_slow_pins.overlay"
      - idle_spim_loopback_EXTRA_DTC_OVERLAY_FILE="${ZEPHYR_NRF_MODULE_DIR}/tests/benchmarks/multicore/common/workaround_idle.overlay"
    harness: pytest
    harness_config:
      fixture: spi_loopback
      pytest_root:
        - "${CUSTOM_ROOT_TEST_DIR}/test_measure_power_consumption.py::test_measure_and_data_dump_spim_and_idle"
    build_only: true
    platform_allow:
      - nrf54h20dk/nrf54h20/cpuapp
    integration_platforms:
      - nrf54h20dk/nrf54h20/cpuapp

  benchmarks.multicore.idle_spim_loopback.4_bytes.s2ram_fast:
    filter: not CONFIG_COVERAGE
    tags: ppk_power_measure
    extra_args:
      - idle_spim_loopback_DTC_OVERLAY_FILE="boards/nrf54h20dk_nrf54h20_cpuapp_fast.overlay"
    harness: pytest
    harness_config:
      fixture: spi_loopback
      pytest_root:
        - "${CUSTOM_ROOT_TEST_DIR}/test_measure_power_consumption.py::test_measure_and_data_dump_spim_and_s2ram"
    platform_allow:
      - nrf54h20dk/nrf54h20/cpuapp
    integration_platforms:
      - nrf54h20dk/nrf54h20/cpuapp

  #
  # 16 Bytes of data
  #

  benchmarks.multicore.idle_spim_loopback.16_bytes.no_sleep:
    filter: not CONFIG_COVERAGE
    extra_args:
      - idle_spim_loopback_EXTRA_CONF_FILE=enable_logs.conf
      - idle_spim_loopback_CONFIG_DATA_FIELD=16
    harness: console
    harness_config:
      fixture: spi_loopback
      type: multi_line
      ordered: true
      regex:
        - "Multicore idle_spi_loopback test on"
        - "16 bytes of data exchanged at once"
        - ".*Run 0 - PASS"
        - ".*Run 1 - PASS"
    platform_allow:
      - nrf54h20dk/nrf54h20/cpuapp
    integration_platforms:
      - nrf54h20dk/nrf54h20/cpuapp

  benchmarks.multicore.idle_spim_loopback.16_bytes.idle_retained:
    filter: not CONFIG_COVERAGE
    tags: ppk_power_measure
    extra_args:
      - idle_spim_loopback_CONFIG_TEST_SLEEP_DURATION_MS=500
      - idle_spim_loopback_CONFIG_DATA_FIELD=16
      - idle_spim_loopback_EXTRA_DTC_OVERLAY_FILE="${ZEPHYR_NRF_MODULE_DIR}/tests/benchmarks/multicore/common/workaround_idle_retained.overlay"
    harness: pytest
    harness_config:
      fixture: spi_loopback
      pytest_root:
        - "${CUSTOM_ROOT_TEST_DIR}/test_measure_power_consumption.py::test_measure_and_data_dump_spim_and_idle"
    platform_allow:
      - nrf54h20dk/nrf54h20/cpuapp
    integration_platforms:
      - nrf54h20dk/nrf54h20/cpuapp

  benchmarks.multicore.idle_spim_loopback.16_bytes.idle:
    filter: not CONFIG_COVERAGE
    tags: ppk_power_measure
    extra_args:
      - idle_spim_loopback_CONFIG_TEST_SLEEP_DURATION_MS=500
      - idle_spim_loopback_CONFIG_DATA_FIELD=16
      - idle_spim_loopback_EXTRA_DTC_OVERLAY_FILE="${ZEPHYR_NRF_MODULE_DIR}/tests/benchmarks/multicore/common/workaround_idle.overlay"
    harness: pytest
    harness_config:
      fixture: spi_loopback
      pytest_root:
        - "${CUSTOM_ROOT_TEST_DIR}/test_measure_power_consumption.py::test_measure_and_data_dump_spim_and_idle"
    platform_allow:
      - nrf54h20dk/nrf54h20/cpuapp
    integration_platforms:
      - nrf54h20dk/nrf54h20/cpuapp

  benchmarks.multicore.idle_spim_loopback.16_bytes.s2ram:
    filter: not CONFIG_COVERAGE
    tags: ppk_power_measure
    extra_args:
      - idle_spim_loopback_CONFIG_DATA_FIELD=16
    harness: pytest
    harness_config:
      fixture: spi_loopback
      pytest_root:
        - "${CUSTOM_ROOT_TEST_DIR}/test_measure_power_consumption.py::test_measure_and_data_dump_spim_and_s2ram"
    platform_allow:
      - nrf54h20dk/nrf54h20/cpuapp
    integration_platforms:
      - nrf54h20dk/nrf54h20/cpuapp

  benchmarks.multicore.idle_spim_loopback.16_bytes.s2ram.cpuppr:
    filter: not CONFIG_COVERAGE
    tags: ppk_power_measure
    extra_args:
      - idle_spim_loopback_CONFIG_DATA_FIELD=16
    harness: pytest
    harness_config:
      fixture: spi_loopback
      pytest_root:
        - "${CUSTOM_ROOT_TEST_DIR}/test_measure_power_consumption.py::test_measure_and_data_dump_spim_and_s2ram_ppr"
    platform_allow:
      - nrf54h20dk/nrf54h20/cpuppr
    integration_platforms:
      - nrf54h20dk/nrf54h20/cpuppr

  benchmarks.multicore.idle_spim_loopback.16_bytes.no_sleep_fast:
    filter: not CONFIG_COVERAGE
    extra_args:
      - idle_spim_loopback_EXTRA_CONF_FILE=enable_logs.conf
      - idle_spim_loopback_DTC_OVERLAY_FILE="boards/nrf54h20dk_nrf54h20_cpuapp_fast.overlay"
      - idle_spim_loopback_CONFIG_DATA_FIELD=16
    harness: console
    harness_config:
      fixture: spi_loopback
      type: multi_line
      ordered: true
      regex:
        - "Multicore idle_spi_loopback test on"
        - "16 bytes of data exchanged at once"
        - ".*Run 0 - PASS"
        - ".*Run 1 - PASS"
    platform_allow:
      - nrf54h20dk/nrf54h20/cpuapp
    integration_platforms:
      - nrf54h20dk/nrf54h20/cpuapp

  benchmarks.multicore.idle_spim_loopback.16_bytes.idle_retained_fast:
    filter: not CONFIG_COVERAGE
    tags: ppk_power_measure
    extra_args:
      - idle_spim_loopback_CONFIG_TEST_SLEEP_DURATION_MS=500
      - idle_spim_loopback_DTC_OVERLAY_FILE="boards/nrf54h20dk_nrf54h20_cpuapp_fast.overlay"
      - idle_spim_loopback_CONFIG_DATA_FIELD=16
      - idle_spim_loopback_EXTRA_DTC_OVERLAY_FILE="${ZEPHYR_NRF_MODULE_DIR}/tests/benchmarks/multicore/common/workaround_idle_retained.overlay"
    harness: pytest
    harness_config:
      fixture: spi_loopback
      pytest_root:
        - "${CUSTOM_ROOT_TEST_DIR}/test_measure_power_consumption.py::test_measure_and_data_dump_spim_and_idle"
    platform_allow:
      - nrf54h20dk/nrf54h20/cpuapp
    integration_platforms:
      - nrf54h20dk/nrf54h20/cpuapp

  benchmarks.multicore.idle_spim_loopback.16_bytes.idle_fast:
    filter: not CONFIG_COVERAGE
    tags: ppk_power_measure
    extra_args:
      - idle_spim_loopback_CONFIG_TEST_SLEEP_DURATION_MS=500
      - idle_spim_loopback_DTC_OVERLAY_FILE="boards/nrf54h20dk_nrf54h20_cpuapp_fast.overlay"
      - idle_spim_loopback_CONFIG_DATA_FIELD=16
      - idle_spim_loopback_EXTRA_DTC_OVERLAY_FILE="${ZEPHYR_NRF_MODULE_DIR}/tests/benchmarks/multicore/common/workaround_idle.overlay"
    harness: pytest
    harness_config:
      fixture: spi_loopback
      pytest_root:
        - "${CUSTOM_ROOT_TEST_DIR}/test_measure_power_consumption.py::test_measure_and_data_dump_spim_and_idle"
    platform_allow:
      - nrf54h20dk/nrf54h20/cpuapp
    integration_platforms:
      - nrf54h20dk/nrf54h20/cpuapp

  benchmarks.multicore.idle_spim_loopback.16_bytes.s2ram_fast:
    filter: not CONFIG_COVERAGE
    tags: ppk_power_measure
    extra_args:
      - idle_spim_loopback_DTC_OVERLAY_FILE="boards/nrf54h20dk_nrf54h20_cpuapp_fast.overlay"
      - idle_spim_loopback_CONFIG_DATA_FIELD=16
    harness: pytest
    harness_config:
      fixture: spi_loopback
      pytest_root:
        - "${CUSTOM_ROOT_TEST_DIR}/test_measure_power_consumption.py::test_measure_and_data_dump_spim_and_s2ram"
    platform_allow:
      - nrf54h20dk/nrf54h20/cpuapp
    integration_platforms:
      - nrf54h20dk/nrf54h20/cpuapp

  #
  # 4 Bytes of data with SPI Chip Select Lock enabled
  #

  benchmarks.multicore.idle_spim_loopback.4_bytes_cs_lock.s2ram_fast:
    filter: not CONFIG_COVERAGE
    tags: ppk_power_measure
    extra_args:
      - idle_spim_loopback_CONFIG_TEST_SPI_HOLD_ON_CS=y
      - idle_spim_loopback_DTC_OVERLAY_FILE="boards/nrf54h20dk_nrf54h20_cpuapp_fast.overlay"
    harness: pytest
    harness_config:
      fixture: spi_loopback
      pytest_root:
        - "${CUSTOM_ROOT_TEST_DIR}/test_measure_power_consumption.py::test_measure_and_data_dump_spim_and_s2ram"
    platform_allow:
      - nrf54h20dk/nrf54h20/cpuapp
    integration_platforms:
      - nrf54h20dk/nrf54h20/cpuapp

  #
  # 4 Bytes of data with SPI Lock enabled
  #

  benchmarks.multicore.idle_spim_loopback.4_bytes_spi_lock.s2ram_fast:
    filter: not CONFIG_COVERAGE
    tags: ppk_power_measure
    extra_args:
      - idle_spim_loopback_CONFIG_TEST_SPI_LOCK_ON=y
      - idle_spim_loopback_DTC_OVERLAY_FILE="boards/nrf54h20dk_nrf54h20_cpuapp_fast.overlay"
    harness: pytest
    harness_config:
      fixture: spi_loopback
      pytest_root:
        - "${CUSTOM_ROOT_TEST_DIR}/test_measure_power_consumption.py::test_measure_and_data_dump_spim_and_s2ram"
    platform_allow:
      - nrf54h20dk/nrf54h20/cpuapp
    integration_platforms:
      - nrf54h20dk/nrf54h20/cpuapp

  #
  # 4 Bytes of data with SPI Chip Select Lock enabled and SPI Lock enabled
  #

  benchmarks.multicore.idle_spim_loopback.4_bytes_cs_and_spi_lock.no_sleep:
    filter: not CONFIG_COVERAGE
    extra_args:
      - idle_spim_loopback_EXTRA_CONF_FILE=enable_logs.conf
      - idle_spim_loopback_CONFIG_TEST_SPI_HOLD_ON_CS=y
      - idle_spim_loopback_CONFIG_TEST_SPI_LOCK_ON=y
    harness: console
    harness_config:
      fixture: spi_loopback
      type: multi_line
      ordered: true
      regex:
        - "Multicore idle_spi_loopback test on"
        - "4 bytes of data exchanged at once"
        - "SPI CS lock enabled"
        - "SPI LOCK enabled"
        - ".*Run 0 - PASS"
        - ".*Run 1 - PASS"
    platform_allow:
      - nrf54h20dk/nrf54h20/cpuapp
    integration_platforms:
      - nrf54h20dk/nrf54h20/cpuapp

  benchmarks.multicore.idle_spim_loopback.4_bytes_cs_and_spi_lock.idle:
    filter: not CONFIG_COVERAGE
    tags: ppk_power_measure
    extra_args:
      - idle_spim_loopback_CONFIG_TEST_SPI_HOLD_ON_CS=y
      - idle_spim_loopback_CONFIG_TEST_SPI_LOCK_ON=y
      - idle_spim_loopback_CONFIG_TEST_SLEEP_DURATION_MS=500
      - idle_spim_loopback_EXTRA_DTC_OVERLAY_FILE="${ZEPHYR_NRF_MODULE_DIR}/tests/benchmarks/multicore/common/workaround_idle.overlay"
    harness: pytest
    harness_config:
      fixture: spi_loopback
      pytest_root:
        - "${CUSTOM_ROOT_TEST_DIR}/test_measure_power_consumption.py::test_measure_and_data_dump_spim_and_idle"
    platform_allow:
      - nrf54h20dk/nrf54h20/cpuapp
    integration_platforms:
      - nrf54h20dk/nrf54h20/cpuapp

  benchmarks.multicore.idle_spim_loopback.4_bytes_cs_and_spi_lock.s2ram:
    filter: not CONFIG_COVERAGE
    tags: ppk_power_measure
    extra_args:
      - idle_spim_loopback_CONFIG_TEST_SPI_HOLD_ON_CS=y
      - idle_spim_loopback_CONFIG_TEST_SPI_LOCK_ON=y
    harness: pytest
    harness_config:
      fixture: spi_loopback
      pytest_root:
        - "${CUSTOM_ROOT_TEST_DIR}/test_measure_power_consumption.py::test_measure_and_data_dump_spim_and_s2ram"
    platform_allow:
      - nrf54h20dk/nrf54h20/cpuapp
    integration_platforms:
      - nrf54h20dk/nrf54h20/cpuapp

  benchmarks.multicore.idle_spim_loopback.4_bytes_cs_and_spi_lock.no_sleep_fast:
    filter: not CONFIG_COVERAGE
    extra_args:
      - idle_spim_loopback_EXTRA_CONF_FILE=enable_logs.conf
      - idle_spim_loopback_CONFIG_TEST_SPI_HOLD_ON_CS=y
      - idle_spim_loopback_CONFIG_TEST_SPI_LOCK_ON=y
      - idle_spim_loopback_DTC_OVERLAY_FILE="boards/nrf54h20dk_nrf54h20_cpuapp_fast.overlay"
    harness: console
    harness_config:
      fixture: spi_loopback
      type: multi_line
      ordered: true
      regex:
        - "Multicore idle_spi_loopback test on"
        - "4 bytes of data exchanged at once"
        - "SPI CS lock enabled"
        - "SPI LOCK enabled"
        - ".*Run 0 - PASS"
        - ".*Run 1 - PASS"
    platform_allow:
      - nrf54h20dk/nrf54h20/cpuapp
    integration_platforms:
      - nrf54h20dk/nrf54h20/cpuapp

  benchmarks.multicore.idle_spim_loopback.4_bytes_cs_and_spi_lock.idle_fast:
    filter: not CONFIG_COVERAGE
    tags: ppk_power_measure
    extra_args:
      - idle_spim_loopback_CONFIG_TEST_SPI_HOLD_ON_CS=y
      - idle_spim_loopback_CONFIG_TEST_SPI_LOCK_ON=y
      - idle_spim_loopback_CONFIG_TEST_SLEEP_DURATION_MS=500
      - idle_spim_loopback_DTC_OVERLAY_FILE="boards/nrf54h20dk_nrf54h20_cpuapp_fast.overlay"
      - idle_spim_loopback_EXTRA_DTC_OVERLAY_FILE="${ZEPHYR_NRF_MODULE_DIR}/tests/benchmarks/multicore/common/workaround_idle.overlay"
    harness: pytest
    harness_config:
      fixture: spi_loopback
      pytest_root:
        - "${CUSTOM_ROOT_TEST_DIR}/test_measure_power_consumption.py::test_measure_and_data_dump_spim_and_idle"
    platform_allow:
      - nrf54h20dk/nrf54h20/cpuapp
    integration_platforms:
      - nrf54h20dk/nrf54h20/cpuapp

  benchmarks.multicore.idle_spim_loopback.4_bytes_cs_and_spi_lock.s2ram_fast:
    filter: not CONFIG_COVERAGE
    tags: ppk_power_measure
    extra_args:
      - idle_spim_loopback_CONFIG_TEST_SPI_HOLD_ON_CS=y
      - idle_spim_loopback_CONFIG_TEST_SPI_LOCK_ON=y
      - idle_spim_loopback_DTC_OVERLAY_FILE="boards/nrf54h20dk_nrf54h20_cpuapp_fast.overlay"
    harness: pytest
    harness_config:
      fixture: spi_loopback
      pytest_root:
        - "${CUSTOM_ROOT_TEST_DIR}/test_measure_power_consumption.py::test_measure_and_data_dump_spim_and_s2ram"
    platform_allow:
      - nrf54h20dk/nrf54h20/cpuapp
    integration_platforms:
      - nrf54h20dk/nrf54h20/cpuapp

  #
  # 4 Bytes of data with SPI Chip Select Lock enabled and SPI Lock
  # No SPI release
  #

  benchmarks.multicore.idle_spim_loopback.4_bytes_cs_and_spi_lock_no_release.no_sleep:
    filter: not CONFIG_COVERAGE
    extra_args:
      - idle_spim_loopback_EXTRA_CONF_FILE=enable_logs.conf
      - idle_spim_loopback_CONFIG_TEST_SPI_HOLD_ON_CS=y
      - idle_spim_loopback_CONFIG_TEST_SPI_LOCK_ON=y
      - idle_spim_loopback_CONFIG_TEST_SPI_RELEASE_BEFORE_SLEEP=n
    harness: console
    harness_config:
      fixture: spi_loopback
      type: multi_line
      ordered: true
      regex:
        - "Multicore idle_spi_loopback test on"
        - "4 bytes of data exchanged at once"
        - "SPI CS lock enabled"
        - "SPI LOCK enabled"
        - "SPI is never released"
        - ".*Run 0 - PASS"
        - ".*Run 1 - PASS"
    platform_allow:
      - nrf54h20dk/nrf54h20/cpuapp
    integration_platforms:
      - nrf54h20dk/nrf54h20/cpuapp

  benchmarks.multicore.idle_spim_loopback.4_bytes_cs_and_spi_lock_no_release.idle:
    filter: not CONFIG_COVERAGE
    tags: ppk_power_measure
    extra_args:
      - idle_spim_loopback_CONFIG_TEST_SPI_HOLD_ON_CS=y
      - idle_spim_loopback_CONFIG_TEST_SPI_LOCK_ON=y
      - idle_spim_loopback_CONFIG_TEST_SPI_RELEASE_BEFORE_SLEEP=n
      - idle_spim_loopback_CONFIG_TEST_SLEEP_DURATION_MS=500
      - idle_spim_loopback_EXTRA_DTC_OVERLAY_FILE="${ZEPHYR_NRF_MODULE_DIR}/tests/benchmarks/multicore/common/workaround_idle.overlay"
    harness: pytest
    harness_config:
      fixture: spi_loopback
      pytest_root:
        - "${CUSTOM_ROOT_TEST_DIR}/test_measure_power_consumption.py::test_measure_and_data_dump_spim_and_idle"
    platform_allow:
      - nrf54h20dk/nrf54h20/cpuapp
    integration_platforms:
      - nrf54h20dk/nrf54h20/cpuapp

  benchmarks.multicore.idle_spim_loopback.4_bytes_cs_and_spi_lock_no_release.s2ram:
    filter: not CONFIG_COVERAGE
    tags: ppk_power_measure
    extra_args:
      - idle_spim_loopback_CONFIG_TEST_SPI_HOLD_ON_CS=y
      - idle_spim_loopback_CONFIG_TEST_SPI_LOCK_ON=y
      - idle_spim_loopback_CONFIG_TEST_SPI_RELEASE_BEFORE_SLEEP=n
    harness: pytest
    harness_config:
      fixture: spi_loopback
      pytest_root:
        - "${CUSTOM_ROOT_TEST_DIR}/test_measure_power_consumption.py::test_measure_and_data_dump_spim_and_s2ram"
    platform_allow:
      - nrf54h20dk/nrf54h20/cpuapp
    integration_platforms:
      - nrf54h20dk/nrf54h20/cpuapp

  benchmarks.multicore.idle_spim_loopback.4_bytes_cs_and_spi_lock_no_release.no_sleep_fast:
    filter: not CONFIG_COVERAGE
    extra_args:
      - idle_spim_loopback_EXTRA_CONF_FILE=enable_logs.conf
      - idle_spim_loopback_CONFIG_TEST_SPI_HOLD_ON_CS=y
      - idle_spim_loopback_CONFIG_TEST_SPI_LOCK_ON=y
      - idle_spim_loopback_CONFIG_TEST_SPI_RELEASE_BEFORE_SLEEP=n
      - idle_spim_loopback_DTC_OVERLAY_FILE="boards/nrf54h20dk_nrf54h20_cpuapp_fast.overlay"
    harness: console
    harness_config:
      fixture: spi_loopback
      type: multi_line
      ordered: true
      regex:
        - "Multicore idle_spi_loopback test on"
        - "4 bytes of data exchanged at once"
        - "SPI CS lock enabled"
        - "SPI LOCK enabled"
        - "SPI is never released"
        - ".*Run 0 - PASS"
        - ".*Run 1 - PASS"
    platform_allow:
      - nrf54h20dk/nrf54h20/cpuapp
    integration_platforms:
      - nrf54h20dk/nrf54h20/cpuapp

  benchmarks.multicore.idle_spim_loopback.4_bytes_cs_and_spi_lock_no_release.idle_fast:
    filter: not CONFIG_COVERAGE
    tags: ppk_power_measure
    extra_args:
      - idle_spim_loopback_CONFIG_TEST_SPI_HOLD_ON_CS=y
      - idle_spim_loopback_CONFIG_TEST_SPI_LOCK_ON=y
      - idle_spim_loopback_CONFIG_TEST_SPI_RELEASE_BEFORE_SLEEP=n
      - idle_spim_loopback_CONFIG_TEST_SLEEP_DURATION_MS=500
      - idle_spim_loopback_DTC_OVERLAY_FILE="boards/nrf54h20dk_nrf54h20_cpuapp_fast.overlay"
      - idle_spim_loopback_EXTRA_DTC_OVERLAY_FILE="${ZEPHYR_NRF_MODULE_DIR}/tests/benchmarks/multicore/common/workaround_idle.overlay"
    harness: pytest
    harness_config:
      fixture: spi_loopback
      pytest_root:
        - "${CUSTOM_ROOT_TEST_DIR}/test_measure_power_consumption.py::test_measure_and_data_dump_spim_and_idle"
    platform_allow:
      - nrf54h20dk/nrf54h20/cpuapp
    integration_platforms:
      - nrf54h20dk/nrf54h20/cpuapp

  benchmarks.multicore.idle_spim_loopback.4_bytes_cs_and_spi_lock_no_release.s2ram_fast:
    filter: not CONFIG_COVERAGE
    tags: ppk_power_measure
    extra_args:
      - idle_spim_loopback_CONFIG_TEST_SPI_HOLD_ON_CS=y
      - idle_spim_loopback_CONFIG_TEST_SPI_LOCK_ON=y
      - idle_spim_loopback_CONFIG_TEST_SPI_RELEASE_BEFORE_SLEEP=n
      - idle_spim_loopback_DTC_OVERLAY_FILE="boards/nrf54h20dk_nrf54h20_cpuapp_fast.overlay"
    harness: pytest
    harness_config:
      fixture: spi_loopback
      pytest_root:
        - "${CUSTOM_ROOT_TEST_DIR}/test_measure_power_consumption.py::test_measure_and_data_dump_spim_and_s2ram"
    platform_allow:
      - nrf54h20dk/nrf54h20/cpuapp
    integration_platforms:
      - nrf54h20dk/nrf54h20/cpuapp

  benchmarks.multicore.idle_spim_loopback.coverage:
    filter: CONFIG_COVERAGE
    extra_args:
      - SHIELD=coverage_support
      - CONF_FILE=coverage.conf
      - EXTRA_DTC_OVERLAY_FILE="disable_s2ram.overlay"
    harness: console
    harness_config:
      fixture: spi_loopback
      type: multi_line
      ordered: true
      regex:
        - ".*Coverage analysis enabled.*"
        - ".*Coverage analysis start.*"
    platform_allow:
      - nrf54h20dk/nrf54h20/cpuapp
    integration_platforms:
      - nrf54h20dk/nrf54h20/cpuapp
```
