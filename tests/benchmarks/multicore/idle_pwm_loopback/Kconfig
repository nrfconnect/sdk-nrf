## tests/benchmarks/multicore/idle_stm/testcase.yaml
```yaml
common:
  sysbuild: true
  tags:
    - ci_build
    - ci_tests_benchmarks_multicore
  required_snippets:
    - nordic-log-stm
  platform_allow:
    - nrf54h20dk/nrf54h20/cpuapp
  integration_platforms:
    - nrf54h20dk/nrf54h20/cpuapp
  extra_args:
    - CONFIG_SOC_NRF54H20_CPURAD_ENABLE=y

tests:
  benchmarks.multicore.idle_stm.nrf54h20dk_cpuapp_cpurad_cpuppr.no_sleep:
    harness: console
    harness_config:
      type: multi_line
      ordered: false
      regex:
        - "Main sleeps for 1000 ms"
        - "Multicore idle_stm test on"
        - "app/idle_stm: Run 0"
        - "rad/idle_stm: Run 0"
        - "ppr/idle_stm: Run 0"
        - "app/idle_stm: Run 1"
        - "rad/idle_stm: Run 1"
        - "ppr/idle_stm: Run 1"
        - "app/idle_stm: Run 2"
        - "rad/idle_stm: Run 2"
        - "ppr/idle_stm: Run 2"

  benchmarks.multicore.idle_stm.nrf54h20dk_cpuapp_cpurad_cpuppr.idle:
    extra_args:
      - idle_stm_CONF_FILE=prj_s2ram.conf
      - remote_rad_CONF_FILE=prj_s2ram.conf
      - remote_ppr_CONF_FILE=prj_s2ram.conf
      - idle_stm_CONFIG_TEST_SLEEP_DURATION_MS=500
      - remote_rad_CONFIG_TEST_SLEEP_DURATION_MS=500
      - remote_ppr_CONFIG_TEST_SLEEP_DURATION_MS=500
    harness: console
    harness_config:
      type: multi_line
      ordered: false
      regex:
        - "Main sleeps for 500 ms"
        - "Multicore idle_stm test on"
        - "app/idle_stm: Run 0"
        - "rad/idle_stm: Run 0"
        - "ppr/idle_stm: Run 0"
        - "app/idle_stm: Run 1"
        - "rad/idle_stm: Run 1"
        - "ppr/idle_stm: Run 1"
        - "app/idle_stm: Run 2"
        - "rad/idle_stm: Run 2"
        - "ppr/idle_stm: Run 2"
        - "ppr/power_off: Wait Sleep State"

  benchmarks.multicore.idle_stm.nrf54h20dk_cpuapp_cpurad_cpuppr.s2ram:
    extra_args:
      - idle_stm_CONF_FILE=prj_s2ram.conf
      - remote_rad_CONF_FILE=prj_s2ram.conf
      - remote_ppr_CONF_FILE=prj_s2ram.conf
    harness: console
    harness_config:
      type: multi_line
      ordered: false
      regex:
        - "Main sleeps for 1000 ms"
        - "Multicore idle_stm test on"
        - "app/idle_stm: Run 0"
        - "rad/idle_stm: Run 0"
        - "ppr/idle_stm: Run 0"
        - "app/idle_stm: Run 1"
        - "rad/idle_stm: Run 1"
        - "ppr/idle_stm: Run 1"
        - "app/idle_stm: Run 2"
        - "rad/idle_stm: Run 2"
        - "ppr/idle_stm: Run 2"
        - "ppr/power_off: Hibernate Sleep State"
```

## tests/benchmarks/multicore/idle_twim/Kconfig.sysbuild
```kconfig
#
# Copyright (c) 2025 Nordic Semiconductor ASA
#
# SPDX-License-Identifier: LicenseRef-Nordic-5-Clause
#

source "share/sysbuild/Kconfig"

choice NETCORE
	default NETCORE_REMOTE_SLEEP_FOREVER

config NETCORE_REMOTE_SLEEP_FOREVER
	bool "Remote sleep forever image"

endchoice

config NETCORE_IMAGE_NAME
	default "remote_sleep_forever" if NETCORE_REMOTE_SLEEP_FOREVER

config NETCORE_IMAGE_PATH
	default "${ZEPHYR_NRF_MODULE_DIR}/tests/benchmarks/power_consumption/common/remote_sleep_forever" if NETCORE_REMOTE_SLEEP_FOREVER

config SUPPORT_NETCORE
	default y if (SOC_NRF54H20_CPUPPR || SOC_NRF54H20_CPUAPP)

config NETCORE_REMOTE_BOARD_TARGET_CPUCLUSTER
	default "cpurad" if (SOC_NRF54H20_CPUPPR || SOC_NRF54H20_CPUAPP)
```

## tests/benchmarks/multicore/idle_twim/boards/nrf54h20dk_nrf54h20_cpuapp.conf
```kconfig
CONFIG_PM_S2RAM=y
CONFIG_PM_S2RAM_CUSTOM_MARKING=y

CONFIG_SOC_NRF54H20_CPURAD_ENABLE=y
```

## tests/benchmarks/multicore/idle_twim/testcase.yaml
```yaml
common:
  sysbuild: true
  depends_on: i2c
  extra_args:
    - CONFIG_SOC_NRF54H20_CPURAD_ENABLE=y

tests:
  benchmarks.multicore.idle_twim.nrf54h20dk_cpuapp_cpurad.s2ram:
    tags:
      - ci_build
      - ci_tests_benchmarks_multicore
      - twim
      - ppk_power_measure
    filter: not CONFIG_COVERAGE
    harness: pytest
    platform_allow:
      - nrf54h20dk/nrf54h20/cpuapp
      - nrf54h20dk/nrf54h20/cpuppr
    integration_platforms:
      - nrf54h20dk/nrf54h20/cpuapp
      - nrf54h20dk/nrf54h20/cpuppr
    extra_args:
      - SHIELD=pca63566
      - vpr_launcher_SHIELD=pca63566_fwd
    harness_config:
      fixture: pca63566
      pytest_root:
        - "${CUSTOM_ROOT_TEST_DIR}/test_measure_power_consumption.py::test_measure_and_data_dump_power_consumption_twim_gated"
    timeout: 120

  benchmarks.multicore.idle_twim.nrf54h20dk_cpuapp_cpurad.coverage:
    tags:
      - ci_build
      - ci_tests_benchmarks_multicore
      - twim
    filter: CONFIG_COVERAGE
    platform_allow:
      - nrf54h20dk/nrf54h20/cpuapp
    integration_platforms:
      - nrf54h20dk/nrf54h20/cpuapp
    extra_args:
      - SHIELD=pca63566;coverage_support
      - CONF_FILE=coverage.conf
    harness: console
    harness_config:
      fixture: pca63566
      type: multi_line
      ordered: true
      regex:
        - ".*Coverage analysis enabled.*"
        - ".*Coverage analysis start.*"
```

## tests/benchmarks/multicore/idle_uarte/Kconfig
```kconfig
#
# Copyright (c) 2026 Nordic Semiconductor ASA
#
# SPDX-License-Identifier: LicenseRef-Nordic-5-Clause
#

config TEST_BAUDRATE_REGISTER_RETENTION
	bool "UARTE baudrate register retention test"

source "Kconfig.zephyr"
```

## tests/benchmarks/multicore/idle_uarte/testcase.yaml
```yaml
common:
  sysbuild: true
  depends_on: gpio
  extra_args:
    - CONFIG_SOC_NRF54H20_CPURAD_ENABLE=y

tests:
  benchmarks.multicore.idle_uarte.nrf54h20dk_cpuapp_cpurad.s2ram:
    tags:
      - ci_build
      - ci_tests_benchmarks_multicore
      - uarte
      - ppk_power_measure
    filter: not CONFIG_COVERAGE
    harness: pytest
    platform_allow:
      - nrf54h20dk/nrf54h20/cpuapp
    integration_platforms:
      - nrf54h20dk/nrf54h20/cpuapp
    extra_args:
      - DTC_OVERLAY_FILE="boards/nrf54h20dk_nrf54h20_cpuapp_normal.overlay"
    harness_config:
      fixture: gpio_loopback
      pytest_root:
        - "${CUSTOM_ROOT_TEST_DIR}/test_measure_power_consumption.py::test_measure_and_data_dump_power_consumption_gated_uarte"
    timeout: 90

  benchmarks.multicore.idle_uarte.nrf54h20dk_cpuapp_cpurad.s2ram.mcuboot:
    tags:
      - ci_build
      - ci_tests_benchmarks_multicore
      - uarte
      - ppk_power_measure
    filter: not CONFIG_COVERAGE
    harness: pytest
    platform_allow:
      - nrf54h20dk/nrf54h20/cpuapp
    integration_platforms:
      - nrf54h20dk/nrf54h20/cpuapp
    extra_args:
      - DTC_OVERLAY_FILE="boards/nrf54h20dk_nrf54h20_cpuapp_normal.overlay"
      - SB_CONFIG_BOOTLOADER_MCUBOOT=y
      - mcuboot_EXTRA_DTC_OVERLAY_FILE="${ZEPHYR_NRF_MODULE_DIR}/tests/benchmarks/multicore/idle_uarte/boards/nrf54h20dk_nrf54h20_cpuapp_normal.overlay"
    harness_config:
      fixture: gpio_loopback
      pytest_root:
        - "${CUSTOM_ROOT_TEST_DIR}/test_measure_power_consumption.py::test_measure_and_data_dump_power_consumption_gated_uarte"
    timeout: 90

  benchmarks.multicore.idle_uarte.fast.nrf54h20dk_cpuapp_cpurad.s2ram:
    tags:
      - ci_build
      - ci_tests_benchmarks_multicore
      - uarte
      - ppk_power_measure
    filter: not CONFIG_COVERAGE
    harness: pytest
    platform_allow:
      - nrf54h20dk/nrf54h20/cpuapp
    integration_platforms:
      - nrf54h20dk/nrf54h20/cpuapp
    extra_args:
      - DTC_OVERLAY_FILE="boards/nrf54h20dk_nrf54h20_cpuapp_fast.overlay"
    harness_config:
      fixture: gpio_loopback
      pytest_root:
        - "${CUSTOM_ROOT_TEST_DIR}/test_measure_power_consumption.py::test_measure_and_data_dump_power_consumption_gated_uarte"
    timeout: 90

  benchmarks.multicore.idle_uarte.fast.nrf54h20dk_cpuapp_cpurad.s2ram.slow_pins:
    tags:
      - ci_build
      - ci_tests_benchmarks_multicore
      - uarte
    filter: not CONFIG_COVERAGE
    platform_allow:
      - nrf54h20dk/nrf54h20/cpuapp
    integration_platforms:
      - nrf54h20dk/nrf54h20/cpuapp
    extra_args:
      - DTC_OVERLAY_FILE="boards/nrf54h20dk_nrf54h20_cpuapp_fast_slow_pins.overlay"
    build_only: true

  benchmarks.multicore.idle_uarte.automatic_pm.nrf54h20dk_cpuapp_cpurad.s2ram:
    tags:
      - ci_build
      - ci_tests_benchmarks_multicore
      - uarte
      - ppk_power_measure
    filter: not CONFIG_COVERAGE
    harness: pytest
    platform_allow:
      - nrf54h20dk/nrf54h20/cpuapp
    integration_platforms:
      - nrf54h20dk/nrf54h20/cpuapp
    extra_args:
      - DTC_OVERLAY_FILE="boards/nrf54h20dk_nrf54h20_cpuapp_normal.overlay"
      - CONFIG_PRINTK=y
      - CONFIG_LOG=y
      - CONFIG_CONSOLE=y
      - CONFIG_UART_CONSOLE=y
    harness_config:
      fixture: gpio_loopback
      pytest_root:
        - "${CUSTOM_ROOT_TEST_DIR}/test_measure_power_consumption.py::test_measure_and_data_dump_power_consumption_gated_uarte_log_enabled"
    timeout: 90

  benchmarks.multicore.idle_uarte.nrf54h20dk_cpuapp_cpurad.coverage:
    tags:
      - ci_build
      - ci_tests_benchmarks_multicore
      - uarte
    filter: CONFIG_COVERAGE
    platform_allow:
      - nrf54h20dk/nrf54h20/cpuapp
    integration_platforms:
      - nrf54h20dk/nrf54h20/cpuapp
    extra_args:
      - DTC_OVERLAY_FILE="boards/nrf54h20dk_nrf54h20_cpuapp_normal.overlay;disable_s2ram.overlay"
      - CONF_FILE=coverage.conf
      - SNIPPET=coverage_support
    harness: console
    harness_config:
      fixture: gpio_loopback
      type: multi_line
      ordered: true
      regex:
        - ".*Coverage analysis start.*"
```

## tests/benchmarks/multicore/idle_usb/Kconfig
```kconfig
config TEST_USB_AND_SYSTEMOFF
	bool "Enter system offi nstead of system on all idle"

source "$(ZEPHYR_BASE)/samples/subsys/usb/common/Kconfig.sample_usbd"

source "Kconfig.zephyr"
```

## tests/benchmarks/multicore/idle_usb/testcase.yaml
```yaml
common:
  sysbuild: true
  depends_on: usbd
  tags:
    - ci_build
    - ci_tests_benchmarks_multicore
    - usb
    - ppk_power_measure
tests:
  benchmarks.multicore.idle_usb:
    harness: pytest
    platform_allow:
      - nrf54h20dk/nrf54h20/cpuapp
      - nrf54lm20dk/nrf54lm20a/cpuapp
      - nrf54lm20dk/nrf54lm20b/cpuapp
    integration_platforms:
      - nrf54h20dk/nrf54h20/cpuapp
      - nrf54lm20dk/nrf54lm20b/cpuapp
    harness_config:
      fixture: ppk_power_measure_usb
      pytest_root:
        - "${CUSTOM_ROOT_TEST_DIR}/test_measure_power_consumption.py::test_measure_and_data_dump_power_consumption_usb"

  benchmarks.multicore.idle_usb.system_off:
    harness: pytest
    platform_allow:
      - nrf54lm20dk/nrf54lm20a/cpuapp
      - nrf54lm20dk/nrf54lm20b/cpuapp
    integration_platforms:
      - nrf54lm20dk/nrf54lm20b/cpuapp
    extra_configs:
      - CONFIG_TEST_USB_AND_SYSTEMOFF=y
    harness_config:
      fixture: ppk_power_measure_usb
      pytest_root:
        - "${CUSTOM_ROOT_TEST_DIR}/test_measure_power_consumption.py::test_measure_and_data_dump_power_consumption_usb_system_off"
```

## tests/benchmarks/multicore/idle_wdt/Kconfig
```kconfig
#
# Copyright (c) 2024 Nordic Semiconductor ASA
#
# SPDX-License-Identifier: LicenseRef-Nordic-5-Clause
#

config TEST_SLEEP_DURATION_MS
	int "Core sleep duration (miliseconds)"
	default 1000
	help
	  Set sleep duration to TEST_SLEEP_DURATION_MS miliseconds.
	  Based on the value of 'min-residency-us' specified for each power state defined in the DTS,
	  core enters the lowest possible power state.

config TEST_SYNCHRONIZE_CORES
	bool "Synchronization with other core"
	help
	  When set to 'y' core will synchronize code execution with the other core.

source "Kconfig.zephyr"
```

## tests/benchmarks/multicore/idle_wdt/Kconfig.sysbuild
```kconfig
#
# Copyright (c) 2024 Nordic Semiconductor ASA
#
# SPDX-License-Identifier: LicenseRef-Nordic-5-Clause
#

choice NETCORE
	default NETCORE_REMOTE

config NETCORE_REMOTE
	bool "Remote image"

config NETCORE_REMOTE_SLEEP_FOREVER
	bool "Remote sleep forever image"

endchoice

config NETCORE_IMAGE_NAME
	default "remote" if NETCORE_REMOTE
	default "remote_sleep_forever" if NETCORE_REMOTE_SLEEP_FOREVER

config NETCORE_IMAGE_PATH
	default "${ZEPHYR_NRF_MODULE_DIR}/tests/benchmarks/multicore/idle_wdt/remote" if NETCORE_REMOTE
	default "${ZEPHYR_NRF_MODULE_DIR}/tests/benchmarks/power_consumption/common/remote_sleep_forever" if NETCORE_REMOTE_SLEEP_FOREVER

config TEST_SYNCHRONIZE_CORES
	bool "Synchronize both cores"
	depends on NETCORE_REMOTE
	default y
	help
	  When set to 'y' both cores will synchronize just before entering the main loop.
	  This requires test code to be compiled for both Application and Radio cores.
	  When one of the cores is flashed with remote_sleep_forever it will not confirm its readines.
	  In such case, the other core will wait forever for event that never happens.

source "share/sysbuild/Kconfig"
```

## tests/benchmarks/multicore/idle_wdt/testcase.yaml
```yaml
common:
  sysbuild: true
  tags:
    - ci_build
    - ci_tests_benchmarks_multicore
  platform_allow:
    - nrf54h20dk/nrf54h20/cpuapp
  integration_platforms:
    - nrf54h20dk/nrf54h20/cpuapp

tests:
  # cpuapp - idle_wdt test with logging
  # cpurad - idle_wdt test with logging
  benchmarks.multicore.idle_wdt.nrf54h20dk_cpuapp_cpurad.no_sleep:
    harness: console
    harness_config:
      type: multi_line
      ordered: true
      regex:
        - "Multicore idle_wdt test on"
        - "Run 0"
        - "Run 1"
    extra_args:
      - idle_wdt_EXTRA_CONF_FILE=enable_logs.conf
      - remote_EXTRA_CONF_FILE=../enable_logs.conf

  # cpuapp - idle_wdt test (idle_retained)
  # cpurad - idle_wdt test (idle)
  benchmarks.multicore.idle_wdt.nrf54h20dk_cpuapp_cpurad.idle_retained:
    tags: ppk_power_measure
    extra_args:
      - idle_wdt_CONFIG_TEST_SLEEP_DURATION_MS=500
      - remote_CONFIG_TEST_SLEEP_DURATION_MS=500
      - idle_wdt_EXTRA_DTC_OVERLAY_FILE="${ZEPHYR_NRF_MODULE_DIR}/tests/benchmarks/multicore/common/workaround_idle_retained.overlay"
    harness: pytest
    harness_config:
      fixture: ppk_power_measure
      pytest_root:
        - "${CUSTOM_ROOT_TEST_DIR}/test_measure_power_consumption.py::test_measure_and_data_dump_pwm_and_idle"

  # cpuapp - idle_wdt test (idle)
  # cpurad - idle_wdt test (idle)
  benchmarks.multicore.idle_wdt.nrf54h20dk_cpuapp_cpurad.idle:
    tags: ppk_power_measure
    extra_args:
      - idle_wdt_CONFIG_TEST_SLEEP_DURATION_MS=500
      - remote_CONFIG_TEST_SLEEP_DURATION_MS=500
      - idle_wdt_EXTRA_DTC_OVERLAY_FILE="${ZEPHYR_NRF_MODULE_DIR}/tests/benchmarks/multicore/common/workaround_idle.overlay"
    harness: pytest
    harness_config:
      fixture: ppk_power_measure
      pytest_root:
        - "${CUSTOM_ROOT_TEST_DIR}/test_measure_power_consumption.py::test_measure_and_data_dump_pwm_and_idle"

  # cpuapp - idle_wdt test (s2ram)
  # cpurad - idle_wdt test (idle)
  benchmarks.multicore.idle_wdt.nrf54h20dk_cpuapp_cpurad.s2ram:
    tags: ppk_power_measure
    harness: pytest
    harness_config:
      fixture: ppk_power_measure
      pytest_root:
        - "${CUSTOM_ROOT_TEST_DIR}/test_measure_power_consumption.py::test_measure_and_data_dump_pwm_and_s2ram"

  # cpuapp - idle_wdt test (s2ram)
  # cpurad - remote sleep forever (idle)
  benchmarks.multicore.idle_wdt.nrf54h20dk_cpuapp.s2ram:
    tags: ppk_power_measure
    extra_args:
      - SB_CONFIG_NETCORE_REMOTE_SLEEP_FOREVER=y
    harness: pytest
    harness_config:
      fixture: ppk_power_measure
      pytest_root:
        - "${CUSTOM_ROOT_TEST_DIR}/test_measure_power_consumption.py::test_measure_and_data_dump_wdt_and_s2ram"
    platform_allow:
      - nrf54h20dk/nrf54h20/cpuapp
    integration_platforms:
      - nrf54h20dk/nrf54h20/cpuapp
```
