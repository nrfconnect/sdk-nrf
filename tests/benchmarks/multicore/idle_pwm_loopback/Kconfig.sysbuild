## tests/drivers/dect/dect_mdm/integration/testcase.yaml
```yaml
# Copyright (c) 2026 Nordic Semiconductor ASA
#
# SPDX-License-Identifier: LicenseRef-Nordic-5-Clause
#
tests:
  unity.dect_integration_test:
    sysbuild: true
    tags:
      - sysbuild
      - ci_tests_drivers_dect
    platform_allow:
      - native_sim
    integration_platforms:
      - native_sim

  unity.dect_integration_test.eth_sink:
    sysbuild: true
    tags:
      - sysbuild
      - ci_tests_drivers_dect
    platform_allow:
      - native_sim
    integration_platforms:
      - native_sim
    extra_args:
      - EXTRA_CONF_FILE=eth_sink.conf
```

## tests/drivers/fprotect/app/testcase.yaml
```yaml
tests:
  lib.fprotect.sys_init_fprotect:
    sysbuild: true
    platform_allow:
      - nrf9160dk/nrf9160
      - nrf5340dk/nrf5340/cpuapp
    integration_platforms:
      - nrf9160dk/nrf9160
      - nrf5340dk/nrf5340/cpuapp
    ignore_faults: true
    tags:
      - b0
      - fprotect
      - sysbuild
      - ci_tests_drivers_fprotect
```

## tests/drivers/fprotect/negative/testcase.yaml
```yaml
common:
  sysbuild: true
  platform_allow:
    - nrf9160dk/nrf9160
    - nrf52dk/nrf52832
    - nrf5340dk/nrf5340/cpuapp
    - nrf52840dk/nrf52840
    - nrf54l15dk/nrf54l15/cpuapp
    - nrf54l15dk/nrf54l10/cpuapp
    - nrf54l15dk/nrf54l05/cpuapp
    - nrf54lc10dk/nrf54lc10a/cpuapp
    - nrf54lv10dk/nrf54lv10a/cpuapp
    - nrf54lm20dk/nrf54lm20a/cpuapp
    - nrf54lm20dk/nrf54lm20b/cpuapp
  tags:
    - b0
    - fprotect
    - ignore_faults
    - sysbuild
    - ci_tests_drivers_fprotect
tests:
  drivers.fprotect.negative:
    integration_platforms:
      - nrf9160dk/nrf9160
      - nrf52dk/nrf52832
      - nrf5340dk/nrf5340/cpuapp
      - nrf52840dk/nrf52840
  drivers.fprotect.negative_and_hw_crypto:
    extra_args:
      - SB_CONFIG_SECURE_BOOT_APPCORE_SIGNATURE_TYPE_HARDWARE=y
      - SB_CONFIG_SECURE_BOOT_APPCORE_HASH_TYPE_HARDWARE=y
    platform_exclude:
      - nrf5340dk/nrf5340/cpuapp
    integration_platforms:
      - nrf9160dk/nrf9160
      - nrf52dk/nrf52832
      - nrf52840dk/nrf52840
```
