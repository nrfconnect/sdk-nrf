## tests/benchmarks/multicore/idle_pwm_loopback/Kconfig.sysbuild
```kconfig
#
# Copyright (c) 2026 Nordic Semiconductor ASA
#
# SPDX-License-Identifier: LicenseRef-Nordic-5-Clause
#

choice NETCORE
	default NETCORE_REMOTE

config NETCORE_REMOTE
	bool "Remote image"

endchoice

config NETCORE_IMAGE_NAME
	default "remote" if NETCORE_REMOTE

config NETCORE_IMAGE_PATH
	default "$(ZEPHYR_NRF_MODULE_DIR)/tests/benchmarks/multicore/idle_pwm_loopback/remote" if NETCORE_REMOTE

choice PPRCORE
	default PPRCORE_REMOTE_SLEEP_FOREVER if SOC_NRF9251_CPUAPP
	default PPRCORE_NONE

config PPRCORE_REMOTE_SLEEP_FOREVER
	bool "Remote sleep forever image"

endchoice

config PPRCORE_IMAGE_NAME
	default "remote_sleep_forever" if PPRCORE_REMOTE_SLEEP_FOREVER

config PPRCORE_IMAGE_PATH
	default "$(ZEPHYR_NRF_MODULE_DIR)/tests/benchmarks/power_consumption/common/remote_sleep_forever" if PPRCORE_REMOTE_SLEEP_FOREVER

source "share/sysbuild/Kconfig"
```

## tests/benchmarks/multicore/idle_pwm_loopback/testcase.yaml
```yaml
common:
  sysbuild: true
  tags:
    - ci_build
    - ci_tests_benchmarks_multicore

tests:
  benchmarks.multicore.idle_pwm_loopback.nrf54h20dk_cpuapp_cpurad.no_sleep:
    filter: not CONFIG_COVERAGE
    extra_args:
      - idle_pwm_loopback_EXTRA_CONF_FILE=enable_logs.conf
      - remote_EXTRA_CONF_FILE=enable_logs.conf
    harness: console
    harness_config:
      fixture: spi_loopback
      type: multi_line
      ordered: true
      regex:
        - "Multicore idle_pwm_loopback test on"
        - "Iteration 0"
        - "Iteration 1"
    platform_allow:
      - nrf54h20dk/nrf54h20/cpuapp
    integration_platforms:
      - nrf54h20dk/nrf54h20/cpuapp

  benchmarks.multicore.idle_pwm_loopback.nrf54h20dk_cpuapp_cpurad.idle_retained:
    filter: not CONFIG_COVERAGE
    tags: ppk_power_measure
    extra_args:
      - idle_pwm_loopback_CONFIG_TEST_SLEEP_DURATION_MS=500
      - remote_CONFIG_TEST_SLEEP_DURATION_MS=500
      - idle_pwm_loopback_EXTRA_DTC_OVERLAY_FILE="${ZEPHYR_NRF_MODULE_DIR}/tests/benchmarks/multicore/common/workaround_idle_retained.overlay"
    harness: pytest
    harness_config:
      fixture: spi_loopback
      pytest_root:
        - "${CUSTOM_ROOT_TEST_DIR}/test_measure_power_consumption.py::test_measure_and_data_dump_pwm_and_idle"
    platform_allow:
      - nrf54h20dk/nrf54h20/cpuapp
    integration_platforms:
      - nrf54h20dk/nrf54h20/cpuapp

  benchmarks.multicore.idle_pwm_loopback.nrf54h20dk_cpuapp_cpurad.idle:
    filter: not CONFIG_COVERAGE
    tags: ppk_power_measure
    extra_args:
      - idle_pwm_loopback_CONFIG_TEST_SLEEP_DURATION_MS=500
      - remote_CONFIG_TEST_SLEEP_DURATION_MS=500
      - idle_pwm_loopback_EXTRA_DTC_OVERLAY_FILE="${ZEPHYR_NRF_MODULE_DIR}/tests/benchmarks/multicore/common/workaround_idle.overlay"
    harness: pytest
    harness_config:
      fixture: spi_loopback
      pytest_root:
        - "${CUSTOM_ROOT_TEST_DIR}/test_measure_power_consumption.py::test_measure_and_data_dump_pwm_and_idle"
    platform_allow:
      - nrf54h20dk/nrf54h20/cpuapp
    integration_platforms:
      - nrf54h20dk/nrf54h20/cpuapp

  benchmarks.multicore.idle_pwm_loopback.nrf54h20dk_cpuapp_cpurad.s2ram:
    filter: not CONFIG_COVERAGE
    tags: ppk_power_measure
    harness: pytest
    harness_config:
      fixture: spi_loopback
      pytest_root:
        - "${CUSTOM_ROOT_TEST_DIR}/test_measure_power_consumption.py::test_measure_and_data_dump_pwm_and_s2ram"
    platform_allow:
      - nrf54h20dk/nrf54h20/cpuapp
    integration_platforms:
      - nrf54h20dk/nrf54h20/cpuapp

  benchmarks.multicore.idle_pwm_loopback.nrf54h20dk_cpuapp_cpurad.no_sleep_fast:
    filter: not CONFIG_COVERAGE
    extra_args:
      - idle_pwm_loopback_EXTRA_CONF_FILE=enable_logs.conf
      - remote_EXTRA_CONF_FILE=enable_logs.conf
      - idle_pwm_loopback_DTC_OVERLAY_FILE="boards/nrf54h20dk_nrf54h20_cpuapp_fast_p7_1.overlay"
    harness: console
    harness_config:
      fixture: spi_loopback
      type: multi_line
      ordered: true
      regex:
        - "Multicore idle_pwm_loopback test on"
        - "Iteration 0"
        - "Iteration 1"
    platform_allow:
      - nrf54h20dk/nrf54h20/cpuapp
    integration_platforms:
      - nrf54h20dk/nrf54h20/cpuapp

  benchmarks.multicore.idle_pwm_loopback.nrf54h20dk_cpuapp_cpurad.idle_retained_fast:
    filter: not CONFIG_COVERAGE
    tags: ppk_power_measure
    extra_args:
      - idle_pwm_loopback_CONFIG_TEST_SLEEP_DURATION_MS=500
      - remote_CONFIG_TEST_SLEEP_DURATION_MS=500
      - idle_pwm_loopback_DTC_OVERLAY_FILE="boards/nrf54h20dk_nrf54h20_cpuapp_fast_p7_1.overlay"
      - idle_pwm_loopback_EXTRA_DTC_OVERLAY_FILE="${ZEPHYR_NRF_MODULE_DIR}/tests/benchmarks/multicore/common/workaround_idle_retained.overlay"
    harness: pytest
    harness_config:
      fixture: spi_loopback
      pytest_root:
        - "${CUSTOM_ROOT_TEST_DIR}/test_measure_power_consumption.py::test_measure_and_data_dump_pwm_and_idle"
    platform_allow:
      - nrf54h20dk/nrf54h20/cpuapp
    integration_platforms:
      - nrf54h20dk/nrf54h20/cpuapp

  benchmarks.multicore.idle_pwm_loopback.nrf54h20dk_cpuapp_cpurad.idle_fast:
    filter: not CONFIG_COVERAGE
    tags: ppk_power_measure
    extra_args:
      - idle_pwm_loopback_CONFIG_TEST_SLEEP_DURATION_MS=500
      - remote_CONFIG_TEST_SLEEP_DURATION_MS=500
      - idle_pwm_loopback_DTC_OVERLAY_FILE="boards/nrf54h20dk_nrf54h20_cpuapp_fast_p7_1.overlay"
      - idle_pwm_loopback_EXTRA_DTC_OVERLAY_FILE="${ZEPHYR_NRF_MODULE_DIR}/tests/benchmarks/multicore/common/workaround_idle.overlay"
    harness: pytest
    harness_config:
      fixture: spi_loopback
      pytest_root:
        - "${CUSTOM_ROOT_TEST_DIR}/test_measure_power_consumption.py::test_measure_and_data_dump_pwm_and_idle"
    platform_allow:
      - nrf54h20dk/nrf54h20/cpuapp
    integration_platforms:
      - nrf54h20dk/nrf54h20/cpuapp

  benchmarks.multicore.idle_pwm_loopback.nrf54h20dk_cpuapp_cpurad.idle_fast.slow_pins:
    filter: not CONFIG_COVERAGE
    tags: ppk_power_measure
    extra_args:
      - idle_pwm_loopback_CONFIG_TEST_SLEEP_DURATION_MS=500
      - remote_CONFIG_TEST_SLEEP_DURATION_MS=500
      - remote_EXTRA_DTC_OVERLAY_FILE="boards/disable_uart135.overlay"
      - idle_pwm_loopback_DTC_OVERLAY_FILE="boards/nrf54h20dk_nrf54h20_cpuapp_fast_slow_pins.overlay"
      - idle_pwm_loopback_EXTRA_DTC_OVERLAY_FILE="${ZEPHYR_NRF_MODULE_DIR}/tests/benchmarks/multicore/common/workaround_idle.overlay"
    build_only: true
    platform_allow:
      - nrf54h20dk/nrf54h20/cpuapp
    integration_platforms:
      - nrf54h20dk/nrf54h20/cpuapp

  benchmarks.multicore.idle_pwm_loopback.nrf54h20dk_cpuapp_cpurad.s2ram_fast.no_clock_control:
    filter: not CONFIG_COVERAGE
    tags: ppk_power_measure
    extra_args:
      - idle_pwm_loopback_DTC_OVERLAY_FILE="boards/nrf54h20dk_nrf54h20_cpuapp_fast_p7_1.overlay"
    harness: pytest
    harness_config:
      fixture: spi_loopback
      pytest_root:
        - "${CUSTOM_ROOT_TEST_DIR}/test_measure_power_consumption.py::test_measure_and_data_dump_pwm_and_s2ram"
    platform_allow:
      - nrf54h20dk/nrf54h20/cpuapp
    integration_platforms:
      - nrf54h20dk/nrf54h20/cpuapp

  benchmarks.multicore.idle_pwm_loopback.nrf54h20dk_cpuapp_cpurad.coverage:
    filter: CONFIG_COVERAGE
    extra_args:
      - idle_pwm_loopback_CONF_FILE=coverage.conf
      - EXTRA_DTC_OVERLAY_FILE="disable_s2ram.overlay"
      - SNIPPET=coverage_support
    harness: console
    harness_config:
      fixture: spi_loopback
      type: multi_line
      ordered: true
      regex:
        - ".*Coverage analysis enabled.*"
        - ".*Coverage analysis start.*"
    platform_allow:
      - nrf54h20dk/nrf54h20/cpuapp
    integration_platforms:
      - nrf54h20dk/nrf54h20/cpuapp

  benchmarks.multicore.idle_pwm_loopback.nrf9251dk_cpuapp_cpuppr.idle_retained:
    filter: not CONFIG_COVERAGE
    tags: ppk_power_measure
    extra_args:
      - idle_pwm_loopback_CONFIG_TEST_SLEEP_DURATION_MS=500
      - idle_pwm_loopback_EXTRA_DTC_OVERLAY_FILE="${ZEPHYR_NRF_MODULE_DIR}/tests/benchmarks/multicore/common/workaround_idle_retained.overlay"
    harness: pytest
    harness_config:
      fixture: spi_loopback
      pytest_root:
        - "${CUSTOM_ROOT_TEST_DIR}/test_measure_power_consumption.py::test_measure_and_data_dump_pwm_and_idle"
    platform_allow:
      - nrf9251dk/nrf9251/cpuapp
    integration_platforms:
      - nrf9251dk/nrf9251/cpuapp

  benchmarks.multicore.idle_pwm_loopback.nrf9251dk_cpuapp_cpuppr.idle:
    filter: not CONFIG_COVERAGE
    tags: ppk_power_measure
    extra_args:
      - idle_pwm_loopback_CONFIG_TEST_SLEEP_DURATION_MS=500
      - idle_pwm_loopback_EXTRA_DTC_OVERLAY_FILE="${ZEPHYR_NRF_MODULE_DIR}/tests/benchmarks/multicore/common/workaround_idle.overlay"
    harness: pytest
    harness_config:
      fixture: spi_loopback
      pytest_root:
        - "${CUSTOM_ROOT_TEST_DIR}/test_measure_power_consumption.py::test_measure_and_data_dump_pwm_and_idle"
    platform_allow:
      - nrf9251dk/nrf9251/cpuapp
    integration_platforms:
      - nrf9251dk/nrf9251/cpuapp

  benchmarks.multicore.idle_pwm_loopback.nrf9251dk_cpuapp_cpuppr.s2ram:
    filter: not CONFIG_COVERAGE
    tags: ppk_power_measure
    harness: pytest
    harness_config:
      fixture: spi_loopback
      pytest_root:
        - "${CUSTOM_ROOT_TEST_DIR}/test_measure_power_consumption.py::test_measure_and_data_dump_pwm_and_s2ram"
    platform_allow:
      - nrf9251dk/nrf9251/cpuapp
    integration_platforms:
      - nrf9251dk/nrf9251/cpuapp
```

## tests/benchmarks/multicore/idle_spim_loopback/test_on_ppr/Kconfig.sysbuild
```kconfig
#
# Copyright (c) 2026 Nordic Semiconductor ASA
#
# SPDX-License-Identifier: LicenseRef-Nordic-5-Clause
#

if SUPPORT_NETCORE

choice NETCORE
	default NETCORE_REMOTE_SLEEP_FOREVER

config NETCORE_REMOTE_SLEEP_FOREVER
	bool "Remote sleep forever image"

endchoice

config NETCORE_IMAGE_NAME
	default "remote_sleep_forever" if NETCORE_REMOTE_SLEEP_FOREVER

config NETCORE_IMAGE_PATH
	default "$(ZEPHYR_NRF_MODULE_DIR)/tests/benchmarks/power_consumption/common/remote_sleep_forever" if NETCORE_REMOTE_SLEEP_FOREVER

endif # SUPPORT_NETCORE

if SUPPORT_PPRCORE

choice PPRCORE
	default PPRCORE_IDLE_SPIM_LOOPBACK

config PPRCORE_IDLE_SPIM_LOOPBACK
	bool "idle_spim_loopback image"

endchoice

config PPRCORE_IMAGE_NAME
	default "idle_spim_loopback" if PPRCORE_IDLE_SPIM_LOOPBACK

config PPRCORE_IMAGE_PATH
	default "$(APP_DIR)/../" if PPRCORE_IDLE_SPIM_LOOPBACK

endif # SUPPORT_PPRCORE

source "share/sysbuild/Kconfig"
```

## tests/benchmarks/multicore/idle_uarte/Kconfig.sysbuild
```kconfig
#
# Copyright (c) 2024 Nordic Semiconductor ASA
#
# SPDX-License-Identifier: LicenseRef-Nordic-5-Clause
#

choice NETCORE
	default NETCORE_REMOTE_SLEEP_FOREVER

config NETCORE_REMOTE_SLEEP_FOREVER
	bool "Remote sleep forever image"

endchoice

config NETCORE_IMAGE_NAME
	default "remote_sleep_forever" if NETCORE_REMOTE_SLEEP_FOREVER

config NETCORE_IMAGE_PATH
	default "$(ZEPHYR_NRF_MODULE_DIR)/tests/benchmarks/power_consumption/common/remote_sleep_forever" if NETCORE_REMOTE_SLEEP_FOREVER

choice PPRCORE
	default PPRCORE_REMOTE_SLEEP_FOREVER if SOC_NRF9251_CPUAPP
	default PPRCORE_NONE

config PPRCORE_REMOTE_SLEEP_FOREVER
	bool "Remote sleep forever image"

endchoice

config PPRCORE_IMAGE_NAME
	default "remote_sleep_forever" if PPRCORE_REMOTE_SLEEP_FOREVER

config PPRCORE_IMAGE_PATH
	default "$(ZEPHYR_NRF_MODULE_DIR)/tests/benchmarks/power_consumption/common/remote_sleep_forever" if PPRCORE_REMOTE_SLEEP_FOREVER

source "share/sysbuild/Kconfig"
```

## tests/benchmarks/power_load/Kconfig.sysbuild
```kconfig
#
# Copyright (c) 2026 Nordic Semiconductor ASA
#
# SPDX-License-Identifier: LicenseRef-Nordic-5-Clause
#

choice FLPRCORE

config FLPR_VPR_TEST_APP
	bool "Test app image for cpuflpr"

endchoice

if !FLPRCORE_NONE

config FLPRCORE_IMAGE_NAME
	default "flpr_vpr_test_app" if FLPR_VPR_TEST_APP

config FLPRCORE_IMAGE_PATH
	default "$(ZEPHYR_NRF_MODULE_DIR)/tests/benchmarks/power_load/vpr_test_app" if FLPR_VPR_TEST_APP

endif # !FLPRCORE_NONE

choice PPRCORE

config PPR_VPR_TEST_APP
	bool "Test app image for cpuppr"

endchoice

if !PPRCORE_NONE

config PPRCORE_IMAGE_NAME
	default "ppr_vpr_test_app" if PPR_VPR_TEST_APP

config PPRCORE_IMAGE_PATH
	default "$(ZEPHYR_NRF_MODULE_DIR)/tests/benchmarks/power_load/vpr_test_app" if PPR_VPR_TEST_APP

endif # !PPRCORE_NONE

source "share/sysbuild/Kconfig"
```

## tests/benchmarks/power_load/boards/nrf54l15dk_nrf54l15_cpuapp.conf
```kconfig
# FLASH
CONFIG_FLASH=y

# PWM
CONFIG_PWM=y

# SENSOR
CONFIG_SENSOR=y

CONFIG_BT_CTLR_TX_PWR_PLUS_8=y
```

## tests/benchmarks/power_load/boards/nrf54lc10dk_nrf54lc10a_cpuapp.conf
```kconfig
# BLUETOOTH
CONFIG_BT=y
CONFIG_BT_DEVICE_NAME="Test beacon"

# SENSOR
CONFIG_SENSOR=y

CONFIG_BT_CTLR_TX_PWR_PLUS_8=y
```

## tests/benchmarks/sdmmc_performance/testcase.yaml
```yaml
common:
  tags:
    - drivers
    - ppk_power_measure
    - ci_tests_benchmarks_sdmmc_performance

tests:
  benchmarks.sd_mmc.performance.semmc:
    platform_allow:
      - nrf54h20dk/nrf54h20/cpuapp
      - nrf54l15dk/nrf54l15/cpuapp
    integration_platforms:
      - nrf54l15dk/nrf54l15/cpuapp
    extra_args:
      - CONFIG_MMC_STACK=y
      - FILE_SUFFIX=semmc

  # DRIVER not ready
  # benchmarks.sd_mmc.performance.ssdcard:
  #   platform_allow:
  #     - nrf54h20dk/nrf54h20/cpuapp
  #     - nrf54l15dk/nrf54l15/cpuapp
  #   integration_platforms:
  #     - nrf54l15dk/nrf54l15/cpuapp
  #   extra_args:
  #     - CONFIG_SDMMC_STACK=y
  #     - FILE_SUFFIX=ssdcard
```

## tests/benchmarks/xspi_performance/Kconfig
```kconfig
#
# Copyright (c) 2026 Nordic Semiconductor ASA
#
# SPDX-License-Identifier: LicenseRef-Nordic-5-Clause
#

source "Kconfig.zephyr"

config TEST_FIXED_OPERATION_SIZE
	bool "Run test for fixed flash operation size"

config TEST_FLASH_OPERATION_SIZE
	int "Flash operation size for fixed size mode"
	default 65536

config TEST_DATA_VERIFICATION
	bool "Verify flash data content after each operation"
	default y
	help
	  When enabled, the test reads back the flash region touched by each
	  erase/write/read operation and checks its content against the
	  expected pattern (erased value after erase, test pattern after
	  write/read). Verification failures are reported but do not affect
	  the measured throughput, which is still based purely on the timed
	  operation itself.
```

## tests/benchmarks/xspi_performance_mspi_api/Kconfig
```kconfig
#
# Copyright (c) 2026 Nordic Semiconductor ASA
#
# SPDX-License-Identifier: LicenseRef-Nordic-5-Clause
#

source "Kconfig.zephyr"

config TEST_BENCHMARK_SCK_DELAY
	bool "Measure SCK delay"
	default y
	select NRFX_GPPI
	select NRFX_GPIOTE
	help
	  Enables tests which measure the delay between triggering the transfer and
	  detecting clock signal on the SCK line. This requires a physical loopback
	  between the MSPI SCK pin and a GPIO input pin used by the tests.
```

## tests/bluetooth/bsim/custom_ltk/testcase.yaml
```yaml
tests:
  bluetooth.custom_ltk:
    build_only: true
    tags:
      - bluetooth
    platform_allow:
      - nrf54l15bsim/nrf54l15/cpuapp
    harness: bsim
    harness_config:
      bsim_exe_name: tests_bluetooth_bsim_custom_ltk_prj_conf
```

## tests/bluetooth/tester/mmdl/testcase.yaml
```yaml
tests:
  bluetooth.general.tester.mmdl.build:
    sysbuild: true
    build_only: true
    platform_allow:
      - nrf54l15dk/nrf54l15/cpuapp
    tags:
      - bluetooth
      - ci_build
      - sysbuild
      - ci_tests_bluetooth_tester
    integration_platforms:
      - nrf54l15dk/nrf54l15/cpuapp
```

## tests/code_extender/Kconfig
```kconfig
#
# Copyright (c) 2026 Nordic Semiconductor ASA
#
# SPDX-License-Identifier: LicenseRef-Nordic-5-Clause
#

config CODE_EXTENDER
	bool "Expand code size"
	help
	  This module is used to measure the performance of boot and update
	  process, in function of application size.

if CODE_EXTENDER

config CODE_EXTENDER_SIZE
	int "Extended code size (in bytes)"
	default 524288

endif # CODE_EXTENDER
```
