/*
 * Copyright (c) 2026 Nordic Semiconductor ASA
 *
 * SPDX-License-Identifier: LicenseRef-Nordic-5-Clause
 */

&cpuppr_vpr {
	execution-memory = <&cpuppr_code_partition>;
	/delete-property/ source-memory;
};

&cpuppr_vpr {
	status = "okay";
};
