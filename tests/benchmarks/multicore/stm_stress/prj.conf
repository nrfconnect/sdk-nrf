## CMakeLists.txt
```
#
# Copyright (c) 2026 Nordic Semiconductor ASA
#
# SPDX-License-Identifier: LicenseRef-Nordic-5-Clause
#

cmake_minimum_required(VERSION 3.20.0)
find_package(Zephyr REQUIRED HINTS $ENV{ZEPHYR_BASE})

project(stm_stress)
target_sources(app PRIVATE src/main.c)
```

## Kconfig.sysbuild
```
#
# Copyright (c) 2026 Nordic Semiconductor ASA
#
# SPDX-License-Identifier: LicenseRef-Nordic-5-Clause
#

choice NETCORE

config NETCORE_TESTAPP
	bool "testapp image"

endchoice

if !NETCORE_NONE

config NETCORE_IMAGE_NAME
	default "testapp_cpunet" if NETCORE_TESTAPP

config NETCORE_IMAGE_PATH
	default "$(ZEPHYR_NRF_MODULE_DIR)/tests/benchmarks/multicore/stm_stress/testapp" if NETCORE_TESTAPP

endif # !NETCORE_NONE

config PPRCORE_REMOTE_BOARD_TARGET_CPUCLUSTER
	string
	default "cpuppr/xip"

choice PPRCORE

config PPRCORE_TESTAPP
	bool "testapp image"

endchoice

if !PPRCORE_NONE

config PPRCORE_IMAGE_NAME
	default "testapp_cpuppr" if PPRCORE_TESTAPP

config PPRCORE_IMAGE_PATH
	default "$(ZEPHYR_NRF_MODULE_DIR)/tests/benchmarks/multicore/stm_stress/testapp" if PPRCORE_TESTAPP

endif # !PPRCORE_NONE

choice FLPRCORE

config FLPRCORE_TESTAPP
	bool "testapp image"

endchoice

if !FLPRCORE_NONE

config FLPRCORE_IMAGE_NAME
	default "testapp_cpuflpr" if FLPRCORE_TESTAPP

config FLPRCORE_IMAGE_PATH
	default "$(ZEPHYR_NRF_MODULE_DIR)/tests/benchmarks/multicore/stm_stress/testapp" if FLPRCORE_TESTAPP

endif # !FLPRCORE_NONE

source "share/sysbuild/Kconfig"
```

## prj.conf
```kconfig
CONFIG_ASSERT=y
CONFIG_LOG=y
CONFIG_REBOOT=y
```

## enable_flpr.overlay
```dts
/*
 * Copyright (c) 2026 Nordic Semiconductor ASA
 *
 * SPDX-License-Identifier: LicenseRef-Nordic-5-Clause
 */

&cpuflpr_vpr {
	status = "okay";
};
```

## enable_ppr.overlay
```dts
/*
 * Copyright (c) 2026 Nordic Semiconductor ASA
 *
 * SPDX-License-Identifier: LicenseRef-Nordic-5-Clause
 */

&cpuppr_vpr {
	execution-memory = <&cpuppr_code_partition>;
	/delete-property/ source-memory;
};

&cpuppr_vpr {
	status = "okay";
};
```

## src/main.c
```c
/*
 * Copyright (c) 2026 Nordic Semiconductor ASA
 *
 * SPDX-License-Identifier: LicenseRef-Nordic-5-Clause
 */

#include <zephyr/kernel.h>
#include <zephyr/sys/printk.h>
#include <zephyr/logging/log.h>
#if IS_ENABLED(CONFIG_SOC_NRF54H20_CPUAPP)
#include <zephyr/sys/reboot.h>
#endif

LOG_MODULE_REGISTER(test, 4);

int main(void)
{
	printk("Hello world from %s\n", CONFIG_BOARD_TARGET);
	k_msleep(1000);

	for (uint32_t i = 0; i < 0xFFFF; i++) {
		LOG_INF("Stm stress test: %d\n", i);
	}

#if IS_ENABLED(CONFIG_SOC_NRF54H20_CPUAPP)
	k_msleep(10000);
	sys_reboot(0);
#endif

	return 0;
}
```
