/*
 * Copyright (c) 2024 Nordic Semiconductor ASA
 *
 * SPDX-License-Identifier: LicenseRef-Nordic-5-Clause
 */

/ {
	aliases {
		/delete-property/ led0;
		/delete-property/ led1;
	};
};

/delete-node/ &led0;
/delete-node/ &led1;
