## CMakeLists.txt
```
#
# Copyright (c) 2022 Nordic Semiconductor ASA
#
# SPDX-License-Identifier: LicenseRef-Nordic-5-Clause
#

cmake_minimum_required(VERSION 3.20.0)

find_package(Zephyr REQUIRED HINTS $ENV{ZEPHYR_BASE})

if(NOT SYSBUILD)
  message(FATAL_ERROR
    " This is a multi-image application that should be built using sysbuild.\n"
    " Add --sysbuild argument to west build command to prepare all the images."
  )
endif()

project(idle_hpu_temp_meas)

target_sources(app PRIVATE ../../power_consumption/common/remote_sleep_forever/src/main.c)
```

## Kconfig.sysbuild
```
#
# Copyright (c) 2023 Nordic Semiconductor ASA
#
# SPDX-License-Identifier: LicenseRef-Nordic-5-Clause
#

if SUPPORT_NETCORE

choice NETCORE
	default NETCORE_REMOTE_SLEEP_FOREVER

config NETCORE_REMOTE_SLEEP_FOREVER
	bool "remote_sleep_forever image"

endchoice

config NETCORE_IMAGE_NAME
	default "remote_sleep_forever" if NETCORE_REMOTE_SLEEP_FOREVER

config NETCORE_IMAGE_PATH
	default "$(ZEPHYR_NRF_MODULE_DIR)/tests/benchmarks/power_consumption/common/remote_sleep_forever" if NETCORE_REMOTE_SLEEP_FOREVER

endif # SUPPORT_NETCORE

if SUPPORT_PPRCORE

choice PPRCORE
	default PPRCORE_REMOTE_SLEEP_FOREVER if SOC_NRF9251_CPUAPP
	default PPRCORE_NONE

config PPRCORE_REMOTE_SLEEP_FOREVER
	bool "Remote sleep forever image"

endchoice

config PPRCORE_IMAGE_NAME
	default "remote_sleep_forever" if PPRCORE_REMOTE_SLEEP_FOREVER

config PPRCORE_IMAGE_PATH
	default "$(ZEPHYR_NRF_MODULE_DIR)/tests/benchmarks/power_consumption/common/remote_sleep_forever" if PPRCORE_REMOTE_SLEEP_FOREVER

endif # SUPPORT_PPRCORE

source "share/sysbuild/Kconfig"
```

## prj.conf
```kconfig
CONFIG_PM=y
CONFIG_PM_DEVICE=y
CONFIG_PM_DEVICE_RUNTIME=y
CONFIG_POWEROFF=y

CONFIG_BOOT_BANNER=n
CONFIG_NCS_BOOT_BANNER=n

CONFIG_ASSERT=y

# Enable for debugging purposes only
CONFIG_PRINTK=n
CONFIG_LOG=n
CONFIG_CONSOLE=n
CONFIG_UART_CONSOLE=n
CONFIG_SERIAL=n
```

## boards/nrf54h20dk_nrf54h20_cpuapp.overlay
```dts
/*
 * Copyright (c) 2024 Nordic Semiconductor ASA
 *
 * SPDX-License-Identifier: LicenseRef-Nordic-5-Clause
 */

#include <zephyr/dt-bindings/gpio/nordic-nrf-gpio.h>

/ {
	aliases {
		led = &led0;
		/delete-property/ led1;
	};
};

/delete-node/ &led1;
```

## boards/nrf9251dk_nrf9251_cpuapp.overlay
```dts
/*
 * Copyright (c) 2026 Nordic Semiconductor ASA
 *
 * SPDX-License-Identifier: LicenseRef-Nordic-5-Clause
 */

/ {
	aliases {
		led = &led0;
	};
};

&cpuppr_vpr {
	status = "okay";
};

&uart132 {
	status = "reserved";
	interrupt-parent = <&cpuppr_clic>;
};
```

## src/main.c
```c
/*
 * Copyright (c) 2024 Nordic Semiconductor ASA
 *
 * SPDX-License-Identifier: LicenseRef-Nordic-5-Clause
 */

#include <zephyr/kernel.h>
#include <zephyr/sys/printk.h>
#include <zephyr/logging/log.h>
#include <nrfs_backend_ipc_service.h>
#include <nrfs_gdpwr.h>

LOG_MODULE_REGISTER(idle_hpu_temp_meas);

/* Required to power off the GD2 and GD3 domains
 * Will be removed when GD handling
 * is implemented in sdk-zephyr
 */
static void gdpwr_handler(nrfs_gdpwr_evt_t const *p_evt, void *context)
{
	switch (p_evt->type) {
	case NRFS_GDPWR_REQ_APPLIED:
		LOG_INF("GDPWR handler - response received: 0x%x, CTX=%d", p_evt->type,
			(uint32_t)context);
		break;
	case NRFS_GDPWR_REQ_REJECTED:
		LOG_ERR("GDPWR handler - request rejected: 0x%x, CTX=%d", p_evt->type,
			(uint32_t)context);
		break;
	default:
		LOG_ERR("GDPWR handler - unexpected event: 0x%x, CTX=%d", p_evt->type,
			(uint32_t)context);
		break;
	}
}

/* Required to power off the GD2 and GD3 domains
 * Will be removed when GD handling
 * is implemented in sdk-zephyr
 */
static void clear_global_power_domains_requests(void)
{
	int service_status;
	int tst_ctx = 1;

	service_status = nrfs_gdpwr_init(gdpwr_handler);
	LOG_INF("Response: %d", service_status);
	LOG_INF("Sending GDPWR DISABLE request for: GDPWR_POWER_DOMAIN_ACTIVE_SLOW");
	service_status = nrfs_gdpwr_power_request(GDPWR_POWER_DOMAIN_ACTIVE_SLOW,
						  GDPWR_POWER_REQUEST_CLEAR, (void *)tst_ctx++);
	LOG_INF("Response: %d", service_status);
	LOG_INF("Sending GDPWR DISABLE request for: GDPWR_POWER_DOMAIN_ACTIVE_FAST");
	service_status = nrfs_gdpwr_power_request(GDPWR_POWER_DOMAIN_ACTIVE_FAST,
						  GDPWR_POWER_REQUEST_CLEAR, (void *)tst_ctx++);
	LOG_INF("Response: %d", service_status);
	LOG_INF("Sending GDPWR DISABLE request for: GDPWR_POWER_DOMAIN_MAIN_SLOW");
	service_status = nrfs_gdpwr_power_request(GDPWR_POWER_DOMAIN_MAIN_SLOW,
						  GDPWR_POWER_REQUEST_CLEAR, (void *)tst_ctx);
	LOG_INF("Response: %d", service_status);
}

int main(void)
{
	LOG_INF("SCFW HPU temperature measurement feature test, %s", CONFIG_BOARD_TARGET);
	nrfs_backend_wait_for_connection(K_FOREVER);
	clear_global_power_domains_requests();
	while (1) {
		LOG_INF("Going to sleep forever");
		k_sleep(K_FOREVER);
	}

	return 0;
}
```
