## CMakeLists.txt
```
#
# Copyright (c) 2024 Nordic Semiconductor ASA
#
# SPDX-License-Identifier: LicenseRef-Nordic-5-Clause
#

cmake_minimum_required(VERSION 3.20.0)

find_package(Zephyr REQUIRED HINTS $ENV{ZEPHYR_BASE})

if(NOT SYSBUILD)
  message(FATAL_ERROR
    " This is a multi-image application that should be built using sysbuild.\n"
    " Add --sysbuild argument to west build command to prepare all the images."
  )
endif()

project(idle_outside_of_main)

target_sources(app PRIVATE src/main.c)
```

## Kconfig.sysbuild
```
#
# Copyright (c) 2024 Nordic Semiconductor ASA
#
# SPDX-License-Identifier: LicenseRef-Nordic-5-Clause
#

choice NETCORE
	default NETCORE_REMOTE

config NETCORE_REMOTE
	bool "Remote image"

endchoice

config NETCORE_IMAGE_NAME
	default "remote" if NETCORE_REMOTE

config NETCORE_IMAGE_PATH
	default "$(ZEPHYR_NRF_MODULE_DIR)/tests/benchmarks/multicore/idle_outside_of_main/remote" if NETCORE_REMOTE

choice PPRCORE
	default PPRCORE_REMOTE

config PPRCORE_REMOTE
	bool "Remote image"

endchoice

config PPRCORE_IMAGE_NAME
	default "remote_ppr" if PPRCORE_REMOTE

config PPRCORE_IMAGE_PATH
	default "$(ZEPHYR_NRF_MODULE_DIR)/tests/benchmarks/multicore/idle_outside_of_main/remote" if PPRCORE_REMOTE

source "share/sysbuild/Kconfig"
```

## prj.conf
```kconfig
CONFIG_PM=y
CONFIG_POWEROFF=y

CONFIG_BOOT_BANNER=n
CONFIG_NCS_BOOT_BANNER=n

# Enable for debugging purposes only
CONFIG_SERIAL=n
CONFIG_PRINTK=n
CONFIG_LOG=n
CONFIG_CONSOLE=n
CONFIG_UART_CONSOLE=n
```

## boards/nrf54h20dk_nrf54h20_cpuapp.overlay
```dts
/*
 * Copyright (c) 2024 Nordic Semiconductor ASA
 *
 * SPDX-License-Identifier: LicenseRef-Nordic-5-Clause
 */

/ {
	aliases {
		led = &led0;
		/delete-property/ led1;
	};
};

/delete-node/ &led1;

&cpuppr_vpr {
	status = "okay";
};
```

## boards/nrf9251dk_nrf9251_cpuapp.overlay
```dts
/*
 * Copyright (c) 2026 Nordic Semiconductor ASA
 *
 * SPDX-License-Identifier: LicenseRef-Nordic-5-Clause
 */

/ {
	aliases {
		led = &led0;
	};
};

&cpuppr_vpr {
	status = "okay";
};
```

## src/main.c
```c
/*
 * Copyright (c) 2024 Nordic Semiconductor ASA
 *
 * SPDX-License-Identifier: LicenseRef-Nordic-5-Clause
 */

#include <zephyr/kernel.h>
#include <zephyr/logging/log.h>
#include <zephyr/drivers/gpio.h>
#include <zephyr/pm/pm.h>

LOG_MODULE_REGISTER(idle_outside_of_main);

static const struct gpio_dt_spec led = GPIO_DT_SPEC_GET(DT_ALIAS(led), gpios);


int main(void)
{
	int ret;

	ret = gpio_is_ready_dt(&led);
	__ASSERT(ret, "Error: GPIO Device not ready");

	ret = gpio_pin_configure_dt(&led, GPIO_OUTPUT_ACTIVE);
	__ASSERT(ret == 0, "Could not configure led GPIO");

	return 0;
}
```
