/*
 * Copyright (c) 2025 Nordic Semiconductor ASA
 *
 * SPDX-License-Identifier: LicenseRef-Nordic-5-Clause
 */

/ {
	aliases {
		/delete-property/ led1;
	};
};

/delete-node/ &led1;

&grtc {
	/delete-property/ child-owned-channels;
	/delete-property/ nonsecure-channels;
};
