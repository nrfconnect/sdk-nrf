/*
 * Copyright (c) 2026 Nordic Semiconductor ASA
 *
 * SPDX-License-Identifier: LicenseRef-Nordic-5-Clause
 */

/ {
	/*
	 * Redefine sw0/button0 to use SPI MOSI - P0.06
	 * Thus, when "remote" starts SPI transfer, there will be gpio interrupt,
	 * the same as originally triggered by sw0 button.
	 * P0.06 - P0.07 loopback is needed.
	 */
	buttons {
		compatible = "gpio-keys";

		button0: button_0 {
			gpios = <&gpio0 6 (GPIO_PULL_DOWN | GPIO_ACTIVE_HIGH)>;
			label = "Push button 0";
			zephyr,code = <INPUT_KEY_0>;
		};
	};
};
