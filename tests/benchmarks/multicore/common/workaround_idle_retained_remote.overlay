/*
 * Copyright (c) 2025 Nordic Semiconductor ASA
 *
 * SPDX-License-Identifier: LicenseRef-Nordic-5-Clause
 */

/* Increase min-residency-us for idle_cache_disabled so the cpu enters
 * idle_cache_retained state. The radio core has no s2ram state.
 */

&idle_cache_disabled {
	min-residency-us = <790000>;
};
