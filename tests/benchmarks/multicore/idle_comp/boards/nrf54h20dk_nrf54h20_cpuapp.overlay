/*
 * Copyright (c) 2024 Nordic Semiconductor ASA
 *
 * SPDX-License-Identifier: LicenseRef-Nordic-5-Clause
 */

/ {
	aliases {
		test-comp = &comp;
		led = &led0;
		/delete-property/ led1;
	};

	zephyr,user {
		test-gpios = <&gpio1 3 GPIO_ACTIVE_HIGH>;
	};
};

/delete-node/ &led1;

&gpio1 {
	status = "okay";
};
