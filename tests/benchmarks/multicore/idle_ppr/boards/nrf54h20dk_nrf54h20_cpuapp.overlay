/*
 * Copyright (c) 2024 Nordic Semiconductor ASA
 *
 * SPDX-License-Identifier: LicenseRef-Nordic-5-Clause
 */

&cpuppr_vpr {
	status = "okay";
};

/ {
	aliases {
		/delete-property/ led1;
	};
};

/delete-node/ &led1;

&gpiote130 {
	status = "okay";
	owned-channels = <0>;
};
