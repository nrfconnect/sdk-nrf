/*
 * Copyright (c) 2024 Nordic Semiconductor ASA
 *
 * SPDX-License-Identifier: LicenseRef-Nordic-5-Clause
 */

&cpuapp_data {
	reg = <0x2f000000 0x20000>;
};

&can120 {
	status = "disabled";
};

&usbhs {
	status = "disabled";
};
