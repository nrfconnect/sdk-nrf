/*
 * Copyright (c) 2025 Nordic Semiconductor ASA
 *
 * SPDX-License-Identifier: LicenseRef-Nordic-5-Clause
 */

&cpurad_ram0x_region {
	reg = <0x2f010000 0x1000>;
	ranges = <0x0 0x2f010000 0x1000>;
};

&cpuapp_ram0x_region {
	reg = <0x2f011000 0x41000>;
	ranges = <0x0 0x2f011000 0x41000>;
};

&cpuapp_data {
	reg = <0x1000 0x40000>;
};
