/*
 * Copyright (c) 2024 Nordic Semiconductor ASA
 *
 * SPDX-License-Identifier: LicenseRef-Nordic-5-Clause
 */

/* Note: updated as part of move to IronSide where the default size of this has increased.
 * At the time of writing the size used here is actually lower than the default.
 * Global RAM retention is now also not based on memory regions in UICR, but must be configured in
 * PERIPHCONF. So this likely needs further updates.
 */
&cpuapp_data {
	reg = <0x2f000000 0x90000>;
};

&can120 {
	status = "disabled";
};

&usbhs {
	status = "disabled";
};
