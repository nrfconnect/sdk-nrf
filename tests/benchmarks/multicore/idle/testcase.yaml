## tests/benchmarks/multicore/idle/testcase.yaml
```yaml
common:
  sysbuild: true
  tags:
    - ci_build
    - ci_tests_benchmarks_multicore
  harness_config:
    type: multi_line
    ordered: true
    regex:
      - "Multicore idle test on"
      - "Multicore idle test iteration 0"
      - "Multicore idle test iteration 1"

tests:
  benchmarks.multicore.idle.nrf5340dk_cpuapp_cpunet:
    harness: console
    platform_allow:
      - nrf5340dk/nrf5340/cpuapp
    integration_platforms:
      - nrf5340dk/nrf5340/cpuapp
    extra_args: SB_CONF_FILE=sysbuild/nrf5340dk_nrf5340_cpunet.conf

  benchmarks.multicore.idle.nrf5340dk_cpuapp_cpunet_mcuboot:
    harness: console
    platform_allow:
      - nrf5340dk/nrf5340/cpuapp
    integration_platforms:
      - nrf5340dk/nrf5340/cpuapp
    extra_configs:
      - CONFIG_BOOTLOADER_MCUBOOT=y
    extra_args: SB_CONF_FILE=sysbuild/nrf5340dk_nrf5340_cpunet.conf

  benchmarks.multicore.idle.nrf54h20dk_cpuapp_cpuppr:
    harness: console
    platform_allow:
      - nrf54h20dk/nrf54h20/cpuapp
    integration_platforms:
      - nrf54h20dk/nrf54h20/cpuapp
    extra_args:
      - SB_CONF_FILE=sysbuild/nrf54h20dk_nrf54h20_cpuppr.conf
      - idle_SNIPPET=nordic-ppr
      - CONFIG_FIRST_SLEEP_OFFSET=y

  benchmarks.multicore.idle.nrf54h20dk_cpuapp_cpuppr_xip:
    harness: console
    platform_allow:
      - nrf54h20dk/nrf54h20/cpuapp
    integration_platforms:
      - nrf54h20dk/nrf54h20/cpuapp
    extra_args:
      - SB_CONF_FILE=sysbuild/nrf54h20dk_nrf54h20_cpuppr_xip.conf
      - idle_SNIPPET=nordic-ppr-xip
      - CONFIG_FIRST_SLEEP_OFFSET=y

  benchmarks.multicore.idle.nrf54h20dk_cpuapp_cpurad:
    harness: console
    platform_allow:
      - nrf54h20dk/nrf54h20/cpuapp
    integration_platforms:
      - nrf54h20dk/nrf54h20/cpuapp
    extra_args:
      - CONFIG_SOC_NRF54H20_CPURAD_ENABLE=y
      - SB_CONF_FILE=sysbuild/nrf54h20dk_nrf54h20_cpurad.conf
      - CONFIG_FIRST_SLEEP_OFFSET=y

  benchmarks.multicore.idle.nrf54h20dk_cpuapp_cpurad.fpu:
    harness: console
    platform_allow:
      - nrf54h20dk/nrf54h20/cpuapp
    integration_platforms:
      - nrf54h20dk/nrf54h20/cpuapp
    extra_args:
      - CONFIG_SOC_NRF54H20_CPURAD_ENABLE=y
      - SB_CONF_FILE=sysbuild/nrf54h20dk_nrf54h20_cpurad.conf
      - CONFIG_FIRST_SLEEP_OFFSET=y
      - CONFIG_FPU=y

  benchmarks.multicore.idle.nrf54h20dk_cpuapp_cpurad.unexpected_reboot:
    platform_allow:
      - nrf54h20dk/nrf54h20/cpuapp
    integration_platforms:
      - nrf54h20dk/nrf54h20/cpuapp
    extra_args:
      - CONFIG_SOC_NRF54H20_CPURAD_ENABLE=y
      - SB_CONF_FILE=sysbuild/nrf54h20dk_nrf54h20_cpurad.conf
      - CONFIG_FIRST_SLEEP_OFFSET=y
    harness: pytest
    harness_config:
      fixture: ppk_power_measure
      pytest_root:
        - "${CUSTOM_ROOT_TEST_DIR}/test_measure_power_consumption.py::test_unexected_reboot_occurrence"
    tags: ppk_power_measure
    timeout: 110

  benchmarks.multicore.idle.nrf54h20dk_cpuapp_cpurad.s2ram:
    platform_allow:
      - nrf54h20dk/nrf54h20/cpuapp
    integration_platforms:
      - nrf54h20dk/nrf54h20/cpuapp
    extra_args:
      - SB_CONF_FILE=sysbuild/nrf54h20dk_nrf54h20_cpurad.conf
      - CONFIG_SOC_NRF54H20_CPURAD_ENABLE=y
      - CONFIG_FIRST_SLEEP_OFFSET=y
      - CONFIG_PM=y
      - CONFIG_PM_S2RAM=y
      - CONFIG_PM_DEVICE=y
      - CONFIG_PM_DEVICE_RUNTIME_ASYNC=n
      - CONFIG_POWEROFF=y
      - CONFIG_PM_S2RAM_CUSTOM_MARKING=y
      - CONFIG_CONSOLE=n
      - CONFIG_UART_CONSOLE=n
      - CONFIG_SERIAL=n
      - CONFIG_GPIO=n
      - CONFIG_BOOT_BANNER=n
      - remote_CONFIG_PM_DEVICE=y
      - remote_CONFIG_PM_DEVICE_RUNTIME_ASYNC=n
      - remote_CONFIG_PM=y
      - remote_CONFIG_POWEROFF=y
      - remote_CONFIG_CONSOLE=n
      - remote_CONFIG_UART_CONSOLE=n
      - remote_CONFIG_SERIAL=n
      - remote_CONFIG_GPIO=n
      - remote_CONFIG_BOOT_BANNER=n
    harness: pytest
    harness_config:
      fixture: lfclk_at_lfxo
      pytest_root:
        - "${CUSTOM_ROOT_TEST_DIR}/test_measure_power_consumption.py::test_measure_and_data_dump_power_consumption"
    tags: ppk_power_measure

  benchmarks.multicore.idle.nrf54h20dk_cpuapp_cpurad.s2ram.fpu:
    platform_allow:
      - nrf54h20dk/nrf54h20/cpuapp
    integration_platforms:
      - nrf54h20dk/nrf54h20/cpuapp
    extra_args:
      - SB_CONF_FILE=sysbuild/nrf54h20dk_nrf54h20_cpurad.conf
      - CONFIG_SOC_NRF54H20_CPURAD_ENABLE=y
      - CONFIG_FIRST_SLEEP_OFFSET=y
      - CONFIG_PM=y
      - CONFIG_PM_S2RAM=y
      - CONFIG_PM_DEVICE=y
      - CONFIG_PM_DEVICE_RUNTIME_ASYNC=n
      - CONFIG_POWEROFF=y
      - CONFIG_PM_S2RAM_CUSTOM_MARKING=y
      - CONFIG_CONSOLE=n
      - CONFIG_UART_CONSOLE=n
      - CONFIG_SERIAL=n
      - CONFIG_GPIO=n
      - CONFIG_BOOT_BANNER=n
      - CONFIG_FPU=y
      - remote_CONFIG_PM_DEVICE=y
      - remote_CONFIG_PM_DEVICE_RUNTIME_ASYNC=n
      - remote_CONFIG_PM=y
      - remote_CONFIG_POWEROFF=y
      - remote_CONFIG_CONSOLE=n
      - remote_CONFIG_UART_CONSOLE=n
      - remote_CONFIG_SERIAL=n
      - remote_CONFIG_GPIO=n
      - remote_CONFIG_BOOT_BANNER=n
    harness: pytest
    harness_config:
      fixture: lfclk_at_lfxo
      pytest_root:
        - "${CUSTOM_ROOT_TEST_DIR}/test_measure_power_consumption.py::test_measure_and_data_dump_power_consumption"
    tags: ppk_power_measure

  benchmarks.multicore.idle.nrf54h20dk_cpuapp_cpurad.ram_retention_high_usage:
    platform_allow:
      - nrf54h20dk/nrf54h20/cpuapp
    integration_platforms:
      - nrf54h20dk/nrf54h20/cpuapp
    extra_args:
      - SB_CONF_FILE=sysbuild/nrf54h20dk_nrf54h20_cpurad.conf
      - CONFIG_SOC_NRF54H20_CPURAD_ENABLE=y
      - CONFIG_FIRST_SLEEP_OFFSET=y
      - CONFIG_PM=y
      - CONFIG_PM_S2RAM=y
      - CONFIG_PM_DEVICE=y
      - CONFIG_PM_DEVICE_RUNTIME_ASYNC=n
      - CONFIG_POWEROFF=y
      - CONFIG_PM_S2RAM_CUSTOM_MARKING=y
      - CONFIG_CONSOLE=n
      - CONFIG_UART_CONSOLE=n
      - CONFIG_SERIAL=n
      - CONFIG_GPIO=n
      - CONFIG_BOOT_BANNER=n
      - remote_CONFIG_PM_DEVICE=y
      - remote_CONFIG_PM_DEVICE_RUNTIME_ASYNC=n
      - remote_CONFIG_PM=y
      - remote_CONFIG_POWEROFF=y
      - remote_CONFIG_CONSOLE=n
      - remote_CONFIG_UART_CONSOLE=n
      - remote_CONFIG_SERIAL=n
      - remote_CONFIG_GPIO=n
      - remote_CONFIG_BOOT_BANNER=n
      - DTC_OVERLAY_FILE="boards/nrf54h20dk_nrf54h20_cpuapp_ram_high_usage.overlay"
    harness: pytest
    harness_config:
      fixture: lfclk_at_lfxo
      pytest_root:
        - "${CUSTOM_ROOT_TEST_DIR}/test_measure_power_consumption.py::test_measure_and_data_dump_power_ram_retention_high_usage"
    tags: ppk_power_measure

  benchmarks.multicore.idle.nrf54h20dk_cpuapp_cpurad.ram_retention_low_usage:
    platform_allow:
      - nrf54h20dk/nrf54h20/cpuapp
    integration_platforms:
      - nrf54h20dk/nrf54h20/cpuapp
    extra_args:
      - SB_CONF_FILE=sysbuild/nrf54h20dk_nrf54h20_cpurad.conf
      - CONFIG_SOC_NRF54H20_CPURAD_ENABLE=y
      - CONFIG_FIRST_SLEEP_OFFSET=y
      - CONFIG_PM=y
      - CONFIG_PM_S2RAM=y
      - CONFIG_PM_DEVICE=y
      - CONFIG_PM_DEVICE_RUNTIME_ASYNC=n
      - CONFIG_POWEROFF=y
      - CONFIG_PM_S2RAM_CUSTOM_MARKING=y
      - CONFIG_CONSOLE=n
      - CONFIG_UART_CONSOLE=n
      - CONFIG_SERIAL=n
      - CONFIG_GPIO=n
      - CONFIG_BOOT_BANNER=n
      - remote_CONFIG_PM_DEVICE=y
      - remote_CONFIG_PM_DEVICE_RUNTIME_ASYNC=n
      - remote_CONFIG_PM=y
      - remote_CONFIG_POWEROFF=y
      - remote_CONFIG_CONSOLE=n
      - remote_CONFIG_UART_CONSOLE=n
      - remote_CONFIG_SERIAL=n
      - remote_CONFIG_GPIO=n
      - remote_CONFIG_BOOT_BANNER=n
      - DTC_OVERLAY_FILE="boards/nrf54h20dk_nrf54h20_cpuapp_ram_low_usage.overlay"
    harness: pytest
    harness_config:
      fixture: lfclk_at_lfxo
      pytest_root:
        - "${CUSTOM_ROOT_TEST_DIR}/test_measure_power_consumption.py::test_measure_and_data_dump_power_ram_retention_low_usage"
    tags: ppk_power_measure

  benchmarks.multicore.idle.nrf54h20dk_cpuapp_cpurad.s2ram.lfrc:
    platform_allow:
      - nrf54h20dk/nrf54h20/cpuapp
    integration_platforms:
      - nrf54h20dk/nrf54h20/cpuapp
    extra_args:
      - SB_CONF_FILE=sysbuild/nrf54h20dk_nrf54h20_cpurad.conf
      - CONFIG_SOC_NRF54H20_CPURAD_ENABLE=y
      - CONFIG_FIRST_SLEEP_OFFSET=y
      - CONFIG_PM=y
      - CONFIG_PM_S2RAM=y
      - CONFIG_PM_DEVICE=y
      - CONFIG_PM_DEVICE_RUNTIME_ASYNC=n
      - CONFIG_POWEROFF=y
      - CONFIG_PM_S2RAM_CUSTOM_MARKING=y
      - CONFIG_CONSOLE=n
      - CONFIG_UART_CONSOLE=n
      - CONFIG_SERIAL=n
      - CONFIG_GPIO=n
      - CONFIG_BOOT_BANNER=n
      - remote_CONFIG_PM_DEVICE=y
      - remote_CONFIG_PM_DEVICE_RUNTIME_ASYNC=n
      - remote_CONFIG_PM=y
      - remote_CONFIG_POWEROFF=y
      - remote_CONFIG_CONSOLE=n
      - remote_CONFIG_UART_CONSOLE=n
      - remote_CONFIG_SERIAL=n
      - remote_CONFIG_GPIO=n
      - remote_CONFIG_BOOT_BANNER=n
    harness: pytest
    harness_config:
      fixture: lfclk_at_lfrc
      pytest_root:
        - "${CUSTOM_ROOT_TEST_DIR}/test_measure_power_consumption.py::test_measure_and_data_dump_power_consumption_lfrc"
    tags: ppk_power_measure

  benchmarks.multicore.idle.nrf54h20dk_cpuapp_cpurad.ram_retention_high_usage.lfrc:
    platform_allow:
      - nrf54h20dk/nrf54h20/cpuapp
    integration_platforms:
      - nrf54h20dk/nrf54h20/cpuapp
    extra_args:
      - SB_CONF_FILE=sysbuild/nrf54h20dk_nrf54h20_cpurad.conf
      - CONFIG_SOC_NRF54H20_CPURAD_ENABLE=y
      - CONFIG_FIRST_SLEEP_OFFSET=y
      - CONFIG_PM=y
      - CONFIG_PM_S2RAM=y
      - CONFIG_PM_DEVICE=y
      - CONFIG_PM_DEVICE_RUNTIME_ASYNC=n
      - CONFIG_POWEROFF=y
      - CONFIG_PM_S2RAM_CUSTOM_MARKING=y
      - CONFIG_CONSOLE=n
      - CONFIG_UART_CONSOLE=n
      - CONFIG_SERIAL=n
      - CONFIG_GPIO=n
      - CONFIG_BOOT_BANNER=n
      - remote_CONFIG_PM_DEVICE=y
      - remote_CONFIG_PM_DEVICE_RUNTIME_ASYNC=n
      - remote_CONFIG_PM=y
      - remote_CONFIG_POWEROFF=y
      - remote_CONFIG_CONSOLE=n
      - remote_CONFIG_UART_CONSOLE=n
      - remote_CONFIG_SERIAL=n
      - remote_CONFIG_GPIO=n
      - remote_CONFIG_BOOT_BANNER=n
      - DTC_OVERLAY_FILE="boards/nrf54h20dk_nrf54h20_cpuapp_ram_high_usage.overlay"
    harness: pytest
    harness_config:
      fixture: lfclk_at_lfrc
      pytest_root:
        - "${CUSTOM_ROOT_TEST_DIR}/test_measure_power_consumption.py::test_measure_and_data_dump_power_ram_retention_high_usage_lfrc"
    tags: ppk_power_measure

  benchmarks.multicore.idle.nrf54h20dk_cpuapp_cpurad.ram_retention_low_usage.lfrc:
    platform_allow:
      - nrf54h20dk/nrf54h20/cpuapp
    integration_platforms:
      - nrf54h20dk/nrf54h20/cpuapp
    extra_args:
      - SB_CONF_FILE=sysbuild/nrf54h20dk_nrf54h20_cpurad.conf
      - CONFIG_SOC_NRF54H20_CPURAD_ENABLE=y
      - CONFIG_FIRST_SLEEP_OFFSET=y
      - CONFIG_PM=y
      - CONFIG_PM_S2RAM=y
      - CONFIG_PM_DEVICE=y
      - CONFIG_PM_DEVICE_RUNTIME_ASYNC=n
      - CONFIG_POWEROFF=y
      - CONFIG_PM_S2RAM_CUSTOM_MARKING=y
      - CONFIG_CONSOLE=n
      - CONFIG_UART_CONSOLE=n
      - CONFIG_SERIAL=n
      - CONFIG_GPIO=n
      - CONFIG_BOOT_BANNER=n
      - remote_CONFIG_PM_DEVICE=y
      - remote_CONFIG_PM_DEVICE_RUNTIME_ASYNC=n
      - remote_CONFIG_PM=y
      - remote_CONFIG_POWEROFF=y
      - remote_CONFIG_CONSOLE=n
      - remote_CONFIG_UART_CONSOLE=n
      - remote_CONFIG_SERIAL=n
      - remote_CONFIG_GPIO=n
      - remote_CONFIG_BOOT_BANNER=n
      - DTC_OVERLAY_FILE="boards/nrf54h20dk_nrf54h20_cpuapp_ram_low_usage.overlay"
    harness: pytest
    harness_config:
      fixture: lfclk_at_lfrc
      pytest_root:
        - "${CUSTOM_ROOT_TEST_DIR}/test_measure_power_consumption.py::test_measure_and_data_dump_power_ram_retention_low_usage_lfrc"
    tags: ppk_power_measure
```

## tests/benchmarks/multicore/idle_adc/Kconfig
```kconfig
#
# Copyright (c) 2025 Nordic Semiconductor ASA
#
# SPDX-License-Identifier: LicenseRef-Nordic-5-Clause
#
config SOC_NRF54H20_CPUPPR
	select HAS_PM
	select HAS_POWEROFF

source "Kconfig.zephyr"
```

## tests/benchmarks/multicore/idle_adc/testcase.yaml
```yaml
common:
  sysbuild: true
  depends_on: adc
  extra_args:
    - CONFIG_SOC_NRF54H20_CPURAD_ENABLE=y

tests:
  benchmarks.multicore.idle_adc.nrf54h20dk_cpuapp_cpurad.s2ram:
    tags:
      - ci_build
      - ci_tests_benchmarks_multicore
      - ppk_power_measure
    filter: not CONFIG_COVERAGE
    harness: pytest
    platform_allow:
      - nrf54h20dk/nrf54h20/cpuapp
    integration_platforms:
      - nrf54h20dk/nrf54h20/cpuapp
    harness_config:
      fixture: gpio_loopback
      pytest_root:
        - "${CUSTOM_ROOT_TEST_DIR}/test_measure_power_consumption.py::test_measure_and_data_dump_power_consumption_adc"

  benchmarks.multicore.idle_adc.nrf54h20dk_cpuppr.s2ram:
    tags:
      - ci_build
      - ci_tests_benchmarks_multicore
      - ppk_power_measure
    harness: pytest
    platform_allow:
      - nrf54h20dk/nrf54h20/cpuppr
    integration_platforms:
      - nrf54h20dk/nrf54h20/cpuppr
    harness_config:
      fixture: gpio_loopback
      pytest_root:
        - "${CUSTOM_ROOT_TEST_DIR}/test_measure_power_consumption.py::test_measure_and_data_dump_power_consumption_adc_ppr"

  benchmarks.multicore.idle_adc.nrf54h20dk_cpuapp_cpurad.s2ram.mcuboot:
    tags:
      - ci_build
      - ci_tests_benchmarks_multicore
      - ppk_power_measure
    filter: not CONFIG_COVERAGE
    harness: pytest
    platform_allow:
      - nrf54h20dk/nrf54h20/cpuapp
    integration_platforms:
      - nrf54h20dk/nrf54h20/cpuapp
    extra_args:
      - SB_CONFIG_BOOTLOADER_MCUBOOT=y
      - mcuboot_EXTRA_DTC_OVERLAY_FILE="${ZEPHYR_NRF_MODULE_DIR}/tests/benchmarks/multicore/idle_adc/boards/nrf54h20dk_mcuboot.overlay"
    harness_config:
      fixture: gpio_loopback
      pytest_root:
        - "${CUSTOM_ROOT_TEST_DIR}/test_measure_power_consumption.py::test_measure_and_data_dump_power_consumption_adc"

  benchmarks.multicore.idle_adc.nrf54h20dk_cpuapp_cpurad.coverage:
    tags:
      - ci_build
      - ci_tests_benchmarks_multicore
      - adc
    filter: CONFIG_COVERAGE
    platform_allow:
      - nrf54h20dk/nrf54h20/cpuapp
    integration_platforms:
      - nrf54h20dk/nrf54h20/cpuapp
    extra_args:
      - CONF_FILE=coverage.conf
      - EXTRA_DTC_OVERLAY_FILE="disable_s2ram.overlay"
      - SNIPPET=coverage_support
    harness: console
    harness_config:
      fixture: gpio_loopback
      type: multi_line
      ordered: true
      regex:
        - ".*Coverage analysis enabled.*"
        - ".*Coverage analysis start.*"
```

## tests/benchmarks/multicore/idle_clock_control/Kconfig.sysbuild
```kconfig
#
# Copyright (c) 2024 Nordic Semiconductor ASA
#
# SPDX-License-Identifier: LicenseRef-Nordic-5-Clause
#

config REMOTE_BOARD
	string
	default "$(BOARD)/nrf54h20/cpurad" if SOC_NRF54H20_CPUAPP
	default "$(BOARD)/nrf54h20/cpuapp" if SOC_NRF54H20_CPURAD

source "share/sysbuild/Kconfig"
```
