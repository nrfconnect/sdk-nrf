## tests/benchmarks/multicore/idle_clock_control/testcase.yaml
```yaml
common:
  sysbuild: true

tests:
  benchmarks.multicore.idle_clock_control.app:
    tags:
      - ci_build
      - ci_tests_benchmarks_multicore
      - ppk_power_measure
    filter: not CONFIG_COVERAGE
    harness: pytest
    platform_allow:
      - nrf54h20dk/nrf54h20/cpuapp
    integration_platforms:
      - nrf54h20dk/nrf54h20/cpuapp
    harness_config:
      fixture: lfclk_at_lfxo
      pytest_root:
        - "${CUSTOM_ROOT_TEST_DIR}/test_measure_power_consumption.py::test_measure_and_data_dump_power_consumption_clock_control"
    timeout: 90

  # note: in this scenario cpuapp is the 'remote'
  benchmarks.multicore.idle_clock_control.rad:
    tags:
      - ci_build
      - ci_tests_benchmarks_multicore
      - ppk_power_measure
    filter: not CONFIG_COVERAGE
    harness: pytest
    platform_allow:
      - nrf54h20dk/nrf54h20/cpurad
    integration_platforms:
      - nrf54h20dk/nrf54h20/cpurad
    extra_args:
      - remote_CONFIG_PM_DEVICE=y
      - remote_CONFIG_PM_DEVICE_RUNTIME=y
      - remote_CONFIG_BOOT_BANNER=n
      - remote_CONFIG_NCS_BOOT_BANNER=n
      - remote_CONFIG_CLOCK_CONTROL=n
      - remote_CONFIG_SOC_NRF54H20_CPURAD_ENABLE=y
    harness_config:
      fixture: lfclk_at_lfxo
      pytest_root:
        - "${CUSTOM_ROOT_TEST_DIR}/test_measure_power_consumption.py::test_measure_and_data_dump_power_consumption_clock_control"
    timeout: 90

  benchmarks.multicore.idle_clock_control.app.lfrc:
    tags:
      - ci_build
      - ci_tests_benchmarks_multicore
      - ppk_power_measure
    filter: not CONFIG_COVERAGE
    harness: pytest
    platform_allow:
      - nrf54h20dk/nrf54h20/cpuapp
    integration_platforms:
      - nrf54h20dk/nrf54h20/cpuapp
    harness_config:
      fixture: lfclk_at_lfrc
      pytest_root:
        - "${CUSTOM_ROOT_TEST_DIR}/test_measure_power_consumption.py::test_measure_and_data_dump_power_consumption_clock_control"
    timeout: 90
    extra_args:
      - CONFIG_AT_LFRC=y

  # note: in this scenario cpuapp is the 'remote'
  benchmarks.multicore.idle_clock_control.rad.lfrc:
    tags:
      - ci_build
      - ci_tests_benchmarks_multicore
      - ppk_power_measure
    filter: not CONFIG_COVERAGE
    harness: pytest
    platform_allow:
      - nrf54h20dk/nrf54h20/cpurad
    integration_platforms:
      - nrf54h20dk/nrf54h20/cpurad
    extra_args:
      - CONFIG_AT_LFRC=y
      - remote_CONFIG_PM_DEVICE=y
      - remote_CONFIG_PM_DEVICE_RUNTIME=y
      - remote_CONFIG_BOOT_BANNER=n
      - remote_CONFIG_NCS_BOOT_BANNER=n
      - remote_CONFIG_CLOCK_CONTROL=n
      - remote_CONFIG_SOC_NRF54H20_CPURAD_ENABLE=y
    harness_config:
      fixture: lfclk_at_lfrc
      pytest_root:
        - "${CUSTOM_ROOT_TEST_DIR}/test_measure_power_consumption.py::test_measure_and_data_dump_power_consumption_clock_control"
    timeout: 90

  benchmarks.multicore.idle_clock_control.coverage:
    tags:
      - ci_build
      - ci_tests_benchmarks_multicore
    filter: CONFIG_COVERAGE
    harness: console
    harness_config:
      type: multi_line
      regex:
        - ".*Start testing.*"
        - ".*Testing done.*"
    extra_args:
      - CONF_FILE=coverage.conf
      - SNIPPET=coverage_support
    platform_allow:
      - nrf54h20dk/nrf54h20/cpuapp
```

## tests/benchmarks/multicore/idle_comp/testcase.yaml
```yaml
common:
  sysbuild: true
  extra_args:
    - CONFIG_SOC_NRF54H20_CPURAD_ENABLE=y

tests:
  benchmarks.multicore.idle_comp.nrf54h20dk_cpuapp_cpurad.s2ram:
    tags:
      - ci_build
      - ci_tests_benchmarks_multicore
      - ppk_power_measure
    filter: not CONFIG_COVERAGE
    harness: pytest
    platform_allow:
      - nrf54h20dk/nrf54h20/cpuapp
    integration_platforms:
      - nrf54h20dk/nrf54h20/cpuapp
    extra_args:
      - EXTRA_DTC_OVERLAY_FILE="boards/comp.overlay"
    harness_config:
      fixture: gpio_loopback
      pytest_root:
        - "${CUSTOM_ROOT_TEST_DIR}/test_measure_power_consumption.py::test_measure_and_data_dump_power_consumption_comp"

  benchmarks.multicore.idle_comp.nrf54h20dk_cpuapp_cpurad.s2ram.mcuboot:
    tags:
      - ci_build
      - ci_tests_benchmarks_multicore
      - ppk_power_measure
    filter: not CONFIG_COVERAGE
    harness: pytest
    platform_allow:
      - nrf54h20dk/nrf54h20/cpuapp
    integration_platforms:
      - nrf54h20dk/nrf54h20/cpuapp
    extra_args:
      - SB_CONFIG_BOOTLOADER_MCUBOOT=y
      - mcuboot_EXTRA_DTC_OVERLAY_FILE="${ZEPHYR_NRF_MODULE_DIR}/tests/benchmarks/multicore/idle_comp/boards/nrf54h20dk_nrf54h20_cpuapp.overlay"
      - EXTRA_DTC_OVERLAY_FILE="boards/comp.overlay"
    harness_config:
      fixture: gpio_loopback
      pytest_root:
        - "${CUSTOM_ROOT_TEST_DIR}/test_measure_power_consumption.py::test_measure_and_data_dump_power_consumption_comp"

  benchmarks.multicore.idle_lpcomp.nrf54h20dk_cpuapp_cpurad.s2ram:
    tags:
      - ci_build
      - ci_tests_benchmarks_multicore
      - ppk_power_measure
    filter: not CONFIG_COVERAGE
    harness: pytest
    platform_allow:
      - nrf54h20dk/nrf54h20/cpuapp
    integration_platforms:
      - nrf54h20dk/nrf54h20/cpuapp
    extra_args:
      - EXTRA_DTC_OVERLAY_FILE="boards/lpcomp.overlay"
    harness_config:
      fixture: gpio_loopback
      pytest_root:
        - "${CUSTOM_ROOT_TEST_DIR}/test_measure_power_consumption.py::test_measure_and_data_dump_power_consumption_comp"

  benchmarks.multicore.idle_lpcomp.nrf54h20dk_cpuapp_cpurad.coverage:
    tags:
      - ci_build
      - ci_tests_benchmarks_multicore
    filter: CONFIG_COVERAGE
    platform_allow:
      - nrf54h20dk/nrf54h20/cpuapp
    integration_platforms:
      - nrf54h20dk/nrf54h20/cpuapp
    extra_args:
      - EXTRA_DTC_OVERLAY_FILE="boards/lpcomp.overlay;disable_s2ram.overlay"
      - CONF_FILE=coverage.conf
      - SHIELD=coverage_support
    harness: console
    harness_config:
      fixture: gpio_loopback
      type: multi_line
      ordered: true
      regex:
        - ".*Coverage analysis enabled.*"
        - ".*Coverage analysis start.*"
```

## tests/benchmarks/multicore/idle_counter/remote/Kconfig
```kconfig
#
# Copyright (c) 2025 Nordic Semiconductor ASA
#
# SPDX-License-Identifier: LicenseRef-Nordic-5-Clause
#

config TEST_SLEEP_DURATION_MS
	int "Core sleep duration (miliseconds)"
	default 1000
	help
	  Set sleep duration to TEST_SLEEP_DURATION_MS miliseconds.
	  Based on the value of 'min-residency-us' specified for each power state defined in the DTS,
	  core enters the lowest possible power state.

config TEST_ROLE_REMOTE
	bool "Execute test variant for Remote core"
	default y
	help
	  KConfig used in synchronization phase.
	  Set TEST_ROLE_REMOTE=y on core that shall synchronize with the Host core.

source "Kconfig.zephyr"
```

## tests/benchmarks/multicore/idle_exmif/testcase.yaml
```yaml
common:
  sysbuild: true
  depends_on: spi
  extra_args:
    - CONFIG_SOC_NRF54H20_CPURAD_ENABLE=y

tests:
  benchmarks.multicore.idle_exmif.nrf54h20dk_cpuapp_cpurad:
    tags:
      - ci_build
      - ci_tests_benchmarks_multicore
      - exmif
      - ppk_power_measure
    filter: not CONFIG_COVERAGE
    platform_allow:
      - nrf54h20dk/nrf54h20/cpuapp
    integration_platforms:
      - nrf54h20dk/nrf54h20/cpuapp
    harness: pytest
    harness_config:
      fixture: ppk_power_measure
      pytest_root:
        - "${CUSTOM_ROOT_TEST_DIR}/test_measure_power_consumption.py::test_measure_and_data_dump_exmif_and_s2ram"
    timeout: 90

  benchmarks.multicore.idle_exmif.nrf54h20dk_cpuapp_cpurad.mcuboot:
    tags:
      - ci_build
      - ci_tests_benchmarks_multicore
      - exmif
      - ppk_power_measure
    filter: not CONFIG_COVERAGE
    platform_allow:
      - nrf54h20dk/nrf54h20/cpuapp
    integration_platforms:
      - nrf54h20dk/nrf54h20/cpuapp
    extra_args:
      - SB_CONFIG_BOOTLOADER_MCUBOOT=y
      - mcuboot_EXTRA_DTC_OVERLAY_FILE="${ZEPHYR_NRF_MODULE_DIR}/tests/benchmarks/multicore/idle_exmif/boards/nrf54h20dk_mcuboot.overlay"
    harness: pytest
    harness_config:
      fixture: ppk_power_measure
      pytest_root:
        - "${CUSTOM_ROOT_TEST_DIR}/test_measure_power_consumption.py::test_measure_and_data_dump_exmif_and_s2ram"
    timeout: 90

  benchmarks.multicore.idle_exmif.nrf54h20dk_cpuapp_cpurad.coverage:
    tags:
      - ci_build
      - ci_tests_benchmarks_multicore
      - exmif
    filter: CONFIG_COVERAGE
    platform_allow:
      - nrf54h20dk/nrf54h20/cpuapp
    integration_platforms:
      - nrf54h20dk/nrf54h20/cpuapp
    extra_args:
      - CONF_FILE=coverage.conf
      - EXTRA_DTC_OVERLAY_FILE="disable_s2ram.overlay"
      - SHIELD=coverage_support
    harness: console
    harness_config:
      type: multi_line
      ordered: true
      regex:
        - ".*Coverage analysis enabled.*"
        - ".*Coverage analysis start.*"
```

## tests/benchmarks/multicore/idle_flpr/Kconfig.sysbuild
```kconfig
#
# Copyright (c) 2026 Nordic Semiconductor ASA
#
# SPDX-License-Identifier: LicenseRef-Nordic-5-Clause
#

config SUPPORT_FLPRCORE_TESTAPP
	bool
	default y

choice FLPRCORE

config FLPRCORE_TESTAPP
	bool "testapp image"

endchoice

if !FLPRCORE_NONE

config FLPRCORE_IMAGE_NAME
	default "flpr_test_app" if FLPRCORE_TESTAPP

config FLPRCORE_IMAGE_PATH
	default "${ZEPHYR_NRF_MODULE_DIR}/tests/benchmarks/multicore/idle_flpr/flpr_test_app" if FLPRCORE_TESTAPP

endif # !FLPRCORE_NONE

source "share/sysbuild/Kconfig"
```

## tests/benchmarks/multicore/idle_flpr/testcase.yaml
```yaml
common:
  sysbuild: true
  tags:
    - ci_build
    - ci_tests_benchmarks_multicore
  platform_allow:
    - nrf54h20dk/nrf54h20/cpuapp
  integration_platforms:
    - nrf54h20dk/nrf54h20/cpuapp

tests:
  benchmarks.multicore.idle_flpr.no_sleep:
    required_snippets:
      - nordic-log-stm
    harness: console
    harness_config:
      type: multi_line
      ordered: true
      regex:
        - "app/idle_flpr: Multicore idle_flpr test on"
        - "flpr/idle_flpr: Multicore idle_flpr test on"
        - "idle_flpr: Run 0"
        - "idle_flpr: Run 1"

  benchmarks.multicore.idle_flpr.idle:
    tags: ppk_power_measure
    extra_args:
      - idle_flpr_CONF_FILE=prj_s2ram.conf
      - remote_flpr_CONF_FILE=prj_s2ram.conf
      - idle_flpr_CONFIG_TEST_SLEEP_DURATION_MS=500
      - remote_flpr_CONFIG_TEST_SLEEP_DURATION_MS=500
      - idle_flpr_EXTRA_DTC_OVERLAY_FILE="${ZEPHYR_NRF_MODULE_DIR}/tests/benchmarks/multicore/common/workaround_idle.overlay"
    harness: pytest
    harness_config:
      fixture: ppk_power_measure
      pytest_root:
        - "${CUSTOM_ROOT_TEST_DIR}/test_measure_power_consumption.py::test_measure_and_data_dump_ppr_and_idle"

  benchmarks.multicore.idle_flpr.s2ram:
    tags: ppk_power_measure
    extra_args:
      - idle_flpr_CONF_FILE=prj_s2ram.conf
      - remote_flpr_CONF_FILE=prj_s2ram.conf
    harness: pytest
    harness_config:
      fixture: ppk_power_measure
      pytest_root:
        - "${CUSTOM_ROOT_TEST_DIR}/test_measure_power_consumption.py::test_measure_and_data_dump_ppr_and_s2ram"
```

## tests/benchmarks/multicore/idle_gpio/Kconfig
```kconfig
#
# Copyright (c) 2026 Nordic Semiconductor ASA
#
# SPDX-License-Identifier: LicenseRef-Nordic-5-Clause
#

config GPIOTE_LATENCY_LOWPOWER
	bool "Set GPIOTE latency to low power"

source "Kconfig.zephyr"
```

## tests/benchmarks/multicore/idle_gpio/Kconfig.sysbuild
```kconfig
#
# Copyright (c) 2024 Nordic Semiconductor ASA
#
# SPDX-License-Identifier: LicenseRef-Nordic-5-Clause
#

source "share/sysbuild/Kconfig"

config RUN_PPRCORE
	bool "Run test on Peripheral Processor Core (PPR)"

choice PPRCORE
	default PPRCORE_REMOTE if RUN_PPRCORE

config PPRCORE_REMOTE
	bool "Remote image"

endchoice

config PPRCORE_IMAGE_NAME
	default "remote" if PPRCORE_REMOTE

config PPRCORE_IMAGE_PATH
	default "${ZEPHYR_NRF_MODULE_DIR}/tests/benchmarks/multicore/idle_gpio/remote" if PPRCORE_REMOTE

choice NETCORE
	default NETCORE_REMOTE if PPRCORE_NONE
	default NETCORE_REMOTE_SLEEP_FOREVER if !PPRCORE_NONE

config NETCORE_REMOTE
	bool "Remote image"

config NETCORE_REMOTE_SLEEP_FOREVER
	bool "Remote sleep forever image"

endchoice

config NETCORE_IMAGE_NAME
	default "remote" if NETCORE_REMOTE
	default "remote_sleep_forever" if NETCORE_REMOTE_SLEEP_FOREVER

config NETCORE_IMAGE_PATH
	default "${ZEPHYR_NRF_MODULE_DIR}/tests/benchmarks/multicore/idle_gpio/remote" if NETCORE_REMOTE
	default "${ZEPHYR_NRF_MODULE_DIR}/tests/benchmarks/power_consumption/common/remote_sleep_forever" if NETCORE_REMOTE_SLEEP_FOREVER
```

## tests/benchmarks/multicore/idle_gpio/remote/boards/nrf9251dk_nrf9251_cpuppr.conf
```kconfig
# Used to manually configure the GPIO pin to NS
CONFIG_NRF_PERIPHCONF_SECTION=y
CONFIG_NRF_PERIPHCONF_GENERATE_ENTRIES=n
```
