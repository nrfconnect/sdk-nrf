## tests/benchmarks/multicore/idle_gpio/testcase.yaml
```yaml
common:
  sysbuild: true
  tags:
    - ci_build
    - ci_tests_benchmarks_multicore
  harness_config:
    type: multi_line
    ordered: true
    regex:
      - "Multicore idle_gpio test on"
      - "Multicore idle_gpio test iteration 0"

tests:
  benchmarks.multicore.idle_gpio.nrf54h20dk_cpuapp_cpurad.s2ram:
    platform_allow:
      - nrf54h20dk/nrf54h20/cpuapp
    integration_platforms:
      - nrf54h20dk/nrf54h20/cpuapp
    extra_args:
      - FILE_SUFFIX=s2ram
      - SB_CONFIG_NETCORE_REMOTE=y
    harness: pytest
    harness_config:
      fixture: ppk_power_measure
      pytest_root:
        - "${CUSTOM_ROOT_TEST_DIR}/test_measure_power_consumption.py::test_measure_and_data_dump_power_consumption_simple"
    tags: ppk_power_measure

  benchmarks.multicore.idle_gpio.nrf54h20dk_cpuapp_cpuppr.s2ram:
    platform_allow:
      - nrf54h20dk/nrf54h20/cpuapp
    integration_platforms:
      - nrf54h20dk/nrf54h20/cpuapp
    extra_args:
      - FILE_SUFFIX=s2ram
      - SB_CONFIG_NETCORE_REMOTE_SLEEP_FOREVER=y
      - SB_CONFIG_PPRCORE_REMOTE=y
    harness: pytest
    harness_config:
      fixture: ppk_power_measure
      pytest_root:
        - "${CUSTOM_ROOT_TEST_DIR}/test_measure_power_consumption.py::test_measure_and_data_dump_power_consumption_simple"
    tags: ppk_power_measure

  benchmarks.multicore.idle_gpio.nrf54h20dk_cpuapp_cpurad.s2ram.mcuboot:
    platform_allow:
      - nrf54h20dk/nrf54h20/cpuapp
    integration_platforms:
      - nrf54h20dk/nrf54h20/cpuapp
    extra_args:
      - SB_CONFIG_BOOTLOADER_MCUBOOT=y
      - FILE_SUFFIX=s2ram
      - mcuboot_EXTRA_DTC_OVERLAY_FILE="${ZEPHYR_NRF_MODULE_DIR}/tests/benchmarks/multicore/idle_gpio/boards/nrf54h20dk_nrf54h20_cpuapp_s2ram.overlay"
      - SB_CONFIG_NETCORE_REMOTE=y
    harness: pytest
    harness_config:
      fixture: ppk_power_measure
      pytest_root:
        - "${CUSTOM_ROOT_TEST_DIR}/test_measure_power_consumption.py::test_measure_and_data_dump_power_consumption_simple"
    tags: ppk_power_measure

  benchmarks.multicore.idle_gpio.nrf54h20dk_cpuapp_cpurad.s2ram.mcuboot.direct_xip:
    platform_allow:
      - nrf54h20dk/nrf54h20/cpuapp
    integration_platforms:
      - nrf54h20dk/nrf54h20/cpuapp
    extra_args:
      - FILE_SUFFIX=s2ram_merged_slot
      - SB_CONFIG_BOOTLOADER_MCUBOOT=y
      - SB_EXTRA_CONF_FILE="sysbuild/sysbuild_merged_slot.conf"
      - SB_CONFIG_NETCORE_REMOTE=y
    harness: pytest
    harness_config:
      fixture: ppk_power_measure
      pytest_root:
        - "${CUSTOM_ROOT_TEST_DIR}/test_measure_power_consumption.py::test_measure_and_data_dump_power_consumption_simple"
    tags: ppk_power_measure

  benchmarks.multicore.idle_gpio.nrf54h20dk_cpuapp_cpurad.s2ram.wakeup_from_uart_pins:
    platform_allow:
      - nrf54h20dk/nrf54h20/cpuapp
    integration_platforms:
      - nrf54h20dk/nrf54h20/cpuapp
    extra_args:
      - FILE_SUFFIX=s2ram
      - EXTRA_DTC_OVERLAY_FILE="wakeup_from_uart_pins.overlay"
      - SB_CONFIG_NETCORE_REMOTE=y
      - remote_EXTRA_DTC_OVERLAY_FILE="wakeup_from_uart_pins.overlay"
    harness: pytest
    harness_config:
      fixture: gpio_loopback
      pytest_root:
        - "${CUSTOM_ROOT_TEST_DIR}/test_measure_power_consumption.py::test_measure_and_data_dump_power_consumption_with_wakeups_two_cores"
    timeout: 120
    tags: ppk_power_measure

  benchmarks.multicore.idle_gpio.nrf54h20dk_cpuapp_cpurad.s2ram.wakeup_from_uart_pins.cpurad_gpiote0:
    platform_allow:
      - nrf54h20dk/nrf54h20/cpuapp
    integration_platforms:
      - nrf54h20dk/nrf54h20/cpuapp
    extra_args:
      - FILE_SUFFIX=s2ram
      - EXTRA_DTC_OVERLAY_FILE="wakeup_from_uart_pins.overlay"
      - SB_CONFIG_NETCORE_REMOTE=y
      - remote_EXTRA_DTC_OVERLAY_FILE="wakeup_from_uart_pins_gpiote0.overlay"
    harness: pytest
    harness_config:
      fixture: gpio_loopback
      pytest_root:
        - "${CUSTOM_ROOT_TEST_DIR}/test_measure_power_consumption.py::test_measure_and_data_dump_power_consumption_with_wakeups_two_cores_int_edge"
    timeout: 120
    tags: ppk_power_measure

  benchmarks.multicore.idle_gpio.nrf54h20dk_cpuapp_cpurad.s2ram.wakeup_from_uart_pins.cpurad_gpiote0.latency_low_power:
    platform_allow:
      - nrf54h20dk/nrf54h20/cpuapp
    integration_platforms:
      - nrf54h20dk/nrf54h20/cpuapp
    extra_args:
      - FILE_SUFFIX=s2ram
      - EXTRA_DTC_OVERLAY_FILE="wakeup_from_uart_pins.overlay"
      - SB_CONFIG_NETCORE_REMOTE=y
      - remote_EXTRA_DTC_OVERLAY_FILE="wakeup_from_uart_pins_gpiote0.overlay"
      - remote_CONFIG_TEST_GPIOTE_LATENCY_LOWPOWER=y
    harness: pytest
    harness_config:
      fixture: gpio_loopback
      pytest_root:
        - "${CUSTOM_ROOT_TEST_DIR}/test_measure_power_consumption.py::test_measure_and_data_dump_power_consumption_with_wakeups_two_cores_int_edge"
    timeout: 120
    tags: ppk_power_measure

  benchmarks.multicore.idle_gpio.nrf54h20dk_cpuapp_cpuppr.s2ram.wakeup_from_uart_pins:
    platform_allow:
      - nrf54h20dk/nrf54h20/cpuapp
    integration_platforms:
      - nrf54h20dk/nrf54h20/cpuapp
    extra_args:
      - FILE_SUFFIX=s2ram
      - EXTRA_DTC_OVERLAY_FILE="wakeup_from_uart_pins.overlay"
      - SB_CONFIG_NETCORE_REMOTE_SLEEP_FOREVER=y
      - SB_CONFIG_PPRCORE_REMOTE=y
      - remote_EXTRA_DTC_OVERLAY_FILE="wakeup_from_uart_pins.overlay"
    harness: pytest
    harness_config:
      fixture: gpio_loopback
      pytest_root:
        - "${CUSTOM_ROOT_TEST_DIR}/test_measure_power_consumption.py::test_measure_and_data_dump_power_consumption_with_wakeups_two_cores"
    timeout: 120
    tags: ppk_power_measure
```

## tests/benchmarks/multicore/idle_grtc/testcase.yaml
```yaml
common:
  sysbuild: true

tests:
  benchmarks.multicore.idle_grtc:
    tags:
      - ci_build
      - ci_tests_benchmarks_multicore
      - timer
      - ppk_power_measure
    platform_allow:
      - nrf54h20dk/nrf54h20/cpuppr
    integration_platforms:
      - nrf54h20dk/nrf54h20/cpuppr
    extra_args:
      - vpr_launcher_CONFIG_SOC_NRF54H20_CPURAD_ENABLE=y
      - vpr_launcher_EXTRA_CONF_FILE=${ZEPHYR_NRF_MODULE_DIR}/tests/benchmarks/multicore/idle_grtc/vpr_launcher.conf
      - vpr_launcher_EXTRA_DTC_OVERLAY_FILE=${ZEPHYR_NRF_MODULE_DIR}/tests/benchmarks/multicore/idle_grtc/boards/nrf54h20dk_nrf54h20_cpuapp.overlay
    harness: pytest
    harness_config:
      fixture: ppk_power_measure
      pytest_root:
        - "${CUSTOM_ROOT_TEST_DIR}/test_measure_power_consumption.py::test_measure_power_consumption_idle_grtc"
```

## tests/benchmarks/multicore/idle_hpu_temp_meas/testcase.yaml
```yaml
common:
  sysbuild: true
  tags: ci_build ci_tests_benchmarks_multicore hpu ppk_power_measure

tests:
  benchmarks.multicore.idle_hpu_temp_meas:
    harness: pytest
    platform_allow:
      - nrf54h20dk/nrf54h20/cpuapp
    integration_platforms:
      - nrf54h20dk/nrf54h20/cpuapp
    extra_args:
      - SB_CONF_FILE=sysbuild/nrf54h20dk_nrf54h20_cpurad.conf
    harness_config:
      fixture: ppk_power_measure
      pytest_root:
        - "${CUSTOM_ROOT_TEST_DIR}/test_measure_power_consumption.py::test_measure_and_data_dump_power_consumption_hpu_feature"
    timeout: 120
```

## tests/benchmarks/multicore/idle_ipc/Kconfig.common
```kconfig
#
# Copyright (c) 2024 Nordic Semiconductor ASA
#
# SPDX-License-Identifier: LicenseRef-Nordic-5-Clause
#

config APP_IPC_SERVICE_MESSAGE_LEN
	int "Length of single IPC message in bytes"
	default 100

config TEST_START_DELAY_MS
	int "Delay for test startup [ms]"
	default 0

config SLEEP_TIME_MS
	int "Core sleep time [ms]"
	default 1000
```

## tests/benchmarks/multicore/idle_ipc/testcase.yaml
```yaml
common:
  sysbuild: true
  extra_args:
    - CONFIG_SOC_NRF54H20_CPURAD_ENABLE=y

tests:
  benchmarks.multicore.idle_ipc.nrf54h20dk_cpuapp_cpurad.s2ram:
    tags:
      - ci_build
      - ci_tests_benchmarks_multicore
      - ipc
      - ppk_power_measure
    filter: not CONFIG_COVERAGE
    harness: pytest
    platform_allow:
      - nrf54h20dk/nrf54h20/cpuapp
    integration_platforms:
      - nrf54h20dk/nrf54h20/cpuapp
    harness_config:
      fixture: ppk_power_measure
      pytest_root:
        - "${CUSTOM_ROOT_TEST_DIR}/test_measure_power_consumption.py::test_measure_and_data_dump_power_consumption_ipc"

  benchmarks.multicore.idle_ipc.nrf54h20dk_cpuapp_cpurad.s2ram.mcuboot:
    tags:
      - ci_build
      - ci_tests_benchmarks_multicore
      - ipc
      - ppk_power_measure
    filter: not CONFIG_COVERAGE
    harness: pytest
    platform_allow:
      - nrf54h20dk/nrf54h20/cpuapp
    integration_platforms:
      - nrf54h20dk/nrf54h20/cpuapp
    extra_args:
      - SB_CONFIG_BOOTLOADER_MCUBOOT=y
      - mcuboot_EXTRA_DTC_OVERLAY_FILE="${ZEPHYR_NRF_MODULE_DIR}/tests/benchmarks/multicore/idle_ipc/boards/nrf54h20dk_nrf54h20_cpuapp.overlay"
    harness_config:
      fixture: ppk_power_measure
      pytest_root:
        - "${CUSTOM_ROOT_TEST_DIR}/test_measure_power_consumption.py::test_measure_and_data_dump_power_consumption_ipc"

  benchmarks.multicore.idle_ipc.shifted.nrf54h20dk_cpuapp_cpurad.s2ram:
    tags:
      - ci_build
      - ci_tests_benchmarks_multicore
      - ipc
      - ppk_power_measure
    filter: not CONFIG_COVERAGE
    harness: pytest
    platform_allow:
      - nrf54h20dk/nrf54h20/cpuapp
    integration_platforms:
      - nrf54h20dk/nrf54h20/cpuapp
    extra_args:
      - remote_TEST_START_DELAY_MS=1000
    harness_config:
      fixture: ppk_power_measure
      pytest_root:
        - "${CUSTOM_ROOT_TEST_DIR}/test_measure_power_consumption.py::test_measure_and_data_dump_power_consumption_ipc"

  benchmarks.multicore.idle_ipc.shifted.nrf54h20dk_cpuapp_cpurad.coverage:
    tags:
      - ci_build
      - ci_tests_benchmarks_multicore
      - ipc
    filter: CONFIG_COVERAGE
    platform_allow:
      - nrf54h20dk/nrf54h20/cpuapp
    integration_platforms:
      - nrf54h20dk/nrf54h20/cpuapp
    extra_args:
      - CONF_FILE=coverage.conf
      - EXTRA_DTC_OVERLAY_FILE="disable_s2ram.overlay"
      - SHIELD=coverage_support
    harness: console
    harness_config:
      type: multi_line
      ordered: true
      regex:
        - ".*Coverage analysis enabled.*"
        - ".*Coverage analysis start.*"
```

## tests/benchmarks/multicore/idle_outside_of_main/Kconfig.sysbuild
```kconfig
#
# Copyright (c) 2024 Nordic Semiconductor ASA
#
# SPDX-License-Identifier: LicenseRef-Nordic-5-Clause
#

source "share/sysbuild/Kconfig"

config REMOTE_BOARD
	string "The board used for remote target"
```

## tests/benchmarks/multicore/idle_outside_of_main/testcase.yaml
```yaml
common:
  sysbuild: true
  tags:
    - ci_build
    - ci_tests_benchmarks_multicore
    - ppk_power_measure
  extra_args:
    - CONFIG_SOC_NRF54H20_CPURAD_ENABLE=y

tests:
  benchmarks.multicore.idle_outside_of_main.nrf54h20dk_cpuapp_cpurad.s2ram:
    harness: pytest
    platform_allow:
      - nrf54h20dk/nrf54h20/cpuapp
    integration_platforms:
      - nrf54h20dk/nrf54h20/cpuapp
    harness_config:
      fixture: ppk_power_measure
      pytest_root:
        - "${CUSTOM_ROOT_TEST_DIR}/test_measure_power_consumption.py::test_measure_and_data_dump_power_consumption_s2ram_outside_of_main"
    timeout: 120

  benchmarks.multicore.idle_outside_of_main.nrf54h20dk_cpuapp_cpurad.s2ram.mcuboot:
    harness: pytest
    platform_allow:
      - nrf54h20dk/nrf54h20/cpuapp
    integration_platforms:
      - nrf54h20dk/nrf54h20/cpuapp
    extra_args:
      - SB_CONFIG_BOOTLOADER_MCUBOOT=y
      - mcuboot_EXTRA_DTC_OVERLAY_FILE="${ZEPHYR_NRF_MODULE_DIR}/tests/benchmarks/multicore/idle_outside_of_main/boards/nrf54h20dk_nrf54h20_cpuapp.overlay"
    harness_config:
      fixture: ppk_power_measure
      pytest_root:
        - "${CUSTOM_ROOT_TEST_DIR}/test_measure_power_consumption.py::test_measure_and_data_dump_power_consumption_s2ram_outside_of_main"
    timeout: 120

  benchmarks.multicore.idle_outside_of_main.nrf54h20dk_cpuapp_cpurad.s2ram.cooperative:
    harness: pytest
    platform_allow:
      - nrf54h20dk/nrf54h20/cpuapp
    integration_platforms:
      - nrf54h20dk/nrf54h20/cpuapp
    extra_args:
      - CONFIG_MAIN_THREAD_PRIORITY=-1
      - remote_CONFIG_MAIN_THREAD_PRIORITY=-1
    harness_config:
      fixture: ppk_power_measure
      pytest_root:
        - "${CUSTOM_ROOT_TEST_DIR}/test_measure_power_consumption.py::test_measure_and_data_dump_power_consumption_s2ram_outside_of_main"
    timeout: 120
```

## tests/benchmarks/multicore/idle_ppr/remote/Kconfig
```kconfig
#
# Copyright (c) 2024 Nordic Semiconductor ASA
#
# SPDX-License-Identifier: LicenseRef-Nordic-5-Clause
#

config TEST_SLEEP_DURATION_MS
	int "Amount of time (in miliseconds) the core is sleeping"
	default 1000
	help
	  Set sleep duration to TEST_SLEEP_DURATION_MS miliseconds.
	  Based on the value of 'min-residency-us' specified for each power state defined in the DTS,
	  core enters the lowest possible power state.

config APP_PROVIDE_PM_HOOKS
	bool "Application provides PM hooks"
	default y
	select HAS_PM
	select HAS_POWEROFF

source "Kconfig.zephyr"
```

## tests/benchmarks/multicore/idle_ppr/testcase.yaml
```yaml
common:
  sysbuild: true
  tags: ci_build ci_tests_benchmarks_multicore
  platform_allow:
    - nrf54h20dk/nrf54h20/cpuapp
  integration_platforms:
    - nrf54h20dk/nrf54h20/cpuapp

tests:
  benchmarks.multicore.idle_ppr.no_sleep:
    harness: console
    harness_config:
      type: multi_line
      ordered: true
      regex:
        - "Multicore idle_ppr test on"
        - "idle_ppr: Run 0"
        - "idle_ppr: Run 1"

  benchmarks.multicore.idle_ppr.idle:
    tags: ppk_power_measure
    extra_args:
      idle_ppr_CONF_FILE=prj_s2ram.conf
      remote_rad_CONF_FILE=prj_s2ram.conf
      remote_ppr_CONF_FILE=prj_s2ram.conf
      idle_ppr_CONFIG_TEST_SLEEP_DURATION_MS=500
      remote_rad_CONFIG_TEST_SLEEP_DURATION_MS=500
      remote_ppr_CONFIG_TEST_SLEEP_DURATION_MS=500
    harness: pytest
    harness_config:
      fixture: ppk_power_measure
      pytest_root:
        - "${CUSTOM_ROOT_TEST_DIR}/test_measure_power_consumption.py::test_measure_and_data_dump_ppr_and_idle"

  benchmarks.multicore.idle_ppr.s2ram:
    tags: ppk_power_measure
    extra_args:
      idle_ppr_CONF_FILE=prj_s2ram.conf
      remote_rad_CONF_FILE=prj_s2ram.conf
      remote_ppr_CONF_FILE=prj_s2ram.conf
    harness: pytest
    harness_config:
      fixture: ppk_power_measure
      pytest_root:
        - "${CUSTOM_ROOT_TEST_DIR}/test_measure_power_consumption.py::test_measure_and_data_dump_ppr_and_s2ram"
```

## tests/benchmarks/multicore/idle_pwm_led/Kconfig.sysbuild
```kconfig
#
# Copyright (c) 2024 Nordic Semiconductor ASA
#
# SPDX-License-Identifier: LicenseRef-Nordic-5-Clause
#

choice NETCORE
	default NETCORE_REMOTE

config NETCORE_REMOTE
	bool "Remote image"

endchoice

config NETCORE_IMAGE_NAME
	default "remote" if NETCORE_REMOTE

config NETCORE_IMAGE_PATH
	default "${ZEPHYR_NRF_MODULE_DIR}/tests/benchmarks/multicore/idle_pwm_led/remote" if NETCORE_REMOTE

source "share/sysbuild/Kconfig"
```
