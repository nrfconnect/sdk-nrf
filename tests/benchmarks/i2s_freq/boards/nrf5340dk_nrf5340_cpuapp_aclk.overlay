/*
 * Copyright (c) 2025 Nordic Semiconductor ASA
 *
 * SPDX-License-Identifier: LicenseRef-Nordic-5-Clause
 */

/* Drive i2s peripheral from ACLK. */

&clock {
	hfclkaudio-frequency = <11289600>;
};

&i2s0 {
	clock-source = "ACLK";
};
