## CMakeLists.txt
```
#
# Copyright (c) 2025 Nordic Semiconductor ASA
#
# SPDX-License-Identifier: LicenseRef-Nordic-5-Clause
#

cmake_minimum_required(VERSION 3.20.0)

find_package(Zephyr REQUIRED HINTS $ENV{ZEPHYR_BASE})
project(kernel_freq_change)

FILE(GLOB app_sources src/*.c)
target_sources(app PRIVATE ${app_sources})
```

## Kconfig
```
# SPDX-License-Identifier: LicenseRef-Nordic-5-Clause
# Copyright (c) 2025 Nordic Semiconductor ASA

config SYS_CLOCK_TICKS_PER_SEC
	default 16384 if NRF_RTC_TIMER && TICKLESS_KERNEL

source "Kconfig.zephyr"
```

## prj.conf
```kconfig
CONFIG_ZTEST=y
CONFIG_ZTEST_SHUFFLE=y
CONFIG_ZTEST_SUITE_REPEAT_COUNT=1
CONFIG_ZTEST_SHUFFLE_SUITE_REPEAT_COUNT=1
CONFIG_NRFS=y
CONFIG_CLOCK_CONTROL=y
CONFIG_CLOCK_CONTROL_LOG_LEVEL_DBG=y
CONFIG_ASSERT=y
```

## boards/nrf54h20dk_nrf54h20_cpurad.overlay
```dts
&hsfll120 {
	status = "okay";
};
```

## src/main.c
```c
/*
 * Copyright (c) 2025 Nordic Semiconductor ASA
 *
 * SPDX-License-Identifier: LicenseRef-Nordic-5-Clause
 */

#include <zephyr/kernel.h>
#include <zephyr/ztest.h>
#include <zephyr/devicetree/clocks.h>
#include <zephyr/drivers/clock_control/nrf_clock_control.h>

static void set_clock_frequency(uint32_t freq_mhz, const struct device *clk_dev)
{
	int ret = 0;
	int res = 0;
	struct onoff_client cli;
	uint32_t rate;
	const struct nrf_clock_spec clk_spec = {.frequency = freq_mhz};

	TC_PRINT("Clock under test: %s\n", clk_dev->name);
	sys_notify_init_spinwait(&cli.notify);
	ret = nrf_clock_control_request(clk_dev, &clk_spec, &cli);
	TC_PRINT("nrf_clock_control_request return code: %d\n", ret);
	zassert_between_inclusive(ret, 0, 2);
	do {
		ret = sys_notify_fetch_result(&cli.notify, &res);
		k_yield();
	} while (ret == -EAGAIN);
	TC_PRINT("Clock control request return value: %d\n", ret);
	TC_PRINT("Clock control request response code: %d\n", res);
	zassert_ok(ret);
	zassert_ok(res);
	ret = clock_control_get_rate(clk_dev, NULL, &rate);
	if (ret != -ENOSYS) {
		zassert_ok(ret);
		zassert_equal(rate, clk_spec.frequency);
	}
}

static void release_clock(uint32_t freq_mhz, const struct device *clk_dev)
{
	int ret = 0;
	const struct nrf_clock_spec clk_spec = {.frequency = freq_mhz};

	ret = nrf_clock_control_release(clk_dev, &clk_spec);
	TC_PRINT("nrf_clock_control_release return code: %d\n", ret);
	zassert_equal(ret, ONOFF_STATE_ON);
}

const struct device *global_hsfll_dev = DEVICE_DT_GET(DT_NODELABEL(hsfll120));
#if CONFIG_BOARD_NRF54H20DK_NRF54H20_CPUAPP
const struct device *local_hsfll_dev = DEVICE_DT_GET(DT_NODELABEL(cpuapp_hsfll));
#endif

extern void test_ms_time_duration(void);
extern void kernel_init_objects(void);
extern void test_k_sleep(void);
extern void test_busy_wait(void);
extern void test_timer_status_get_anytime(void);
extern void test_timer_remaining(void);
extern void test_timer_k_define(void);
extern void *setup_timer_api(void);

ZTEST(clock, test_kernel_common_gd_320MHz)
{
	set_clock_frequency(MHZ(320), global_hsfll_dev);
	test_ms_time_duration();
	release_clock(MHZ(320), global_hsfll_dev);
}

ZTEST(clock, test_kernel_common_gd_256MHz)
{
	set_clock_frequency(MHZ(256), global_hsfll_dev);
	test_ms_time_duration();
	release_clock(MHZ(256), global_hsfll_dev);
}

ZTEST(clock, test_kernel_common_gd_128MHz)
{
	set_clock_frequency(MHZ(128), global_hsfll_dev);
	test_ms_time_duration();
	release_clock(MHZ(128), global_hsfll_dev);
}

ZTEST(clock, test_kernel_common_gd_64MHz)
{
	set_clock_frequency(MHZ(64), global_hsfll_dev);
	test_ms_time_duration();
	release_clock(MHZ(64), global_hsfll_dev);
}

ZTEST(clock, test_kernel_common)
{
	test_ms_time_duration();
}

#if CONFIG_BOARD_NRF54H20DK_NRF54H20_CPUAPP
ZTEST(clock, test_kernel_common_ld_64MHz)
{
	set_clock_frequency(MHZ(64), local_hsfll_dev);
	test_ms_time_duration();
	release_clock(MHZ(64), local_hsfll_dev);
}

ZTEST(clock, test_kernel_common_ld_128MHz)
{
	set_clock_frequency(MHZ(128), local_hsfll_dev);
	test_ms_time_duration();
	release_clock(MHZ(128), local_hsfll_dev);
}

ZTEST(clock, test_kernel_common_ld_320MHz)
{
	set_clock_frequency(MHZ(320), local_hsfll_dev);
	test_ms_time_duration();
	release_clock(MHZ(320), local_hsfll_dev);
}
#endif

ZTEST(clock, test_kernel_context_gd_320MHz)
{
	set_clock_frequency(MHZ(320), global_hsfll_dev);
	test_k_sleep();
	test_busy_wait();
	release_clock(MHZ(320), global_hsfll_dev);
}

ZTEST(clock, test_kernel_context_gd_256MHz)
{
	set_clock_frequency(MHZ(256), global_hsfll_dev);
	test_k_sleep();
	test_busy_wait();
	release_clock(MHZ(256), global_hsfll_dev);
}

ZTEST(clock, test_kernel_context_gd_128MHz)
{
	set_clock_frequency(MHZ(128), global_hsfll_dev);
	test_k_sleep();
	test_busy_wait();
	release_clock(MHZ(128), global_hsfll_dev);
}

ZTEST(clock, test_kernel_context_gd_64MHz)
{
	set_clock_frequency(MHZ(64), global_hsfll_dev);
	test_k_sleep();
	test_busy_wait();
	release_clock(MHZ(64), global_hsfll_dev);
}

ZTEST(clock, test_kernel_context)
{
	test_k_sleep();
	test_busy_wait();
}

#if CONFIG_BOARD_NRF54H20DK_NRF54H20_CPUAPP
ZTEST(clock, test_kernel_context_ld_64MHz)
{
	set_clock_frequency(MHZ(64), local_hsfll_dev);
	test_k_sleep();
	test_busy_wait();
	release_clock(MHZ(64), local_hsfll_dev);
}

ZTEST(clock, test_kernel_context_ld_128MHz)
{
	set_clock_frequency(MHZ(128), local_hsfll_dev);
	test_k_sleep();
	test_busy_wait();
	release_clock(MHZ(128), local_hsfll_dev);
}

ZTEST(clock, test_kernel_context_ld_320MHz)
{
	set_clock_frequency(MHZ(320), local_hsfll_dev);
	test_k_sleep();
	test_busy_wait();
	release_clock(MHZ(320), local_hsfll_dev);
}
#endif

ZTEST(clock, test_kernel_timer_gd_320MHz)
{
	set_clock_frequency(MHZ(320), global_hsfll_dev);
	test_timer_k_define();
	test_timer_remaining();
	test_timer_status_get_anytime();
	release_clock(MHZ(320), global_hsfll_dev);
}

ZTEST(clock, test_kernel_timer_gd_256MHz)
{
	set_clock_frequency(MHZ(256), global_hsfll_dev);
	test_timer_k_define();
	test_timer_remaining();
	test_timer_status_get_anytime();
	release_clock(MHZ(256), global_hsfll_dev);
}

ZTEST(clock, test_kernel_timer_gd_128MHz)
{
	set_clock_frequency(MHZ(128), global_hsfll_dev);
	test_timer_k_define();
	test_timer_remaining();
	test_timer_status_get_anytime();
	release_clock(MHZ(128), global_hsfll_dev);
}

ZTEST(clock, test_kernel_timer_gd_64MHz)
{
	set_clock_frequency(MHZ(64), global_hsfll_dev);
	test_timer_k_define();
	test_timer_remaining();
	test_timer_status_get_anytime();
	release_clock(MHZ(64), global_hsfll_dev);
}

ZTEST(clock, test_kernel_timer)
{
	test_timer_k_define();
	test_timer_remaining();
	test_timer_status_get_anytime();
}

#if CONFIG_BOARD_NRF54H20DK_NRF54H20_CPUAPP
ZTEST(clock, test_kernel_timer_ld_64MHz)
{
	set_clock_frequency(MHZ(64), local_hsfll_dev);
	test_timer_k_define();
	test_timer_remaining();
	test_timer_status_get_anytime();
	release_clock(MHZ(64), local_hsfll_dev);
}

ZTEST(clock, test_kernel_timer_ld_128MHz)
{
	set_clock_frequency(MHZ(128), local_hsfll_dev);
	test_timer_k_define();
	test_timer_remaining();
	test_timer_status_get_anytime();
	release_clock(MHZ(128), local_hsfll_dev);
}

ZTEST(clock, test_kernel_timer_ld_320MHz)
{
	set_clock_frequency(MHZ(320), local_hsfll_dev);
	test_timer_k_define();
	test_timer_remaining();
	test_timer_status_get_anytime();
	release_clock(MHZ(320), local_hsfll_dev);
}
#endif

static bool once;

static void *clock_setup(void)
{
	kernel_init_objects();
	setup_timer_api();

	/** wait for clock initialization */
	if (!once) {
		k_msleep(2000);
		once = true;
	}
	return NULL;
}

ZTEST_SUITE(clock, NULL, clock_setup, NULL, NULL, NULL);
```

## src/kernel_common.c
```c
/*
 * Copyright (c) 2025 Nordic Semiconductor ASA
 *
 * SPDX-License-Identifier: LicenseRef-Nordic-5-Clause
 */

#include <zephyr/kernel.h>
#include <zephyr/ztest.h>

/*
 * Taken from zephyr/tests/kernel/common/kernel.common
 *
 */

struct timer_data {
	int duration_count;
	int stop_count;
};
static void duration_expire(struct k_timer *timer);
static void stop_expire(struct k_timer *timer);

/** TESTPOINT: init timer via K_TIMER_DEFINE */
static K_TIMER_DEFINE(ktimer, duration_expire, stop_expire);

static ZTEST_BMEM struct timer_data tdata;

#define DURATION      100
#define LESS_DURATION 70

/*
 *help function
 */
static void duration_expire(struct k_timer *timer)
{
	tdata.duration_count++;
}

static void stop_expire(struct k_timer *timer)
{
	tdata.stop_count++;
}

static void init_data_count(void)
{
	tdata.duration_count = 0;
	tdata.stop_count = 0;
}

/**
 * @brief Test millisecond time duration
 *
 * @details initialize a timer, then providing time duration in
 * millisecond, and check the duration time whether correct.
 *
 * @see k_timer_init(), k_timer_start(), k_timer_stop(),
 * k_busy_wait()
 *
 *
 */

void test_ms_time_duration(void)
{
	init_data_count();
	k_timer_start(&ktimer, K_MSEC(DURATION), K_NO_WAIT);

	/** TESTPOINT: waiting time less than duration and check the count*/
	k_busy_wait(LESS_DURATION * 1000);
	zassert_true(tdata.duration_count == 0);
	zassert_true(tdata.stop_count == 0);

	/** TESTPOINT: proving duration in millisecond */
	init_data_count();
	k_timer_start(&ktimer, K_MSEC(100), K_MSEC(50));

	/** TESTPOINT: waiting time more than duration and check the count */
	k_usleep(1); /* align to tick */
	k_busy_wait((DURATION + 1) * 1000);
	zassert_true(tdata.duration_count == 1, "duration %u not 1", tdata.duration_count);
	zassert_true(tdata.stop_count == 0, "stop %u not 0", tdata.stop_count);

	/** cleanup environment */
	k_timer_stop(&ktimer);
}
```

## src/kernel_context.c
```c
/*
 * Copyright (c) 2012-2015 Wind River Systems, Inc.
 * Copyright (c) 2025 Nordic Semiconductor ASA
 *
 * SPDX-License-Identifier: Apache-2.0
 */

#include <zephyr/kernel.h>
#include <zephyr/ztest.h>

/*
 * Taken from zephyr/tests/kernel/context/kernel.context
 */

/*
 * @brief Timeout tests
 *
 * Test the k_sleep() API, as well as the k_thread_create() ones.
 */
struct timeout_order {
	void *link_in_fifo;
	int32_t timeout;
	int timeout_order;
	int q_order;
};

struct timeout_order timeouts[] = {
	{0, 1000, 2, 0}, {0, 1500, 4, 1}, {0, 500, 0, 2},  {0, 750, 1, 3},
	{0, 1750, 5, 4}, {0, 2000, 6, 5}, {0, 1250, 3, 6},
};

#define THREAD_PRIORITY	    4
#define THREAD_STACKSIZE2   (384 + CONFIG_TEST_EXTRA_STACK_SIZE)
#define NUM_TIMEOUT_THREADS ARRAY_SIZE(timeouts)
static K_THREAD_STACK_ARRAY_DEFINE(timeout_stacks, NUM_TIMEOUT_THREADS, THREAD_STACKSIZE2);
static struct k_thread timeout_threads[NUM_TIMEOUT_THREADS];
static struct k_sem reply_timeout;
static struct k_timer timer;
struct k_fifo timeout_order_fifo;

/* a thread busy waits */
static void busy_wait_thread(void *mseconds, void *arg2, void *arg3)
{
	uint32_t usecs;

	ARG_UNUSED(arg2);
	ARG_UNUSED(arg3);

	usecs = POINTER_TO_INT(mseconds) * 1000;

	k_busy_wait(usecs);

	int key = arch_irq_lock();

	k_busy_wait(usecs);
	arch_irq_unlock(key);

	/*
	 * Ideally the test should verify that the correct number of ticks
	 * have elapsed. However, when running under QEMU, the tick interrupt
	 * may be processed on a very irregular basis, meaning that far
	 * fewer than the expected number of ticks may occur for a given
	 * number of clock cycles vs. what would ordinarily be expected.
	 *
	 * Consequently, the best we can do for now to test busy waiting is
	 * to invoke the API and verify that it returns. (If it takes way
	 * too long, or never returns, the main test thread may be able to
	 * time out and report an error.)
	 */

	k_sem_give(&reply_timeout);
}

/* a thread sleeps and times out, then reports through a fifo */
static void thread_sleep(void *delta, void *arg2, void *arg3)
{
	int64_t timestamp;
	int timeout = POINTER_TO_INT(delta);

	ARG_UNUSED(arg2);
	ARG_UNUSED(arg3);

	timestamp = k_uptime_get();
	k_msleep(timeout);
	timestamp = k_uptime_get() - timestamp;

	int slop = MAX(k_ticks_to_ms_floor64(2), 1);

	if (timestamp < timeout || timestamp > timeout + slop) {
		TC_ERROR("timestamp out of range, got %d\n", (int)timestamp);
		return;
	}

	k_sem_give(&reply_timeout);
}

/* a thread is started with a delay, then it reports that it ran via a fifo */
static void delayed_thread(void *num, void *arg2, void *arg3)
{
	struct timeout_order *timeout = &timeouts[POINTER_TO_INT(num)];

	ARG_UNUSED(arg2);
	ARG_UNUSED(arg3);

	TC_PRINT(" thread (q order: %d, t/o: %d) is running\n", timeout->q_order, timeout->timeout);

	k_fifo_put(&timeout_order_fifo, timeout);
}

/**
 *
 * @brief Initialize kernel objects
 *
 * This routine initializes the kernel objects used in this module's tests.
 *
 */
void kernel_init_objects(void)
{
	k_sem_init(&reply_timeout, 0, UINT_MAX);
	k_timer_init(&timer, NULL, NULL);
	k_fifo_init(&timeout_order_fifo);
}

/**
 * @brief Test timeouts
 *
 * @ingroup kernel_context_tests
 *
 * @see k_busy_wait(), k_sleep()
 */
void test_busy_wait(void)
{
	int32_t timeout;
	int rv;

	timeout = 20; /* in ms */

	k_thread_create(&timeout_threads[0], timeout_stacks[0], THREAD_STACKSIZE2, busy_wait_thread,
			INT_TO_POINTER(timeout), NULL, NULL, K_PRIO_COOP(THREAD_PRIORITY), 0,
			K_NO_WAIT);

	rv = k_sem_take(&reply_timeout, K_MSEC(timeout * 2 * 2));

	zassert_false(rv, " *** thread timed out waiting for "
			  "k_busy_wait()");
}

/**
 * @brief Test timeouts
 *
 * @ingroup kernel_context_tests
 *
 * @see k_sleep()
 */
void test_k_sleep(void)
{
	struct timeout_order *data;
	int32_t timeout;
	int rv;
	int i;

	timeout = 50;

	k_thread_create(&timeout_threads[0], timeout_stacks[0], THREAD_STACKSIZE2, thread_sleep,
			INT_TO_POINTER(timeout), NULL, NULL, K_PRIO_COOP(THREAD_PRIORITY), 0,
			K_NO_WAIT);

	rv = k_sem_take(&reply_timeout, K_MSEC(timeout * 2));
	zassert_equal(rv, 0,
		      " *** thread timed out waiting for thread on "
		      "k_sleep().");

	/* test k_thread_create() without cancellation */
	TC_PRINT("Testing k_thread_create() without cancellation\n");

	for (i = 0; i < NUM_TIMEOUT_THREADS; i++) {
		k_thread_create(&timeout_threads[i], timeout_stacks[i], THREAD_STACKSIZE2,
				delayed_thread, INT_TO_POINTER(i), NULL, NULL, K_PRIO_COOP(5), 0,
				K_MSEC(timeouts[i].timeout));
	}
	for (i = 0; i < NUM_TIMEOUT_THREADS; i++) {
		data = k_fifo_get(&timeout_order_fifo, K_MSEC(750));
		zassert_not_null(data, " *** timeout while waiting for"
				       " delayed thread");

		zassert_equal(data->timeout_order, i,
			      " *** wrong delayed thread ran (got %d, "
			      "expected %d)\n",
			      data->timeout_order, i);

		TC_PRINT(" got thread (q order: %d, t/o: %d) as expected\n", data->q_order,
			 data->timeout);
	}

	/* ensure no more thread fire */
	data = k_fifo_get(&timeout_order_fifo, K_MSEC(750));

	zassert_false(data, " *** got something unexpected in the fifo");

	/* test k_thread_create() with cancellation */
	TC_PRINT("Testing k_thread_create() with cancellations\n");

	int cancellations[] = {0, 3, 4, 6};
	int num_cancellations = ARRAY_SIZE(cancellations);
	int next_cancellation = 0;

	k_tid_t delayed_threads[NUM_TIMEOUT_THREADS];

	for (i = 0; i < NUM_TIMEOUT_THREADS; i++) {
		k_tid_t id;

		id = k_thread_create(&timeout_threads[i], timeout_stacks[i], THREAD_STACKSIZE2,
				     delayed_thread, INT_TO_POINTER(i), NULL, NULL, K_PRIO_COOP(5),
				     0, K_MSEC(timeouts[i].timeout));

		delayed_threads[i] = id;
	}

	for (i = 0; i < NUM_TIMEOUT_THREADS; i++) {
		int j;

		if (i == cancellations[next_cancellation]) {
			TC_PRINT(" cancelling "
				 "[q order: %d, t/o: %d, t/o order: %d]\n",
				 timeouts[i].q_order, timeouts[i].timeout, i);

			for (j = 0; j < NUM_TIMEOUT_THREADS; j++) {
				if (timeouts[j].timeout_order == i) {
					break;
				}
			}

			if (j < NUM_TIMEOUT_THREADS) {
				k_thread_abort(delayed_threads[j]);
				++next_cancellation;
				continue;
			}
		}

		data = k_fifo_get(&timeout_order_fifo, K_MSEC(2750));

		zassert_not_null(data, " *** timeout while waiting for"
				       " delayed thread");

		zassert_equal(data->timeout_order, i,
			      " *** wrong delayed thread ran (got %d, "
			      "expected %d)\n",
			      data->timeout_order, i);

		TC_PRINT(" got (q order: %d, t/o: %d, t/o order %d) "
			 "as expected\n",
			 data->q_order, data->timeout, data->timeout_order);
	}

	zassert_equal(num_cancellations, next_cancellation,
		      " *** wrong number of cancellations (expected %d, "
		      "got %d\n",
		      num_cancellations, next_cancellation);

	/* ensure no more thread fire */
	data = k_fifo_get(&timeout_order_fifo, K_MSEC(750));
	zassert_false(data, " *** got something unexpected in the fifo");
}
```

## src/kernel_timer.c
```c
/*
 * Copyright (c) 2025 Nordic Semiconductor ASA
 *
 * SPDX-License-Identifier: LicenseRef-Nordic-5-Clause
 */

#include <stdlib.h>
#include <zephyr/ztest.h>
#include <zephyr/types.h>

/*
 * Taken from zephyr/tests/kernel/timer/timer_api/kernel.timer
 */

struct timer_data {
	int expire_cnt;
	int stop_cnt;
	int64_t timestamp;
};

#define DURATION			   100
#define PERIOD				   50
#define EXPIRE_TIMES			   4
#define WITHIN_ERROR(var, target, epsilon) (llabs((int64_t)((target) - (var))) <= (epsilon))

/* ms can be converted precisely to ticks only when a ms is exactly
 * represented by an integral number of ticks.  If the conversion is
 * not precise, then the reverse conversion of a difference in ms can
 * end up being off by a tick depending on the relative error between
 * the first and second ms conversion, and we need to adjust the
 * tolerance interval.
 */
#define INEXACT_MS_CONVERT ((CONFIG_SYS_CLOCK_TICKS_PER_SEC % MSEC_PER_SEC) != 0)

#if CONFIG_ARCH_HAS_CUSTOM_BUSY_WAIT && CONFIG_NRF_RTC_TIMER
/* On Nordic SOCs using RTC_TIMER as the system timer and custom k_busy_wait() implementation,
 * one or both of the tick and busy-wait clocks may derive from sources that have slews that
 * sum to +/- 13%.
 */
#define BUSY_TICK_SLEW_PPM 130000U
#elif CONFIG_ARCH_HAS_CUSTOM_BUSY_WAIT && CONFIG_NRF_GRTC_TIMER
/* On Nordic SOCs using GRTC_TIMER as the system timer and custom k_busy_wait() implementation,
 * one or both of the tick and busy-wait clocks may derive from sources that have slews that
 * sum to +/- 2%.
 */
#define BUSY_TICK_SLEW_PPM 20000U
#else
/* In other cases assume the clocks are perfectly aligned. */
#define BUSY_TICK_SLEW_PPM 0U
#endif /* CONFIG_ARCH_HAS_CUSTOM_BUSY_WAIT && CONFIG_NRF_RTC_TIMER */
#define PPM_DIVISOR 1000000U

/* If the tick clock is faster or slower than the busywait clock the
 * remaining time for a partially elapsed timer in ticks will be
 * larger or smaller than expected by a value that depends on the slew
 * between the two clocks.  Produce a maximum error for a given
 * duration in microseconds.
 */
#define BUSY_SLEW_THRESHOLD_TICKS(_us)                                                             \
	k_us_to_ticks_ceil32((_us) * (uint64_t)BUSY_TICK_SLEW_PPM / PPM_DIVISOR)

static void duration_expire(struct k_timer *timer);
static void duration_stop(struct k_timer *timer);

/** TESTPOINT: init timer via K_TIMER_DEFINE */
static K_TIMER_DEFINE(ktimer, duration_expire, duration_stop);

static struct k_timer status_anytime_timer;
static struct k_timer remain_timer;

static ZTEST_BMEM struct timer_data tdata;

#define TIMER_ASSERT(exp, tmr)                                                                     \
	do {                                                                                       \
		if (!(exp)) {                                                                      \
			k_timer_stop(tmr);                                                         \
			zassert_true(exp);                                                         \
		}                                                                                  \
	} while (0)

static void init_timer_data(void)
{
	tdata.expire_cnt = 0;
	tdata.stop_cnt = 0;

	if (IS_ENABLED(CONFIG_MULTITHREADING)) {
		k_usleep(1); /* align to tick */
	}

	tdata.timestamp = k_uptime_get();
}

static bool interval_check(int64_t interval, int64_t desired)
{
	int64_t slop = INEXACT_MS_CONVERT ? 1 : 0;

	/* Tickless kernels will advance time inside of an ISR, so it
	 * is always possible (especially with high tick rates and
	 * slow CPUs) for us to arrive at the uptime check above too
	 * late to see a full period elapse before the next period.
	 * We can alias at both sides of the interval, so two
	 * one-ticks deltas (NOT one two-tick delta!)
	 */
	if (IS_ENABLED(CONFIG_TICKLESS_KERNEL)) {
		slop += 2 * k_ticks_to_ms_ceil32(1);
	}

	if (!WITHIN_ERROR(interval, desired, slop)) {
		return false;
	}

	return true;
}

/* entry routines */
static void duration_expire(struct k_timer *timer)
{
	/** TESTPOINT: expire function */
	int64_t interval = k_uptime_delta(&tdata.timestamp);

	tdata.expire_cnt++;
	if (tdata.expire_cnt == 1) {
		TIMER_ASSERT(interval_check(interval, DURATION), timer);
	} else {
		TIMER_ASSERT(interval_check(interval, PERIOD), timer);
	}

	if (tdata.expire_cnt >= EXPIRE_TIMES) {
		k_timer_stop(timer);
	}
}

static void duration_stop(struct k_timer *timer)
{
	tdata.stop_cnt++;
}

static void busy_wait_ms(int32_t ms)
{
	k_busy_wait(ms * 1000);
}

/**
 * @brief Test Timer status randomly after certain duration
 *
 * Validate timer status function using k_timer_status_get().
 *
 * It initializes the timer with k_timer_init(), then starts the timer
 * using k_timer_start() with specific initial duration and period.
 * Checks for timer status randomly after certain duration.
 * Stops the timer using k_timer_stop().
 *
 * @ingroup kernel_timer_tests
 *
 * @see k_timer_init(), k_timer_start(), k_timer_status_get(),
 * k_timer_stop(), k_busy_wait()
 */
void test_timer_status_get_anytime(void)
{
	init_timer_data();
	k_timer_start(&status_anytime_timer, K_MSEC(DURATION), K_MSEC(PERIOD));
	busy_wait_ms(DURATION + PERIOD * (EXPIRE_TIMES - 1) + PERIOD / 2);

	/** TESTPOINT: status get at any time */
	TIMER_ASSERT(k_timer_status_get(&status_anytime_timer) == EXPIRE_TIMES,
		     &status_anytime_timer);
	busy_wait_ms(PERIOD);
	TIMER_ASSERT(k_timer_status_get(&status_anytime_timer) == 1, &status_anytime_timer);

	/* cleanup environment */
	k_timer_stop(&status_anytime_timer);
}

/**
 * @brief Test statically defined Timer init
 *
 * Validate statically defined timer init using K_TIMER_DEFINE
 *
 * It creates prototype of K_TIMER_DEFINE to statically define timer
 * init and starts the timer with k_timer_start() with specific initial
 * duration and period. Stops the timer using k_timer_stop() and checks
 * for proper completion of duration and period.
 *
 * @ingroup kernel_timer_tests
 *
 * @see k_timer_start(), K_TIMER_DEFINE(), k_timer_stop()
 * k_uptime_get(), k_busy_wait()
 */
void test_timer_k_define(void)
{
	init_timer_data();
	/** TESTPOINT: init timer via k_timer_init */
	k_timer_start(&ktimer, K_MSEC(DURATION), K_MSEC(PERIOD));
	busy_wait_ms(DURATION + PERIOD * EXPIRE_TIMES + PERIOD / 2);

	/** TESTPOINT: check expire and stop times */
	TIMER_ASSERT(tdata.expire_cnt == EXPIRE_TIMES, &ktimer);
	TIMER_ASSERT(tdata.stop_cnt == 1, &ktimer);

	/* cleanup environment */
	k_timer_stop(&ktimer);

	init_timer_data();
	/** TESTPOINT: init timer via k_timer_init */
	k_timer_start(&ktimer, K_MSEC(DURATION), K_MSEC(PERIOD));

	/* Call the k_timer_start() again to make sure that
	 * the initial timeout request gets cancelled and new
	 * one will get added.
	 */
	busy_wait_ms(DURATION / 2);
	k_timer_start(&ktimer, K_MSEC(DURATION), K_MSEC(PERIOD));
	tdata.timestamp = k_uptime_get();
	busy_wait_ms(DURATION + PERIOD * EXPIRE_TIMES + PERIOD / 2);

	/** TESTPOINT: check expire and stop times */
	TIMER_ASSERT(tdata.expire_cnt == EXPIRE_TIMES, &ktimer);
	TIMER_ASSERT(tdata.stop_cnt == 1, &ktimer);

	/* cleanup environment */
	k_timer_stop(&ktimer);
}

/**
 * @brief Test accuracy of k_timer_remaining_get()
 *
 * Validate countdown of time to expiration
 *
 * Starts a timer, busy-waits for half the DURATION, then checks the
 * remaining time to expiration and stops the timer. The remaining time
 * should reflect the passage of at least the busy-wait interval.
 *
 * @ingroup kernel_timer_tests
 *
 * @see k_timer_init(), k_timer_start(), k_timer_stop(),
 * k_timer_remaining_get()
 */

void test_timer_remaining(void)
{
	uint32_t target_rem_ticks = k_ms_to_ticks_ceil32(DURATION / 2);
	uint32_t rem_ms, rem_ticks, exp_ticks;
	uint32_t latency_ticks;
	int32_t delta_ticks;
	uint32_t slew_ticks;
	uint64_t now;

	/* Test is running in a user space thread so there is an additional latency
	 * involved in executing k_busy_wait and k_timer_remaining_ticks. Due
	 * to that latency, returned ticks won't be exact as expected even if
	 * k_busy_wait is running using the same clock source as the system clock.
	 * If system clock frequency is low (e.g. 100Hz) 1 tick will be enough but
	 * for cases where clock frequency is much higher we need to accept higher
	 * deviation (in ticks). Arbitrary value of 100 us processing overhead is used.
	 */
	latency_ticks = k_us_to_ticks_ceil32(100);

	init_timer_data();
	k_timer_start(&remain_timer, K_MSEC(DURATION), K_NO_WAIT);
	busy_wait_ms(DURATION / 2);
	rem_ticks = k_timer_remaining_ticks(&remain_timer);
	now = k_uptime_ticks();
	rem_ms = k_timer_remaining_get(&remain_timer);
	exp_ticks = k_timer_expires_ticks(&remain_timer);
	k_timer_stop(&remain_timer);
	TIMER_ASSERT(tdata.expire_cnt == 0, &remain_timer);
	TIMER_ASSERT(tdata.stop_cnt == 1, &remain_timer);

	/*
	 * While the busy_wait_ms() works with the maximum possible resolution,
	 * the k_timer api is limited by the system tick abstraction. As result
	 * the value obtained through k_timer_remaining_get() could be larger
	 * than actual remaining time with maximum error equal to one tick.
	 * That one tick of error has to be converted to ms by rounding up:
	 * a tick shorter than a millisecond would otherwise round down to a
	 * zero tolerance and the legitimate one-tick overshoot would trip the
	 * check on high tick rate platforms.
	 */
	zassert_true(rem_ms <= (DURATION / 2) + k_ticks_to_ms_ceil64(1),
		     NULL);

	/* We stopped half way through the wait, so the remaining ticks
	 * should match the half duration converted to ticks. That is
	 * target_rem_ticks, k_ms_to_ticks_ceil32(DURATION / 2). Halving
	 * the full duration in ticks would not do: it truncates when
	 * DURATION / 2 is not a whole number of ticks (at a 2048 Hz tick
	 * rate the full duration rounds to 205 ticks, half of which floors
	 * to 102 while ceil(50 ms) is 103). Allow the larger of the
	 * busy-wait clock skew and the read latency.
	 */
	delta_ticks = (int32_t)(rem_ticks - target_rem_ticks);
	slew_ticks = BUSY_SLEW_THRESHOLD_TICKS(DURATION * USEC_PER_MSEC / 2U);
	zassert_true(abs(delta_ticks) <= MAX(slew_ticks, latency_ticks),
		     "tick/busy slew %d larger than test threshold %u",
		     delta_ticks, slew_ticks);

	/* k_timer_expires_ticks() returns the absolute expiry tick, so
	 * "now" plus the remaining ticks must land on it. This checks the
	 * three queries agree; it is not another half-way check, so neither
	 * the duration nor the busy-wait slew enter into it.
	 *
	 * rem_ticks, now and exp_ticks are read in three separate syscalls.
	 * exp_ticks is invariant over time, but "now" can only have advanced
	 * past the rem_ticks sample, so (exp_ticks - now) is at most rem_ticks
	 * and falls short of it by at most the read latency.
	 */
	zassert_between_inclusive((int64_t)rem_ticks -
				  ((int64_t)exp_ticks - (int64_t)now),
				  0, latency_ticks, NULL);
}

static void timer_init(struct k_timer *timer, k_timer_expiry_t expiry_fn, k_timer_stop_t stop_fn)
{
	if (IS_ENABLED(CONFIG_MULTITHREADING)) {
		k_object_access_grant(timer, k_current_get());
	}

	k_timer_init(timer, expiry_fn, stop_fn);
}

void *setup_timer_api(void)
{
	timer_init(&status_anytime_timer, NULL, NULL);
	timer_init(&remain_timer, duration_expire, duration_stop);

	if (IS_ENABLED(CONFIG_MULTITHREADING)) {
		k_thread_access_grant(k_current_get(), &ktimer);
	}

	return NULL;
}
```
