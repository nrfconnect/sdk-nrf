## CMakeLists.txt
```
#
# Copyright (c) 2021 Nordic Semiconductor ASA
#
# SPDX-License-Identifier: LicenseRef-Nordic-5-Clause
#

cmake_minimum_required(VERSION 3.20.0)

find_package(Zephyr REQUIRED HINTS $ENV{ZEPHYR_BASE})

project(tfm_regression_test)

target_sources(app PRIVATE src/main.c)


get_target_property(TFM_BINARY_DIR           tfm TFM_BINARY_DIR)
get_target_property(TFM_NS_BIN_FILE          tfm TFM_NS_BIN_FILE)
get_target_property(TFM_NS_HEX_FILE          tfm TFM_NS_HEX_FILE)
get_target_property(TFM_NS_SIGNED_BIN_FILE   tfm TFM_NS_SIGNED_BIN_FILE)

get_target_property(TFM_TOOLCHAIN_PATH       tfm TFM_TOOLCHAIN_PATH)
get_target_property(TFM_TOOLCHAIN_PREFIX     tfm TFM_TOOLCHAIN_PREFIX)
get_target_property(TFM_TOOLCHAIN_NS_FILE    tfm TFM_TOOLCHAIN_NS_FILE)

set(TFM_TEST_REPO_PATH ${ZEPHYR_TRUSTED_FIRMWARE_M_MODULE_DIR}/../tf-m-tests)

set(TFM_TEST_DIR         "${TFM_TEST_REPO_PATH}/tests_reg/test/secure_regression")
set(TFM_TEST_CONFIG_FILE "${TFM_TEST_REPO_PATH}/tests_reg/test/config/config.cmake")

set_property(TARGET zephyr_property_target
             APPEND PROPERTY TFM_CMAKE_OPTIONS
             -DCONFIG_TFM_TEST_DIR=${TFM_TEST_DIR}
)

set_property(TARGET zephyr_property_target
             APPEND PROPERTY TFM_CMAKE_OPTIONS
             -DCONFIG_TFM_TEST_CONFIG_FILE=${TFM_TEST_CONFIG_FILE}
)

# Install t_cose

file(COPY   ${ZEPHYR_TRUSTED_FIRMWARE_M_MODULE_DIR}/lib/ext/t_cose
     DESTINATION ${TFM_BINARY_DIR}/api_ns)

# Initial attestation headers are needed for the tests
set(TFM_SECURE_FW_SRC_DIR ${ZEPHYR_TRUSTED_FIRMWARE_M_MODULE_DIR}/secure_fw)
file(COPY           ${TFM_SECURE_FW_SRC_DIR}/partitions/initial_attestation
     DESTINATION    ${TFM_BINARY_DIR}/api_ns
     FILES_MATCHING PATTERN "*.h")

file(COPY           ${TFM_SECURE_FW_SRC_DIR}/spm/include/boot/tfm_boot_status.h
     DESTINATION    ${TFM_BINARY_DIR}/api_ns/initial_attestation)


include(ExternalProject)

ExternalProject_Add(tfm_regression_test_app
    SOURCE_DIR ${TFM_TEST_REPO_PATH}/tests_reg
    BINARY_DIR ${PROJECT_BINARY_DIR}/tfm_ns
    CONFIGURE_COMMAND
        ${CMAKE_COMMAND}
                -G ${CMAKE_GENERATOR}
                -S ${TFM_TEST_REPO_PATH}/tests_reg
                -B ${PROJECT_BINARY_DIR}/tfm_ns
                -DCONFIG_SPE_PATH=${TFM_BINARY_DIR}/api_ns
                -DTFM_TOOLCHAIN_FILE=cmake/${TFM_TOOLCHAIN_NS_FILE}
                -DCROSS_COMPILE=${TFM_TOOLCHAIN_PATH}/${TFM_TOOLCHAIN_PREFIX}
                -DQCBOR_PATH${QCBOR_PATH_TYPE}=${CONFIG_TFM_QCBOR_PATH}
                -DCMAKE_BUILD_TYPE=RelWithDebInfo
                -DZEPHYR_NRF_MODULE_DIR=${ZEPHYR_NRF_MODULE_DIR}
                -DTFM_BOARDS_NRF_DIR=${TFM_BOARDS_NRF_DIR}
                -DNRF_CONFIG_CPU_FREQ_MHZ=${CONFIG_TFM_CPU_FREQ_MHZ}
    BUILD_COMMAND ${CMAKE_COMMAND} --build .
    INSTALL_COMMAND ""
    BUILD_ALWAYS True
    USES_TERMINAL_BUILD True
    WORKING_DIRECTORY ${PROJECT_BINARY_DIR}/tfm_ns
    DEPENDS tfm
    BUILD_BYPRODUCTS
        ${TFM_NS_HEX_FILE}
        ${TFM_NS_BIN_FILE}
        ${TFM_NS_SIGNED_BIN_FILE}
)

add_dependencies(app tfm_regression_test_app)
```

## sample.yaml
```
common:
    tags: tfm
    platform_allow: nrf5340dk_nrf5340_cpuapp_ns nrf9160dk_nrf9160_ns
    harness: console
    harness_config:
      type: multi_line
      regex:
        - "Non-Secure system starting..."
        - "\\#\\#\\#\\# Execute test suites for the Non-secure area \\#\\#\\#\\#"
        - "\\*\\*\\* End of Non-secure test suites \\*\\*\\*"

sample:
  name: "TFM Regression Test"

tests:
  sample.tfm.regression_lib_mode:
    extra_args: CONFIG_TFM_LIBRARY=y CONFIG_TFM_ISOLATION_LEVEL=1 CONFIG_TFM_PARTITION_AUDIT_LOG=y
    timeout: 200

  sample.tfm.regression_ipc_lvl1:
    extra_args: CONFIG_TFM_IPC=y CONFIG_TFM_ISOLATION_LEVEL=1
    timeout: 200

  sample.tfm.regression_ipc_lvl2:
    timeout: 200
```

## prj.conf
```kconfig
#
# Copyright (c) 2021 Nordic Semiconductor ASA
#
# SPDX-License-Identifier: LicenseRef-Nordic-5-Clause
#

CONFIG_TFM_PROFILE_TYPE_NOT_SET=y
CONFIG_TFM_USE_NS_APP=y
CONFIG_TFM_REGRESSION_S=y
CONFIG_TFM_REGRESSION_NS=y

# Regression tests are included if a related secure partition is enabled.
CONFIG_TFM_PARTITION_PROTECTED_STORAGE=y
CONFIG_TFM_PARTITION_INTERNAL_TRUSTED_STORAGE=y
CONFIG_TFM_PARTITION_CRYPTO=y
CONFIG_TFM_PARTITION_INITIAL_ATTESTATION=y
CONFIG_TFM_PARTITION_PLATFORM=y

# Initial Attestation service requires provisioning
CONFIG_TFM_NRF_PROVISIONING=y
CONFIG_NRF_APPROTECT_LOCK=y
CONFIG_NRF_SECURE_APPROTECT_LOCK=y
CONFIG_IDENTITY_KEY_TFM=y

# Enable IPC mode and isolation level 2 by default
CONFIG_TFM_IPC=y
CONFIG_TFM_ISOLATION_LEVEL=2

# RNG
CONFIG_PSA_WANT_GENERATE_RANDOM=y

# Keys
CONFIG_PSA_WANT_KEY_TYPE_AES=y
CONFIG_PSA_WANT_KEY_TYPE_ECC_KEY_PAIR_IMPORT=y
CONFIG_PSA_WANT_KEY_TYPE_ECC_KEY_PAIR_EXPORT=y
CONFIG_PSA_WANT_KEY_TYPE_ECC_KEY_PAIR_DERIVE=y
CONFIG_PSA_WANT_KEY_TYPE_ECC_KEY_PAIR_GENERATE=y
CONFIG_PSA_WANT_KEY_TYPE_RSA_KEY_PAIR_IMPORT=y
CONFIG_PSA_WANT_KEY_TYPE_RSA_KEY_PAIR_EXPORT=y
CONFIG_PSA_WANT_KEY_TYPE_RSA_KEY_PAIR_GENERATE=y
CONFIG_PSA_WANT_KEY_TYPE_RSA_KEY_PAIR_DERIVE=y

# Ciphers
CONFIG_PSA_WANT_ALG_ECB_NO_PADDING=y
CONFIG_PSA_WANT_ALG_CBC_NO_PADDING=y
CONFIG_PSA_WANT_ALG_CBC_PKCS7=y
CONFIG_PSA_WANT_ALG_CTR=y

# Key derivation functions
CONFIG_PSA_WANT_ALG_HKDF=y
CONFIG_PSA_WANT_ALG_TLS12_PRF=y
CONFIG_PSA_WANT_ALG_TLS12_PSK_TO_MS=y

# MAC
CONFIG_PSA_WANT_ALG_HMAC=y

# AEAD
CONFIG_PSA_WANT_ALG_CCM=y
CONFIG_PSA_WANT_ALG_GCM=y

# ECC
CONFIG_PSA_WANT_ALG_ECDH=y
CONFIG_PSA_WANT_ALG_ECDSA=y
CONFIG_PSA_WANT_ALG_DETERMINISTIC_ECDSA=y

# ECC curves
CONFIG_PSA_WANT_ECC_SECP_R1_256=y

# RSA
CONFIG_PSA_WANT_ALG_RSA_OAEP=y
CONFIG_PSA_WANT_ALG_RSA_PKCS1V15_CRYPT=y
CONFIG_PSA_WANT_ALG_RSA_PKCS1V15_SIGN=y
CONFIG_PSA_WANT_ALG_RSA_PSS=y

CONFIG_PSA_WANT_RSA_KEY_SIZE_1024=y
CONFIG_PSA_WANT_RSA_KEY_SIZE_2048=y
CONFIG_PSA_WANT_RSA_KEY_SIZE_3072=y

# HASH
CONFIG_PSA_WANT_ALG_SHA_1=n # This is used to test not supported return code
CONFIG_PSA_WANT_ALG_SHA_224=y
CONFIG_PSA_WANT_ALG_SHA_256=y
CONFIG_PSA_WANT_ALG_SHA_384=y
CONFIG_PSA_WANT_ALG_SHA_512=y

CONFIG_TFM_SECURE_UART_SHARE_INSTANCE=n
```

## boards/nrf5340dk_nrf5340_cpuapp_ns.conf
```kconfig
# Using the following configuration for TFM UART1 allows both secure and
# non-secure UART output to arrive on the two COM ports available on the
# newer (>=2.0.0) dev-kits.
# Users of older versioned dev-kits should take appropriate actions in
# order to get both UART outputs. See: https://developer.nordicsemi.com/nRF_Connect_SDK/doc/latest/nrf/ug_tfm.html#id7
CONFIG_TFM_UART1_RXD_PIN=32
CONFIG_TFM_UART1_TXD_PIN=33
CONFIG_TFM_UART1_CTS_PIN=10
CONFIG_TFM_UART1_RTS_PIN=11
```

## boards/nrf54l15dk_nrf54l15_cpuapp_ns.conf
```kconfig
#
# Copyright (c) 2024 Nordic Semiconductor ASA
#
# SPDX-License-Identifier: LicenseRef-Nordic-5-Clause
#

# The tests need more RAM
CONFIG_PM_PARTITION_SIZE_TFM_SRAM=0x17000

# NCSDK-22598: Attestation support for nRF54L15 is not implemented yet
# So disable it for now
CONFIG_TFM_PARTITION_INITIAL_ATTESTATION=n
CONFIG_TFM_NRF_PROVISIONING=n

# The Identiy Key library is not used for the nRF54L15
CONFIG_IDENTITY_KEY_TFM=n
```

## boards/nrf54lm20dk_nrf54lm20a_cpuapp_ns.conf
```kconfig
#
# Copyright (c) 2026 Nordic Semiconductor ASA
#
# SPDX-License-Identifier: LicenseRef-Nordic-5-Clause
#

# The tests need more RAM
CONFIG_PM_PARTITION_SIZE_TFM_SRAM=0x17000

# Attestation support for nRF54LM20 is not implemented yet
CONFIG_TFM_PARTITION_INITIAL_ATTESTATION=n
CONFIG_TFM_NRF_PROVISIONING=n
```

## boards/nrf54lv10dk_nrf54lv10a_cpuapp_ns.conf
```kconfig
#
# Copyright (c) 2026 Nordic Semiconductor ASA
#
# SPDX-License-Identifier: LicenseRef-Nordic-5-Clause
#

# The tests need more RAM
CONFIG_PM_PARTITION_SIZE_TFM_SRAM=0x17000

# Attestation support for nRF54LV10A is not implemented yet
CONFIG_TFM_PARTITION_INITIAL_ATTESTATION=n
CONFIG_TFM_NRF_PROVISIONING=n
```

## boards/nrf7120dk_nrf7120_cpuapp_ns.conf
```kconfig
#
# Copyright (c) 2025 Nordic Semiconductor ASA
#
# SPDX-License-Identifier: LicenseRef-Nordic-5-Clause
#

# The tests need more RAM
CONFIG_PM_PARTITION_SIZE_TFM_SRAM=0x17000

# WZN-7352: Attestation support for nRF7120 is not implemented yet
# So disable it for now
CONFIG_TFM_PARTITION_INITIAL_ATTESTATION=n
CONFIG_TFM_NRF_PROVISIONING=n
```

## app.overlay
```dts
/*
 * Copyright (c) 2023 Nordic Semiconductor ASA
 *
 * SPDX-License-Identifier: LicenseRef-Nordic-5-Clause
 */
&uart0 {
        compatible = "nordic,nrf-uarte";
        current-speed = <115200>;
        status = "okay";
        hw-flow-control;
};

&uart1 {
        compatible = "nordic,nrf-uarte";
        current-speed = <115200>;
        /* Set to disabled in application, since TF-M will be using it. */
        status = "disabled";
        hw-flow-control;
};
```

## boards/nrf5340dk_nrf5340_cpuapp_ns.overlay
```dts
/*
 * Copyright (c) 2024 Nordic Semiconductor ASA
 *
 * SPDX-License-Identifier: LicenseRef-Nordic-5-Clause
 */
 &uart0 {
        compatible = "nordic,nrf-uarte";
        current-speed = <115200>;
        status = "okay";
        hw-flow-control;
};

&uart1 {
        compatible = "nordic,nrf-uarte";
        current-speed = <115200>;
        /* Set to disabled in application, since TF-M will be using it. */
        status = "disabled";
        hw-flow-control;
};
```

## boards/nrf54l15dk_nrf54l15_cpuapp_ns.overlay
```dts
/*
 * Copyright (c) 2024 Nordic Semiconductor ASA
 *
 * SPDX-License-Identifier: LicenseRef-Nordic-5-Clause
 */
&uart20 {
        compatible = "nordic,nrf-uarte";
        current-speed = <115200>;
        status = "okay";
        hw-flow-control;
};

&uart30 {
        compatible = "nordic,nrf-uarte";
        current-speed = <115200>;
        /* Set to disabled in application, since TF-M will be using it. */
        status = "disabled";
        hw-flow-control;
};
```

## boards/nrf54l15pdk_nrf54l15_cpuapp_ns.overlay
```dts
/*
 * Copyright (c) 2024 Nordic Semiconductor ASA
 *
 * SPDX-License-Identifier: LicenseRef-Nordic-5-Clause
 */
 &uart20 {
        compatible = "nordic,nrf-uarte";
        current-speed = <115200>;
        status = "okay";
        hw-flow-control;
};

&uart30 {
        compatible = "nordic,nrf-uarte";
        current-speed = <115200>;
        /* Set to disabled in application, since TF-M will be using it. */
        status = "disabled";
        hw-flow-control;
};
```

## boards/nrf54lm20dk_nrf54lm20a_cpuapp_ns.overlay
```dts
/*
 * Copyright (c) 2026 Nordic Semiconductor ASA
 *
 * SPDX-License-Identifier: LicenseRef-Nordic-5-Clause
 */
&uart30 {
	compatible = "nordic,nrf-uarte";
	current-speed = <115200>;
	/* Set to disabled in application, since TF-M will be using it. */
	status = "disabled";
	hw-flow-control;
};
```

## boards/nrf54lv10dk_nrf54lv10a_cpuapp_ns.overlay
```dts
/*
 * Copyright (c) 2026 Nordic Semiconductor ASA
 *
 * SPDX-License-Identifier: LicenseRef-Nordic-5-Clause
 */
&uart20 {
	compatible = "nordic,nrf-uarte";
	current-speed = <115200>;
	/* Set to disabled in application, since TF-M will be using it. */
	status = "disabled";
	hw-flow-control;
};
```

## src/main.c
```c
/*
 * Copyright (c) 2022 Nordic Semiconductor ASA.
 *
 * SPDX-License-Identifier: LicenseRef-Nordic-5-Clause
 */

#include <zephyr/kernel.h>

int main(void)
{
	printk("Should not be printed, expected TF-M's NS application to be run instead.\n");
	k_panic();

	return 0;		/* unreachable */
}
```
