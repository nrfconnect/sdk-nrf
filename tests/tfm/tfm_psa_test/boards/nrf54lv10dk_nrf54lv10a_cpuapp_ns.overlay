/*
 * Copyright (c) 2026 Nordic Semiconductor ASA
 *
 * SPDX-License-Identifier: LicenseRef-Nordic-5-Clause
 */

/ {
	soc {
		#address-cells = <1>;
		#size-cells = <1>;

		uicr_tfm: uicr@ffd000 {
			compatible = "nordic,nrf-uicr";
			reg = <0xffd000 0x1000>;
			ranges = <0x0 0xffd000 0x1000>;
			#address-cells = <1>;
			#size-cells = <1>;

			bl_storage: uicr@500 {
				reg = <0x500 0x460>;
			};
		};
	};
};
