## scripts/west_commands/genboard/templates/nrf54l/Kconfig.board.jinja2
```kconfig
config BOARD_{{ board | upper }}
	select SOC_{{ soc | upper }}_ENGA_CPUAPP if BOARD_{{ board | upper }}_{{ soc | upper }}_CPUAPP
	select SOC_{{ soc | upper }}_ENGA_CPUFLPR if \
		BOARD_{{ board | upper }}_{{ soc | upper }}_CPUFLPR || \
		BOARD_{{ board | upper }}_{{ soc | upper }}_CPUFLPR_XIP
```

## scripts/west_commands/genboard/templates/nrf54l/Kconfig.defconfig.jinja2
```kconfig
if BOARD_{{ board | upper }}_CPUAPP

config BT_CTLR
	default BT

config ROM_START_OFFSET
	default 0x800 if BOOTLOADER_MCUBOOT

endif # BOARD_{{ board | upper }}_CPUAPP
```

## scripts/west_commands/genboard/templates/nrf91/Kconfig.board.jinja2
```kconfig
config BOARD_{{ board | upper }}
{% if ncs_version < hwmv2_since %}
	bool "{{ board_desc }}"
	depends on SOC_{{ soc | upper }}_{{ variant | upper}}
{% else %}
	select SOC_{{ soc | upper }}_{{ variant | upper}}
{% endif %}
```

## scripts/west_commands/genboard/templates/nrf91/Kconfig.defconfig.jinja2
```kconfig
{% if ncs_version < hwmv2_since %}
config BOARD
	default "{{ board }}"

{% endif %}
{% if ncs_version < hwmv2_since %}
if  BOARD_{{ board | upper }} || BOARD_{{ board | upper }}_NS
{% else %}
if  BOARD_{{ board | upper }}_{{ soc | upper }} || BOARD_{{ board | upper }}_{{ soc | upper }}_NS
{% endif %}

# For the secure version of the board the firmware is linked at the beginning of
# the flash, or into the code-partition defined in DT if it is intended to be
# loaded by MCUboot. If the secure firmware is to be combined with a non-secure
# image (TRUSTED_EXECUTION_SECURE=y), the secure FW image shall always be
# restricted to the size of its code partition. For the non-secure version of
# the board, the firmware must be linked into the code-partition (non-secure)
# defined in DT, regardless. Apply this configuration below by setting the
# Kconfig symbols used by the linker according to the information extracted from
# DT partitions.

DT_CHOSEN_Z_CODE_PARTITION := zephyr,code-partition

config FLASH_LOAD_SIZE
	default $(dt_chosen_reg_size_hex,$(DT_CHOSEN_Z_CODE_PARTITION))
{% if ncs_version < hwmv2_since %}
	depends on BOARD_{{ board | upper }} && TRUSTED_EXECUTION_SECURE
{% else %}
	depends on BOARD_{{ board | upper }}_{{ soc | upper }} && TRUSTED_EXECUTION_SECURE
{% endif %}

{% if ncs_version < hwmv2_since %}
if BOARD_{{ board | upper }}_NS
{% else %}
if BOARD_{{ board | upper }}_{{ soc | upper }}_NS
{% endif %}

config FLASH_LOAD_OFFSET
	default $(dt_chosen_reg_addr_hex,$(DT_CHOSEN_Z_CODE_PARTITION))

config FLASH_LOAD_SIZE
	default $(dt_chosen_reg_size_hex,$(DT_CHOSEN_Z_CODE_PARTITION))

{% if ncs_version < hwmv2_since %}
endif # BOARD_{{ board | upper }}_NS
{% else %}
endif # BOARD_{{ board | upper }}_{{ soc | upper }}_NS
{% endif %}

{% if ncs_version < hwmv2_since %}
endif # BOARD_{{ board | upper }} || BOARD_{{ board | upper }}_NS
{% else %}
endif # BOARD_{{ board | upper }}_{{ soc | upper }} || BOARD_{{ board | upper }}_{{ soc | upper }}_NS
{% endif %}
```

## snippets/matter-bootloader/boards/nrf54lm20pdk_nrf54lm20a_cpuapp_internal.conf
```kconfig
#
# Copyright (c) 2025 Nordic Semiconductor ASA
#
# SPDX-License-Identifier: LicenseRef-Nordic-5-Clause
#

CONFIG_HW_STACK_PROTECTION=n
CONFIG_BOOT_WATCHDOG_FEED=n

# Bootloader size optimization to fit into 28 KB partition.
# These options can be safely disabled because in this configuration,
# the secondary slot resides in the internal RRAM, so features
# needed to handle the external flash are not needed.
CONFIG_GPIO=n
CONFIG_SPI_NOR=n
CONFIG_SPI=n
CONFIG_PM_OVERRIDE_EXTERNAL_DRIVER_CHECK=y

# Currently, without tickless kernel, the SYSCOUNTER value after the software
# reset is not set properly and due to that the first system interrupt is not called
# in the proper time - the SYSCOUNTER value is set to the value from before
# reset + 1. Hence, the reboot time increases more and more.
# To avoid it enable tickles kernel for mcuboot.
CONFIG_TICKLESS_KERNEL=y
```

## snippets/matter-power-consumption-tests/boards/nrf54l15dk.conf
```kconfig
#
# Copyright (c) 2025 Nordic Semiconductor ASA
#
# SPDX-License-Identifier: LicenseRef-Nordic-5-Clause
#

# Disable LEDs that lead to the current leakages
CONFIG_NCS_SAMPLE_MATTER_LEDS=n

# Disable watchdog that increases the sleep current
CONFIG_NCS_SAMPLE_MATTER_WATCHDOG=n

# Increase MPSL calibration period to prevent too often CPU wake-ups.
CONFIG_MPSL_CALIBRATION_PERIOD=60000
```

## snippets/matter-power-consumption-tests/boards/nrf54lm20dk.conf
```kconfig
#
# Copyright (c) 2025 Nordic Semiconductor ASA
#
# SPDX-License-Identifier: LicenseRef-Nordic-5-Clause
#

# Disable LEDs that lead to the current leakages
CONFIG_NCS_SAMPLE_MATTER_LEDS=n

# Disable watchdog that increases the sleep current
CONFIG_NCS_SAMPLE_MATTER_WATCHDOG=n
```

## snippets/mpsl-pin-debug/boards/nrf54h20dk_nrf54h20_cpurad.conf
```kconfig
#
# Copyright (c) 2026 Nordic Semiconductor
#
# SPDX-License-Identifier: LicenseRef-Nordic-5-Clause
#

CONFIG_MPSL_PIN_DEBUG=y
```

## snippets/nordic-bt-rpc/boards/nrf54h20_cpuapp.conf
```kconfig
#
# Copyright (c) 2024 Nordic Semiconductor
#
# SPDX-License-Identifier: LicenseRef-Nordic-5-Clause
#

CONFIG_BT_RPC_STACK=y
```

## snippets/nrf70-fw-patch-ext-flash/boards/nrf54lm20dk_nrf54lm20b_cpuapp.conf
```kconfig
#
# Copyright (c) 2026 Nordic Semiconductor ASA
#
# SPDX-License-Identifier: LicenseRef-Nordic-5-Clause
#

CONFIG_GPIO=y
CONFIG_SPI=y
CONFIG_SPI_NOR=y
CONFIG_SPI_NOR_SFDP_DEVICETREE=y
CONFIG_SPI_NOR_FLASH_LAYOUT_PAGE_SIZE=4096
```

## snippets/nrf70-fw-patch-ext-flash/boards/nrf7002dk_nrf5340_cpuapp.conf
```kconfig
#
# Copyright (c) 2023 Nordic Semiconductor ASA
#
# SPDX-License-Identifier: LicenseRef-Nordic-5-Clause
#

# nRF7002DK uses SPI NOR external flash
CONFIG_GPIO=y
CONFIG_SPI=y
CONFIG_SPI_NOR=y
CONFIG_SPI_NOR_SFDP_DEVICETREE=y
CONFIG_SPI_NOR_FLASH_LAYOUT_PAGE_SIZE=4096

CONFIG_PM_OVERRIDE_EXTERNAL_DRIVER_CHECK=y
```

## soc/arm/nordic_nrf/Kconfig.defconfig
```kconfig
# Nordic Semiconductor nRFx MCU line

# Copyright (c) 2016-2018 Nordic Semiconductor ASA
# SPDX-License-Identifier: Apache-2.0

if SOC_FAMILY_NRF

source "soc/arm/nordic_nrf/*/Kconfig.defconfig.series"

endif # SOC_FAMILY_NRF
```

## soc/arm/nordic_nrf/nrf70/Kconfig.defconfig.series
```kconfig
# Nordic Semiconductor nRF53 MCU line

# Copyright (c) 2019 Nordic Semiconductor ASA
# SPDX-License-Identifier: Apache-2.0

if SOC_SERIES_NRF70X

source "soc/arm/nordic_nrf/nrf70/Kconfig.defconfig.nrf70*"

config SOC_SERIES
	default "nrf70"

endif # SOC_SERIES_NRF70X
```

## soc/arm/nordic_nrf/nrf70/Kconfig.soc
```kconfig
# Nordic Semiconductor nRF53 MCU line

# Copyright (c) 2019 Nordic Semiconductor ASA
# SPDX-License-Identifier: Apache-2.0

if SOC_SERIES_NRF70X
config SOC_NRF7002_CPUAPP
	bool
	select SOC_NRF5340_CPUAPP_QKAA
	select CPU_HAS_NRF_IDAU
	select CPU_HAS_FPU
	select ARMV8_M_DSP

config SOC_NRF7002_CPUNET
	bool
	select SOC_NRF5340_CPUNET_QKAA
	select HAS_NO_PM

choice
	prompt "nRF70x MCU Selection"

config SOC_NRF7002_CPUAPP_QKAA
	bool "NRF7002_CPUAPP_QKAA"
	select SOC_NRF7002_CPUAPP

config SOC_NRF7002_CPUNET_QKAA
	bool "NRF7002_CPUNET_QKAA"
	select SOC_NRF7002_CPUNET

endchoice

endif # SOC_SERIES_NRF70X
```

## soc/nordic/Kconfig.defconfig
```kconfig
# Nordic Semiconductor nRFx MCU line

# Copyright (c) 2016-2025 Nordic Semiconductor ASA
# SPDX-License-Identifier: Apache-2.0

# This file is contains Zephyr build system Kconfig references and is not
# re-usable outside the Zephyr tree.
if SOC_FAMILY_NORDIC_NRF

rsource "*/Kconfig.defconfig"

endif # SOC_FAMILY_NORDIC_NRF
```

## soc/nordic/common/vpr/Kconfig.sysbuild
```kconfig
# Copyright (c) 2025 Nordic Semiconductor ASA
# SPDX-License-Identifier: LicenseRef-Nordic-5-Clause

config VPR_LAUNCHER
	bool "VPR launcher"
	default y
	depends on SOC_NRF54LV10A_ENGA_CPUFLPR
	help
	  Include VPR launcher in build.
	  VPR launcher is a minimal sample built for an ARM core that starts given VPR core.
	  It is based on samples/basic/minimal with an appropriate snippet.
```

## soc/nordic/nrf54h/Kconfig.defconfig
```kconfig
# Nordic Semiconductor nRF54H MCU line

# Copyright (c) 2025 Nordic Semiconductor ASA
# SPDX-License-Identifier: LicenseRef-Nordic-5-Clause

if SOC_NRF54H20_CPURAD

rsource "Kconfig.defconfig.nrf54h20_cpurad"

endif # SOC_NRF54H20_CPURAD
```

## soc/nordic/nrf54h/Kconfig.defconfig.nrf54h20_cpurad
```kconfig
# Nordic Semiconductor nRF54H20 Radio MCU

# Copyright (c) 2025 Nordic Semiconductor ASA
# SPDX-License-Identifier: LicenseRef-Nordic-5-Clause

if SOC_NRF54H20_CPURAD

DT_CHOSEN_Z_CODE = zephyr,code-partition
DT_CHOSEN_Z_SRAM = zephyr,sram

config BUILD_OUTPUT_ADJUST_LMA
	depends on !XIP
	default "$(dt_chosen_partition_addr_hex,$(DT_CHOSEN_Z_CODE)) - \
		 $(dt_chosen_reg_addr_hex,$(DT_CHOSEN_Z_SRAM))"

endif # SOC_NRF54H20_CPURAD
```

## soc/nordic/nrf54h/Kconfig.sysbuild
```kconfig
#
# Copyright (c) 2026 Nordic Semiconductor ASA
# SPDX-License-Identifier: LicenseRef-Nordic-5-Clause
#

if SOC_SERIES_NRF54H

config MCUBOOT_DIRECT_XIP_GENERATE_VARIANT
	default n

endif # SOC_SERIES_NRF54H
```

## soc/nordic/nrf54l/Kconfig
```kconfig
# Nordic Semiconductor nRF54 MCU line

# Copyright (c) 2024 Nordic Semiconductor ASA
# SPDX-License-Identifier: LicenseRef-Nordic-5-Clause

config SOC_NRF54LV10A_CPUAPP
	select SOC_NRF54L_CPUAPP_COMMON
	select ARMV8_M_DSP
	select CPU_HAS_ARM_MPU
	select CPU_HAS_ARM_SAU
	select CPU_HAS_FPU
	select HAS_SWO

config SOC_NRF54LV10A_CPUFLPR
	select RISCV_CORE_NORDIC_VPR

config SOC_NRF54LS05A_CPUAPP
	select SOC_NRF54L_CPUAPP_COMMON
	select CPU_HAS_ARM_MPU

config SOC_NRF54LS05B_CPUAPP
	select SOC_NRF54L_CPUAPP_COMMON
	select CPU_HAS_ARM_MPU

config SOC_NRF54LS05A_DEVELOP_IN_NRF54LS05B
	bool
	help
	  The nrf54ls05dk board can be used to develop the nRF54LS05A or nRF54LS05B SoCs
	  onto the nRF54LS05B DK. This symbol needs to be considered by certain system
	  initialization functionality residing in SoC erratas.
```

## soc/nordic/nrf54l/Kconfig.defconfig
```kconfig
# Nordic Semiconductor nRF54L MCU line

# Copyright (c) 2024 Nordic Semiconductor ASA
# SPDX-License-Identifier: LicenseRef-Nordic-5-Clause

if SOC_SERIES_NRF54L

rsource "Kconfig.defconfig.nrf54l*"

if ARM

config CORTEX_M_SYSTICK
	default !NRF_GRTC_TIMER

config CACHE_NRF_CACHE
	default y if EXTERNAL_CACHE

endif # ARM

if RISCV

DT_CHOSEN_Z_SRAM = zephyr,sram
DT_CHOSEN_Z_CODE = zephyr,code-partition

config BUILD_OUTPUT_ADJUST_LMA
	depends on !XIP
	default "$(dt_chosen_partition_addr_hex,$(DT_CHOSEN_Z_CODE)) - \
		 $(dt_chosen_reg_addr_hex,$(DT_CHOSEN_Z_SRAM))"

endif # RISCV

endif # SOC_SERIES_NRF54L
```

## soc/nordic/nrf54l/Kconfig.defconfig.nrf54lc10a_cpuapp
```kconfig
# Nordic Semiconductor nRF54LC10A MCU

# Copyright (c) 2026 Nordic Semiconductor ASA
# SPDX-License-Identifier: LicenseRef-Nordic-5-Clause

if SOC_NRF54LC10A_CPUAPP

config NUM_IRQS
	default 290

config NRF_RRAM_WRITE_BUFFER_SIZE
	default 16
	range 0 16

endif # SOC_NRF54LC10A_CPUAPP
```

## soc/nordic/nrf54l/Kconfig.defconfig.nrf54lc10a_cpuflpr
```kconfig
# Nordic Semiconductor nRF54LC10A MCU

# Copyright (c) 2026 Nordic Semiconductor ASA
# SPDX-License-Identifier: LicenseRef-Nordic-5-Clause

if SOC_NRF54LC10A_CPUFLPR

config NUM_IRQS
	default 287

endif # SOC_NRF54LC10A_CPUFLPR
```
