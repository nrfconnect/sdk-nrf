#include "{{ board }}-memory_map.dtsi"
#include "{{ board }}-ipc_conf.dtsi"
#include "{{ board }}-pinctrl.dtsi"

&hfxo {
	status = "okay";
	accuracy-ppm = <30>;
	startup-time-us = <850>;
	mode = "crystal";
};

&lfxo {
	status = "okay";
	accuracy-ppm = <20>;
	startup-time-us = <600000>;
	mode = "crystal";
};
