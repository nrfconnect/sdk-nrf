## subsys/bluetooth/Kconfig.scan
```kconfig
#
# Copyright (c) 2019 Nordic Semiconductor ASA
#
# SPDX-License-Identifier: LicenseRef-Nordic-5-Clause
#

menuconfig BT_SCAN
	depends on BT_OBSERVER
	bool "Scan library"
	default n
	help
	  Enable BLE Scan library

if BT_SCAN

config BT_SCAN_NAME_MAX_LEN
	int "Maximum size for the name to search in the advertisement report"
	default 32
	help
	  "Maximum size for the name to search in the advertisement report."

config BT_SCAN_SHORT_NAME_MAX_LEN
	int "Maximum size of the short name to search for in the advertisement report"
	default 32
	help
	  Maximum size of the short name to search for in the advertisement report.

config BT_SCAN_FILTER_ENABLE
	bool "Enabling filters for the Scan library"
	default n
	help
	  Enabling filters for the Scan library.

config BT_SCAN_MANUFACTURER_DATA_MAX_LEN
	int "Maximum size for the manufacturer data to search in the advertisement report"
	default 32
	help
	  "Maximum size for the manufacturer data to search in the advertisement report."

if BT_SCAN_FILTER_ENABLE

config BT_SCAN_UUID_CNT
	int "Number of filters for UUIDs"
	default 0
	help
	  Number of filters for UUIDs

config BT_SCAN_NAME_CNT
	int "Number of name filters"
	default 0
	help
	  Number of name filters

config BT_SCAN_SHORT_NAME_CNT
	int "Number of short name filters"
	default 0
	help
	  Number of short name filters

config BT_SCAN_ADDRESS_CNT
	int "Number of address filters"
	default 0
	help
	  Number of address filters

config BT_SCAN_APPEARANCE_CNT
	int "Number of appearance filters"
	default 0
	help
	  Number of appearance filters

config BT_SCAN_MANUFACTURER_DATA_CNT
	int "Number of manufacturer data filters"
	default 0
	help
	  Number of manufacturer data filters
endif

if !BT_SCAN_FILTER_ENABLE

config BT_SCAN_UUID_CNT
	int
	default 0
	help
	  Number of filters for UUIDs

config BT_SCAN_NAME_CNT
	int
	default 0
	help
	  Number of name filters

config BT_SCAN_SHORT_NAME_CNT
	int
	default 0
	help
	  Number of short name filters

config BT_SCAN_ADDRESS_CNT
	int
	default 0
	help
	  Number of address filters

config BT_SCAN_APPEARANCE_CNT
	int
	default 0
	help
	  Number of appearance filters

config BT_SCAN_MANUFACTURER_DATA_CNT
	int
	default 0
	help
	  Number of manufacturer data filters

endif

config BT_SCAN_CONN_ATTEMPTS_FILTER
	bool "Connection attempts filter"
	help
	 Connection attempts filter. This filter limits the number of attempts
	 to connect to the device.

if BT_SCAN_CONN_ATTEMPTS_FILTER

config BT_SCAN_CONN_ATTEMPTS_FILTER_LEN
	int "Connection attempts filtered device count"
	default 2
	help
	  The maximum number of the filtered devices by
	  the connection attempts filter.

config BT_SCAN_CONN_ATTEMPTS_COUNT
	int "Connection attempts count"
	default 2
	help
	 Connection attempts count. Defines how many times the device will
	 try to connect with a given peripheral.
endif

config BT_SCAN_BLOCKLIST
	bool "Scanning device blocklist"
	help
	  Scanning device blocklist. Scanning module ignores
	  any devices which are on this list.

if BT_SCAN_BLOCKLIST

config BT_SCAN_BLOCKLIST_LEN
	int "Blocklist maximum device count"
	default 2
	help
	  Maximum blocklist devices count.

endif # BT_SCAN_BLOCKLIST

module = BT_SCAN
module-str = scan library
source "${ZEPHYR_BASE}/subsys/logging/Kconfig.template.log_config"

endif # BT_SCAN
```

## subsys/bluetooth/adv_prov/Kconfig
```kconfig
#
# Copyright (c) 2022 Nordic Semiconductor ASA
#
# SPDX-License-Identifier: LicenseRef-Nordic-5-Clause
#

menuconfig BT_ADV_PROV
	bool "Bluetooth LE advertising providers"
	depends on BT_BROADCASTER
	help
	  Enable Bluetooth LE advertising providers. The subsystem manages
	  advertising packets and scan response packets. It does not control
	  advertising start and stop.

if BT_ADV_PROV

module = BT_ADV_PROV
module-str = Bluetooth LE advertising providers
source "${ZEPHYR_BASE}/subsys/logging/Kconfig.template.log_config"

rsource "providers/Kconfig"

endif # BT_ADV_PROV
```

## subsys/bluetooth/adv_prov/providers/Kconfig
```kconfig
#
# Copyright (c) 2022 Nordic Semiconductor ASA
#
# SPDX-License-Identifier: LicenseRef-Nordic-5-Clause
#

comment "Bluetooth LE advertising providers"

rsource "Kconfig.fast_pair"
rsource "Kconfig.flags"
rsource "Kconfig.gap_appearance"
rsource "Kconfig.device_name"
rsource "Kconfig.swift_pair"
rsource "Kconfig.tx_power"
```

## subsys/bluetooth/adv_prov/providers/Kconfig.device_name
```kconfig
#
# Copyright (c) 2022 Nordic Semiconductor ASA
#
# SPDX-License-Identifier: LicenseRef-Nordic-5-Clause
#

menuconfig BT_ADV_PROV_DEVICE_NAME
	bool "Bluetooth device name"
	help
	  Adds Bluetooth device name to scan response data or advertising data.

if BT_ADV_PROV_DEVICE_NAME

config BT_ADV_PROV_DEVICE_NAME_PAIRING_MODE_ONLY
	bool "Provide device name only in pairing mode"
	default y
	help
	  If the option is enabled, the Bluetooth device name is not provided
	  outside of pairing mode.

config BT_ADV_PROV_DEVICE_NAME_SD
	bool "Move device name to scan response"
	default y
	help
	  Adds Bluetooth device name to scan response data. If this option is
	  disabled, the device name is included in the advertising data.

endif # BT_ADV_PROV_DEVICE_NAME
```

## subsys/bluetooth/adv_prov/providers/Kconfig.fast_pair
```kconfig
#
# Copyright (c) 2022 Nordic Semiconductor ASA
#
# SPDX-License-Identifier: LicenseRef-Nordic-5-Clause
#

menuconfig BT_ADV_PROV_FAST_PAIR
	bool "Google Fast Pair"
	depends on BT_FAST_PAIR
	help
	  Adds Google Fast Pair payload to advertising data.

	  If device is in pairing mode, provider uses Fast Pair discoverable
	  advertising. Otherwise, Fast Pair not discoverable advertising is used.
	  By default, battery data is not included in advertising payload.

	  Application can control the generated payload using provider's Kconfig
	  options or dedicated API.

if BT_ADV_PROV_FAST_PAIR

config BT_ADV_PROV_FAST_PAIR_ADV_BUF_SIZE
	int "Size of buffer used for advertising data"
	range 11 26
	default 26
	help
	  Size of the buffer must be big enough to fit Fast Pair advertising packet.

	  (10 + 1.2 * maximum number of Account Keys encoded in the advertising packet) - truncated
	  bytes are needed. Additional 4 bytes are needed when battery data is included in Fast Pair
	  advertising.

	  11 bytes are needed when battery data is not included in Fast Pair advertising
	  and only 1 Account Key has been written.

	  20 bytes are needed when battery data is included in Fast Pair advertising
	  and 5 Account Keys have been written.

	  26 bytes are needed when battery data is included in Fast Pair advertising
	  and 10 Account Keys have been written.

config BT_ADV_PROV_FAST_PAIR_SHOW_UI_PAIRING
	bool "Show UI indication in Fast Pair not discoverable advertising"
	default y
	help
	  The UI indication should be displayed if device is ready for pairing.
	  The provider also exposes API to show/hide UI indication in runtime.

choice BT_ADV_PROV_FAST_PAIR_BATTERY_DATA_MODE
	prompt "Select advertising battery data mode"
	default BT_ADV_PROV_FAST_PAIR_BATTERY_DATA_NONE
	help
	  The provider also exposes API to change battery data advertising mode in runtime.

config BT_ADV_PROV_FAST_PAIR_BATTERY_DATA_SHOW_UI
	bool "Include battery data in Fast Pair not discoverable advertising and show UI indication"
	help
	  When this option is enabled, battery data is included in Fast Pair not discoverable
	  advertising and the show battery data UI indication mode is enabled.

config BT_ADV_PROV_FAST_PAIR_BATTERY_DATA_HIDE_UI
	bool "Include battery data in Fast Pair not discoverable advertising and hide UI indication"
	help
	  When this option is enabled, battery data is included in Fast Pair not discoverable
	  advertising and the hide battery data UI indication mode is enabled.

config BT_ADV_PROV_FAST_PAIR_BATTERY_DATA_NONE
	bool "Do not include battery data in Fast Pair advertising"

endchoice

config BT_ADV_PROV_FAST_PAIR_AUTO_SET_PAIRING_MODE
	bool "Automatically set Fast Pair pairing mode"
	default y
	help
	  The advertising data provider automatically sets Fast Pair pairing
	  mode (using bt_fast_pair_set_pairing_mode API) while providing
	  advertising data. This is done to ensure consistency between Fast
	  Pair pairing mode and advertised data if generated advertising data
	  is instantly used in advertising packets.

config BT_ADV_PROV_FAST_PAIR_STOP_DISCOVERABLE_ON_RPA_ROTATION
	bool "Drop payload on RPA rotation while discoverable advertising"
	default y
	help
	  The Fast Pair specification requires no Resolvable Private Address
	  rotation during Fast Pair discoverable advertising session. The
	  provider desists from providing data after RPA was rotated during
	  ongoing Fast Pair discoverable advertising session.

endif # BT_ADV_PROV_FAST_PAIR
```

## subsys/bluetooth/adv_prov/providers/Kconfig.flags
```kconfig
#
# Copyright (c) 2022 Nordic Semiconductor ASA
#
# SPDX-License-Identifier: LicenseRef-Nordic-5-Clause
#

config BT_ADV_PROV_FLAGS
	bool "Advertising flags"
	help
	  Adds flag indicating that BR/EDR is not supported. If device is
	  in pairing mode, adds also General Discoverable flag.
```

## subsys/bluetooth/adv_prov/providers/Kconfig.gap_appearance
```kconfig
#
# Copyright (c) 2022 Nordic Semiconductor ASA
#
# SPDX-License-Identifier: LicenseRef-Nordic-5-Clause
#

menuconfig BT_ADV_PROV_GAP_APPEARANCE
	bool "GAP appearance"
	help
	  Adds Generic Access Profile (GAP) appearance to advertising data if
	  device is in pairing mode.

if BT_ADV_PROV_GAP_APPEARANCE

config BT_ADV_PROV_GAP_APPEARANCE_SD
	bool "Move GAP appearance to scan response"
	help
	  Moves the GAP appearance value to scan response data. By default, the
	  GAP appearance is included in the advertising data.

endif # BT_ADV_PROV_GAP_APPEARANCE
```

## subsys/bluetooth/adv_prov/providers/Kconfig.swift_pair
```kconfig
#
# Copyright (c) 2022 Nordic Semiconductor ASA
#
# SPDX-License-Identifier: LicenseRef-Nordic-5-Clause
#

menuconfig BT_ADV_PROV_SWIFT_PAIR
	bool "Microsoft Swift Pair"
	help
	  Adds Microsoft Swfit Pair manufacturer data to advertising data if
	  device is in pairing mode and advertising has not entered grace
	  period.

if BT_ADV_PROV_SWIFT_PAIR

config BT_ADV_PROV_SWIFT_PAIR_COOL_DOWN_DURATION
	int "Swift Pair cool down duration [s]"
	default 30
	range 30 600
	help
	  To ensure users would not try to connect to a device which is no
	  longer available, Swift Pair vendor section is removed and
	  advertising is continued without Swift Pair data for additional time
	  before the advertising is stopped.

	  The cool down phase is reported as requested grace period. The used
	  grace period is greater than or equal to the requested value.

endif # BT_ADV_PROV_SWIFT_PAIR
```

## subsys/bluetooth/adv_prov/providers/Kconfig.tx_power
```kconfig
#
# Copyright (c) 2022 Nordic Semiconductor ASA
#
# SPDX-License-Identifier: LicenseRef-Nordic-5-Clause
#

menuconfig BT_ADV_PROV_TX_POWER
	bool "TX power"
	select BT_CTLR_TX_PWR_DYNAMIC_CONTROL if BT_CTLR
	help
	  Adds TX power to advertising data. Provider reads the advertising TX
	  power from Bluetooth controller and adds predefined correction value
	  to it.

	  Tx power dynamic control is selected if Bluetooth controller is part
	  of the application. Otherwise, make sure to manually enable mentioned
	  feature in the Bluetooth controller configuration.

if BT_ADV_PROV_TX_POWER

config BT_ADV_PROV_TX_POWER_CORRECTION_VAL
	int "TX power correction value"
	default 0
	help
	  The configured value is added to the TX power incluced in the
	  advertising data. The correction may be needed to take into acccount
	  hardware configuration (e.g. used antenna, device's casing).

endif # BT_ADV_PROV_TX_POWER
```

## subsys/bluetooth/common/Kconfig
```kconfig
# Kconfig - common module configuration options

comment "BLE Libraries"

rsource "Kconfig.pool"
rsource "Kconfig.scan"
rsource "Kconfig.discovery"
```

## subsys/bluetooth/common/Kconfig.common
```kconfig
menuconfig NRF_BT_SVC_COMMON
	bool "Descriptor pools"
	default y if NRF_BT_HIDS
	help
	  Enable pools for UUID, characteristics and CCCD descriptors.

if NRF_BT_SVC_COMMON

config NRF_BT_UUID_16_POOL_SIZE
	int "Maximum number of 16-bit UUID descriptors"
	default 10
	range 0 255
	help
	  Maximum number of 16-bit UUID descriptors that can be dynamically registered.

config NRF_BT_UUID_32_POOL_SIZE
	int "Maximum number of 32-bit UUID descriptors"
	default 0
	range 0 255
	help
	  Maximum number of 32-bit UUID descriptors that can be dynamically registered.

config NRF_BT_UUID_128_POOL_SIZE
	int "Maximum number of 128-bit UUID descriptors"
	default 0
	range 0 255
	help
	  Maximum number of 128-bit UUID descriptors that can be dynamically registered.

config NRF_BT_CHRC_POOL_SIZE
	int "Maximum number of characteristic descriptors"
	default 5
	range 0 255
	help
	  Maximum number of characteristic descriptors that can be dynamically registered.

config NRF_BT_CCC_POOL_SIZE
	int "Maximum number of CCCD descriptors"
	default 5
	range 0 255
	help
	  Maximum number of CCCD descriptors that can be dynamically registered.

config NRF_BT_STATISTICS_PRINT
	bool
	prompt "Enable functions for printing module statistics"
	default n
	help
	  Enable functions for printing module statistics

endif # NRF_BT_SVC_COMMON
```

## subsys/bluetooth/common/Kconfig.discovery
```kconfig
menuconfig BT_GATT_DM
	bool "GATT Discovery Manager library"
	help
	  Enable BLE GATT Discovery Manager library

if BT_GATT_DM

config BT_GATT_DM_MAX_ATTRS
	int "Maximum number of attributes that can be present in the discovered service"
	default 35
	help
	  Maximum number of attributes that can be present in the discovered service.

config BT_GATT_DM_MAX_MEM_CHUNKS
	int "Maximum number of allocated memory chunks containing GATT attribute data"
	default 6
	help
	  Maximum number of allocated memory blocks containing GATT attribute data.

config BT_GATT_DM_DATA_PRINT
	bool
	prompt "Enable functions for printing discovery related data"
	default y
	select BT_DEBUG
	help
	  Enable functions for printing discovery related data

module = BT_GATT_DM
module-str = GATT database discovery
source "${ZEPHYR_BASE}/subsys/logging/Kconfig.template.log_config"

endif # BT_GATT_DM
```
