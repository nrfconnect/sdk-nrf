## subsys/bluetooth/common/Kconfig.scan
```kconfig
menuconfig NRF_BT_SCAN
	depends on BT_CENTRAL
	bool "Scan library"
	default n
	help
	  Enable BLE Scan library

if NRF_BT_SCAN

config NRF_BT_SCAN_NAME_MAX_LEN
	int "Maximum size for the name to search in the advertisement report."
	default 32
	help
	  "Maximum size for the name to search in the advertisement report."

config NRF_BT_SCAN_SHORT_NAME_MAX_LEN
	int "Maximum size of the short name to search for in the advertisement report."
	default 32
	help
	  Maximum size of the short name to search for in the advertisement report.

config NRF_BT_SCAN_FILTER_ENABLE
	bool "Enabling filters for the Scan library."
	default n
	help
	  Enabling filters for the Scan library.

if NRF_BT_SCAN_FILTER_ENABLE

config NRF_BT_SCAN_UUID_CNT
	int "Number of filters for UUIDs."
	default 0
	help
	  Number of filters for UUIDs

config NRF_BT_SCAN_NAME_CNT
	int "Number of name filters"
	default 0
	help
	  Number of name filters

config NRF_BT_SCAN_SHORT_NAME_CNT
	int "Number of short name filters"
	default 0
	help
	  Number of short name filters

config NRF_BT_SCAN_ADDRESS_CNT
	int "Number of address filters"
	default 0
	help
	  Number of address filters

config NRF_BT_SCAN_APPEARANCE_CNT
	int "Number of appearance filters"
	default 0
	help
	  Number of appearance filters
endif

if !NRF_BT_SCAN_FILTER_ENABLE

config NRF_BT_SCAN_UUID_CNT
	int
	default 0
	help
	  Number of filters for UUIDs

config NRF_BT_SCAN_NAME_CNT
	int
	default 0
	help
	  Number of name filters

config NRF_BT_SCAN_SHORT_NAME_CNT
	int
	default 0
	help
	  Number of short name filters

config NRF_BT_SCAN_ADDRESS_CNT
	int
	default 0
	help
	  Number of address filters

config NRF_BT_SCAN_APPEARANCE_CNT
	int
	default 0
	help
	  Number of appearance filters

endif

choice
	prompt "Scan logging level"
	default NRF_BT_SCAN_LOG_LEVEL_INF

config NRF_BT_SCAN_LOG_LEVEL_OFF
	bool "Off"
config NRF_BT_SCAN_LOG_LEVEL_ERR
	bool "Error"
config NRF_BT_SCAN_LOG_LEVEL_WRN
	bool "Warning"
config NRF_BT_SCAN_LOG_LEVEL_INF
	bool "Info"
config NRF_BT_SCAN_LOG_LEVEL_DBG
	bool "Debug"

endchoice

config NRF_BT_SCAN_LOG_LEVEL
	int
	default 0 if NRF_BT_SCAN_LOG_LEVEL_OFF
	default 1 if NRF_BT_SCAN_LOG_LEVEL_ERR
	default 2 if NRF_BT_SCAN_LOG_LEVEL_WRN
	default 3 if NRF_BT_SCAN_LOG_LEVEL_INF
	default 4 if NRF_BT_SCAN_LOG_LEVEL_DBG

endif # NRF_BT_SCAN
```
