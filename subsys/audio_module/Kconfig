## subsys/audio_module/Kconfig
```kconfig
#
# Copyright (c) 2023 Nordic Semiconductor ASA
#
# SPDX-License-Identifier: LicenseRef-Nordic-5-Clause
#
menu "Audio Modules"

config AUDIO_MODULE
	tristate "Audio module"
	depends on DATA_FIFO || AUDIO_MODULE_TEST

config AUDIO_MODULE_TEST
	bool "Test mode"
	help
	  Enable the test mode for the audio module.

config AUDIO_MODULE_NAME_SIZE
	int "Maximum size for module naming in characters"
	depends on AUDIO_MODULE
	default 20

#----------------------------------------------------------------------------#
menu "Log levels"

if AUDIO_MODULE || AUDIO_MODULE_TEST

module = AUDIO_MODULE
module-str = audio_module
source "subsys/logging/Kconfig.template.log_config"

endif

endmenu # Log levels
endmenu # Audio Modules
```

## subsys/audio_modules/lc3/Kconfig
```kconfig
#
# Copyright (c) 2024 Nordic Semiconductor ASA
#
# SPDX-License-Identifier: LicenseRef-Nordic-5-Clause
#

menu "Audio Modules"

config AUDIO_MODULE_LC3_DECODER_T2
	bool "Select the T2 software LC3 Decoder"
	depends on AUDIO_MODULE

#----------------------------------------------------------------------------#
menu "Log levels"

module = AUDIO_MODULE_LC3_DECODER_T2
module-str = lc3_decoder_t2
source "subsys/logging/Kconfig.template.log_config"

endmenu # Log levels
#----------------------------------------------------------------------------#

menu "LC3"
visible if SW_CODEC_LC3

config SW_LC3_PLC_DISABLED
	bool "Skip PLC on a bad frame and fill the output buffer(s) with zeros instead"
	default n
	select LC3_PLC_DISABLED

config SW_LC3_BITRATE_MAX
	int "Max bitrate"
	default 124000

config SW_LC3_BITRATE_MIN
	int "Min bitrate"
	default 32000

config SW_LC3_BITRATE
	int
	range SW_LC3_BITRATE_MIN SW_LC3_BITRATE_MAX
	default 96000

choice SW_LC3_FRAME_DURATION
	prompt "Select frame duration - 7.5 ms frame duration is not tested"
	default SW_LC3_FRAME_DURATION_10_MS
	help
	  LC3 supports frame duration of 7.5 and 10 ms.
	  If USB is selected as audio source, we should
	  have a frame duration of 10 ms since USB sends 1ms at a time.

config SW_LC3_FRAME_DURATION_7_5_MS
	bool "7.5 ms"

config SW_LC3_FRAME_DURATION_10_MS
	bool "10 ms"
endchoice

config SW_LC3_FRAME_DURATION_US
	int
	default 7500 if SW_LC3_FRAME_DURATION_7_5_MS
	default 10000 if SW_LC3_FRAME_DURATION_10_MS
	help
	  Audio frame duration in µs.

choice SW_LC3_SAMPLE_RATE
	prompt "Audio sample rate"
	default SW_LC3_SAMPLE_RATE_16000_HZ if BT_BAP_BROADCAST_16_2_1 || BT_BAP_BROADCAST_16_2_2 || BT_BAP_UNICAST_16_2_1
	default SW_LC3_SAMPLE_RATE_24000_HZ if BT_BAP_BROADCAST_24_2_1 || BT_BAP_BROADCAST_24_2_2 || BT_BAP_UNICAST_24_2_1
	default SW_LC3_SAMPLE_RATE_48000_HZ
	help
	  This will be selected based on the BAP settings.

config SW_LC3_SAMPLE_RATE_16000_HZ
	bool "16 kHz"
	help
	  Sample rate of 16kHz is currently only valid for I2S/line-in.

config SW_LC3_SAMPLE_RATE_24000_HZ
	bool "24 kHz"
	help
	  Sample rate of 24kHz is currently only valid for I2S/line-in.

config SW_LC3_SAMPLE_RATE_48000_HZ
	bool "48 kHz"
	help
	  Sample rate of 48kHz is valid for both I2S/line-in and USB.
endchoice

config SW_LC3_SAMPLE_RATE_HZ
	int
	default 16000 if SW_LC3_SAMPLE_RATE_16000_HZ
	default 24000 if SW_LC3_SAMPLE_RATE_24000_HZ
	default 48000 if SW_LC3_SAMPLE_RATE_48000_HZ
	help
	  I2S supports 16, 24, and 48 kHz sample rates for both input and output.
	  USB supports only 48 kHz for input.

choice SW_LC3_BIT_DEPTH
	prompt "Audio bit depth"
	default SW_LC3_BIT_DEPTH_16
	help
	  Select the bit depth for audio.

config SW_LC3_BIT_DEPTH_16
	bool "16 bit audio"

config SW_LC3_BIT_DEPTH_32
	bool "32 bit audio"
endchoice

config SW_LC3_BIT_DEPTH_BITS
	int
	default 16 if SW_LC3_BIT_DEPTH_16
	default 32 if SW_LC3_BIT_DEPTH_32
	help
	  Bit depth of one sample in storage.

config SW_LC3_BIT_DEPTH_OCTETS
	int
	default 2 if SW_LC3_BIT_DEPTH_16
	default 4 if SW_LC3_BIT_DEPTH_32
	help
	  Bit depth of one sample in storage given in octets.

#----------------------------------------------------------------------------#

osource "../nrfxlib/lc3/Kconfig"

endmenu # LC3
endmenu # Audio Modules
```

## subsys/audio_modules/lc3/t2/decoder/Kconfig
```kconfig
#
# Copyright (c) 2024 Nordic Semiconductor ASA
#
# SPDX-License-Identifier: LicenseRef-Nordic-5-Clause
#

menu "Audio Modules"

config AUDIO_MODULE_T2_LC3_DECODER
	bool "Enable the T2 LC3 decoder"
	default y
	help
	  Enable the T2 LC3 decoder audio module in test mode.

config AUDIO_MODULE_T2_LC3_DECODER_TEST
	bool "Enable the T2 LC3 decoder"
	default n
	help
	  Enable the T2 LC3 decoder audio module in test mode.


config LC3_DEC_CHANNELS_MAX
	int "Maximum audio channels"
	default 2
	help
	  The maximum audio channels the decoder can support.
	  
choice LC3_DECODER_FRAME_DURATION
	prompt "Select frame duration - 7.5 ms frame duration is not tested"
	default LC3_DECODER_FRAME_DURATION_10_MS
	help
	  LC3 supports frame duration of 7.5 and 10 ms.
	  
config LC3_DECODER_FRAME_DURATION_7_5_MS
	bool "7.5 ms"

config LC3_DECODER_FRAME_DURATION_10_MS
	bool "10 ms"
endchoice

config LC3_DECODER_FRAME_DURATION_US
	int
	default 7500 if LC3_DECODER_FRAME_DURATION_7_5_MS
	default 10000 if LC3_DECODER_FRAME_DURATION_10_MS
	help
	  Audio frame duration in µs.

choice LC3_DECODER_SYSTEM_SAMPLE_RATE
	prompt "System audio sample rate"
	default LC3_DECODER_SAMPLE_RATE_48000_HZ
	help
	  This configuration reflects the decoding sample rate.

config LC3_DECODER_SAMPLE_RATE_8000_HZ
	bool "8 kHz"
	help
	  Sample rate of 16kHz.

config LC3_DECODER_SAMPLE_RATE_16000_HZ
	bool "16 kHz"
	help
	  Sample rate of 16kHz.

config LC3_DECODER_SAMPLE_RATE_24000_HZ
	bool "24 kHz"
	help
	  Sample rate of 24kHz.

config LC3_DECODER_SAMPLE_RATE_32000_HZ
	bool "32 kHz"
	help
	  Sample rate of 16kHz.

config LC3_DECODER_SAMPLE_RATE_44100_HZ
	bool "44.1 kHz"
	help
	  Sample rate of 16kHz.

config LC3_DECODER_SAMPLE_RATE_48000_HZ
	bool "48 kHz"
	help
	  Sample rate of 48kHz.
endchoice

config LC3_DECODER_SAMPLE_RATE_HZ
	int
	default 8000  if LC3_DECODER_SAMPLE_RATE_8000_HZ
	default 16000 if LC3_DECODER_SAMPLE_RATE_16000_HZ
	default 24000 if LC3_DECODER_SAMPLE_RATE_24000_HZ
	default 32000 if LC3_DECODER_SAMPLE_RATE_32000_HZ
	default 44100 if LC3_DECODER_SAMPLE_RATE_44100_HZ
	default 48000 if LC3_DECODER_SAMPLE_RATE_48000_HZ
	help
	  I2S supports 16, 24, and 48 kHz sample rates for both input and output.
	  USB supports only 48 kHz for input.

choice LC3_DECODER_BIT_DEPTH
	prompt "Audio bit depth"
	default LC3_DECODER_BIT_DEPTH_16
	help
	  Select the bit depth for audio.

config LC3_DECODER_BIT_DEPTH_16
	bool "16 bit audio"

config LC3_DECODER_BIT_DEPTH_32
	bool "32 bit audio"
endchoice

config LC3_DECODER_BIT_DEPTH_BITS
	int
	default 16 if LC3_DECODER_BIT_DEPTH_16
	default 32 if LC3_DECODER_BIT_DEPTH_32
	help
	  Bit depth of one sample in storage.

config LC3_DECODER_BIT_DEPTH_OCTETS
	int
	default 2 if LC3_DECODER_BIT_DEPTH_16
	default 4 if LC3_DECODER_BIT_DEPTH_32
	help
	  Bit depth of one sample in storage given in octets.

config LC3_DECODER_THREAD_PRIO
	int "Priority for the decoder thread"
	default 3
	help
	  This is a preemptible thread.

config LC3_DECODER_STACK_SIZE
	int "Stack size for the decoder thread"
	default 11000 if LC3_DECODER_BIT_DEPTH_16
	default 21400 if LC3_DECODER_BIT_DEPTH_32
	help
	  The modules thread stack size.

osource "../nrfxlib/lc3/Kconfig"

#----------------------------------------------------------------------------#
menu "Log levels"

module = AUDIO_MODULE_LC3_DECODER
module-str = t2_lc3_decoder
source "subsys/logging/Kconfig.template.log_config"

endmenu # Log levels
endmenu # Audio Modules
```

## subsys/benchmark/Kconfig
```kconfig
#
# Copyright (c) 2022 Nordic Semiconductor ASA
#
# SPDX-License-Identifier: LicenseRef-Nordic-5-Clause
#

menu "Benchmark"

config BENCHMARK
	bool "Enable Benchmark component"
	help
	  Enable the benchmark component.

config BENCHMARK_ZIGBEE
	bool "Enable Benchmark for Zigbee"
	imply BENCHMARK
	imply ZIGBEE_SHELL
	help
	  The benchmark component for ZigBee.

endmenu
```

## subsys/bluetooth/Kconfig
```kconfig
#
# Copyright (c) 2018 Nordic Semiconductor
#
# SPDX-License-Identifier: LicenseRef-Nordic-5-Clause
#

menu "Bluetooth Low Energy"

if BT

config BT_COMPANY_ID_NORDIC
	hex
	# Will never change
	default 0x0059

config BT_COMPANY_ID
	hex
	default BT_COMPANY_ID_NORDIC

# BT_MAX_CONN is declared in Zephyr, here we add the range and default for
# BT_LL_SOFTDEVICE which is tested with 20 connections.
# When both connection roles are enabled there has to be one for each role.
config BT_MAX_CONN
	int
	range 1 20 if BT_LL_SOFTDEVICE
	default 2 if BT_LL_SOFTDEVICE && BT_CENTRAL && BT_PERIPHERAL
	help
	  When using the SoftDevice controller, the application needs to configure
	  the number of peripheral and central links explicity.
	  See BT_CTLR_SDC_PERIPHERAL_COUNT

config BT_LL_SOFTDEVICE_HEADERS_INCLUDE
	bool
	depends on (SOC_SERIES_BSIM_NRFXX || SOC_FAMILY_NORDIC_NRF)
	default y if !HAS_BT_CTLR
	help
	  Include SoftDevice header files provided with the library.

config BT_LL_SOFTDEVICE_HEADERS_INCLUDE_PATH_OVERRIDE
	bool

config BT_LONG_WQ_STACK_SIZE
	int
	default 2100 if (BT_ECC || BT_GATT_CACHING) && SOC_SERIES_NRF54L
	default 1800 if (BT_ECC || BT_GATT_CACHING)
	default 1024

rsource "controller/Kconfig"
rsource "host_extensions/Kconfig"
rsource "cs_de/Kconfig"

comment "BLE Libraries"
rsource "Kconfig.pool"
rsource "Kconfig.discovery"
rsource "adv_prov/Kconfig"
rsource "Kconfig.scan"
rsource "Kconfig.link"
rsource "Kconfig.enocean"
rsource "mesh/Kconfig"

rsource "services/Kconfig"

endif # BT

menu "BLE over nRF RPC"

rsource "rpc/Kconfig"

endmenu

endmenu
```

## subsys/bluetooth/Kconfig.discovery
```kconfig
#
# Copyright (c) 2019 Nordic Semiconductor ASA
#
# SPDX-License-Identifier: LicenseRef-Nordic-5-Clause
#

menuconfig BT_GATT_DM
	bool "GATT Discovery Manager library"
	help
	  Enable BLE GATT Discovery Manager library

if BT_GATT_DM

choice BT_GATT_DM_WORKQ_CHOICE
	prompt "GATT Discovery Manager workqueue selection"
	default BT_GATT_DM_WORKQ_OWN
	help
	  Select the workqueue implementation for GATT Discovery Manager.

config BT_GATT_DM_WORKQ_OWN
	bool "Use own workqueue"
	help
	  Use own workqueue for GATT Discovery Manager.

config BT_GATT_DM_WORKQ_SYS
	bool "Use system workqueue"
	help
	  Use system workqueue for GATT Discovery Manager. Can be used if creating a new thread
	  is not viable due to memory constraints.

endchoice

if BT_GATT_DM_WORKQ_OWN

config BT_GATT_DM_WORKQ_STACK_SIZE
	# Hidden option for workqueue stack size. Should be derived from system
	# requirements.
	int
	default 1300 if BT_GATT_CACHING
	default 1024

config BT_GATT_DM_WORKQ_PRIO
	int "GATT Discovery Manager workqueue priority."
	default 10
	help
	  Priority level for the GATT Discovery Manager workqueue.

config BT_GATT_DM_WORKQ_INIT_PRIO
	int "GATT Discovery Manager workqueue init priority"
	default 50
	help
	  Init priority level to setup the GATT Discovery Manager workqueue.

endif # BT_GATT_DM_WORKQ_OWN

config BT_GATT_DM_MAX_ATTRS
	int "Maximum number of attributes that can be present in the discovered service"
	default 35
	help
	  Maximum number of attributes that can be present in the discovered service.

config BT_GATT_DM_DATA_PRINT
	bool "Enable functions for printing discovery related data"
	help
	  Enable functions for printing discovery related data

config HEAP_MEM_POOL_ADD_SIZE_BT_GATT_DM
	int
	default 512

module = BT_GATT_DM
module-str = GATT database discovery
source "$(ZEPHYR_BASE)/subsys/logging/Kconfig.template.log_config"

endif # BT_GATT_DM
```

## subsys/bluetooth/Kconfig.enocean
```kconfig
#
# Copyright (c) 2020 Nordic Semiconductor ASA
#
# SPDX-License-Identifier: LicenseRef-BSD-5-Clause-Nordic
#

menuconfig BT_ENOCEAN
	bool "EnOcean library"
	depends on BT_OBSERVER
	depends on BT_HOST_CCM
	help
	  The EnOcean library implements support for commissioning and observing
	  of BLE enabled EnOcean devices, such as the PTM 215B Pushbutton
	  transmitter module.

if BT_ENOCEAN

config BT_ENOCEAN_DEVICES_MAX
	int "Maximum number of EnOcean devices"
	range 1 999
	default 1
	help
	  This value defines the maximum number of EnOcean devices this library
	  can manage at a time. Each device requires about 30 bytes of RAM.

menuconfig BT_ENOCEAN_STORE
	bool "Store EnOcean device data persistently"
	depends on BT_SETTINGS
	default y
	help
	  Stores all commissioned devices persistently, including periodic
	  samples of the device sequence number.

if BT_ENOCEAN_STORE

menuconfig BT_ENOCEAN_STORE_SEQ
	bool "Continuously store the EnOcean sequence number"
	default y
	help
	  Defines whether the sequence numbers of incoming EnOcean packets
	  should be stored persistently. The sequence number is used in
	  replay attack protection, and unless it is stored, third parties
	  will be able to replay EnOcean messages after a power cycle.

if BT_ENOCEAN_STORE_SEQ

config BT_ENOCEAN_STORE_TIMEOUT
	int "Delay (in seconds) before storing EnOcean data persistently"
	range 0 10000000
	default 5
	help
	  This parameter controls the duration of the write delay.
	  Whenever new EnOcean data is received, the library will start a timer
	  that stores the sequence number when it expires. Reducing this timer
	  shortens the timespan in which attackers could replay a message, but
	  increases the wear on the storage medium.

endif

endif

config BT_ENOCEAN_DEBUG
	bool "Enable debug logs"
	depends on BT_DEBUG
	help
	  Use this option to enable debug logs for the Bluetooth
	  Enocean functionality.

endif
```

## subsys/bluetooth/Kconfig.link
```kconfig
#
# Copyright (c) 2019 Nordic Semiconductor ASA
#
# SPDX-License-Identifier: LicenseRef-Nordic-5-Clause
#

menuconfig BT_CONN_CTX
	bool
	prompt "Connection context library"
	default n
	help
	  Enable the Bluetooth connection context library.
	  This library helps maintaining per-connection context data.

if BT_CONN_CTX

config BT_CONN_CTX_MEM_BUF_ALIGN
	int "Memory slab buffer alignment"
	default 4
	help
	 The memory buffer must be aligned to an N-byte boundary,
	 where N is a power of 2 larger than 2 (i.e. 4, 8, 16, …).

module = BT_CONN_CTX
module-str = connection context library
source "${ZEPHYR_BASE}/subsys/logging/Kconfig.template.log_config"

endif # BT_CONN_CTX
```

## subsys/bluetooth/Kconfig.pool
```kconfig
#
# Copyright (c) 2019 Nordic Semiconductor ASA
#
# SPDX-License-Identifier: LicenseRef-Nordic-5-Clause
#

menuconfig BT_GATT_POOL
	bool "GATT Attribute pools"
	help
	  Enable pools for UUID, characteristics and CCCD descriptors.

if BT_GATT_POOL

config BT_GATT_UUID16_POOL_SIZE
	int "Number of 16-bit UUID descriptors"
	default 10
	range 0 255
	help
	  Maximum number of 16-bit UUID descriptors that can be stored in the pool.

config BT_GATT_UUID32_POOL_SIZE
	int "Number of 32-bit UUID descriptors"
	default 0
	range 0 255
	help
	  Maximum number of 32-bit UUID descriptors that can be stored in the pool.

config BT_GATT_UUID128_POOL_SIZE
	int "Number of 128-bit UUID descriptors"
	default 0
	range 0 255
	help
	  Maximum number of 128-bit UUID descriptors that can be stored in the pool.

config BT_GATT_CHRC_POOL_SIZE
	int "Number of characteristic descriptors"
	default 5
	range 0 255
	help
	  Maximum number of characteristic descriptors that can be stored in the pool.

config BT_GATT_POOL_STATS
	bool
	prompt "Enable functions for printing module statistics"
	default n
	help
	  Enable functions for printing module statistics

module = BT_GATT_POOL
module-str = GATT_POOL
source "${ZEPHYR_BASE}/subsys/logging/Kconfig.template.log_config"

endif # BT_GATT_POOL
```
