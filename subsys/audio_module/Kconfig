## subsys/bluetooth/cs_de/Kconfig
```kconfig
#
# Copyright (c) 2025 Nordic Semiconductor
#
# SPDX-License-Identifier: LicenseRef-Nordic-5-Clause
#

menuconfig BT_CS_DE
	bool "Bluetooth Channel Sounding Distance Estimation [EXPERIMENTAL]"
	depends on BT_CHANNEL_SOUNDING
	imply FPU
	select FPU_SHARING if FPU
	select CMSIS_DSP
	select CMSIS_DSP_TRANSFORM
	select CMSIS_DSP_STATISTICS
	select EXPERIMENTAL


if BT_CS_DE

module = BT_CS_DE
module-str = CS_DE
source "$(ZEPHYR_BASE)/subsys/logging/Kconfig.template.log_config"

choice BT_CS_DE_NFFT_SIZE_SELECTION
	prompt "FFT size used in the CS_DE IFFT algorithm"
	default BT_CS_DE_512_NFFT

config BT_CS_DE_512_NFFT
	bool "Use NFFT with 512 samples."

config BT_CS_DE_1024_NFFT
	bool "Use NFFT with 1024 samples."

config BT_CS_DE_2048_NFFT
	bool "Use NFFT with 2048 samples."

endchoice

config BT_CS_DE_NFFT_SIZE
	int
	default 512 if BT_CS_DE_512_NFFT
	default 1024 if BT_CS_DE_1024_NFFT
	default 2048 if BT_CS_DE_2048_NFFT
	help
	  Internal config. Not intended for use.

endif # BT_CS_DE
```

## subsys/bluetooth/fast_pair/fhn/pf/Kconfig
```kconfig
#
# Copyright (c) 2026 Nordic Semiconductor ASA
#
# SPDX-License-Identifier: LicenseRef-Nordic-5-Clause
#

config BT_FAST_PAIR_FHN_PF
	bool "Precision Finding support for the Find Hub Network extension [EXPERIMENTAL]"
	select EXPERIMENTAL
	help
	  Enable the Precision Finding support in the Find Hub Network (FHN)
	  extension for Fast Pair.
```
