## subsys/rtfw/Kconfig
```kconfig
#
# Copyright (c) 2026 Nordic Semiconductor
#
# SPDX-License-Identifier: LicenseRef-Nordic-5-Clause
#

menuconfig RTFW
	bool "App-domain event-driven real-time framework"
	depends on ATOMIC_OPERATIONS_BUILTIN || ATOMIC_OPERATIONS_ARCH
	depends on !SMP
	depends on SOC_FAMILY_NORDIC_NRF || ZTEST
	help
	  Enable the same-core, event-driven framework for a small backend-owned
	  zero-latency fast path. The framework provides a latest-wins command
	  mailbox, coherent applied status and bounded RT-to-Zephyr delivery.

if RTFW

config RTFW_COMMAND_DATA_SIZE
	int "Opaque command payload size"
	default 16
	range 4 64
	help
	  Maximum backend-specific command payload size in bytes.

config RTFW_EVENT_QUEUE_SIZE
	int "RT-to-Zephyr event queue size"
	default 16
	range 2 256
	help
	  Number of fixed-size entries in the public Zephyr SPSC queue. The value
	  must be a power of two.

config RTFW_QUEUE_USAGE_STATS
	bool "Track maximum event queue depth"
	default y
	help
	  Track the maximum number of queued events observed since
	  initialization. Disable this option to remove queue-depth calculation
	  and its atomic update from the zero-latency producer path. Overflow
	  counters and fault reporting remain enabled.

config RTFW_DRAIN_BUDGET
	int "Maximum events handled per work item"
	default 8
	range 1 256
	help
	  Bounds one invocation of the dedicated delivery work item. If events
	  remain, the work item resubmits itself.

config RTFW_WORKQ_STACK_SIZE
	int "Dedicated delivery workqueue stack size"
	default 1536

config RTFW_WORKQ_PRIORITY
	int "Dedicated delivery workqueue priority"
	default 5

config RTFW_EGU_IRQ_PRIORITY
	int "Normal-priority EGU doorbell IRQ priority"
	default 1

config RTFW_NRF_EGU
	bool
	depends on SOC_FAMILY_NORDIC_NRF
	depends on !RTFW_TEST
	default y

config RTFW_TEST
	bool
	depends on ZTEST

endif # RTFW
```

## subsys/vtf_monitoring/Kconfig
```kconfig
#
# Copyright (c) 2026 Nordic Semiconductor ASA
#
# SPDX-License-Identifier: LicenseRef-Nordic-5-Clause
#


# Workaround for not being able to have commas in macro arguments
DT_CHOSEN_VTF_REGION := nordic,vtf-region

menuconfig VTF_MONITORING
	bool "Subsystem to monitor VTF"
	depends on $(dt_chosen_enabled,$(DT_CHOSEN_VTF_REGION))
	help
	  Enable the VTF (Voltage-Temperature-Frequency) monitoring.
	  Each enabled channel collects live data through its own
	  work item.

if VTF_MONITORING

menuconfig VTF_DIE_TEMP_MONITOR
	bool "Monitor die temperature"
	depends on HAS_HW_NRF_TEMP
	select SENSOR
	select TEMP_NRF5

if VTF_DIE_TEMP_MONITOR

config VTF_DIE_TEMP_MONITOR_INTERVAL_MS
	int "Die temperature measurement interval (ms)"
	default 10000
	help
	  Interval between die temperature measurements in milliseconds.

endif # VTF_DIE_TEMP_MONITOR

config VTF_FREQ_OFFSET_MONITOR
	bool "Monitor frequency offset"

config VTF_BATTERY_VOLTAGE_MONITOR
	bool "Monitor battery voltage"

config VTF_LOG_LEVEL
	int "Logging level in VTF monitoring system"
	default LOG_DEFAULT_LEVEL
	depends on LOG
	help
	  Sets the logging level for VTF monitoring.

config VTF_DIE_TEMP_DEFAULT_VALUE
	int "Die temperature default value (degC)"
	default 25
	help
	  Default value when VTF_DIE_TEMP_MONITOR=n. 25 = 25 C.

config VTF_BATTERY_VOLTAGE_DEFAULT_VALUE
	int "Battery voltage default value (0.100V)"
	default 35
	help
	  Default value when VTF_BATTERY_VOLTAGE_MONITOR=n. 35 = 3.5 V.

config VTF_FREQ_OFFSET_DEFAULT_VALUE
	int "Frequency offset default value (ppm)"
	default 0
	help
	  Default value when VTF_FREQ_OFFSET_MONITOR=n. 0 = 0 ppm.

config VTF_SNAPSHOT_INTERVAL_MS
	int "Snapshot interval (ms)"
	default 10000
	help
	  How often a snapshot is captured from every
	  enabled channel.

endif # VTF_MONITORING
```

## sysbuild/Kconfig.cracen
```kconfig
# Copyright (c) 2024 Nordic Semiconductor
#
# SPDX-License-Identifier: LicenseRef-Nordic-5-Clause

config SUPPORT_CRACEN
	bool
	default y if SOC_SERIES_NRF54L
	help
	  Hidden symbol indicating if CRACEN is supported on the device.

if SUPPORT_CRACEN

config SUPPORT_CRACEN_MICROCODE
	bool
	default y if SOC_NRF54L15 || SOC_NRF54L10 || SOC_NRF54L05
	help
	  Hidden symbol indicating if CRACEN microcode loading is supported on the device.

config CRACEN_KMU_CUSTOM_LAYOUT
	bool "Use a custom CRACEN KMU slot layout in all images"
	help
	  Apply the KMU slot layout below to every image, so that all images agree on the slots
	  reserved by the CRACEN driver. The layout is stored in the CRACEN_KMU_* Kconfig options
	  of each image. If not enabled, each image uses its own values for these options.

if CRACEN_KMU_CUSTOM_LAYOUT

config CRACEN_KMU_PROVISIONING_SLOT
	int "KMU slot recording that provisioning is in progress"
	range 0 255
	default 186

config CRACEN_KMU_PROT_RAM_INV_SLOT
	int "First KMU slot of the protected RAM invalidation data (2 slots)"
	range 0 254
	default 248

config CRACEN_IKG_SEED_KMU_SLOT
	int "First KMU slot of the CRACEN IKG seed (3 slots)"
	range 0 253
	default 183

config CRACEN_KMU_NS_SLOT_FIRST
	int "First KMU slot the TF-M non-secure agent may access"
	range 0 255
	default 0

config CRACEN_KMU_NS_SLOT_LAST
	int "Last KMU slot the TF-M non-secure agent may access"
	range 0 255
	default 179

endif # CRACEN_KMU_CUSTOM_LAYOUT

if SUPPORT_CRACEN_MICROCODE

menu "CRACEN"

config CRACEN_MICROCODE_LOAD_B0
	bool
	depends on SECURE_BOOT_APPCORE && SECURE_BOOT_SIGNATURE_TYPE_ED25519
	default y
	help
	  Hidden symbol indicating if b0 is using CRACEN.

config CRACEN_MICROCODE_LOAD_MCUBOOT
	bool
	depends on BOOTLOADER_MCUBOOT && BOOT_SIGNATURE_TYPE_ED25519
	default y
	help
	  Hidden symbol indicating if MCUboot is using CRACEN.

config CRACEN_MICROCODE_LOAD_ONCE
	bool "Load CRACEN microcode once only"
	depends on CRACEN_MICROCODE_LOAD_B0 || CRACEN_MICROCODE_LOAD_MCUBOOT
	default y
	help
	  If enabled, will only load microcode for CRACEN in the first system bootable image,
	  which will be either b0 or MCUboot, depending on project configuration.

endmenu

endif # SUPPORT_CRACEN_MICROCODE

endif # SUPPORT_CRACEN
```

## tests/benchmarks/can_performance/Kconfig
```kconfig
#
# Copyright (c) 2026 Nordic Semiconductor ASA
#
# SPDX-License-Identifier: LicenseRef-Nordic-5-Clause
#

mainmenu "CAN performance benchmark"

config TEST_CAN_PERF_FRAME_COUNT
	int "Number of frames per throughput test"
	default 100 if !TEST_CAN_PERF_SHORT_RUN
	default 10 if TEST_CAN_PERF_SHORT_RUN
	help
	  Number of frames transmitted during each throughput measurement.

config TEST_CAN_PERF_LATENCY_SAMPLES
	int "Number of round-trip latency samples"
	default 50 if !TEST_CAN_PERF_SHORT_RUN
	default 5 if TEST_CAN_PERF_SHORT_RUN
	help
	  Number of send/receive iterations used for latency statistics.

config TEST_CAN_PERF_SUSTAINED_ROUNDTRIP_COUNT
	int "Number of sustained round-trip latency samples"
	default 50 if !TEST_CAN_PERF_SHORT_RUN
	default 5 if TEST_CAN_PERF_SHORT_RUN
	help
	  Repeated send (wait TX complete, then RX msgq) in internal loopback.

config TEST_CAN_PERF_BURST_FRAME_COUNT
	int "Number of frames for RX burst test"
	default 3
	help
	  Frames sent without reading the RX message queue before draining it.
	  Should not exceed the controller RX FIFO depth.

config TEST_CAN_PERF_NOMINAL_SAMPLE_POINT
	int "Nominal (arbitration) sample point in permille"
	default 875
	help
	  Same default as zephyr/tests/drivers/can/api (TEST_SAMPLE_POINT) and
	  zephyr/tests/drivers/can/timing CiA 301 nominal bitrates.

config TEST_CAN_PERF_FD_DATA_SAMPLE_POINT
	int "CAN FD data-phase sample point in permille"
	default 750
	help
	  Same default as zephyr/tests/drivers/can/timing data-phase tests.

config TEST_CAN_PERF_FD_BITRATE
	int "Arbitration bitrate for CAN FD performance tests in bit/s"
	default 1000000
	help
	  Arbitration-phase bitrate for CAN FD throughput tests.

config TEST_CAN_PERF_FD_BITRATE_DATA
	int "Data-phase bitrate for CAN FD performance tests in bit/s"
	default 8000000
	help
	  Data-phase bitrate for CAN FD throughput tests with BRS enabled.

config TEST_CAN_PERF_MIN_BUS_EFFICIENCY_PERMILLE
	int "Minimum bus efficiency in permille"
	default 500
	help
	  Measured throughput must be at least this fraction of the theoretical
	  bus maximum. 500 equals 50%.

config TEST_CAN_PERF_STRICT_THRESHOLDS
	bool "Enable hard minimum throughput limits"
	help
	  When enabled, additional fixed minimum throughput limits are enforced.

config TEST_CAN_PERF_MIN_TX_FPS_CLASSIC
	int "Minimum classic CAN throughput in frames/s"
	default 0
	help
	  Hard lower limit for classic throughput when
	  CONFIG_TEST_CAN_PERF_STRICT_THRESHOLDS is enabled. Zero disables the check.

config TEST_CAN_PERF_MIN_TX_FPS_FD
	int "Minimum CAN FD throughput in frames/s"
	default 0
	help
	  Hard lower limit for CAN FD throughput when
	  CONFIG_TEST_CAN_PERF_STRICT_THRESHOLDS is enabled. Zero disables the check.

config TEST_CAN_PERF_MAX_AVG_LATENCY_US
	int "Maximum average round-trip latency in microseconds"
	default 10000
	help
	  Loose upper bound for average send-to-receive latency.

config TEST_CAN_PERF_SHORT_RUN
	bool "Run a shortened benchmark (fewer frames, single classic bitrate)"
	help
	  Used by automated PPK/pytest scenarios to limit runtime.

config TEST_CAN_PERF_DEAD_TIME_MS
	int "Idle time between benchmark phases in milliseconds"
	default 1000
	help
	  Delay between scenarios for baseline idle current measurement windows.

source "Kconfig.zephyr"
```
