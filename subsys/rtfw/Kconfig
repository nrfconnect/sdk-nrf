## tests/benchmarks/crypto/Kconfig
```kconfig
#
# Copyright (c) 2026 Nordic Semiconductor ASA
#
# SPDX-License-Identifier: LicenseRef-Nordic-5-Clause
#

menu "Crypto benchmarks"

choice CRYPTO_BENCHMARKS_OUTPUT_FORMAT
	prompt "Format of the operation summary"
	default CRYPTO_BENCHMARKS_OUTPUT_TEXT

config CRYPTO_BENCHMARKS_OUTPUT_TEXT
	bool "Human-readable table"
	help
	  One log line per operation, aligned into a table.

config CRYPTO_BENCHMARKS_OUTPUT_JSON
	bool "JSON, for machine consumption"
	help
	  One JSON document, printed between the markers
	  ---CRYPTO-DEMO-JSON-BEGIN--- and ---CRYPTO-DEMO-JSON-END--- so that it
	  can be cut out of a serial capture that also holds log output. Every
	  operation carries the name of the src/suites folder it came from, so
	  that a consumer can group the results by cryptographic family.

	  The document is printed with printk() rather than logged, because the
	  log prefix would leave it unparsable.

endchoice

config CRYPTO_BENCHMARKS_OP_STACK_SIZE
	int "Stack size of the operation threads"
	default 32768
	help
	  Size of the single stack that every operation thread reuses. The
	  operations run one at a time, so this is sized for the most demanding
	  one rather than for the sum of them.

config CRYPTO_BENCHMARKS_OP_TIMEOUT_MS
	int "Time to wait for an operation to finish, in milliseconds"
	default 30000
	help
	  An operation thread does not log, so one that faults or wedges cannot
	  report it. If it has not finished within this time the runner records
	  it as failed and carries on.

config CRYPTO_BENCHMARKS_PSA_CIPHER
	bool "Enable all PSA cipher tests"
	default y
	select PSA_CRYPTO
	select PSA_WANT_ALG_CBC_NO_PADDING
	select PSA_WANT_ALG_CBC_PKCS7
	select PSA_WANT_ALG_CTR
	select PSA_WANT_ALG_ECB_NO_PADDING
	select PSA_WANT_ALG_STREAM_CIPHER
	select PSA_WANT_KEY_TYPE_AES
	select PSA_WANT_KEY_TYPE_CHACHA20

config CRYPTO_BENCHMARKS_PSA_AEAD
	bool "Enable all PSA AEAD tests"
	default y
	select PSA_CRYPTO
	select PSA_WANT_ALG_CCM
	select PSA_WANT_ALG_GCM
	select PSA_WANT_ALG_CHACHA20_POLY1305
	select PSA_WANT_KEY_TYPE_AES
	select PSA_WANT_KEY_TYPE_CHACHA20

config CRYPTO_BENCHMARKS_PSA_HASH
	bool "Enable all PSA hash tests"
	default y
	select PSA_CRYPTO
	select PSA_WANT_ALG_SHA_1
	select PSA_WANT_ALG_SHA_224
	select PSA_WANT_ALG_SHA_256
	select PSA_WANT_ALG_SHA_384
	select PSA_WANT_ALG_SHA_512
	select PSA_WANT_ALG_SHA3_224
	select PSA_WANT_ALG_SHA3_256
	select PSA_WANT_ALG_SHA3_384
	select PSA_WANT_ALG_SHA3_512

config CRYPTO_BENCHMARKS_PSA_XOF
	bool "Enable all PSA XOF tests"
	default y
	select PSA_CRYPTO
	select PSA_WANT_ALG_SHAKE256_512
	select PSA_WANT_ALG_SHAKE128
	select PSA_WANT_ALG_SHAKE256

config CRYPTO_BENCHMARKS_PSA_MAC
	bool "Enable all PSA MAC tests"
	default y
	select PSA_CRYPTO
	select PSA_WANT_ALG_HMAC
	select PSA_WANT_ALG_CMAC
	select PSA_WANT_ALG_SHA_1
	select PSA_WANT_ALG_SHA_224
	select PSA_WANT_ALG_SHA_256
	select PSA_WANT_ALG_SHA_384
	select PSA_WANT_ALG_SHA_512
	select PSA_WANT_KEY_TYPE_HMAC
	select PSA_WANT_KEY_TYPE_AES

config CRYPTO_BENCHMARKS_PSA_KEY_DERIVATION
	bool "Enable all PSA key derivation tests"
	default y
	select PSA_CRYPTO
	select PSA_WANT_ALG_HKDF
	select PSA_WANT_ALG_PBKDF2_HMAC
	select PSA_WANT_ALG_TLS12_PRF
	select PSA_WANT_ALG_TLS12_PSK_TO_MS
	select PSA_WANT_ALG_HMAC
	select PSA_WANT_ALG_SHA_256
	select PSA_WANT_KEY_TYPE_DERIVE
	select PSA_WANT_KEY_TYPE_PASSWORD

config CRYPTO_BENCHMARKS_PSA_KEY_AGREEMENT
	bool "Enable all PSA key agreement tests"
	default y
	select PSA_CRYPTO
	select PSA_WANT_ALG_ECDH
	select PSA_WANT_KEY_TYPE_ECC_KEY_PAIR_GENERATE
	select PSA_WANT_KEY_TYPE_ECC_KEY_PAIR_IMPORT
	select PSA_WANT_KEY_TYPE_ECC_KEY_PAIR_EXPORT
	select PSA_WANT_KEY_TYPE_ECC_PUBLIC_KEY
	select PSA_WANT_ECC_BRAINPOOL_P_R1_256
	select PSA_WANT_ECC_BRAINPOOL_P_R1_384
	select PSA_WANT_ECC_BRAINPOOL_P_R1_512
	select PSA_WANT_ECC_MONTGOMERY_255
	select PSA_WANT_ECC_MONTGOMERY_448
	select PSA_WANT_ECC_SECP_K1_256
	select PSA_WANT_ECC_SECP_R1_224
	select PSA_WANT_ECC_SECP_R1_256
	select PSA_WANT_ECC_SECP_R1_384
	select PSA_WANT_ECC_SECP_R1_521

config CRYPTO_BENCHMARKS_PSA_SIGNATURE
	bool "Enable all PSA signature tests"
	default y
	select PSA_CRYPTO
	select PSA_WANT_ALG_ECDSA
	select PSA_WANT_ALG_PURE_EDDSA
	select PSA_WANT_ALG_RSA_PKCS1V15_SIGN
	select PSA_WANT_ALG_RSA_PSS
	select PSA_WANT_ALG_ML_DSA
	# Only the public key type: Cracen has no ML-DSA key pair support at all,
	# so the suite imports a known-answer public key and verifies with it.
	select PSA_WANT_KEY_TYPE_ML_DSA_PUBLIC_KEY
	select PSA_WANT_ML_DSA_KEY_SIZE_65
	# Cracen builds ML-DSA out of these.
	select PSA_WANT_ALG_SHAKE128
	select PSA_WANT_ALG_SHA_1
	select PSA_WANT_ALG_SHA_224
	select PSA_WANT_ALG_SHA_256
	select PSA_WANT_ALG_SHA_384
	select PSA_WANT_ALG_SHA_512
	select PSA_WANT_ALG_SHAKE256
	select PSA_WANT_KEY_TYPE_ECC_KEY_PAIR_GENERATE
	select PSA_WANT_KEY_TYPE_RSA_KEY_PAIR_GENERATE
	select PSA_WANT_ECC_BRAINPOOL_P_R1_256
	select PSA_WANT_ECC_BRAINPOOL_P_R1_384
	select PSA_WANT_ECC_BRAINPOOL_P_R1_512
	select PSA_WANT_ECC_SECP_K1_256
	select PSA_WANT_ECC_SECP_R1_224
	select PSA_WANT_ECC_SECP_R1_256
	select PSA_WANT_ECC_SECP_R1_384
	select PSA_WANT_ECC_SECP_R1_521
	select PSA_WANT_ECC_TWISTED_EDWARDS_255
	select PSA_WANT_RSA_KEY_SIZE_4096
	select PSA_WANT_RSA_KEY_SIZE_2048

config CRYPTO_BENCHMARKS_PSA_ASYMMETRIC_ENCRYPTION
	bool "Enable all PSA asymmetric encryption tests"
	default y
	select PSA_CRYPTO
	select PSA_WANT_ALG_RSA_OAEP
	select PSA_WANT_ALG_RSA_PKCS1V15_CRYPT
	select PSA_WANT_ALG_SHA_256
	select PSA_WANT_KEY_TYPE_RSA_KEY_PAIR_GENERATE
	select PSA_WANT_RSA_KEY_SIZE_2048

config CRYPTO_BENCHMARKS_PSA_PAKE
	bool "Enable all PSA PAKE tests"
	default y
	select PSA_CRYPTO
	# EC J-PAKE, the same set as samples/crypto/ecjpake.
	select PSA_WANT_ALG_JPAKE
	select PSA_WANT_ALG_TLS12_ECJPAKE_TO_PMS
	select PSA_WANT_ALG_SHA_256
	select PSA_WANT_KEY_TYPE_PASSWORD
	select PSA_WANT_KEY_TYPE_DERIVE
	select PSA_WANT_KEY_TYPE_ECC_PUBLIC_KEY
	select PSA_WANT_ECC_SECP_R1_256
	# SPAKE2+, the same set as samples/crypto/spake2p. Both sides import a
	# half of a registration record, so the key pair and the public key type
	# are both needed, and HKDF turns the agreed secret into bytes.
	select PSA_WANT_ALG_SPAKE2P_HMAC
	select PSA_WANT_KEY_TYPE_SPAKE2P_KEY_PAIR_IMPORT
	select PSA_WANT_KEY_TYPE_SPAKE2P_PUBLIC_KEY
	select PSA_WANT_ALG_HKDF
	select PSA_WANT_ALG_HMAC
	# SRP-6. Cracen's implementation is hardwired to SHA-512 over the
	# 3072-bit MODP group, so SHA-512 is not optional here. The client
	# derives its private key with the SRP password hash rather than
	# importing one, and the server imports the verifier as a public key.
	select PSA_WANT_ALG_SRP_6
	select PSA_WANT_ALG_SRP_PASSWORD_HASH
	select PSA_WANT_ALG_SHA_512
	select PSA_WANT_KEY_TYPE_SRP_KEY_PAIR_DERIVE
	select PSA_WANT_KEY_TYPE_SRP_PUBLIC_KEY

config CRYPTO_BENCHMARKS_PSA_KEY_WRAP
	bool "Enable all PSA key wrap tests"
	default y
	select PSA_CRYPTO
	select PSA_WANT_ALG_AES_KW
	select PSA_WANT_ALG_AES_KWP
	select PSA_WANT_ALG_ECB_NO_PADDING
	select PSA_WANT_KEY_TYPE_AES

config CRYPTO_BENCHMARKS_PSA_RNG
	bool "Enable all PSA RNG tests"
	default y
	select PSA_CRYPTO
	select PSA_WANT_GENERATE_RANDOM

endmenu

source "Kconfig.zephyr"
```

## tests/benchmarks/crypto/sample.yaml
```yaml
sample:
  description: |
    This sample demonstrates the PSA Crypto API operations of the individual
    crypto samples in one application, split into key setup, single-part and
    multipart stages, with one thread per operation.
  name: Crypto benchmarks
common:
  sysbuild: true
  tags:
    - introduction
    - psa
    - sysbuild
    - ci_samples_crypto
    - crypto
  harness: console
  harness_config:
    type: multi_line
    regex:
      - ".*Example finished successfully!.*"
tests:
  sample.crypto.crypto_benchmarks.cc3xx:
    tags:
      - cc3xx
    platform_allow:
      - nrf5340dk/nrf5340/cpuapp/ns
      - nrf5340dk/nrf5340/cpuapp
      - nrf9160dk/nrf9160/ns
      - nrf9160dk/nrf9160
      - nrf52840dk/nrf52840
      - nrf9161dk/nrf9161
      - nrf9161dk/nrf9161/ns
      - nrf9151dk/nrf9151
      - nrf9151dk/nrf9151/ns
    integration_platforms:
      - nrf5340dk/nrf5340/cpuapp/ns
      - nrf5340dk/nrf5340/cpuapp
      - nrf9160dk/nrf9160/ns
      - nrf9160dk/nrf9160
      - nrf52840dk/nrf52840
      - nrf9161dk/nrf9161
      - nrf9161dk/nrf9161/ns
      - nrf9151dk/nrf9151
      - nrf9151dk/nrf9151/ns
  sample.crypto.crypto_benchmarks.cracen:
    tags:
      - cracen
    platform_allow:
      - nrf54l15dk/nrf54l15/cpuapp
      - nrf54l15dk/nrf54l15/cpuapp/ns
      - nrf54l15dk/nrf54l10/cpuapp
      - nrf54l15dk/nrf54l10/cpuapp/ns
      - nrf54l15dk/nrf54l05/cpuapp
      - nrf54ls05dk/nrf54ls05a/cpuapp
      - nrf54ls05dk/nrf54ls05b/cpuapp
      - nrf54lm20dk/nrf54lm20a/cpuapp
      - nrf54lm20dk/nrf54lm20a/cpuapp/ns
      - nrf54lm20dk/nrf54lm20b/cpuapp
      - nrf54lm20dk/nrf54lm20b/cpuapp/ns
      - nrf54lv10dk/nrf54lv10a/cpuapp
      - nrf54lv10dk/nrf54lv10a/cpuapp/ns
      - nrf54lc10dk/nrf54lc10a/cpuapp
      - nrf54lc10dk/nrf54lc10a/cpuapp/ns
      - nrf7120dk/nrf7120/cpuapp
      - nrf7120dk/nrf7120/cpuapp/ns
    integration_platforms:
      - nrf54l15dk/nrf54l15/cpuapp
      - nrf54l15dk/nrf54l15/cpuapp/ns
      - nrf54l15dk/nrf54l10/cpuapp
      - nrf54l15dk/nrf54l10/cpuapp/ns
      - nrf54l15dk/nrf54l05/cpuapp
      - nrf54ls05dk/nrf54ls05a/cpuapp
      - nrf54ls05dk/nrf54ls05b/cpuapp
      - nrf54lm20dk/nrf54lm20a/cpuapp
      - nrf54lm20dk/nrf54lm20a/cpuapp/ns
      - nrf54lm20dk/nrf54lm20b/cpuapp
      - nrf54lm20dk/nrf54lm20b/cpuapp/ns
      - nrf54lv10dk/nrf54lv10a/cpuapp
      - nrf54lv10dk/nrf54lv10a/cpuapp/ns
      - nrf54lc10dk/nrf54lc10a/cpuapp
      - nrf54lc10dk/nrf54lc10a/cpuapp/ns
      - nrf7120dk/nrf7120/cpuapp
      - nrf7120dk/nrf7120/cpuapp/ns
  sample.crypto.crypto_benchmarks.cracen.json:
    tags:
      - cracen
    extra_configs:
      - CONFIG_CRYPTO_BENCHMARKS_OUTPUT_JSON=y
    platform_allow:
      - nrf54l15dk/nrf54l15/cpuapp
    integration_platforms:
      - nrf54l15dk/nrf54l15/cpuapp
  sample.crypto.crypto_benchmarks.cracen.crypto_service:
    tags:
      - cracen
    platform_allow:
      - nrf54h20dk/nrf54h20/cpuapp
    integration_platforms:
      - nrf54h20dk/nrf54h20/cpuapp
```

## tests/benchmarks/current_consumption/hpf_gpio_idle/testcase.yaml
```yaml
common:
  tags:
    - ci_tests_benchmarks_current_consumption
    - ppk_power_measure
  depends_on: gpio
  harness: pytest
  harness_config:
    fixture: gpio_loopback
    pytest_root:
      - "${CUSTOM_ROOT_TEST_DIR}/test_measure_power_consumption.py::test_current_consumption_hpf_gpio_idle"
  platform_allow:
    - nrf54l15dk/nrf54l15/cpuapp
    - nrf54lm20dk/nrf54lm20a/cpuapp
    - nrf54lm20dk/nrf54lm20b/cpuapp
    - nrf54lv10dk/nrf54lv10a/cpuapp
    - nrf54lc10dk/nrf54lc10a/cpuapp
  integration_platforms:
    - nrf54l15dk/nrf54l15/cpuapp
  sysbuild: true

tests:
  benchmarks.current_consumption.hpf_gpio_idle.icmsg:
    extra_args: SB_CONFIG_HPF_GPIO_BACKEND_ICMSG=y

  benchmarks.current_consumption.hpf_gpio_idle.icbmsg:
    extra_args: SB_CONFIG_HPF_GPIO_BACKEND_ICBMSG=y

  benchmarks.current_consumption.hpf_gpio_idle.mbox:
    extra_args: SB_CONFIG_HPF_GPIO_BACKEND_MBOX=y
```

## tests/benchmarks/current_consumption/hpf_mspi_flash/testcase.yaml
```yaml
common:
  tags:
    - drivers
    - mspi
    - ci_tests_drivers_hpf
    - ppk_power_measure
  harness: pytest
  harness_config:
    fixture: ppk_power_measure
    pytest_root:
      - "${CUSTOM_ROOT_TEST_DIR}/test_measure_power_consumption.py::test_measure_and_data_dump_flpr_idle"
tests:
  benchmarks.current_consumption.hpf_mspi_flash:
    platform_allow:
      - nrf54l15dk/nrf54l15/cpuapp
      - nrf54lm20dk/nrf54lm20a/cpuapp
      - nrf54lm20dk/nrf54lm20b/cpuapp
    integration_platforms:
      - nrf54lm20dk/nrf54lm20b/cpuapp
    extra_args:
      - hpf_mspi_CONFIG_HPF_MSPI_FAULT_TIMER=n
      - CONFIG_MSPI_HPF_FAULT_TIMER=n
```

## tests/benchmarks/current_consumption/multicore_system_off/Kconfig.sysbuild
```kconfig
#
# Copyright (c) 2024 Nordic Semiconductor ASA
#
# SPDX-License-Identifier: LicenseRef-Nordic-5-Clause
#

if SUPPORT_FLPRCORE

choice FLPRCORE
	default FLPRCORE_REMOTE

config FLPRCORE_REMOTE
	bool "remote image"

endchoice

config FLPRCORE_IMAGE_NAME
	default "remote" if FLPRCORE_REMOTE

config FLPRCORE_IMAGE_PATH
	default "$(APP_DIR)/remote" if FLPRCORE_REMOTE

endif # SUPPORT_FLPRCORE

source "share/sysbuild/Kconfig"
```

## tests/benchmarks/current_consumption/saadct_idle/testcase.yaml
```yaml
common:
  tags:
    - ppk_power_measure
    - ci_tests_benchmarks_current_consumption
  harness: pytest
  integration_platforms:
    - nrf54h20dk/nrf54h20/cpuapp
  platform_allow:
    - nrf54h20dk/nrf54h20/cpuapp
    - nrf54l15dk/nrf54l15/cpuapp

tests:
  benchmarks.power_consumption.saadct:
    harness_config:
      fixture: ppk_power_measure
      pytest_root:
        - "${CUSTOM_ROOT_TEST_DIR}/test_measure_power_consumption.py::test_measure_and_data_dump_power_consumption_saadct"
```

## tests/benchmarks/multicore/idle/Kconfig
```kconfig
#
# Copyright (c) 2023 Nordic Semiconductor ASA
#
# SPDX-License-Identifier: LicenseRef-Nordic-5-Clause
#

config SOC_NRF53_CPUNET_ENABLE
	bool
	depends on BOARD_NRF5340DK_NRF5340_CPUAPP || BOARD_NRF5340DK_NRF5340_CPUAPP_NS
	default y

config FIRST_SLEEP_OFFSET
	bool "Enable the time shift before first sleep in a loop"
	default n

source "Kconfig.zephyr"
```

## tests/benchmarks/multicore/idle/Kconfig.sysbuild
```kconfig
#
# Copyright (c) 2024 Nordic Semiconductor ASA
#
# SPDX-License-Identifier: LicenseRef-Nordic-5-Clause
#

if SUPPORT_PPRCORE

choice PPRCORE
	default PPRCORE_NONE

config PPRCORE_REMOTE
	bool "remote image"

endchoice

config PPRCORE_XIP_VARIANT
	bool "pprcore XIP board variant"

config PPRCORE_REMOTE_BOARD_TARGET_CPUCLUSTER
	default "cpuppr/xip" if PPRCORE_XIP_VARIANT

config PPRCORE_IMAGE_NAME
	default "remote" if PPRCORE_REMOTE

config PPRCORE_IMAGE_PATH
	default "${APP_DIR}/remote" if PPRCORE_REMOTE

endif # SUPPORT_PPRCORE

if SUPPORT_NETCORE

choice NETCORE
	default NETCORE_NONE

config NETCORE_REMOTE
	bool "remote image"

endchoice

config NETCORE_IMAGE_NAME
	default "remote" if NETCORE_REMOTE

config NETCORE_IMAGE_PATH
	default "${APP_DIR}/remote" if NETCORE_REMOTE

endif # SUPPORT_NETCORE

source "share/sysbuild/Kconfig"
```

## tests/benchmarks/multicore/idle_adc/Kconfig.sysbuild
```kconfig
#
# Copyright (c) 2024 Nordic Semiconductor ASA
#
# SPDX-License-Identifier: LicenseRef-Nordic-5-Clause
#

choice NETCORE
	default NETCORE_REMOTE_SLEEP_FOREVER

config NETCORE_REMOTE_SLEEP_FOREVER
	bool "Remote sleep forever image"

endchoice

config NETCORE_IMAGE_NAME
	default "remote_sleep_forever" if NETCORE_REMOTE_SLEEP_FOREVER

config NETCORE_IMAGE_PATH
	default "$(ZEPHYR_NRF_MODULE_DIR)/tests/benchmarks/power_consumption/common/remote_sleep_forever" if NETCORE_REMOTE_SLEEP_FOREVER

config SUPPORT_NETCORE
	default y if (SOC_NRF54H20_CPUPPR || SOC_NRF54H20_CPUAPP)

config NETCORE_REMOTE_BOARD_TARGET_CPUCLUSTER
	default "cpurad" if (SOC_NRF54H20_CPUPPR || SOC_NRF54H20_CPUAPP)

if SUPPORT_PPRCORE

choice PPRCORE
	default PPRCORE_REMOTE_SLEEP_FOREVER if SOC_NRF9251_CPUAPP
	default PPRCORE_NONE

config PPRCORE_REMOTE_SLEEP_FOREVER
	bool "Remote sleep forever image"

endchoice

config PPRCORE_IMAGE_NAME
	default "remote_sleep_forever" if PPRCORE_REMOTE_SLEEP_FOREVER

config PPRCORE_IMAGE_PATH
	default "$(ZEPHYR_NRF_MODULE_DIR)/tests/benchmarks/power_consumption/common/remote_sleep_forever" if PPRCORE_REMOTE_SLEEP_FOREVER

endif # SUPPORT_PPRCORE

source "share/sysbuild/Kconfig"
```
