## tests/benchmarks/multicore/idle_clock_control/Kconfig
```kconfig
#
# Copyright (c) 2025 Nordic Semiconductor ASA
#
# SPDX-License-Identifier: LicenseRef-Nordic-5-Clause
#

config TEST_AT_LFRC
	bool "BICR configured to use LFRC at LFCLK"
	help
	  Use this option if custom BICR (LFRC at LFCLK) is programmed.

config TEST_HSFLL_SERVICE_SUPPORTED
	bool "Selected if board supports Local Domain HSFLL service"
	default y if BOARD_NRF54H20DK_NRF54H20_CPUAPP
	default y if BOARD_NRF9251DK_NRF9251_CPUAPP

config TEST_GDHSFLL_SERVICE_SUPPORTED
	bool "Selected if board supports GD HSFLL service"
	default y if BOARD_NRF54H20DK_NRF54H20_CPUAPP

config TEST_HFXO_CONTROL_SUPPORTED
	bool "Selected if board supports HFXO control"
	default y if BOARD_NRF54H20DK_NRF54H20_CPUAPP
	default y if BOARD_NRF9251DK_NRF9251_CPUAPP

config TEST_AUXPLL_CONTROL_SUPPORTED
	bool "Selected if board supports CANPLL or other AUDIOPLL control"
	default y if BOARD_NRF54H20DK_NRF54H20_CPUAPP

source "Kconfig.zephyr"
```

## tests/benchmarks/multicore/idle_counter/Kconfig
```kconfig
#
# Copyright (c) 2025 Nordic Semiconductor ASA
#
# SPDX-License-Identifier: LicenseRef-Nordic-5-Clause
#

config TEST_SLEEP_DURATION_MS
	int "Core sleep duration (miliseconds)"
	default 1000
	help
	  Set sleep duration to TEST_SLEEP_DURATION_MS miliseconds.
	  Based on the value of 'min-residency-us' specified for each power state
	  defined in the DTS, core enters the lowest possible power state.

config TEST_SLEEP_ERROR_MS
	int "Allowed error (miliseconds)"
	default 10
	help
	  Test will pass if actual Alarm arrives within
	  TEST_SLEEP_DURATION_MS +/- TEST_SLEEP_ERROR_MS.

source "Kconfig.zephyr"
```

## tests/benchmarks/multicore/idle_counter/Kconfig.sysbuild
```kconfig
#
# Copyright (c) 2024 Nordic Semiconductor ASA
#
# SPDX-License-Identifier: LicenseRef-Nordic-5-Clause
#

if SUPPORT_NETCORE

choice NETCORE
	default NETCORE_REMOTE

config NETCORE_REMOTE
	bool "Remote image"

endchoice

config NETCORE_IMAGE_NAME
	default "remote" if NETCORE_REMOTE

config NETCORE_IMAGE_PATH
	default "$(ZEPHYR_NRF_MODULE_DIR)/tests/benchmarks/multicore/idle_counter/remote" if NETCORE_REMOTE

endif # SUPPORT_NETCORE

if SUPPORT_PPRCORE

choice PPRCORE
	default PPRCORE_REMOTE if SOC_NRF9251_CPUAPP
	default PPRCORE_NONE

config PPRCORE_REMOTE
	bool "Remote image"

endchoice

config PPRCORE_IMAGE_NAME
	default "remote_ppr" if PPRCORE_REMOTE

config PPRCORE_IMAGE_PATH
	default "$(ZEPHYR_NRF_MODULE_DIR)/tests/benchmarks/multicore/idle_counter/remote" if PPRCORE_REMOTE

endif # SUPPORT_PPRCORE

source "share/sysbuild/Kconfig"
```

## tests/benchmarks/multicore/idle_counter/testcase.yaml
```yaml
common:
  sysbuild: true
  tags:
    - ppk_power_measure
    - ci_tests_benchmarks_current_consumption
  harness: pytest
  harness_config:
    fixture: ppk_power_measure
    pytest_root:
      - "${CUSTOM_ROOT_TEST_DIR}/test_measure_power_consumption.py::test_measure_and_data_dump_fast_counter_and_s2ram_with_clock_control"

tests:
  benchmarks.power_consumption.counter:
    integration_platforms:
      - nrf54h20dk/nrf54h20/cpuapp
    platform_allow:
      - nrf54h20dk/nrf54h20/cpuapp
      - nrf9251dk/nrf9251/cpuapp

  benchmarks.power_consumption.counter.mcuboot:
    extra_args:
      - SB_CONFIG_BOOTLOADER_MCUBOOT=y
      - mcuboot_EXTRA_DTC_OVERLAY_FILE="${ZEPHYR_NRF_MODULE_DIR}/tests/benchmarks/multicore/idle_counter/boards/nrf54h20dk_nrf54h20_cpuapp.overlay"
    integration_platforms:
      - nrf54h20dk/nrf54h20/cpuapp
    platform_allow:
      - nrf54h20dk/nrf54h20/cpuapp

  benchmarks.power_consumption.counter.nrf9251dk.mcuboot:
    extra_args:
      - SB_CONFIG_BOOTLOADER_MCUBOOT=y
      - mcuboot_EXTRA_DTC_OVERLAY_FILE="${ZEPHYR_NRF_MODULE_DIR}/tests/benchmarks/multicore/idle_counter/boards/nrf9251dk_nrf9251_cpuapp.overlay"
    integration_platforms:
      - nrf9251dk/nrf9251/cpuapp
    platform_allow:
      - nrf9251dk/nrf9251/cpuapp
```

## tests/benchmarks/multicore/idle_hpu_temp_meas/Kconfig.sysbuild
```kconfig
#
# Copyright (c) 2023 Nordic Semiconductor ASA
#
# SPDX-License-Identifier: LicenseRef-Nordic-5-Clause
#

if SUPPORT_NETCORE

choice NETCORE
	default NETCORE_REMOTE_SLEEP_FOREVER

config NETCORE_REMOTE_SLEEP_FOREVER
	bool "remote_sleep_forever image"

endchoice

config NETCORE_IMAGE_NAME
	default "remote_sleep_forever" if NETCORE_REMOTE_SLEEP_FOREVER

config NETCORE_IMAGE_PATH
	default "$(ZEPHYR_NRF_MODULE_DIR)/tests/benchmarks/power_consumption/common/remote_sleep_forever" if NETCORE_REMOTE_SLEEP_FOREVER

endif # SUPPORT_NETCORE

if SUPPORT_PPRCORE

choice PPRCORE
	default PPRCORE_REMOTE_SLEEP_FOREVER if SOC_NRF9251_CPUAPP
	default PPRCORE_NONE

config PPRCORE_REMOTE_SLEEP_FOREVER
	bool "Remote sleep forever image"

endchoice

config PPRCORE_IMAGE_NAME
	default "remote_sleep_forever" if PPRCORE_REMOTE_SLEEP_FOREVER

config PPRCORE_IMAGE_PATH
	default "$(ZEPHYR_NRF_MODULE_DIR)/tests/benchmarks/power_consumption/common/remote_sleep_forever" if PPRCORE_REMOTE_SLEEP_FOREVER

endif # SUPPORT_PPRCORE

source "share/sysbuild/Kconfig"
```

## tests/benchmarks/multicore/idle_ipc/remote/boards/nrf54h20dk_nrf54h20_cpurad.conf
```kconfig
#
# Copyright (c) 2026 Nordic Semiconductor ASA
#
# SPDX-License-Identifier: LicenseRef-Nordic-5-Clause
#

CONFIG_PM=y
CONFIG_POWEROFF=y

CONFIG_LOG_PROCESS_THREAD_PRIORITY=-15
CONFIG_LOG_PROCESS_THREAD_CUSTOM_PRIORITY=y
CONFIG_IPC_SERVICE_LOG_LEVEL_INF=y
```

## tests/benchmarks/multicore/idle_ppr/Kconfig.sysbuild
```kconfig
#
# Copyright (c) 2024 Nordic Semiconductor ASA
#
# SPDX-License-Identifier: LicenseRef-Nordic-5-Clause
#

choice NETCORE
	default NETCORE_REMOTE

config NETCORE_REMOTE
	bool "Remote image"

endchoice

config NETCORE_IMAGE_NAME
	default "remote" if NETCORE_REMOTE

config NETCORE_IMAGE_PATH
	default "$(ZEPHYR_NRF_MODULE_DIR)/tests/benchmarks/multicore/idle_ppr/remote" if NETCORE_REMOTE

choice PPRCORE
	default PPRCORE_REMOTE

config PPRCORE_REMOTE
	bool "Remote image"

endchoice

config PPRCORE_IMAGE_NAME
	default "remote_ppr" if PPRCORE_REMOTE

config PPRCORE_IMAGE_PATH
	default "$(ZEPHYR_NRF_MODULE_DIR)/tests/benchmarks/multicore/idle_ppr/remote" if PPRCORE_REMOTE

source "share/sysbuild/Kconfig"
```

## tests/benchmarks/multicore/idle_pwm_led/testcase.yaml
```yaml
common:
  sysbuild: true
  tags:
    - ci_build
    - ci_tests_benchmarks_multicore

tests:
  benchmarks.multicore.idle_pwm_led.nrf54h20dk_cpuapp_cpurad.no_sleep:
    filter: not CONFIG_COVERAGE
    extra_args:
      - idle_pwm_led_EXTRA_CONF_FILE=enable_logs.conf
      - remote_EXTRA_CONF_FILE=enable_logs.conf
    harness: console
    harness_config:
      type: multi_line
      ordered: true
      regex:
        - "Multicore idle_pwm_led test on"
        - "Multicore idle_pwm_led test iteration 0"
        - "Multicore idle_pwm_led test iteration 1"
    platform_allow:
      - nrf54h20dk/nrf54h20/cpuapp
    integration_platforms:
      - nrf54h20dk/nrf54h20/cpuapp

  benchmarks.multicore.idle_pwm_led.nrf54h20dk_cpuapp_cpurad.idle_retained:
    filter: not CONFIG_COVERAGE
    tags: ppk_power_measure
    extra_args:
      - idle_pwm_led_CONFIG_TEST_SLEEP_DURATION_MS=500
      - remote_CONFIG_TEST_SLEEP_DURATION_MS=500
      - idle_pwm_led_EXTRA_DTC_OVERLAY_FILE="${ZEPHYR_NRF_MODULE_DIR}/tests/benchmarks/multicore/common/workaround_idle_retained.overlay"
    harness: pytest
    harness_config:
      fixture: ppk_power_measure
      pytest_root:
        - "${CUSTOM_ROOT_TEST_DIR}/test_measure_power_consumption.py::test_measure_and_data_dump_pwm_and_idle"
    platform_allow:
      - nrf54h20dk/nrf54h20/cpuapp
    integration_platforms:
      - nrf54h20dk/nrf54h20/cpuapp

  benchmarks.multicore.idle_pwm_led.nrf54h20dk_cpuapp_cpurad.idle:
    filter: not CONFIG_COVERAGE
    tags: ppk_power_measure
    extra_args:
      - idle_pwm_led_CONFIG_TEST_SLEEP_DURATION_MS=500
      - remote_CONFIG_TEST_SLEEP_DURATION_MS=500
      - idle_pwm_led_EXTRA_DTC_OVERLAY_FILE="${ZEPHYR_NRF_MODULE_DIR}/tests/benchmarks/multicore/common/workaround_idle.overlay"
    harness: pytest
    harness_config:
      fixture: ppk_power_measure
      pytest_root:
        - "${CUSTOM_ROOT_TEST_DIR}/test_measure_power_consumption.py::test_measure_and_data_dump_pwm_and_idle"
    platform_allow:
      - nrf54h20dk/nrf54h20/cpuapp
    integration_platforms:
      - nrf54h20dk/nrf54h20/cpuapp

  benchmarks.multicore.idle_pwm_led.nrf54h20dk_cpuapp_cpurad.s2ram:
    filter: not CONFIG_COVERAGE
    tags: ppk_power_measure
    harness: pytest
    harness_config:
      fixture: ppk_power_measure
      pytest_root:
        - "${CUSTOM_ROOT_TEST_DIR}/test_measure_power_consumption.py::test_measure_and_data_dump_pwm_and_s2ram"
    platform_allow:
      - nrf54h20dk/nrf54h20/cpuapp
    integration_platforms:
      - nrf54h20dk/nrf54h20/cpuapp

  benchmarks.multicore.idle_pwm_led.nrf54h20dk_cpuapp_cpurad.idle_retained_fast:
    filter: not CONFIG_COVERAGE
    tags: ppk_power_measure
    extra_args:
      - idle_pwm_led_CONFIG_TEST_SLEEP_DURATION_MS=500
      - remote_CONFIG_TEST_SLEEP_DURATION_MS=500
      - idle_pwm_led_DTC_OVERLAY_FILE="boards/nrf54h20dk_nrf54h20_cpuapp_fast_p7_0.overlay"
      - idle_pwm_led_EXTRA_DTC_OVERLAY_FILE="${ZEPHYR_NRF_MODULE_DIR}/tests/benchmarks/multicore/common/workaround_idle_retained.overlay"
    harness: pytest
    harness_config:
      fixture: ppk_power_measure
      pytest_root:
        - "${CUSTOM_ROOT_TEST_DIR}/test_measure_power_consumption.py::test_measure_and_data_dump_pwm_and_idle"
    platform_allow:
      - nrf54h20dk/nrf54h20/cpuapp
    integration_platforms:
      - nrf54h20dk/nrf54h20/cpuapp

  benchmarks.multicore.idle_pwm_led.nrf54h20dk_cpuapp_cpurad.s2ram.mcuboot:
    filter: not CONFIG_COVERAGE
    tags: ppk_power_measure
    extra_args:
      - SB_CONFIG_BOOTLOADER_MCUBOOT=y
      - mcuboot_EXTRA_DTC_OVERLAY_FILE="${ZEPHYR_NRF_MODULE_DIR}/tests/benchmarks/multicore/idle_pwm_led/boards/nrf54h20dk_nrf54h20_cpuapp.overlay"
    harness: pytest
    harness_config:
      fixture: ppk_power_measure
      pytest_root:
        - "${CUSTOM_ROOT_TEST_DIR}/test_measure_power_consumption.py::test_measure_and_data_dump_pwm_and_s2ram"
    platform_allow:
      - nrf54h20dk/nrf54h20/cpuapp
    integration_platforms:
      - nrf54h20dk/nrf54h20/cpuapp

  benchmarks.multicore.idle_pwm_led.nrf54h20dk_cpuapp_cpurad.idle_fast:
    filter: not CONFIG_COVERAGE
    tags: ppk_power_measure
    extra_args:
      - idle_pwm_led_CONFIG_TEST_SLEEP_DURATION_MS=500
      - remote_CONFIG_TEST_SLEEP_DURATION_MS=500
      - idle_pwm_led_DTC_OVERLAY_FILE="boards/nrf54h20dk_nrf54h20_cpuapp_fast_p7_0.overlay"
      - idle_pwm_led_EXTRA_DTC_OVERLAY_FILE="${ZEPHYR_NRF_MODULE_DIR}/tests/benchmarks/multicore/common/workaround_idle.overlay"
    harness: pytest
    harness_config:
      fixture: ppk_power_measure
      pytest_root:
        - "${CUSTOM_ROOT_TEST_DIR}/test_measure_power_consumption.py::test_measure_and_data_dump_pwm_and_idle"
    platform_allow:
      - nrf54h20dk/nrf54h20/cpuapp
    integration_platforms:
      - nrf54h20dk/nrf54h20/cpuapp

  benchmarks.multicore.idle_pwm_led.nrf54h20dk_cpuapp_cpurad.s2ram_fast:
    filter: not CONFIG_COVERAGE
    tags: ppk_power_measure
    extra_args:
      - idle_pwm_led_DTC_OVERLAY_FILE="boards/nrf54h20dk_nrf54h20_cpuapp_fast_p7_0.overlay"
    harness: pytest
    harness_config:
      fixture: ppk_power_measure
      pytest_root:
        - "${CUSTOM_ROOT_TEST_DIR}/test_measure_power_consumption.py::test_measure_and_data_dump_pwm_and_s2ram"
    platform_allow:
      - nrf54h20dk/nrf54h20/cpuapp
    integration_platforms:
      - nrf54h20dk/nrf54h20/cpuapp

  benchmarks.multicore.idle_pwm_led.nrf54h20dk_cpuapp_cpurad.coverage:
    filter: CONFIG_COVERAGE
    extra_args:
      - idle_pwm_led_CONF_FILE=coverage.conf
      - EXTRA_DTC_OVERLAY_FILE="disable_s2ram.overlay"
      - SNIPPET=coverage_support
    harness: console
    harness_config:
      type: multi_line
      ordered: true
      regex:
        - ".*Coverage analysis enabled.*"
        - ".*Coverage analysis start.*"
    timeout: 90
    platform_allow:
      - nrf54h20dk/nrf54h20/cpuapp
    integration_platforms:
      - nrf54h20dk/nrf54h20/cpuapp

  benchmarks.multicore.idle_pwm_led.nrf9251dk_cpuapp_cpuppr.idle_retained:
    filter: not CONFIG_COVERAGE
    tags: ppk_power_measure
    extra_args:
      - idle_pwm_led_CONFIG_TEST_SLEEP_DURATION_MS=500
      - remote_CONFIG_TEST_SLEEP_DURATION_MS=500
      - idle_pwm_led_EXTRA_DTC_OVERLAY_FILE="${ZEPHYR_NRF_MODULE_DIR}/tests/benchmarks/multicore/common/workaround_idle_retained.overlay"
    harness: pytest
    harness_config:
      fixture: ppk_power_measure
      pytest_root:
        - "${CUSTOM_ROOT_TEST_DIR}/test_measure_power_consumption.py::test_measure_and_data_dump_pwm_and_idle"
    platform_allow:
      - nrf9251dk/nrf9251/cpuapp
    integration_platforms:
      - nrf9251dk/nrf9251/cpuapp

  benchmarks.multicore.idle_pwm_led.nrf9251dk_cpuapp_cpuppr.idle:
    filter: not CONFIG_COVERAGE
    tags: ppk_power_measure
    extra_args:
      - idle_pwm_led_CONFIG_TEST_SLEEP_DURATION_MS=500
      - remote_CONFIG_TEST_SLEEP_DURATION_MS=500
      - idle_pwm_led_EXTRA_DTC_OVERLAY_FILE="${ZEPHYR_NRF_MODULE_DIR}/tests/benchmarks/multicore/common/workaround_idle.overlay"
    harness: pytest
    harness_config:
      fixture: ppk_power_measure
      pytest_root:
        - "${CUSTOM_ROOT_TEST_DIR}/test_measure_power_consumption.py::test_measure_and_data_dump_pwm_and_idle"
    platform_allow:
      - nrf9251dk/nrf9251/cpuapp
    integration_platforms:
      - nrf9251dk/nrf9251/cpuapp

  benchmarks.multicore.idle_pwm_led.nrf9251dk_cpuapp_cpuppr.s2ram:
    filter: not CONFIG_COVERAGE
    tags: ppk_power_measure
    harness: pytest
    harness_config:
      fixture: ppk_power_measure
      pytest_root:
        - "${CUSTOM_ROOT_TEST_DIR}/test_measure_power_consumption.py::test_measure_and_data_dump_pwm_and_s2ram"
    platform_allow:
      - nrf9251dk/nrf9251/cpuapp
    integration_platforms:
      - nrf9251dk/nrf9251/cpuapp
```
