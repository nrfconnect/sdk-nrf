## subsys/nonsecure/Kconfig
```kconfig
#
# Copyright (c) 2022 Nordic Semiconductor ASA
#
# SPDX-License-Identifier: LicenseRef-Nordic-5-Clause
#

if BUILD_WITH_TFM || IS_SPM
menu "Trusted Execution Non-Secure"

menu "Peripheral Secure mapping"

config NRF_FPU_SECURE
	bool "FPU configured as secure peripheral"
	depends on CPU_HAS_FPU
	help
	  FPU is implemented with user-selectable security mapping.
	  If it has been configured as a secure peripheral then only the secure
	  processing environment is able to access the peripheral

peripheral=DCNF
rsource "Kconfig.template.peripheral_secure"

peripheral=OSCILLATORS
rsource "Kconfig.template.peripheral_secure"

peripheral=REGULATORS
rsource "Kconfig.template.peripheral_secure"

peripheral=CLOCK
rsource "Kconfig.template.peripheral_secure"

peripheral=POWER
rsource "Kconfig.template.peripheral_secure"

peripheral=RESET
rsource "Kconfig.template.peripheral_secure"

config NRF_CTRLAP_SECURE
	bool "CTRLAP configured as secure peripheral"
	# TODO: Use template when HAS_HW_NRF_CTRLAP is available in zephyr.
	depends on SOC_NRF9160 || SOC_NRF5340_CPUAPP
	help
	  CTRLAP is implemented with user-selectable security mapping.
	  If it has been configured as a secure peripheral then only the secure
	  processing environment is able to access the peripheral

peripheral=SPIM0
rsource "Kconfig.template.peripheral_secure"

peripheral=SPIS0
rsource "Kconfig.template.peripheral_secure"

peripheral=TWIM0
rsource "Kconfig.template.peripheral_secure"

peripheral=TWIS0
rsource "Kconfig.template.peripheral_secure"

peripheral=UARTE0
rsource "Kconfig.template.peripheral_secure"

peripheral=SPIM1
rsource "Kconfig.template.peripheral_secure"

peripheral=SPIS1
rsource "Kconfig.template.peripheral_secure"

peripheral=TWIM1
rsource "Kconfig.template.peripheral_secure"

peripheral=TWIS1
rsource "Kconfig.template.peripheral_secure"

peripheral=UARTE1
rsource "Kconfig.template.peripheral_secure"

peripheral=SPIM4
rsource "Kconfig.template.peripheral_secure"

peripheral=SPIM2
rsource "Kconfig.template.peripheral_secure"

peripheral=SPIS2
rsource "Kconfig.template.peripheral_secure"

peripheral=TWIM2
rsource "Kconfig.template.peripheral_secure"

peripheral=TWIS2
rsource "Kconfig.template.peripheral_secure"

peripheral=UARTE2
rsource "Kconfig.template.peripheral_secure"

peripheral=SPIM3
rsource "Kconfig.template.peripheral_secure"

peripheral=SPIS3
rsource "Kconfig.template.peripheral_secure"

peripheral=TWIM3
rsource "Kconfig.template.peripheral_secure"

peripheral=TWIS3
rsource "Kconfig.template.peripheral_secure"

peripheral=UARTE3
rsource "Kconfig.template.peripheral_secure"

peripheral=SAADC
rsource "Kconfig.template.peripheral_secure"

peripheral=TIMER0
rsource "Kconfig.template.peripheral_secure"

peripheral=TIMER1
rsource "Kconfig.template.peripheral_secure"

peripheral=TIMER2
rsource "Kconfig.template.peripheral_secure"

peripheral=RTC0
rsource "Kconfig.template.peripheral_secure"

peripheral=RTC1
rsource "Kconfig.template.peripheral_secure"

config NRF_DPPI_SECURE
	bool "DPPI configured as secure peripheral"
	depends on HAS_HW_NRF_DPPIC
	help
	  DPPI is implemented with user-selectable security mapping.
	  If it has been configured as a secure peripheral then only the secure
	  processing environment is able to access the peripheral

peripheral=WDT
rsource "Kconfig.template.peripheral_secure"

peripheral=WDT0
rsource "Kconfig.template.peripheral_secure"

peripheral=WDT1
rsource "Kconfig.template.peripheral_secure"

peripheral=COMP
rsource "Kconfig.template.peripheral_secure"

peripheral=LPCOMP
rsource "Kconfig.template.peripheral_secure"

peripheral=EGU0
rsource "Kconfig.template.peripheral_secure"

peripheral=EGU1
rsource "Kconfig.template.peripheral_secure"

peripheral=EGU2
rsource "Kconfig.template.peripheral_secure"

peripheral=EGU3
rsource "Kconfig.template.peripheral_secure"

peripheral=EGU4
rsource "Kconfig.template.peripheral_secure"

peripheral=EGU5
rsource "Kconfig.template.peripheral_secure"

peripheral=PWM0
rsource "Kconfig.template.peripheral_secure"

peripheral=PWM1
rsource "Kconfig.template.peripheral_secure"

peripheral=PWM2
rsource "Kconfig.template.peripheral_secure"

peripheral=PWM3
rsource "Kconfig.template.peripheral_secure"

peripheral=PDM
rsource "Kconfig.template.peripheral_secure"

peripheral=I2S
rsource "Kconfig.template.peripheral_secure"

peripheral=IPC
rsource "Kconfig.template.peripheral_secure"

peripheral=QSPI
rsource "Kconfig.template.peripheral_secure"

peripheral=NFCT
rsource "Kconfig.template.peripheral_secure"

peripheral=MUTEX
rsource "Kconfig.template.peripheral_secure"

peripheral=QDEC0
rsource "Kconfig.template.peripheral_secure"

peripheral=QDEC1
rsource "Kconfig.template.peripheral_secure"

peripheral=USBD
rsource "Kconfig.template.peripheral_secure"

peripheral=USBREG
rsource "Kconfig.template.peripheral_secure"

config NRF_NVMC_SECURE
	bool "NVMC configured as secure peripheral"
	help
	  NVMC is implemented with split security.
	  If it has been configured a a secure peripheral then only the secure
	  processing environment is able to access the peripheral.
	  If it has been configured as non-secure, only a subset of the
	  registers is available from the non-secure processing environment.

peripheral=GPIO0
rsource "Kconfig.template.peripheral_secure"

peripheral=GPIO1
rsource "Kconfig.template.peripheral_secure"

peripheral=VMC
rsource "Kconfig.template.peripheral_secure"

config NRF_GPIOTE0_SECURE
	bool "GPIOTE configured as secure peripheral"
	depends on HAS_HW_NRF_GPIOTE
	help
	  GPIOTE0 is implemented with secure only security.
	  This option only enables it to be used in the secure image.

config NRF_GPIO0_PIN_MASK_SECURE
	hex "Set GPIO0 PERM mask for Secure"
	default 0x00000000
	depends on HAS_HW_NRF_GPIO0 && !NRF_GPIO0_SECURE
	help
	  GPIO is implemented with split security. If it has been configured as
	  non-secure it can be accessed by both secure and non-secure accesses.
	  A bitmask can be set to configure a subset of the GPIO pins as secure
	  to prevent non-secure from accessing these pin. Secure accesses can be
	  made to GPIO pins configured as non-secure.

config NRF_GPIO1_PIN_MASK_SECURE
	hex "Set GPIO1 PERM mask for Secure"
	default 0x00000000
	depends on HAS_HW_NRF_GPIO1 && !NRF_GPIO1_SECURE
	help
	  GPIO is implemented with split security. If it has been configured as
	  non-secure it can be accessed by both secure and non-secure accesses.
	  A bitmask can be set to configure a subset of the GPIO pins as secure
	  to prevent non-secure from accessing these pin. Secure accesses can be
	  made to GPIO pins configured as non-secure.

config NRF_DPPI_CHANNEL_MASK_SECURE
	hex "Set DPPI PERM mask for Secure"
	default 0x00000000
	depends on HAS_HW_NRF_DPPIC && !NRF_DPPI_SECURE
	help
	  DPPI is implemented with split securety. If it has been configured as
	  non-secure it can be accessed by both secure and non-secure accesses.
	  A bitmask can be set to configure a subset of the DPPI channels as
	  secure to prevent non-secure from accessing these channels. Secure
	  accesses can be made to the DPPI pins configured as non-secure.

endmenu # Peripheral Secure mapping

endmenu # Trusted Execution Non-Secure

endif # BUILD_WITH_TFM || IS_SPM
```

## subsys/nonsecure/Kconfig.template.peripheral_secure
```kconfig
#
# Copyright (c) 2022 Nordic Semiconductor ASA
#
# SPDX-License-Identifier: LicenseRef-Nordic-5-Clause
#

config NRF_$(peripheral)_SECURE
	bool "$(peripheral) configured as secure peripheral"
	depends on HAS_HW_NRF_$(peripheral)
	help
	  $(peripheral) is implemented with user-selectable security mapping.
	  If it has been configured as a secure peripheral then only the secure
	  processing environment is able to access the peripheral
```

## subsys/nrf_compress/Kconfig
```kconfig
#
# Copyright (c) 2024 Nordic Semiconductor ASA
#
# SPDX-License-Identifier: LicenseRef-Nordic-5-Clause
#

menuconfig NRF_COMPRESS
	bool "Compression/decompression library"

if NRF_COMPRESS

config NRF_COMPRESS_COMPRESSION
	bool
	help
	  Enables support for compression functions in library.

config NRF_COMPRESS_DECOMPRESSION
	bool "Decompression support"
	help
	  Enables support for decompression functions in library.

menu "Type support"
	depends on NRF_COMPRESS_COMPRESSION || NRF_COMPRESS_DECOMPRESSION

config NRF_COMPRESS_TYPE_SELECTED
	bool
	help
	  Hidden option to know if at least one implementation has been selected.

menuconfig NRF_COMPRESS_LZMA
	bool "LZMA"
	depends on NRF_COMPRESS_DECOMPRESSION
	select NRF_COMPRESS_TYPE_SELECTED
	help
	  Enables LZMA support for decompression.

if NRF_COMPRESS_LZMA

choice NRF_COMPRESS_LZMA_VERSION
	prompt "Version"
	default NRF_COMPRESS_LZMA_VERSION_LZMA2

config NRF_COMPRESS_LZMA_VERSION_LZMA1
	bool "lzma1"

config NRF_COMPRESS_LZMA_VERSION_LZMA2
	bool "lzma2"

endchoice

endif # NRF_COMPRESS_LZMA

config NRF_COMPRESS_ARM_THUMB
	bool "ARM Thumb"
	depends on NRF_COMPRESS_DECOMPRESSION
	select NRF_COMPRESS_TYPE_SELECTED
	help
	  Enables ARM thumb support for decompression.

endmenu

config NRF_COMPRESS_CHUNK_SIZE
	int "Chunk size"
	default 256
	help
	  The chunk size is the default maximum amount of data that if returned by the
	  decompress_bytes_needed() function. The value is returned by the decompress bytes
	  function that is available. Strive to provide the exact amount returned and not more.
	  If not possible otherwise, for example because of streaming or end of input, a lower
	  amount can be provided as well.

config NRF_COMPRESS_MIN_MEMORY_REQUIRED
	hex
	default 0x26f80 if NRF_COMPRESS_DECOMPRESSION && NRF_COMPRESS_LZMA
	default 0
	help
	  Hidden symbol indicating minimum buffer size for operation if operating in malloc mode.

choice NRF_COMPRESS_MEMORY_TYPE
	prompt "Memory type for buffers"
	default NRF_COMPRESS_MEMORY_TYPE_STATIC

config NRF_COMPRESS_MEMORY_TYPE_STATIC
	bool "Static buffers"
	help
	  Use static buffers to hold the data for decompression. This will reduce the
	  memory available to everything else in the application.

config NRF_COMPRESS_MEMORY_TYPE_MALLOC
	bool "Malloc"
	depends on COMMON_LIBC_MALLOC
	depends on (COMMON_LIBC_MALLOC_ARENA_SIZE = -1) || (COMMON_LIBC_MALLOC_ARENA_SIZE >= NRF_COMPRESS_MIN_MEMORY_REQUIRED)
	help
	  Use the dynamic memory allocation to hold the data for decompression. If there is
	  insufficient free contiguous space, decompression will not be usable.

endchoice

config NRF_COMPRESS_MEMORY_ALIGNMENT
	int "Buffer memory alignment"
	default 4
	range 1 32
	help
	  Memory alignment of the output decompression buffer. Set to 1 to disable.

config NRF_COMPRESS_CLEANUP
	bool "Clean up buffers on deinitialization"
	default y
	help
	  If enabled, will clean up all memory buffers in the deinitialization function. This
	  prevents leakage of the information, for example to other boot targets.

	  This option can be disabled if it is not needed and the data contains nothing sensitive.

module = NRF_COMPRESS
module-str = compression/decompression library
source "subsys/logging/Kconfig.template.log_config"

endif # NRF_COMPRESS
```

## subsys/nrf_lcs/Kconfig
```kconfig
#
# Copyright (c) 2026 Nordic Semiconductor ASA
#
# SPDX-License-Identifier: LicenseRef-Nordic-5-Clause
#

menuconfig NRF_LCS
	bool "Life Cycle State handling"
	select EXPERIMENTAL
	help
	  Enable device Life Cycle State subsystem.

if NRF_LCS

choice NRF_LCS_MEM
	prompt "LCS memory storage backend"
	default NRF_LCS_MEM_BL_STORAGE

config NRF_LCS_MEM_BL_STORAGE
	bool "Bootloader Storage"
	depends on SECURE_BOOT_STORAGE
	help
	  Store Life Cycle State values in bootloader storage.

endchoice # NRF_LCS_MEM

module = NRF_LCS
module-str = Life Cycle State
source "${ZEPHYR_BASE}/subsys/logging/Kconfig.template.log_config"

endif # NRF_LCS
```

## subsys/nrf_profiler/Kconfig
```kconfig
#
# Copyright (c) 2018 Nordic Semiconductor
#
# SPDX-License-Identifier: LicenseRef-Nordic-5-Clause

menuconfig NRF_PROFILER
	bool "System nrf_profiler"
	default n

if NRF_PROFILER

config NRF_PROFILER_MAX_NUMBER_OF_APP_EVENTS
	int "Maximum number of stored application event types"
	default 32
	range 0 255
	help
	  Maximum number of stored event types.

config NRF_PROFILER_CUSTOM_EVENT_BUF_LEN
	int "Length of data buffer for custom event data (in bytes)"
	default 64
	range 5 1023

config NRF_PROFILER_MAX_LENGTH_OF_CUSTOM_EVENTS_DESCRIPTIONS
	int "Maximum number of characters used to describe single event type"
	default 128

config NRF_PROFILER_SHELL
	bool "Enable shell integration"
	depends on SHELL
	default y
	help
	  Enable nRF Profiler shell commands to list the profiled event types
	  and to enable or disable profiling of specified event types.

choice
	prompt "Profiler selection"
	default NRF_PROFILER_NORDIC
	depends on NRF_PROFILER

config NRF_PROFILER_NORDIC
	bool "Nordic nrf_profiler"
	select USE_SEGGER_RTT

endchoice

config NRF_PROFILER_NUMBER_OF_INTERNAL_EVENTS
	int
	default 1 if NRF_PROFILER_NORDIC
	default 0
	help
	  Number of internal events.

menu "Nordic nrf_profiler advanced"
	depends on NRF_PROFILER_NORDIC

config NRF_PROFILER_NORDIC_START_LOGGING_ON_SYSTEM_START
	bool "Start logging on system start"
	depends on NRF_PROFILER_NORDIC
	default n

config NRF_PROFILER_NORDIC_COMMAND_BUFFER_SIZE
	int "Command buffer size"
	default 16

config NRF_PROFILER_NORDIC_DATA_BUFFER_SIZE
	int "Data buffer size"
	default 2048

config NRF_PROFILER_NORDIC_INFO_BUFFER_SIZE
	int "Info buffer size"
	default 256

config NRF_PROFILER_NORDIC_RTT_CHANNEL_DATA
	int "Data up channel index"
	default 1

config NRF_PROFILER_NORDIC_RTT_CHANNEL_INFO
	int "Info up channel index"
	default 2

config NRF_PROFILER_NORDIC_RTT_CHANNEL_COMMANDS
	int "Command down channel index"
	default 1

config NRF_PROFILER_NORDIC_STACK_SIZE
	int "Stack size for thread handling host input"
	default 512

config NRF_PROFILER_NORDIC_THREAD_PRIORITY
	int "Priority of thread handling host input"
	default 10

endmenu # Advanced

endif # NRF_PROFILER
```
