## subsys/nrf_security/Kconfig.psa.nordic
```kconfig
#
# Copyright (c) 2024 Nordic Semiconductor
#
# SPDX-License-Identifier: LicenseRef-Nordic-5-Clause
#

comment "Nordic-added meta types"

config PSA_HAS_AEAD_SUPPORT
	bool
	default y
	depends on PSA_WANT_ALG_CCM || \
		   PSA_WANT_ALG_GCM || \
		   PSA_WANT_ALG_CHACHA20_POLY1305 || \
		   PSA_WANT_ALG_XCHACHA20_POLY1305 || \
		   PSA_WANT_ALG_ASCON_AEAD128
	help
	  Prompt-less configuration that states that AEAD is supported.

config PSA_HAS_ASYM_ENCRYPT_SUPPORT
	bool
	default y
	depends on PSA_WANT_ALG_RSA_OAEP || \
		   PSA_WANT_ALG_RSA_PKCS1V15_CRYPT
	help
	  Prompt-less configuration that states that asymmetric encryption
	  is supported.

config PSA_HAS_ASYM_SIGN_SUPPORT
	bool
	default y
	depends on PSA_WANT_ALG_DETERMINISTIC_ECDSA	|| \
		   PSA_WANT_ALG_ECDSA 			|| \
		   PSA_WANT_ALG_ECDSA_ANY		|| \
		   PSA_WANT_ALG_ED25519PH               || \
		   PSA_WANT_ALG_ED448PH                 || \
		   PSA_WANT_ALG_PURE_EDDSA              || \
		   PSA_WANT_ALG_RSA_PKCS1V15_SIGN	|| \
		   PSA_WANT_ALG_RSA_PKCS1V15_SIGN_RAW   || \
		   PSA_WANT_ALG_RSA_PSS                 || \
		   PSA_WANT_ALG_RSA_PSS_ANY_SALT        || \
		   PSA_WANT_ALG_HSS                     || \
		   PSA_WANT_ALG_LMS                     || \
		   PSA_WANT_ALG_XMSS                    || \
		   PSA_WANT_ALG_XMSS_MT                 || \
		   PSA_WANT_ALG_ML_DSA
	help
	  Prompt-less configuration that states that asymmetric signing
	  is supported.

config PSA_HAS_CIPHER_SUPPORT
	bool
	default y
	depends on PSA_WANT_ALG_ECB_NO_PADDING		|| \
		   PSA_WANT_ALG_CBC_NO_PADDING		|| \
		   PSA_WANT_ALG_CBC_PKCS7		|| \
		   PSA_WANT_ALG_CCM_STAR_NO_TAG 	|| \
		   PSA_WANT_ALG_CTR			|| \
		   PSA_WANT_ALG_XTS			|| \
		   PSA_WANT_ALG_STREAM_CIPHER
	help
	  Prompt-less configuration that states that cipher is supported.

config PSA_HAS_HASH_SUPPORT
	bool
	default y
	depends on PSA_WANT_ALG_MD5		|| \
		   PSA_WANT_ALG_SHA_1		|| \
		   PSA_WANT_ALG_SHA_224		|| \
		   PSA_WANT_ALG_SHA_256		|| \
		   PSA_WANT_ALG_SHA_384		|| \
		   PSA_WANT_ALG_SHA_512		|| \
		   PSA_WANT_ALG_SHA_512_224	|| \
		   PSA_WANT_ALG_SHA_512_256	|| \
		   PSA_WANT_ALG_SHA3_224	|| \
		   PSA_WANT_ALG_SHA3_256	|| \
		   PSA_WANT_ALG_SHA3_384	|| \
		   PSA_WANT_ALG_SHA3_512    || \
		   PSA_WANT_ALG_ASCON_HASH256 || \
		   PSA_WANT_ALG_SHAKE128_256  || \
		   PSA_WANT_ALG_SHAKE256_192  || \
		   PSA_WANT_ALG_SHAKE256_256  || \
		   PSA_WANT_ALG_SHAKE256_512
	help
	  Prompt-less configuration that states that hash is supported.

config PSA_HAS_KEY_AGREEMENT
	bool
	default y
	depends on PSA_WANT_ALG_ECDH
	help
	  Promt-less configuration that states that key agreement is supported.

config PSA_HAS_KEY_DERIVATION
	bool
	default y
	depends on PSA_WANT_ALG_HKDF			|| \
		   PSA_WANT_ALG_HKDF_EXPAND		|| \
		   PSA_WANT_ALG_HKDF_EXTRACT		|| \
		   PSA_WANT_ALG_PBKDF2_HMAC		|| \
		   PSA_WANT_ALG_PBKDF2_AES_CMAC_PRF_128	|| \
		   PSA_WANT_ALG_TLS12_PRF		|| \
		   PSA_WANT_ALG_TLS12_PSK_TO_MS		|| \
		   PSA_WANT_ALG_TLS12_ECJPAKE_TO_PMS	|| \
		   PSA_WANT_ALG_SP800_108_COUNTER_CMAC 	|| \
		   PSA_WANT_ALG_SP800_108_COUNTER_HMAC  || \
		   PSA_WANT_ALG_SRP_PASSWORD_HASH       || \
		   PSA_WANT_ALG_WPA3_SAE_H2E
	help
	  Prompt-less configuration that states that key derivation is supported.

config PSA_HAS_KEY_SUPPORT
	bool
	default y
	depends on PSA_WANT_KEY_TYPE_AES 			|| \
		   PSA_WANT_KEY_TYPE_CHACHA20			|| \
		   PSA_WANT_KEY_TYPE_DERIVE			|| \
		   PSA_WANT_KEY_TYPE_ECC_KEY_PAIR_IMPORT	|| \
		   PSA_WANT_KEY_TYPE_ECC_KEY_PAIR_EXPORT	|| \
		   PSA_WANT_KEY_TYPE_ECC_KEY_PAIR_GENERATE	|| \
		   PSA_WANT_KEY_TYPE_ECC_KEY_PAIR_DERIVE	|| \
		   PSA_WANT_KEY_TYPE_ECC_PUBLIC_KEY		|| \
		   PSA_WANT_KEY_TYPE_HMAC			|| \
		   PSA_WANT_KEY_TYPE_PASSWORD			|| \
		   PSA_WANT_KEY_TYPE_PASSWORD_HASH		|| \
		   PSA_WANT_KEY_TYPE_PEPPER			|| \
		   PSA_WANT_KEY_TYPE_RAW_DATA			|| \
		   PSA_WANT_KEY_TYPE_RSA_KEY_PAIR_IMPORT	|| \
		   PSA_WANT_KEY_TYPE_RSA_KEY_PAIR_EXPORT	|| \
		   PSA_WANT_KEY_TYPE_RSA_KEY_PAIR_GENERATE	|| \
		   PSA_WANT_KEY_TYPE_RSA_KEY_PAIR_DERIVE	|| \
		   PSA_WANT_KEY_TYPE_RSA_PUBLIC_KEY		|| \
		   PSA_WANT_KEY_TYPE_SPAKE2P_KEY_PAIR_IMPORT	|| \
		   PSA_WANT_KEY_TYPE_SPAKE2P_KEY_PAIR_EXPORT	|| \
		   PSA_WANT_KEY_TYPE_SPAKE2P_KEY_PAIR_GENERATE	|| \
		   PSA_WANT_KEY_TYPE_SPAKE2P_KEY_PAIR_DERIVE	|| \
		   PSA_WANT_KEY_TYPE_SPAKE2P_PUBLIC_KEY		|| \
		   PSA_WANT_KEY_TYPE_SRP_KEY_PAIR_IMPORT	|| \
		   PSA_WANT_KEY_TYPE_SRP_KEY_PAIR_EXPORT	|| \
		   PSA_WANT_KEY_TYPE_SRP_KEY_PAIR_EXPORT	|| \
		   PSA_WANT_KEY_TYPE_SRP_KEY_PAIR_GENERATE	|| \
		   PSA_WANT_KEY_TYPE_SRP_KEY_PAIR_DERIVE	|| \
		   PSA_WANT_KEY_TYPE_SRP_PUBLIC_KEY		|| \
		   PSA_WANT_KEY_TYPE_WPA3_SAE                 || \
		   PSA_WANT_KEY_TYPE_XCHACHA20                || \
		   PSA_WANT_KEY_TYPE_HSS_PUBLIC_KEY           || \
		   PSA_WANT_KEY_TYPE_LMS_PUBLIC_KEY           || \
		   PSA_WANT_KEY_TYPE_XMSS_PUBLIC_KEY          || \
		   PSA_WANT_KEY_TYPE_XMSS_MT_PUBLIC_KEY       || \
		   PSA_WANT_KEY_TYPE_ML_DSA_KEY_PAIR_BASIC    || \
		   PSA_WANT_KEY_TYPE_ML_DSA_KEY_PAIR_IMPORT   || \
		   PSA_WANT_KEY_TYPE_ML_DSA_KEY_PAIR_EXPORT   || \
		   PSA_WANT_KEY_TYPE_ML_DSA_KEY_PAIR_GENERATE || \
		   PSA_WANT_KEY_TYPE_ML_DSA_KEY_PAIR_DERIVE   || \
		   PSA_WANT_KEY_TYPE_ML_DSA_PUBLIC_KEY        || \
		   PSA_WANT_KEY_TYPE_ML_KEM_KEY_PAIR_BASIC    || \
		   PSA_WANT_KEY_TYPE_ML_KEM_KEY_PAIR_IMPORT   || \
		   PSA_WANT_KEY_TYPE_ML_KEM_KEY_PAIR_EXPORT   || \
		   PSA_WANT_KEY_TYPE_ML_KEM_KEY_PAIR_GENERATE || \
		   PSA_WANT_KEY_TYPE_ML_KEM_KEY_PAIR_DERIVE   || \
		   PSA_WANT_KEY_TYPE_ML_KEM_PUBLIC_KEY        || \
		   PSA_WANT_KEY_TYPE_ASCON

	help
	  Prompt-less configuration that states that key types are supported.

config PSA_HAS_MAC_SUPPORT
	bool
	default y
	depends on PSA_WANT_ALG_CMAC	|| \
		   PSA_WANT_ALG_HMAC
	help
	  Prompt-less configuration that states that MAC is supported.

config PSA_HAS_PAKE_SUPPORT
	bool
	default y
	depends on PSA_WANT_ALG_JPAKE			|| \
		   PSA_WANT_ALG_SPAKE2P_HMAC		|| \
		   PSA_WANT_ALG_SPAKE2P_CMAC		|| \
		   PSA_WANT_ALG_SPAKE2P_MATTER 		|| \
		   PSA_WANT_ALG_SRP_6 			|| \
		   PSA_WANT_ALG_SRP_PASSWORD_HASH	|| \
		   PSA_WANT_ALG_WPA3_SAE_FIXED 		|| \
		   PSA_WANT_ALG_WPA3_SAE_GDH
	help
	  Prompt-less configuration that states that PAKE is supported.

comment "Nordic added alg types"

config PSA_WANT_ALG_ECDSA_ANY
	bool "PSA ECDSA support, without hashing" if !PSA_PROMPTLESS
	default y if PSA_CRYPTO_ENABLE_ALL

config PSA_WANT_ALG_ED25519PH
	bool "PSA ED25519PH support" if !PSA_PROMPTLESS
	default y if PSA_CRYPTO_ENABLE_ALL

config PSA_WANT_ALG_ED448PH
	bool "PSA ED448PH support" if !PSA_PROMPTLESS
	default y if PSA_CRYPTO_ENABLE_ALL

config PSA_WANT_ALG_HSS
	bool "PSA HSS support [EXPERIMENTAL]" if !PSA_PROMPTLESS
	default y if PSA_CRYPTO_ENABLE_ALL
	select EXPERIMENTAL

config PSA_WANT_ALG_LMS
	bool "PSA LMS support [EXPERIMENTAL]" if !PSA_PROMPTLESS
	default y if PSA_CRYPTO_ENABLE_ALL
	select EXPERIMENTAL

config PSA_WANT_ALG_ML_DSA
	bool "PSA ML_DSA support [EXPERIMENTAL]" if !PSA_PROMPTLESS
	default y if PSA_CRYPTO_ENABLE_ALL
	select EXPERIMENTAL

config PSA_WANT_ALG_DETERMINISTIC_ML_DSA
	bool "PSA ML_DSA deterministic support [EXPERIMENTAL]" if !PSA_PROMPTLESS
	select EXPERIMENTAL

config PSA_WANT_ALG_HASH_ML_DSA
	bool "PSA ML_DSA hash support [EXPERIMENTAL]" if !PSA_PROMPTLESS
	select EXPERIMENTAL

config PSA_WANT_ALG_DETERMINISTIC_HASH_ML_DSA
	bool "PSA ML_DSA deterministic hash support [EXPERIMENTAL]" if !PSA_PROMPTLESS
	select EXPERIMENTAL

config PSA_WANT_ALG_XMSS
	bool "PSA XMSS support [EXPERIMENTAL]" if !PSA_PROMPTLESS
	default y if PSA_CRYPTO_ENABLE_ALL
	select EXPERIMENTAL

config PSA_WANT_ALG_XMSS_MT
	bool "PSA XMSS_MT support [EXPERIMENTAL]" if !PSA_PROMPTLESS
	default y if PSA_CRYPTO_ENABLE_ALL
	select EXPERIMENTAL

config PSA_WANT_ALG_ML_KEM
	bool "PSA ML_KEM support [EXPERIMENTAL]" if !PSA_PROMPTLESS
	default y if PSA_CRYPTO_ENABLE_ALL
	select EXPERIMENTAL

config PSA_WANT_ALG_PURE_EDDSA
	bool "PSA PURE_EDDSA support" if !PSA_PROMPTLESS

config PSA_WANT_ALG_RSA_PKCS1V15_SIGN_RAW
	bool "PSA RSA raw PKCS#1 v1.5 message signature support, without hashing)" if !PSA_PROMPTLESS
	default y if PSA_CRYPTO_ENABLE_ALL

config PSA_WANT_ALG_RSA_PSS_ANY_SALT
	bool "PSA RSA PSS message signature support, any salt length" if !PSA_PROMPTLESS
	default y if PSA_CRYPTO_ENABLE_ALL

config PSA_WANT_ALG_SHA_256_192
	bool "PSA SHA-256/192 support" if !PSA_PROMPTLESS
	default y if PSA_CRYPTO_ENABLE_ALL

config PSA_WANT_ALG_SHA_512_224
	bool "PSA SHA-512/224 support" if !PSA_PROMPTLESS
	default y if PSA_CRYPTO_ENABLE_ALL

config PSA_WANT_ALG_SHA_512_256
	bool "PSA SHA-512/256 support" if !PSA_PROMPTLESS
	default y if PSA_CRYPTO_ENABLE_ALL

config PSA_WANT_ALG_ASCON_HASH256
	bool "PSA ASCON HASH256 support [EXPERIMENTAL]" if !PSA_PROMPTLESS
	select EXPERIMENTAL

config PSA_WANT_ALG_SPAKE2P_HMAC
	bool "PSA SPAKE2+ HMAC support" if !PSA_PROMPTLESS
	default y if PSA_CRYPTO_ENABLE_ALL

config PSA_WANT_ALG_SPAKE2P_CMAC
	bool "PSA SPAKE2+ CMAC support" if !PSA_PROMPTLESS
	default y if PSA_CRYPTO_ENABLE_ALL

config PSA_WANT_ALG_SPAKE2P_MATTER
	bool "PSA SPAKE2+ MATTER support" if !PSA_PROMPTLESS
	default y if PSA_CRYPTO_ENABLE_ALL

config PSA_WANT_ALG_SP800_108_COUNTER_HMAC
	bool "NIST SP 800-108 conformant HMAC-based KDF" if !PSA_PROMPTLESS
	default y if PSA_CRYPTO_ENABLE_ALL
	depends on PSA_WANT_ALG_HMAC

config PSA_WANT_ALG_SP800_108_COUNTER_CMAC
	bool "NIST SP 800-108 conformant CMAC-based KDF" if !PSA_PROMPTLESS
	default y if PSA_CRYPTO_ENABLE_ALL
	depends on PSA_WANT_ALG_CMAC

config PSA_WANT_ALG_SRP_6
	bool "PSA SRP-6 support [EXPERIMENTAL]" if !PSA_PROMPTLESS
	select EXPERIMENTAL
	default y if PSA_CRYPTO_ENABLE_ALL

config PSA_WANT_ALG_SRP_PASSWORD_HASH
	bool "PSA SRP password hash support [EXPERIMENTAL]" if !PSA_PROMPTLESS
	select EXPERIMENTAL
	default y if PSA_CRYPTO_ENABLE_ALL

config PSA_WANT_ALG_XTS
	bool "PSA XTS block cipher mode support" if !PSA_PROMPTLESS
	default y if PSA_CRYPTO_ENABLE_ALL

config PSA_WANT_ALG_ECB_NO_PADDING
	bool "PSA ECB support" if !PSA_PROMPTLESS
	default y if PSA_CRYPTO_ENABLE_ALL
	default y if MBEDTLS_BUILTIN && !MBEDTLS_FORCE_LEGACY_CIPHER && \
		     PSA_WANT_KEY_TYPE_AES && (PSA_WANT_ALG_GCM || PSA_WANT_ALG_CCM)

config PSA_WANT_ALG_CHACHA20
	bool "PSA CHACHA20 stream cipher support" if !PSA_PROMPTLESS
	default y if PSA_CRYPTO_ENABLE_ALL

config PSA_WANT_ALG_XCHACHA20_POLY1305
	bool "PSA XCHACHA20 POLY1305 support [EXPERIMENTAL]" if !PSA_PROMPTLESS
	default y if PSA_CRYPTO_ENABLE_ALL
	select EXPERIMENTAL

config PSA_WANT_ALG_SHAKE128_256
	bool "PSA SHAKE128 256 bits support [EXPERIMENTAL]" if !PSA_PROMPTLESS
	default y if PSA_CRYPTO_ENABLE_ALL
	select EXPERIMENTAL

config PSA_WANT_ALG_SHAKE256_192
	bool "PSA SHAKE256 192 bits support" if !PSA_PROMPTLESS
	default y if PSA_CRYPTO_ENABLE_ALL

config PSA_WANT_ALG_SHAKE256_256
	bool "PSA SHAKE256 256 bits support" if !PSA_PROMPTLESS
	default y if PSA_CRYPTO_ENABLE_ALL

config PSA_WANT_ALG_SHAKE256_512
	bool "PSA SHAKE256 512 bits support" if !PSA_PROMPTLESS
	default y if PSA_CRYPTO_ENABLE_ALL

config PSA_WANT_ALG_AES_KW
	bool "AES Key Wrap support (NIST-SP-800-38F and RFC3394) [EXPERIMENTAL]" if !PSA_PROMPTLESS
	select EXPERIMENTAL
	depends on !BUILD_WITH_TFM

config PSA_WANT_ALG_AES_KWP
	bool "AES Key Wrap with padding support (NIST-SP-800-38F and RFC5649) [EXPERIMENTAL]" if !PSA_PROMPTLESS
	select EXPERIMENTAL
	depends on !BUILD_WITH_TFM

config PSA_WANT_ALG_WPA3_SAE_H2E
	bool "WPA3-SAE-H2E support [EXPERIMENTAL]" if !PSA_PROMPTLESS
	select EXPERIMENTAL

config PSA_WANT_ALG_WPA3_SAE_FIXED
	bool "WPA3-SAE-FIXED support [EXPERIMENTAL]" if !PSA_PROMPTLESS
	select EXPERIMENTAL

config PSA_WANT_ALG_WPA3_SAE_GDH
	bool "WPA3-SAE-GDH support [EXPERIMENTAL]" if !PSA_PROMPTLESS
	select EXPERIMENTAL

config PSA_WANT_ALG_SHAKE128
	bool "SHAKE128 support [EXPERIMENTAL]" if !PSA_PROMPTLESS
	select EXPERIMENTAL

config PSA_WANT_ALG_SHAKE256
	bool "SHAKE256 support [EXPERIMENTAL]" if !PSA_PROMPTLESS
	select EXPERIMENTAL

config PSA_WANT_ALG_ASCON_XOF128
	bool "ASCON XOF128 support [EXPERIMENTAL]" if !PSA_PROMPTLESS
	select EXPERIMENTAL

config PSA_WANT_ALG_ASCON_CXOF128
	bool "ASCON CXOF128 support [EXPERIMENTAL]" if !PSA_PROMPTLESS
	select EXPERIMENTAL

config PSA_WANT_ALG_ASCON_AEAD128
	bool "ASCON AEAD128 support [EXPERIMENTAL]" if !PSA_PROMPTLESS
	select EXPERIMENTAL

comment "Nordic added ECC curve types"

config PSA_WANT_ECC_BRAINPOOL_P_R1_224
	bool "PSA ECC BrainpoolP224r1 support" if !PSA_PROMPTLESS

config PSA_WANT_ECC_BRAINPOOL_P_R1_320
	bool "PSA ECC BrainpoolP320r1 support" if !PSA_PROMPTLESS

config PSA_WANT_ECC_TWISTED_EDWARDS_255
	bool "PSA ECC Edwards25519 (Ed25519) support" if !PSA_PROMPTLESS

config PSA_WANT_ECC_TWISTED_EDWARDS_448
	bool "PSA ECC Edwards448 (Ed448) support" if !PSA_PROMPTLESS

config PSA_WANT_ECC_SECP_K1_224
	bool "PSA ECC secp224k1 support" if !PSA_PROMPTLESS


config PSA_WANT_ECC_SECT_R1_233
	bool "PSA ECC sect233r1 support" if !PSA_PROMPTLESS

config PSA_WANT_ECC_SECT_R1_283
	bool "PSA ECC sect283r1 support" if !PSA_PROMPTLESS

config PSA_WANT_ECC_SECT_R1_409
	bool "PSA ECC sect409r1 support" if !PSA_PROMPTLESS

config PSA_WANT_ECC_SECT_R1_571
	bool "PSA ECC sect571r1 support" if !PSA_PROMPTLESS

comment "Nordic addded RNG configuration"

config PSA_WANT_GENERATE_RANDOM
	bool "PSA RNG support" if !PSA_PROMPTLESS
	default y if PSA_CRYPTO_ENABLE_ALL

comment "Nordic added key types"

config PSA_WANT_KEY_TYPE_PEPPER
	bool "PSA pepper key type support" if !PSA_PROMPTLESS
	default y if PSA_CRYPTO_ENABLE_ALL

config PSA_WANT_KEY_TYPE_SPAKE2P_KEY_PAIR_BASIC
	bool
	select PSA_WANT_KEY_TYPE_ECC_KEY_PAIR_BASIC if PSA_CRYPTO_DRIVER_CRACEN
	default y
	depends on PSA_WANT_KEY_TYPE_SPAKE2P_KEY_PAIR_IMPORT	|| \
		   PSA_WANT_KEY_TYPE_SPAKE2P_KEY_PAIR_EXPORT	|| \
		   PSA_WANT_KEY_TYPE_SPAKE2P_KEY_PAIR_GENERATE	|| \
		   PSA_WANT_KEY_TYPE_SPAKE2P_KEY_PAIR_DERIVE
	help
	  SPAKE2+ key pair: Basic key support

config PSA_WANT_KEY_TYPE_SPAKE2P_KEY_PAIR_IMPORT
	bool "SPAKE2+ key pair import support" if !PSA_PROMPTLESS
	select PSA_WANT_KEY_TYPE_SPAKE2P_PUBLIC_KEY
	select PSA_WANT_KEY_TYPE_ECC_KEY_PAIR_IMPORT if PSA_CRYPTO_DRIVER_CRACEN
	default y if PSA_CRYPTO_ENABLE_ALL
	help
	  SPAKE2+ key pair: Import key for both the private and public key.

config PSA_WANT_KEY_TYPE_SPAKE2P_KEY_PAIR_EXPORT
	bool "SPAKE2+ key pair export support" if !PSA_PROMPTLESS
	select PSA_WANT_KEY_TYPE_SPAKE2P_PUBLIC_KEY
	select PSA_WANT_KEY_TYPE_ECC_KEY_PAIR_EXPORT if PSA_CRYPTO_DRIVER_CRACEN
	default y if PSA_CRYPTO_ENABLE_ALL
	help
	  SPAKE2+ key pair: Export key for both the private and public key.

config PSA_WANT_KEY_TYPE_SPAKE2P_KEY_PAIR_GENERATE
	bool "SPAKE2+ key pair generate support" if !PSA_PROMPTLESS
	select PSA_WANT_KEY_TYPE_SPAKE2P_PUBLIC_KEY
	select PSA_WANT_KEY_TYPE_ECC_KEY_PAIR_GENERATE if PSA_CRYPTO_DRIVER_CRACEN
	default y if PSA_CRYPTO_ENABLE_ALL
	help
	  SPAKE2+ key pair: Generate key for both the private and public key.

config PSA_WANT_KEY_TYPE_SPAKE2P_KEY_PAIR_DERIVE
	bool "SPAKE2+ key pair derive support" if !PSA_PROMPTLESS
	select PSA_WANT_KEY_TYPE_SPAKE2P_PUBLIC_KEY
	select PSA_WANT_KEY_TYPE_ECC_KEY_PAIR_DERIVE if PSA_CRYPTO_DRIVER_CRACEN
	default y if PSA_CRYPTO_ENABLE_ALL
	help
	  SPAKE2+ key pair: Derive key for both the private and public key.

config PSA_WANT_KEY_TYPE_SPAKE2P_PUBLIC_KEY
	bool "SPAKE2+ public key support" if !PSA_PROMPTLESS
	select PSA_WANT_KEY_TYPE_ECC_PUBLIC_KEY if PSA_CRYPTO_DRIVER_CRACEN
	default y if PSA_CRYPTO_ENABLE_ALL
	help
	  SPAKE2+ public key support.

config PSA_WANT_KEY_TYPE_SRP_KEY_PAIR_BASIC
	bool
	default y
	depends on PSA_WANT_KEY_TYPE_SRP_KEY_PAIR_IMPORT	|| \
		   PSA_WANT_KEY_TYPE_SRP_KEY_PAIR_EXPORT	|| \
		   PSA_WANT_KEY_TYPE_SRP_KEY_PAIR_GENERATE	|| \
		   PSA_WANT_KEY_TYPE_SRP_KEY_PAIR_DERIVE

config PSA_WANT_KEY_TYPE_SRP_KEY_PAIR_IMPORT
	bool "SRP key pair import support" if !PSA_PROMPTLESS
	select PSA_WANT_KEY_TYPE_SRP_PUBLIC_KEY
	default y if PSA_CRYPTO_ENABLE_ALL
	help
	  SRP key pair: import key for both the private and public key.

config PSA_WANT_KEY_TYPE_SRP_KEY_PAIR_EXPORT
	bool "SRP key pair export support" if !PSA_PROMPTLESS
	select PSA_WANT_KEY_TYPE_SRP_PUBLIC_KEY
	default y if PSA_CRYPTO_ENABLE_ALL
	help
	  SRP key pair: export key for both the private and public key.

config PSA_WANT_KEY_TYPE_SRP_KEY_PAIR_GENERATE
	bool "SRP key pair export support" if !PSA_PROMPTLESS
	select PSA_WANT_KEY_TYPE_SRP_PUBLIC_KEY
	default y if PSA_CRYPTO_ENABLE_ALL
	help
	  SRP key pair: export key for both the private and public key.

config PSA_WANT_KEY_TYPE_SRP_KEY_PAIR_DERIVE
	bool "SRP key pair derive support" if !PSA_PROMPTLESS
	select PSA_WANT_KEY_TYPE_SRP_PUBLIC_KEY
	default y if PSA_CRYPTO_ENABLE_ALL
	help
	  SRP key pair: derive key for both the private and public key.

config PSA_WANT_KEY_TYPE_SRP_PUBLIC_KEY
	bool "SRP public key support" if !PSA_PROMPTLESS
	help
	  SRP public key support.

config PSA_WANT_KEY_TYPE_WPA3_SAE
	bool "WPA3-SAE password token support" if !PSA_PROMPTLESS
	select PSA_WANT_KEY_TYPE_ECC_PUBLIC_KEY

config PSA_WANT_KEY_TYPE_XCHACHA20
	bool "PSA XCHACHA20 key type support" if !PSA_PROMPTLESS
	default y if PSA_CRYPTO_ENABLE_ALL

config PSA_WANT_KEY_TYPE_HSS_PUBLIC_KEY
	bool "PSA HSS public key support" if !PSA_PROMPTLESS
	default y if PSA_CRYPTO_ENABLE_ALL

config PSA_WANT_KEY_TYPE_LMS_PUBLIC_KEY
	bool "PSA LMS public key support" if !PSA_PROMPTLESS
	default y if PSA_CRYPTO_ENABLE_ALL

config PSA_WANT_KEY_TYPE_XMSS_PUBLIC_KEY
	bool "PSA XMSS public key support" if !PSA_PROMPTLESS
	default y if PSA_CRYPTO_ENABLE_ALL

config PSA_WANT_KEY_TYPE_XMSS_MT_PUBLIC_KEY
	bool "PSA XMSS_MT public key support" if !PSA_PROMPTLESS
	default y if PSA_CRYPTO_ENABLE_ALL

config PSA_WANT_ML_DSA_KEY_SIZE_44
	bool "PSA ML-DSA-44 security level key support" if !PSA_PROMPTLESS
	default y if PSA_CRYPTO_ENABLE_ALL

config PSA_WANT_ML_DSA_KEY_SIZE_65
	bool "PSA ML-DSA-65 security level key support" if !PSA_PROMPTLESS
	default y if PSA_CRYPTO_ENABLE_ALL

config PSA_WANT_ML_DSA_KEY_SIZE_87
	bool "PSA ML-DSA-87 security level key support" if !PSA_PROMPTLESS
	default y if PSA_CRYPTO_ENABLE_ALL

config PSA_WANT_KEY_TYPE_ML_DSA_KEY_PAIR_BASIC
	bool
	default y
	depends on PSA_WANT_KEY_TYPE_ML_DSA_KEY_PAIR_IMPORT	|| \
		   PSA_WANT_KEY_TYPE_ML_DSA_KEY_PAIR_EXPORT	|| \
		   PSA_WANT_KEY_TYPE_ML_DSA_KEY_PAIR_GENERATE	|| \
		   PSA_WANT_KEY_TYPE_ML_DSA_KEY_PAIR_DERIVE

config PSA_WANT_KEY_TYPE_ML_DSA_KEY_PAIR_IMPORT
	bool "ML_DSA key pair import support" if !PSA_PROMPTLESS
	select PSA_WANT_KEY_TYPE_ML_DSA_PUBLIC_KEY
	default y if PSA_CRYPTO_ENABLE_ALL
	help
	  ML_DSA key pair: import key for both the private and public key.

config PSA_WANT_KEY_TYPE_ML_DSA_KEY_PAIR_EXPORT
	bool "ML_DSA key pair export support" if !PSA_PROMPTLESS
	select PSA_WANT_KEY_TYPE_ML_DSA_PUBLIC_KEY
	default y if PSA_CRYPTO_ENABLE_ALL
	help
	  ML_DSA key pair: export key for both the private and public key.

config PSA_WANT_KEY_TYPE_ML_DSA_KEY_PAIR_GENERATE
	bool "ML_DSA key pair generate support" if !PSA_PROMPTLESS
	select PSA_WANT_KEY_TYPE_ML_DSA_PUBLIC_KEY
	default y if PSA_CRYPTO_ENABLE_ALL
	help
	  ML_DSA key pair: generate key for both the private and public key.

config PSA_WANT_KEY_TYPE_ML_DSA_KEY_PAIR_DERIVE
	bool "ML_DSA key pair derive support" if !PSA_PROMPTLESS
	select PSA_WANT_KEY_TYPE_ML_DSA_PUBLIC_KEY
	default y if PSA_CRYPTO_ENABLE_ALL
	help
	  ML_DSA key pair: derive key for both the private and public key.

config PSA_WANT_KEY_TYPE_ML_DSA_PUBLIC_KEY
	bool "ML_DSA public key support" if !PSA_PROMPTLESS
	help
	  ML_DSA public key support.

config PSA_WANT_ML_KEM_KEY_SIZE_512
	bool "PSA ML-KEM-512 security level key support" if !PSA_PROMPTLESS
	default y if PSA_CRYPTO_ENABLE_ALL

config PSA_WANT_ML_KEM_KEY_SIZE_768
	bool "PSA ML-KEM-768 security level key support" if !PSA_PROMPTLESS
	default y if PSA_CRYPTO_ENABLE_ALL

config PSA_WANT_ML_KEM_KEY_SIZE_1024
	bool "PSA ML-KEM-1024 security level key support" if !PSA_PROMPTLESS
	default y if PSA_CRYPTO_ENABLE_ALL

config PSA_WANT_KEY_TYPE_ML_KEM_KEY_PAIR_BASIC
	bool
	default y
	depends on PSA_WANT_KEY_TYPE_ML_KEM_KEY_PAIR_IMPORT	|| \
		   PSA_WANT_KEY_TYPE_ML_KEM_KEY_PAIR_EXPORT	|| \
		   PSA_WANT_KEY_TYPE_ML_KEM_KEY_PAIR_GENERATE	|| \
		   PSA_WANT_KEY_TYPE_ML_KEM_KEY_PAIR_DERIVE

config PSA_WANT_KEY_TYPE_ML_KEM_KEY_PAIR_IMPORT
	bool "ML_KEM key pair import support" if !PSA_PROMPTLESS
	select PSA_WANT_KEY_TYPE_ML_KEM_PUBLIC_KEY
	default y if PSA_CRYPTO_ENABLE_ALL
	help
	  ML_KEM key pair: import key for both the private and public key.

config PSA_WANT_KEY_TYPE_ML_KEM_KEY_PAIR_EXPORT
	bool "ML_KEM key pair export support" if !PSA_PROMPTLESS
	select PSA_WANT_KEY_TYPE_ML_KEM_PUBLIC_KEY
	default y if PSA_CRYPTO_ENABLE_ALL
	help
	  ML_KEM key pair: export key for both the private and public key.

config PSA_WANT_KEY_TYPE_ML_KEM_KEY_PAIR_GENERATE
	bool "ML_KEM key pair generate support" if !PSA_PROMPTLESS
	select PSA_WANT_KEY_TYPE_ML_KEM_PUBLIC_KEY
	default y if PSA_CRYPTO_ENABLE_ALL
	help
	  ML_KEM key pair: generate key for both the private and public key.

config PSA_WANT_KEY_TYPE_ML_KEM_KEY_PAIR_DERIVE
	bool "ML_KEM key pair derive support" if !PSA_PROMPTLESS
	select PSA_WANT_KEY_TYPE_ML_KEM_PUBLIC_KEY
	default y if PSA_CRYPTO_ENABLE_ALL
	help
	  ML_KEM key pair: derive key for both the private and public key.

config PSA_WANT_KEY_TYPE_ML_KEM_PUBLIC_KEY
	bool "ML_KEM public key support" if !PSA_PROMPTLESS
	help
	  ML_KEM public key support.

config PSA_WANT_KEY_TYPE_ASCON
	bool "ASCON key support" if !PSA_PROMPTLESS
	help
	  ASCON key support.

config PSA_WANT_ALG_STREAM_CIPHER
	select PSA_WANT_KEY_TYPE_CHACHA20

config PSA_WANT_KEY_TYPE_ECC_KEY_PAIR_IMPORT
	select PSA_WANT_KEY_TYPE_ECC_PUBLIC_KEY

config PSA_WANT_KEY_TYPE_ECC_KEY_PAIR_EXPORT
	select PSA_WANT_KEY_TYPE_ECC_PUBLIC_KEY

config PSA_WANT_KEY_TYPE_ECC_KEY_PAIR_GENERATE
	select PSA_WANT_KEY_TYPE_ECC_PUBLIC_KEY

config PSA_WANT_KEY_TYPE_ECC_KEY_PAIR_DERIVE
	select PSA_WANT_KEY_TYPE_ECC_PUBLIC_KEY

config PSA_WANT_KEY_TYPE_RSA_KEY_PAIR_IMPORT
	select PSA_WANT_KEY_TYPE_RSA_PUBLIC_KEY

config PSA_WANT_KEY_TYPE_RSA_KEY_PAIR_EXPORT
	select PSA_WANT_KEY_TYPE_RSA_PUBLIC_KEY

config PSA_WANT_KEY_TYPE_RSA_KEY_PAIR_GENERATE
	select PSA_WANT_KEY_TYPE_RSA_PUBLIC_KEY

config ENTROPY_PSA_CRYPTO_RNG
	select PSA_WANT_GENERATE_RANDOM
```
