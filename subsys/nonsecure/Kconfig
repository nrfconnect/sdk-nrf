## subsys/nrf_security/src/core/lite/Kconfig
```kconfig
#
# Copyright (c) 2026 Nordic Semiconductor
#
# SPDX-License-Identifier: LicenseRef-Nordic-5-Clause
#

if PSA_CORE_LITE

config PSA_CORE_LITE_NSIB_ED25519_OPTIMIZATIONS
	bool "Optimized Ed25519 (only) support for NSIB usage"
	depends on \
		!PSA_CORE_LITE_HAS_ECDSA && \
		!PSA_CORE_LITE_HAS_RSA
	help
	  This configuration calls low-level APIs in CRACEN for Ed25519 instead of
	  going through PSA crypto driver wrappers APIs. This optimization limits
	  supported algorithms for signature verification to only Pure Ed25519 and
	  Ed25519ph.

config PSA_CORE_LITE_HAS_ECDSA
	bool
	default y
	depends on \
		PSA_WANT_ALG_ECDSA || \
		PSA_WANT_ALG_DETERMINISTIC_ECDSA

config PSA_CORE_LITE_HAS_RSA_VERIFY
	bool
	default y
	depends on \
		PSA_WANT_ALG_RSA_PSS || \
		PSA_WANT_ALG_RSA_PKCS1V15_SIGN

config PSA_CORE_LITE_HAS_RSA_DECRYPT
	bool
	default y
	depends on \
		PSA_WANT_ALG_RSA_OAEP

config PSA_CORE_LITE_HAS_RSA
	bool
	default y
	depends on \
		PSA_CORE_LITE_HAS_RSA_VERIFY || \
		PSA_CORE_LITE_HAS_RSA_DECRYPT

config PSA_CORE_LITE_HAS_HASH
	bool
	default y
	depends on \
		PSA_WANT_ALG_SHA_256 || \
		PSA_WANT_ALG_SHA_384 || \
		PSA_WANT_ALG_SHA_512

config PSA_CORE_LITE_HAS_VERIFY_MESSAGE
	bool
	default y
	depends on \
		PSA_CORE_LITE_HAS_ECDSA || \
		PSA_WANT_ALG_PURE_EDDSA || \
		PSA_CORE_LITE_HAS_RSA_VERIFY

config PSA_CORE_LITE_HAS_VERIFY_HASH
	bool
	default y
	depends on \
		PSA_CORE_LITE_HAS_ECDSA || \
		PSA_WANT_ALG_ED25519PH || \
		PSA_CORE_LITE_HAS_RSA_VERIFY

config PSA_CORE_LITE_HAS_VERIFY_SIGNATURE
	bool
	default y
	depends on PSA_CORE_LITE_HAS_VERIFY_MESSAGE || PSA_CORE_LITE_HAS_VERIFY_HASH

config PSA_CORE_LITE_PUB_KEY_MAX_SIZE
	int
	default 398 if (PSA_WANT_ALG_RSA_PSS || PSA_WANT_ALG_RSA_PKCS1V15_SIGN) && \
			PSA_WANT_RSA_KEY_SIZE_3072
	default 270 if (PSA_WANT_ALG_RSA_PSS || PSA_WANT_ALG_RSA_PKCS1V15_SIGN) && \
			PSA_WANT_RSA_KEY_SIZE_2048
	default 97 if (PSA_WANT_ALG_ECDSA || PSA_WANT_ALG_DETERMINISTIC_ECDSA) && \
			PSA_WANT_ECC_SECP_R1_384
	default 65 if (PSA_WANT_ALG_ECDSA || PSA_WANT_ALG_DETERMINISTIC_ECDSA) && \
			PSA_WANT_ECC_SECP_R1_256
	default 32 if (PSA_WANT_ALG_ED25519PH || PSA_WANT_ALG_PURE_EDDSA) && \
			PSA_WANT_ECC_TWISTED_EDWARDS_255
	default 0

config PSA_CORE_LITE_PRIV_KEY_MAX_SIZE
	int
	default 1851 if PSA_WANT_ALG_RSA_OAEP && PSA_WANT_RSA_KEY_SIZE_3072
	default 1248 if PSA_WANT_ALG_RSA_OAEP && PSA_WANT_RSA_KEY_SIZE_2048
	default 32 if PSA_WANT_ALG_ECDH && PSA_WANT_ECC_MONTGOMERY_255
	default 0

config PSA_CORE_LITE_AES_KEY_MAX_SIZE
	int
	default 32 if PSA_WANT_AES_KEY_SIZE_256
	default 16 if PSA_WANT_AES_KEY_SIZE_128
	default 0

config PSA_CORE_LITE_HAS_VOLATILE_KEY_STORAGE
	bool
	default y
	depends on \
		PSA_WANT_ALG_CTR || \
		PSA_WANT_ALG_AES_KW || \
		PSA_WANT_ALG_HKDF || \
		PSA_WANT_ALG_HMAC || \
		PSA_CORE_LITE_HAS_RSA

config PSA_CORE_LITE_MAX_VOLATILE_KEYS_COUNT
	int
	default 1
	depends on PSA_CORE_LITE_HAS_VOLATILE_KEY_STORAGE

endif # PSA_CORE_LITE
```

## subsys/nrf_security/src/drivers/Kconfig
```kconfig
#
# Copyright (c) 2022 Nordic Semiconductor
#
# SPDX-License-Identifier: LicenseRef-Nordic-5-Clause
#

# Legacy config that needs to be removed later. The Oberon PSA driver is now the fallback option
# for all the crypto operations when hardware acceleration is not available.
config PSA_CRYPTO_DRIVER_OBERON
	# The Oberon driver is required to provide HKDF needed for protected storage and bultin keys
	bool "Oberon PSA driver" if !(TFM_PARTITION_PROTECTED_STORAGE || TFM_CRYPTO_BUILTIN_KEYS)
	default y if !HAS_HW_NRF_CRACEN
	help
	  This configuration enables the usage of the Oberon PSA driver.

config PSA_CRYPTO_DRIVER_CC3XX
	bool "CryptoCell PSA driver"
	depends on HAS_HW_NRF_CC3XX
	help
	  This configuration enables the usage of CryptoCell for the supported operations.
	  Disabling this option will result in all crypto operations being handled by
	  the Oberon PSA driver. However, please note that disabling this option does not
	  affect the DRBG algorithms; even when disabled, DRBG will still be provided by CryptoCell.
	  The CryptoCell PSA driver does not support key size configurations. When enabled,
	  all supported key sizes are included in the build.

config PSA_CRYPTO_DRIVER_CRACEN
	bool "Cracen PSA driver"
	depends on MBEDTLS_PSA_CRYPTO_C
	depends on HAS_HW_NRF_CRACEN
	# CRACEN uses the k_event_ API
	select EVENTS if MULTITHREADING
	default y
	help
	  PSA crypto driver for the CRACEN HW peripheral.

config PSA_CRYPTO_DRIVER_IRONSIDE
	bool
	help
	  Internal option selected by IronSide firmware to enable
	  the IronSide PSA crypto driver.

menu "Choose DRBG algorithm"
config PSA_WANT_ALG_CTR_DRBG
	bool "CTR_DRBG"
	default y if !PSA_WANT_ALG_HMAC_DRBG
	depends on PSA_WANT_GENERATE_RANDOM

config PSA_WANT_ALG_HMAC_DRBG
	bool "HMAC_DRBG"
	depends on PSA_WANT_GENERATE_RANDOM

# The Oberon PSA core requires the USE symbols to choose a DRBG algorithm.
config PSA_USE_CTR_DRBG_DRIVER
	bool
	default y if PSA_WANT_ALG_CTR_DRBG

config PSA_USE_HMAC_DRBG_DRIVER
	bool
	default y if PSA_WANT_ALG_HMAC_DRBG

endmenu

menu "CryptoCell PSA Driver Configuration"
if PSA_CRYPTO_DRIVER_CC3XX

config PSA_USE_CC3XX_CIPHER_DRIVER
	bool "CryptoCell driver support for the PSA cipher APIs"
	default y
	help
	  Enable CryptoCell for the PSA Cipher APIs. Enabling this
	  will provide support for AES with modes CTR,CBC PKCS7,
	  CBC no padding, ECB no padding and Chacha20.

config PSA_USE_CC3XX_AEAD_DRIVER
	bool "CryptoCell driver support for the PSA AEAD APIs"
	default y
	help
	  Enable CryptoCell for the PSA AEAD APIs. Enabling this
	  will provide support for AES CCM, AES GCM (only available on CC312)
	  and Chacha20Poly1305.

config PSA_USE_CC3XX_HASH_DRIVER
	bool "CryptoCell driver support for the PSA hash APIs"
	default y
	help
	  Enable CryptoCell for the PSA hash APIs. Enabling this
	  will provide support for SHA1, SHA224 and SHA256.

config PSA_USE_CC3XX_MAC_DRIVER
	bool "CryptoCell driver support for the PSA mac APIs"
	default y
	help
	  Enable CryptoCell for the PSA mac APIs. Enabling this
	  will provide support for HMAC and CMAC.

config PSA_USE_CC3XX_KEY_AGREEMENT_DRIVER
	bool "CryptoCell driver support for the PSA key agreement APIs"
	default y
	help
	  Enable CryptoCell for the PSA key agreement APIs. Enabling this
	  will provide support for key agreement with ECDH.

config PSA_USE_CC3XX_ASYMMETRIC_SIGNATURE_DRIVER
	bool "CryptoCell driver support for the PSA asymmetric signature APIs"
	default y
	help
	  Enable CryptoCell for the PSA asymmetric signature APIs. Enabling this
	  will provide support signing/verification with ECDSA in deterministic
	  and randomized modes and RSA in PKCS1V15 and PSS modes.

config PSA_USE_CC3XX_ASYMMETRIC_ENCRYPTION_DRIVER
	bool "CryptoCell driver support for the PSA asymmetric encryption APIs"
	default y
	help
	  Enable CryptoCell for the PSA asymmetric encryption APIs. Enabling this
	  will provide support for assymetric encryption with RSA
	  in PKCS1V15 and OAEP modes.

config PSA_USE_CC3XX_KEY_MANAGEMENT_DRIVER
	bool "CryptoCell driver support for the PSA key management APIs"
	default y
	depends on PSA_USE_CC3XX_ASYMMETRIC_ENCRYPTION_DRIVER || \
		   PSA_USE_CC3XX_ASYMMETRIC_SIGNATURE_DRIVER  || \
		   PSA_USE_CC3XX_KEY_AGREEMENT_DRIVER
	help
	  Enabling this will provide support for key generation, key importing and
	  public exporting for asymmetric keys. ECC and RSA keys are supported.

endif

config PSA_USE_CC3XX_CTR_DRBG_DRIVER
	bool
	default y
	depends on PSA_USE_CTR_DRBG_DRIVER
	depends on HAS_HW_NRF_CC3XX
	depends on BUILD_WITH_TFM || NRF_CC3XX_PLATFORM

config PSA_USE_CC3XX_HMAC_DRBG_DRIVER
	bool
	default y
	depends on PSA_USE_HMAC_DRBG_DRIVER
	depends on HAS_HW_NRF_CC3XX
	depends on BUILD_WITH_TFM || NRF_CC3XX_PLATFORM

endmenu

menu "CRACEN PSA Driver Configuration"
if PSA_CRYPTO_DRIVER_CRACEN

config PSA_USE_CRACEN_CIPHER_DRIVER
	bool "Cracen cipher driver"
	default y

config PSA_USE_CRACEN_AEAD_DRIVER
	bool "Cracen AEAD driver"
	default y

config PSA_USE_CRACEN_HASH_DRIVER
	bool "Cracen hash driver"
	default y

config PSA_USE_CRACEN_MAC_DRIVER
	bool "Cracen MAC driver"
	default y

config PSA_USE_CRACEN_KEY_AGREEMENT_DRIVER
	bool "Cracen key agreement driver"
	default y

config PSA_USE_CRACEN_ASYMMETRIC_ENCRYPTION_DRIVER
	bool "Cracen asymmetric encryption driver"
	default y

config PSA_USE_CRACEN_KEY_MANAGEMENT_DRIVER
	bool "Cracen key management driver"
	default y
	depends on PSA_USE_CRACEN_ASYMMETRIC_ENCRYPTION_DRIVER || \
		   PSA_USE_CRACEN_KEY_AGREEMENT_DRIVER


if PSA_USE_CRACEN_KEY_MANAGEMENT_DRIVER

config PSA_USE_CRACEN_KEY_DERIVATION_DRIVER
	bool "Cracen key derivation driver"
	default y

config PSA_USE_CRACEN_PAKE_DRIVER
	bool "Cracen PAKE driver"
	default y

config PSA_USE_CRACEN_ASYMMETRIC_SIGNATURE_DRIVER
	bool "Cracen asymmetric signature driver"
	default y

endif # PSA_USE_CRACEN_KEY_MANAGEMENT_DRIVER

config PSA_USE_CRACEN_CTR_DRBG_DRIVER
	bool
	default y

endif
endmenu

menu "AES key size configuration"

config PSA_WANT_AES_KEY_SIZE_128
	bool "AES 128 bits key"
	default y

config PSA_WANT_AES_KEY_SIZE_192
	bool "AES 192 bits key"

config PSA_WANT_AES_KEY_SIZE_256
	bool "AES 256 bits key"
	default y

endmenu

menu "RSA key size configuration"

config PSA_WANT_RSA_KEY_SIZE_1024
	bool "RSA 1024 bits key (weak)"
	help
	  RSA with 1024 bit keys are not recommended for new designs.
	  Please see https://www.keylength.com/

config PSA_WANT_RSA_KEY_SIZE_1536
	bool "RSA 1536 bits key (weak)"
	help
	  RSA with 1536 bit keys are not recommended for new designs.
	  Please see https://www.keylength.com/

config PSA_WANT_RSA_KEY_SIZE_2048
	bool "RSA 2048 bits key"
	default y if (PSA_WANT_KEY_TYPE_RSA_KEY_PAIR_BASIC || PSA_WANT_KEY_TYPE_RSA_PUBLIC_KEY) && \
	             !(PSA_WANT_RSA_KEY_SIZE_1024 || PSA_WANT_RSA_KEY_SIZE_1536 || \
	               PSA_WANT_RSA_KEY_SIZE_3072 || PSA_WANT_RSA_KEY_SIZE_4096 || \
	               PSA_WANT_RSA_KEY_SIZE_6144 || PSA_WANT_RSA_KEY_SIZE_8192)

config PSA_WANT_RSA_KEY_SIZE_3072
	bool "RSA 3072 bits key"

config PSA_WANT_RSA_KEY_SIZE_4096
	bool "RSA 4096 bits key"

config PSA_WANT_RSA_KEY_SIZE_6144
	bool "RSA 6144 bits key"

config PSA_WANT_RSA_KEY_SIZE_8192
	bool "RSA 8192 bits key"

config PSA_MAX_RSA_KEY_BITS
	int
	default 8192 if PSA_WANT_RSA_KEY_SIZE_8192
	default 6144 if PSA_WANT_RSA_KEY_SIZE_6144
	default 4096 if PSA_WANT_RSA_KEY_SIZE_4096
	default 3072 if PSA_WANT_RSA_KEY_SIZE_3072
	default 2048 if PSA_WANT_RSA_KEY_SIZE_2048
	default 1536 if PSA_WANT_RSA_KEY_SIZE_1536
	default 1024 if PSA_WANT_RSA_KEY_SIZE_1024
	default 0

endmenu

rsource "Kconfig.psa_accel"

rsource "nrf_cc3xx/Kconfig"

rsource "cracen/Kconfig"

rsource "nrf_oberon/Kconfig"

rsource "zephyr/Kconfig"
```
