## subsys/nrf_security/src/drivers/Kconfig.psa_accel
```kconfig
# from menuconfig even when show-all mode is enabled
# This invisible menu helps hiding these not user selectable options
# from menuconfig even when show-all mode is enabled
menu "PSA ACCEL - invisible"

visible if 0

config PSA_ACCEL_CBC_MAC_AES_128
	bool

config PSA_ACCEL_CBC_MAC_AES_192
	bool

config PSA_ACCEL_CBC_MAC_AES_256
	bool

config PSA_ACCEL_CBC_MAC_ARIA
	bool

config PSA_ACCEL_CBC_MAC_CAMELLIA
	bool

config PSA_ACCEL_CBC_MAC_DES
	bool

config PSA_ACCEL_CBC_NO_PADDING_AES_128
	bool

config PSA_ACCEL_CBC_NO_PADDING_AES_192
	bool

config PSA_ACCEL_CBC_NO_PADDING_AES_256
	bool

config PSA_ACCEL_CBC_NO_PADDING_ARIA
	bool

config PSA_ACCEL_CBC_NO_PADDING_CAMELLIA
	bool

config PSA_ACCEL_CBC_NO_PADDING_DES
	bool

config PSA_ACCEL_CBC_PKCS7_AES_128
	bool

config PSA_ACCEL_CBC_PKCS7_AES_192
	bool

config PSA_ACCEL_CBC_PKCS7_AES_256
	bool

config PSA_ACCEL_CBC_PKCS7_ARIA
	bool

config PSA_ACCEL_CBC_PKCS7_CAMELLIA
	bool

config PSA_ACCEL_CBC_PKCS7_DES
	bool

config PSA_ACCEL_CCM_AES_128
	bool

config PSA_ACCEL_CCM_AES_192
	bool

config PSA_ACCEL_CCM_AES_256
	bool

config PSA_ACCEL_CCM_ARIA
	bool

config PSA_ACCEL_CCM_CAMELLIA
	bool

config PSA_ACCEL_CCM_STAR_NO_TAG_AES_128
	bool

config PSA_ACCEL_CCM_STAR_NO_TAG_AES_192
	bool

config PSA_ACCEL_CCM_STAR_NO_TAG_AES_256
	bool

config PSA_ACCEL_CFB_AES_128
	bool

config PSA_ACCEL_CFB_AES_192
	bool

config PSA_ACCEL_CFB_AES_256
	bool

config PSA_ACCEL_CFB_ARIA
	bool

config PSA_ACCEL_CFB_CAMELLIA
	bool

config PSA_ACCEL_CFB_DES
	bool

config PSA_ACCEL_CHACHA20_POLY1305
	bool

config PSA_ACCEL_CMAC_AES_128
	bool

config PSA_ACCEL_CMAC_AES_192
	bool

config PSA_ACCEL_CMAC_AES_256
	bool

config PSA_ACCEL_CMAC_ARIA
	bool

config PSA_ACCEL_CMAC_CAMELLIA
	bool

config PSA_ACCEL_CMAC_DES
	bool

config PSA_ACCEL_CTR_AES_128
	bool

config PSA_ACCEL_CTR_AES_192
	bool

config PSA_ACCEL_CTR_AES_256
	bool

config PSA_ACCEL_CTR_ARIA
	bool

config PSA_ACCEL_CTR_CAMELLIA
	bool

config PSA_ACCEL_CTR_DES
	bool

config PSA_ACCEL_ECB_NO_PADDING_AES_128
	bool

config PSA_ACCEL_ECB_NO_PADDING_AES_192
	bool

config PSA_ACCEL_ECB_NO_PADDING_AES_256
	bool

config PSA_ACCEL_ECB_NO_PADDING_ARIA
	bool

config PSA_ACCEL_ECB_NO_PADDING_CAMELLIA
	bool

config PSA_ACCEL_ECB_NO_PADDING_DES
	bool

config PSA_ACCEL_ECDH_MONTGOMERY_255
	bool

config PSA_ACCEL_ECDH_MONTGOMERY_448
	bool

config PSA_ACCEL_ECDH_SECP_R1_224
	bool

config PSA_ACCEL_ECDH_SECP_R1_256
	bool

config PSA_ACCEL_ECDH_SECP_R1_384
	bool

config PSA_ACCEL_ECDH_SECP_R1_521
	bool

config PSA_ACCEL_ECDSA_SECP_R1_224_SHA_1
	bool

config PSA_ACCEL_ECDSA_SECP_R1_224_SHA_224
	bool

config PSA_ACCEL_ECDSA_SECP_R1_224_SHA_256
	bool

config PSA_ACCEL_ECDSA_SECP_R1_224_SHA3_224
	bool

config PSA_ACCEL_ECDSA_SECP_R1_224_SHA3_256
	bool

config PSA_ACCEL_ECDSA_SECP_R1_224_SHA3_384
	bool

config PSA_ACCEL_ECDSA_SECP_R1_224_SHA3_512
	bool

config PSA_ACCEL_ECDSA_SECP_R1_224_SHA_384
	bool

config PSA_ACCEL_ECDSA_SECP_R1_224_SHA_512
	bool

config PSA_ACCEL_ECDSA_SECP_R1_256_SHA_1
	bool

config PSA_ACCEL_ECDSA_SECP_R1_256_SHA_224
	bool

config PSA_ACCEL_ECDSA_SECP_R1_256_SHA_256
	bool

config PSA_ACCEL_ECDSA_SECP_R1_256_SHA3_224
	bool

config PSA_ACCEL_ECDSA_SECP_R1_256_SHA3_256
	bool

config PSA_ACCEL_ECDSA_SECP_R1_256_SHA3_384
	bool

config PSA_ACCEL_ECDSA_SECP_R1_256_SHA3_512
	bool

config PSA_ACCEL_ECDSA_SECP_R1_256_SHA_384
	bool

config PSA_ACCEL_ECDSA_SECP_R1_256_SHA_512
	bool

config PSA_ACCEL_ECDSA_SECP_R1_384_SHA_1
	bool

config PSA_ACCEL_ECDSA_SECP_R1_384_SHA_224
	bool

config PSA_ACCEL_ECDSA_SECP_R1_384_SHA_256
	bool

config PSA_ACCEL_ECDSA_SECP_R1_384_SHA3_224
	bool

config PSA_ACCEL_ECDSA_SECP_R1_384_SHA3_256
	bool

config PSA_ACCEL_ECDSA_SECP_R1_384_SHA3_384
	bool

config PSA_ACCEL_ECDSA_SECP_R1_384_SHA3_512
	bool

config PSA_ACCEL_ECDSA_SECP_R1_384_SHA_384
	bool

config PSA_ACCEL_ECDSA_SECP_R1_384_SHA_512
	bool

config PSA_ACCEL_ECDSA_SECP_R1_521_SHA_1
	bool

config PSA_ACCEL_ECDSA_SECP_R1_521_SHA_224
	bool

config PSA_ACCEL_ECDSA_SECP_R1_521_SHA_256
	bool

config PSA_ACCEL_ECDSA_SECP_R1_521_SHA3_224
	bool

config PSA_ACCEL_ECDSA_SECP_R1_521_SHA3_256
	bool

config PSA_ACCEL_ECDSA_SECP_R1_521_SHA3_384
	bool

config PSA_ACCEL_ECDSA_SECP_R1_521_SHA3_512
	bool

config PSA_ACCEL_ECDSA_SECP_R1_521_SHA_384
	bool

config PSA_ACCEL_ECDSA_SECP_R1_521_SHA_512
	bool

config PSA_ACCEL_ECJPAKE_SECP_R1_256_SHA_1
	bool

config PSA_ACCEL_ECJPAKE_SECP_R1_256_SHA_224
	bool

config PSA_ACCEL_ECJPAKE_SECP_R1_256_SHA_256
	bool

config PSA_ACCEL_ECJPAKE_SECP_R1_256_SHA_384
	bool

config PSA_ACCEL_ECJPAKE_SECP_R1_256_SHA_512
	bool

config PSA_ACCEL_ED25519PH
	bool

config PSA_ACCEL_ED448PH
	bool

config PSA_ACCEL_FFDH_2048
	bool

config PSA_ACCEL_FFDH_3072
	bool

config PSA_ACCEL_FFDH_4096
	bool

config PSA_ACCEL_FFDH_6144
	bool

config PSA_ACCEL_FFDH_8192
	bool

config PSA_ACCEL_GCM_AES_128
	bool

config PSA_ACCEL_GCM_AES_192
	bool

config PSA_ACCEL_GCM_AES_256
	bool

config PSA_ACCEL_GCM_ARIA
	bool

config PSA_ACCEL_GCM_CAMELLIA
	bool

config PSA_ACCEL_GENERATE_RANDOM
	bool

config PSA_ACCEL_GET_ENTROPY
	bool

config PSA_ACCEL_HKDF_EXPAND_SHA_1
	bool

config PSA_ACCEL_HKDF_EXPAND_SHA_224
	bool

config PSA_ACCEL_HKDF_EXPAND_SHA_256
	bool

config PSA_ACCEL_HKDF_EXPAND_SHA_384
	bool

config PSA_ACCEL_HKDF_EXPAND_SHA_512
	bool

config PSA_ACCEL_HKDF_EXTRACT_SHA_1
	bool

config PSA_ACCEL_HKDF_EXTRACT_SHA_224
	bool

config PSA_ACCEL_HKDF_EXTRACT_SHA_256
	bool

config PSA_ACCEL_HKDF_EXTRACT_SHA_384
	bool

config PSA_ACCEL_HKDF_EXTRACT_SHA_512
	bool

config PSA_ACCEL_HKDF_SHA_1
	bool

config PSA_ACCEL_HKDF_SHA_224
	bool

config PSA_ACCEL_HKDF_SHA_256
	bool

config PSA_ACCEL_HKDF_SHA_384
	bool

config PSA_ACCEL_HKDF_SHA_512
	bool

config PSA_ACCEL_HMAC_SHA_1
	bool

config PSA_ACCEL_HMAC_SHA_224
	bool

config PSA_ACCEL_HMAC_SHA_256
	bool

config PSA_ACCEL_HMAC_SHA_384
	bool

config PSA_ACCEL_HMAC_SHA_512
	bool

config PSA_ACCEL_KEY_TYPE_ECC_KEY_PAIR_DERIVE_BRAINPOOL_P_R1_160
	bool

config PSA_ACCEL_KEY_TYPE_ECC_KEY_PAIR_DERIVE_BRAINPOOL_P_R1_192
	bool

config PSA_ACCEL_KEY_TYPE_ECC_KEY_PAIR_DERIVE_BRAINPOOL_P_R1_224
	bool

config PSA_ACCEL_KEY_TYPE_ECC_KEY_PAIR_DERIVE_BRAINPOOL_P_R1_256
	bool

config PSA_ACCEL_KEY_TYPE_ECC_KEY_PAIR_DERIVE_BRAINPOOL_P_R1_320
	bool

config PSA_ACCEL_KEY_TYPE_ECC_KEY_PAIR_DERIVE_BRAINPOOL_P_R1_384
	bool

config PSA_ACCEL_KEY_TYPE_ECC_KEY_PAIR_DERIVE_BRAINPOOL_P_R1_512
	bool

config PSA_ACCEL_KEY_TYPE_ECC_KEY_PAIR_DERIVE_MONTGOMERY_255
	bool

config PSA_ACCEL_KEY_TYPE_ECC_KEY_PAIR_DERIVE_MONTGOMERY_448
	bool

config PSA_ACCEL_KEY_TYPE_ECC_KEY_PAIR_DERIVE_SECP_K1_192
	bool

config PSA_ACCEL_KEY_TYPE_ECC_KEY_PAIR_DERIVE_SECP_K1_224
	bool

config PSA_ACCEL_KEY_TYPE_ECC_KEY_PAIR_DERIVE_SECP_K1_256
	bool

config PSA_ACCEL_KEY_TYPE_ECC_KEY_PAIR_DERIVE_SECP_R1_192
	bool

config PSA_ACCEL_KEY_TYPE_ECC_KEY_PAIR_DERIVE_SECP_R1_224
	bool

config PSA_ACCEL_KEY_TYPE_ECC_KEY_PAIR_DERIVE_SECP_R1_256
	bool

config PSA_ACCEL_KEY_TYPE_ECC_KEY_PAIR_DERIVE_SECP_R1_384
	bool

config PSA_ACCEL_KEY_TYPE_ECC_KEY_PAIR_DERIVE_SECP_R1_521
	bool

config PSA_ACCEL_KEY_TYPE_ECC_KEY_PAIR_DERIVE_SECT_K1_163
	bool

config PSA_ACCEL_KEY_TYPE_ECC_KEY_PAIR_DERIVE_SECT_K1_233
	bool

config PSA_ACCEL_KEY_TYPE_ECC_KEY_PAIR_DERIVE_SECT_K1_239
	bool

config PSA_ACCEL_KEY_TYPE_ECC_KEY_PAIR_DERIVE_SECT_K1_283
	bool

config PSA_ACCEL_KEY_TYPE_ECC_KEY_PAIR_DERIVE_SECT_K1_409
	bool

config PSA_ACCEL_KEY_TYPE_ECC_KEY_PAIR_DERIVE_SECT_K1_571
	bool

config PSA_ACCEL_KEY_TYPE_ECC_KEY_PAIR_DERIVE_SECT_R1_163
	bool

config PSA_ACCEL_KEY_TYPE_ECC_KEY_PAIR_DERIVE_SECT_R1_233
	bool

config PSA_ACCEL_KEY_TYPE_ECC_KEY_PAIR_DERIVE_SECT_R1_283
	bool

config PSA_ACCEL_KEY_TYPE_ECC_KEY_PAIR_DERIVE_SECT_R1_409
	bool

config PSA_ACCEL_KEY_TYPE_ECC_KEY_PAIR_DERIVE_SECT_R1_571
	bool

config PSA_ACCEL_KEY_TYPE_ECC_KEY_PAIR_DERIVE_TWISTED_EDWARDS_255
	bool

config PSA_ACCEL_KEY_TYPE_ECC_KEY_PAIR_DERIVE_TWISTED_EDWARDS_448
	bool

config PSA_ACCEL_KEY_TYPE_ECC_KEY_PAIR_EXPORT_BRAINPOOL_P_R1_160
	bool

config PSA_ACCEL_KEY_TYPE_ECC_KEY_PAIR_EXPORT_BRAINPOOL_P_R1_192
	bool

config PSA_ACCEL_KEY_TYPE_ECC_KEY_PAIR_EXPORT_BRAINPOOL_P_R1_224
	bool

config PSA_ACCEL_KEY_TYPE_ECC_KEY_PAIR_EXPORT_BRAINPOOL_P_R1_256
	bool

config PSA_ACCEL_KEY_TYPE_ECC_KEY_PAIR_EXPORT_BRAINPOOL_P_R1_320
	bool

config PSA_ACCEL_KEY_TYPE_ECC_KEY_PAIR_EXPORT_BRAINPOOL_P_R1_384
	bool

config PSA_ACCEL_KEY_TYPE_ECC_KEY_PAIR_EXPORT_BRAINPOOL_P_R1_512
	bool

config PSA_ACCEL_KEY_TYPE_ECC_KEY_PAIR_EXPORT_MONTGOMERY_255
	bool

config PSA_ACCEL_KEY_TYPE_ECC_KEY_PAIR_EXPORT_MONTGOMERY_448
	bool

config PSA_ACCEL_KEY_TYPE_ECC_KEY_PAIR_EXPORT_SECP_K1_192
	bool

config PSA_ACCEL_KEY_TYPE_ECC_KEY_PAIR_EXPORT_SECP_K1_224
	bool

config PSA_ACCEL_KEY_TYPE_ECC_KEY_PAIR_EXPORT_SECP_K1_256
	bool

config PSA_ACCEL_KEY_TYPE_ECC_KEY_PAIR_EXPORT_SECP_R1_192
	bool

config PSA_ACCEL_KEY_TYPE_ECC_KEY_PAIR_EXPORT_SECP_R1_224
	bool

config PSA_ACCEL_KEY_TYPE_ECC_KEY_PAIR_EXPORT_SECP_R1_256
	bool

config PSA_ACCEL_KEY_TYPE_ECC_KEY_PAIR_EXPORT_SECP_R1_384
	bool

config PSA_ACCEL_KEY_TYPE_ECC_KEY_PAIR_EXPORT_SECP_R1_521
	bool

config PSA_ACCEL_KEY_TYPE_ECC_KEY_PAIR_EXPORT_SECT_K1_163
	bool

config PSA_ACCEL_KEY_TYPE_ECC_KEY_PAIR_EXPORT_SECT_K1_233
	bool

config PSA_ACCEL_KEY_TYPE_ECC_KEY_PAIR_EXPORT_SECT_K1_239
	bool

config PSA_ACCEL_KEY_TYPE_ECC_KEY_PAIR_EXPORT_SECT_K1_283
	bool

config PSA_ACCEL_KEY_TYPE_ECC_KEY_PAIR_EXPORT_SECT_K1_409
	bool

config PSA_ACCEL_KEY_TYPE_ECC_KEY_PAIR_EXPORT_SECT_K1_571
	bool

config PSA_ACCEL_KEY_TYPE_ECC_KEY_PAIR_EXPORT_SECT_R1_163
	bool

config PSA_ACCEL_KEY_TYPE_ECC_KEY_PAIR_EXPORT_SECT_R1_233
	bool

config PSA_ACCEL_KEY_TYPE_ECC_KEY_PAIR_EXPORT_SECT_R1_283
	bool

config PSA_ACCEL_KEY_TYPE_ECC_KEY_PAIR_EXPORT_SECT_R1_409
	bool

config PSA_ACCEL_KEY_TYPE_ECC_KEY_PAIR_EXPORT_SECT_R1_571
	bool

config PSA_ACCEL_KEY_TYPE_ECC_KEY_PAIR_EXPORT_TWISTED_EDWARDS_255
	bool

config PSA_ACCEL_KEY_TYPE_ECC_KEY_PAIR_EXPORT_TWISTED_EDWARDS_448
	bool

config PSA_ACCEL_KEY_TYPE_ECC_KEY_PAIR_GENERATE_BRAINPOOL_P_R1_160
	bool

config PSA_ACCEL_KEY_TYPE_ECC_KEY_PAIR_GENERATE_BRAINPOOL_P_R1_192
	bool

config PSA_ACCEL_KEY_TYPE_ECC_KEY_PAIR_GENERATE_BRAINPOOL_P_R1_224
	bool

config PSA_ACCEL_KEY_TYPE_ECC_KEY_PAIR_GENERATE_BRAINPOOL_P_R1_256
	bool

config PSA_ACCEL_KEY_TYPE_ECC_KEY_PAIR_GENERATE_BRAINPOOL_P_R1_320
	bool

config PSA_ACCEL_KEY_TYPE_ECC_KEY_PAIR_GENERATE_BRAINPOOL_P_R1_384
	bool

config PSA_ACCEL_KEY_TYPE_ECC_KEY_PAIR_GENERATE_BRAINPOOL_P_R1_512
	bool

config PSA_ACCEL_KEY_TYPE_ECC_KEY_PAIR_GENERATE_MONTGOMERY_255
	bool

config PSA_ACCEL_KEY_TYPE_ECC_KEY_PAIR_GENERATE_MONTGOMERY_448
	bool

config PSA_ACCEL_KEY_TYPE_ECC_KEY_PAIR_GENERATE_SECP_K1_192
	bool

config PSA_ACCEL_KEY_TYPE_ECC_KEY_PAIR_GENERATE_SECP_K1_224
	bool

config PSA_ACCEL_KEY_TYPE_ECC_KEY_PAIR_GENERATE_SECP_K1_256
	bool

config PSA_ACCEL_KEY_TYPE_ECC_KEY_PAIR_GENERATE_SECP_R1_192
	bool

config PSA_ACCEL_KEY_TYPE_ECC_KEY_PAIR_GENERATE_SECP_R1_224
	bool

config PSA_ACCEL_KEY_TYPE_ECC_KEY_PAIR_GENERATE_SECP_R1_256
	bool

config PSA_ACCEL_KEY_TYPE_ECC_KEY_PAIR_GENERATE_SECP_R1_384
	bool

config PSA_ACCEL_KEY_TYPE_ECC_KEY_PAIR_GENERATE_SECP_R1_521
	bool

config PSA_ACCEL_KEY_TYPE_ECC_KEY_PAIR_GENERATE_SECT_K1_163
	bool

config PSA_ACCEL_KEY_TYPE_ECC_KEY_PAIR_GENERATE_SECT_K1_233
	bool

config PSA_ACCEL_KEY_TYPE_ECC_KEY_PAIR_GENERATE_SECT_K1_239
	bool

config PSA_ACCEL_KEY_TYPE_ECC_KEY_PAIR_GENERATE_SECT_K1_283
	bool

config PSA_ACCEL_KEY_TYPE_ECC_KEY_PAIR_GENERATE_SECT_K1_409
	bool

config PSA_ACCEL_KEY_TYPE_ECC_KEY_PAIR_GENERATE_SECT_K1_571
	bool

config PSA_ACCEL_KEY_TYPE_ECC_KEY_PAIR_GENERATE_SECT_R1_163
	bool

config PSA_ACCEL_KEY_TYPE_ECC_KEY_PAIR_GENERATE_SECT_R1_233
	bool

config PSA_ACCEL_KEY_TYPE_ECC_KEY_PAIR_GENERATE_SECT_R1_283
	bool

config PSA_ACCEL_KEY_TYPE_ECC_KEY_PAIR_GENERATE_SECT_R1_409
	bool

config PSA_ACCEL_KEY_TYPE_ECC_KEY_PAIR_GENERATE_SECT_R1_571
	bool

config PSA_ACCEL_KEY_TYPE_ECC_KEY_PAIR_GENERATE_TWISTED_EDWARDS_255
	bool

config PSA_ACCEL_KEY_TYPE_ECC_KEY_PAIR_GENERATE_TWISTED_EDWARDS_448
	bool

config PSA_ACCEL_KEY_TYPE_ECC_KEY_PAIR_IMPORT_BRAINPOOL_P_R1_160
	bool

config PSA_ACCEL_KEY_TYPE_ECC_KEY_PAIR_IMPORT_BRAINPOOL_P_R1_192
	bool

config PSA_ACCEL_KEY_TYPE_ECC_KEY_PAIR_IMPORT_BRAINPOOL_P_R1_224
	bool

config PSA_ACCEL_KEY_TYPE_ECC_KEY_PAIR_IMPORT_BRAINPOOL_P_R1_256
	bool

config PSA_ACCEL_KEY_TYPE_ECC_KEY_PAIR_IMPORT_BRAINPOOL_P_R1_320
	bool

config PSA_ACCEL_KEY_TYPE_ECC_KEY_PAIR_IMPORT_BRAINPOOL_P_R1_384
	bool

config PSA_ACCEL_KEY_TYPE_ECC_KEY_PAIR_IMPORT_BRAINPOOL_P_R1_512
	bool

config PSA_ACCEL_KEY_TYPE_ECC_KEY_PAIR_IMPORT_MONTGOMERY_255
	bool

config PSA_ACCEL_KEY_TYPE_ECC_KEY_PAIR_IMPORT_MONTGOMERY_448
	bool

config PSA_ACCEL_KEY_TYPE_ECC_KEY_PAIR_IMPORT_SECP_K1_192
	bool

config PSA_ACCEL_KEY_TYPE_ECC_KEY_PAIR_IMPORT_SECP_K1_224
	bool

config PSA_ACCEL_KEY_TYPE_ECC_KEY_PAIR_IMPORT_SECP_K1_256
	bool

config PSA_ACCEL_KEY_TYPE_ECC_KEY_PAIR_IMPORT_SECP_R1_192
	bool

config PSA_ACCEL_KEY_TYPE_ECC_KEY_PAIR_IMPORT_SECP_R1_224
	bool

config PSA_ACCEL_KEY_TYPE_ECC_KEY_PAIR_IMPORT_SECP_R1_256
	bool

config PSA_ACCEL_KEY_TYPE_ECC_KEY_PAIR_IMPORT_SECP_R1_384
	bool

config PSA_ACCEL_KEY_TYPE_ECC_KEY_PAIR_IMPORT_SECP_R1_521
	bool

config PSA_ACCEL_KEY_TYPE_ECC_KEY_PAIR_IMPORT_SECT_K1_163
	bool

config PSA_ACCEL_KEY_TYPE_ECC_KEY_PAIR_IMPORT_SECT_K1_233
	bool

config PSA_ACCEL_KEY_TYPE_ECC_KEY_PAIR_IMPORT_SECT_K1_239
	bool

config PSA_ACCEL_KEY_TYPE_ECC_KEY_PAIR_IMPORT_SECT_K1_283
	bool

config PSA_ACCEL_KEY_TYPE_ECC_KEY_PAIR_IMPORT_SECT_K1_409
	bool

config PSA_ACCEL_KEY_TYPE_ECC_KEY_PAIR_IMPORT_SECT_K1_571
	bool

config PSA_ACCEL_KEY_TYPE_ECC_KEY_PAIR_IMPORT_SECT_R1_163
	bool

config PSA_ACCEL_KEY_TYPE_ECC_KEY_PAIR_IMPORT_SECT_R1_233
	bool

config PSA_ACCEL_KEY_TYPE_ECC_KEY_PAIR_IMPORT_SECT_R1_283
	bool

config PSA_ACCEL_KEY_TYPE_ECC_KEY_PAIR_IMPORT_SECT_R1_409
	bool

config PSA_ACCEL_KEY_TYPE_ECC_KEY_PAIR_IMPORT_SECT_R1_571
	bool

config PSA_ACCEL_KEY_TYPE_ECC_KEY_PAIR_IMPORT_TWISTED_EDWARDS_255
	bool

config PSA_ACCEL_KEY_TYPE_ECC_KEY_PAIR_IMPORT_TWISTED_EDWARDS_448
	bool

config PSA_ACCEL_KEY_TYPE_ECC_PUBLIC_KEY_BRAINPOOL_P_R1_160
	bool

config PSA_ACCEL_KEY_TYPE_ECC_PUBLIC_KEY_BRAINPOOL_P_R1_192
	bool

config PSA_ACCEL_KEY_TYPE_ECC_PUBLIC_KEY_BRAINPOOL_P_R1_224
	bool

config PSA_ACCEL_KEY_TYPE_ECC_PUBLIC_KEY_BRAINPOOL_P_R1_256
	bool

config PSA_ACCEL_KEY_TYPE_ECC_PUBLIC_KEY_BRAINPOOL_P_R1_320
	bool

config PSA_ACCEL_KEY_TYPE_ECC_PUBLIC_KEY_BRAINPOOL_P_R1_384
	bool

config PSA_ACCEL_KEY_TYPE_ECC_PUBLIC_KEY_BRAINPOOL_P_R1_512
	bool

config PSA_ACCEL_KEY_TYPE_ECC_PUBLIC_KEY_MONTGOMERY_255
	bool

config PSA_ACCEL_KEY_TYPE_ECC_PUBLIC_KEY_MONTGOMERY_448
	bool

config PSA_ACCEL_KEY_TYPE_ECC_PUBLIC_KEY_SECP_K1_192
	bool

config PSA_ACCEL_KEY_TYPE_ECC_PUBLIC_KEY_SECP_K1_224
	bool

config PSA_ACCEL_KEY_TYPE_ECC_PUBLIC_KEY_SECP_K1_256
	bool

config PSA_ACCEL_KEY_TYPE_ECC_PUBLIC_KEY_SECP_R1_192
	bool

config PSA_ACCEL_KEY_TYPE_ECC_PUBLIC_KEY_SECP_R1_224
	bool

config PSA_ACCEL_KEY_TYPE_ECC_PUBLIC_KEY_SECP_R1_256
	bool

config PSA_ACCEL_KEY_TYPE_ECC_PUBLIC_KEY_SECP_R1_384
	bool

config PSA_ACCEL_KEY_TYPE_ECC_PUBLIC_KEY_SECP_R1_521
	bool

config PSA_ACCEL_KEY_TYPE_ECC_PUBLIC_KEY_SECT_K1_163
	bool

config PSA_ACCEL_KEY_TYPE_ECC_PUBLIC_KEY_SECT_K1_233
	bool

config PSA_ACCEL_KEY_TYPE_ECC_PUBLIC_KEY_SECT_K1_239
	bool

config PSA_ACCEL_KEY_TYPE_ECC_PUBLIC_KEY_SECT_K1_283
	bool

config PSA_ACCEL_KEY_TYPE_ECC_PUBLIC_KEY_SECT_K1_409
	bool

config PSA_ACCEL_KEY_TYPE_ECC_PUBLIC_KEY_SECT_K1_571
	bool

config PSA_ACCEL_KEY_TYPE_ECC_PUBLIC_KEY_SECT_R1_163
	bool

config PSA_ACCEL_KEY_TYPE_ECC_PUBLIC_KEY_SECT_R1_233
	bool

config PSA_ACCEL_KEY_TYPE_ECC_PUBLIC_KEY_SECT_R1_283
	bool

config PSA_ACCEL_KEY_TYPE_ECC_PUBLIC_KEY_SECT_R1_409
	bool

config PSA_ACCEL_KEY_TYPE_ECC_PUBLIC_KEY_SECT_R1_571
	bool

config PSA_ACCEL_KEY_TYPE_ECC_PUBLIC_KEY_TWISTED_EDWARDS_255
	bool

config PSA_ACCEL_KEY_TYPE_ECC_PUBLIC_KEY_TWISTED_EDWARDS_448
	bool

config PSA_ACCEL_KEY_TYPE_RSA_1024_KEY_PAIR_EXPORT
	bool

config PSA_ACCEL_KEY_TYPE_RSA_1024_KEY_PAIR_IMPORT
	bool

config PSA_ACCEL_KEY_TYPE_RSA_1024_PUBLIC_KEY
	bool

config PSA_ACCEL_KEY_TYPE_RSA_1536_KEY_PAIR_EXPORT
	bool

config PSA_ACCEL_KEY_TYPE_RSA_1536_KEY_PAIR_IMPORT
	bool

config PSA_ACCEL_KEY_TYPE_RSA_1536_PUBLIC_KEY
	bool

config PSA_ACCEL_KEY_TYPE_RSA_2048_KEY_PAIR_EXPORT
	bool

config PSA_ACCEL_KEY_TYPE_RSA_2048_KEY_PAIR_IMPORT
	bool

config PSA_ACCEL_KEY_TYPE_RSA_2048_PUBLIC_KEY
	bool

config PSA_ACCEL_KEY_TYPE_RSA_3072_KEY_PAIR_EXPORT
	bool

config PSA_ACCEL_KEY_TYPE_RSA_3072_KEY_PAIR_IMPORT
	bool

config PSA_ACCEL_KEY_TYPE_RSA_3072_PUBLIC_KEY
	bool

config PSA_ACCEL_KEY_TYPE_RSA_KEY_PAIR_EXPORT
	bool

config PSA_ACCEL_KEY_TYPE_RSA_KEY_PAIR_IMPORT
	bool

config PSA_ACCEL_KEY_TYPE_RSA_PUBLIC_KEY
	bool

config PSA_ACCEL_KEY_TYPE_SPAKE2P_KEY_PAIR_DERIVE_SECP_R1_256
	bool

config PSA_ACCEL_KEY_TYPE_SPAKE2P_KEY_PAIR_EXPORT_SECP_R1_256
	bool

config PSA_ACCEL_KEY_TYPE_SPAKE2P_KEY_PAIR_IMPORT_SECP_R1_256
	bool

config PSA_ACCEL_KEY_TYPE_SPAKE2P_PUBLIC_KEY_SECP_R1_256
	bool

config PSA_ACCEL_KEY_TYPE_SRP_6_KEY_PAIR_EXPORT_3072
	bool

config PSA_ACCEL_KEY_TYPE_SRP_6_KEY_PAIR_IMPORT_3072
	bool

config PSA_ACCEL_KEY_TYPE_SRP_6_PUBLIC_KEY_3072
	bool

config PSA_ACCEL_MD5
	bool

config PSA_ACCEL_OFB_AES_128
	bool

config PSA_ACCEL_OFB_AES_192
	bool

config PSA_ACCEL_OFB_AES_256
	bool

config PSA_ACCEL_OFB_ARIA
	bool

config PSA_ACCEL_OFB_CAMELLIA
	bool

config PSA_ACCEL_OFB_DES
	bool

config PSA_ACCEL_PBKDF2_AES_CMAC_PRF_128
	bool

config PSA_ACCEL_PBKDF2_HMAC_SHA_1
	bool

config PSA_ACCEL_PBKDF2_HMAC_SHA_224
	bool

config PSA_ACCEL_PBKDF2_HMAC_SHA_256
	bool

config PSA_ACCEL_PBKDF2_HMAC_SHA_384
	bool

config PSA_ACCEL_PBKDF2_HMAC_SHA_512
	bool

config PSA_ACCEL_PURE_EDDSA_TWISTED_EDWARDS_255
	bool

config PSA_ACCEL_PURE_EDDSA_TWISTED_EDWARDS_448
	bool

config PSA_ACCEL_RIPEMD160
	bool

config PSA_ACCEL_RSA_OAEP_1024_SHA_1
	bool

config PSA_ACCEL_RSA_OAEP_1024_SHA_224
	bool

config PSA_ACCEL_RSA_OAEP_1024_SHA_256
	bool

config PSA_ACCEL_RSA_OAEP_1024_SHA3_224
	bool

config PSA_ACCEL_RSA_OAEP_1024_SHA3_256
	bool

config PSA_ACCEL_RSA_OAEP_1024_SHA3_384
	bool

config PSA_ACCEL_RSA_OAEP_1024_SHA3_512
	bool

config PSA_ACCEL_RSA_OAEP_1024_SHA_384
	bool

config PSA_ACCEL_RSA_OAEP_1024_SHA_512
	bool

config PSA_ACCEL_RSA_OAEP_1536_SHA_1
	bool

config PSA_ACCEL_RSA_OAEP_1536_SHA_224
	bool

config PSA_ACCEL_RSA_OAEP_1536_SHA_256
	bool

config PSA_ACCEL_RSA_OAEP_1536_SHA3_224
	bool

config PSA_ACCEL_RSA_OAEP_1536_SHA3_256
	bool

config PSA_ACCEL_RSA_OAEP_1536_SHA3_384
	bool

config PSA_ACCEL_RSA_OAEP_1536_SHA3_512
	bool

config PSA_ACCEL_RSA_OAEP_1536_SHA_384
	bool

config PSA_ACCEL_RSA_OAEP_1536_SHA_512
	bool

config PSA_ACCEL_RSA_OAEP_2048_SHA_1
	bool

config PSA_ACCEL_RSA_OAEP_2048_SHA_224
	bool

config PSA_ACCEL_RSA_OAEP_2048_SHA_256
	bool

config PSA_ACCEL_RSA_OAEP_2048_SHA3_224
	bool

config PSA_ACCEL_RSA_OAEP_2048_SHA3_256
	bool

config PSA_ACCEL_RSA_OAEP_2048_SHA3_384
	bool

config PSA_ACCEL_RSA_OAEP_2048_SHA3_512
	bool

config PSA_ACCEL_RSA_OAEP_2048_SHA_384
	bool

config PSA_ACCEL_RSA_OAEP_2048_SHA_512
	bool

config PSA_ACCEL_RSA_OAEP_3072_SHA_1
	bool

config PSA_ACCEL_RSA_OAEP_3072_SHA_224
	bool

config PSA_ACCEL_RSA_OAEP_3072_SHA_256
	bool

config PSA_ACCEL_RSA_OAEP_3072_SHA3_224
	bool

config PSA_ACCEL_RSA_OAEP_3072_SHA3_256
	bool

config PSA_ACCEL_RSA_OAEP_3072_SHA3_384
	bool

config PSA_ACCEL_RSA_OAEP_3072_SHA3_512
	bool

config PSA_ACCEL_RSA_OAEP_3072_SHA_384
	bool

config PSA_ACCEL_RSA_OAEP_3072_SHA_512
	bool

config PSA_ACCEL_RSA_OAEP_4096_SHA_1
	bool

config PSA_ACCEL_RSA_OAEP_4096_SHA_224
	bool

config PSA_ACCEL_RSA_OAEP_4096_SHA_256
	bool

config PSA_ACCEL_RSA_OAEP_4096_SHA3_224
	bool

config PSA_ACCEL_RSA_OAEP_4096_SHA3_256
	bool

config PSA_ACCEL_RSA_OAEP_4096_SHA3_384
	bool

config PSA_ACCEL_RSA_OAEP_4096_SHA3_512
	bool

config PSA_ACCEL_RSA_OAEP_4096_SHA_384
	bool

config PSA_ACCEL_RSA_OAEP_4096_SHA_512
	bool

config PSA_ACCEL_RSA_OAEP_6144_SHA_1
	bool

config PSA_ACCEL_RSA_OAEP_6144_SHA_224
	bool

config PSA_ACCEL_RSA_OAEP_6144_SHA_256
	bool

config PSA_ACCEL_RSA_OAEP_6144_SHA3_224
	bool

config PSA_ACCEL_RSA_OAEP_6144_SHA3_256
	bool

config PSA_ACCEL_RSA_OAEP_6144_SHA3_384
	bool

config PSA_ACCEL_RSA_OAEP_6144_SHA3_512
	bool

config PSA_ACCEL_RSA_OAEP_6144_SHA_384
	bool

config PSA_ACCEL_RSA_OAEP_6144_SHA_512
	bool

config PSA_ACCEL_RSA_OAEP_8192_SHA_1
	bool

config PSA_ACCEL_RSA_OAEP_8192_SHA_224
	bool

config PSA_ACCEL_RSA_OAEP_8192_SHA_256
	bool

config PSA_ACCEL_RSA_OAEP_8192_SHA3_224
	bool

config PSA_ACCEL_RSA_OAEP_8192_SHA3_256
	bool

config PSA_ACCEL_RSA_OAEP_8192_SHA3_384
	bool

config PSA_ACCEL_RSA_OAEP_8192_SHA3_512
	bool

config PSA_ACCEL_RSA_OAEP_8192_SHA_384
	bool

config PSA_ACCEL_RSA_OAEP_8192_SHA_512
	bool

config PSA_ACCEL_RSA_PKCS1V15_CRYPT_1024
	bool

config PSA_ACCEL_RSA_PKCS1V15_CRYPT_1536
	bool

config PSA_ACCEL_RSA_PKCS1V15_CRYPT_2048
	bool

config PSA_ACCEL_RSA_PKCS1V15_CRYPT_3072
	bool

config PSA_ACCEL_RSA_PKCS1V15_CRYPT_4096
	bool

config PSA_ACCEL_RSA_PKCS1V15_CRYPT_6144
	bool

config PSA_ACCEL_RSA_PKCS1V15_CRYPT_8192
	bool

config PSA_ACCEL_RSA_PKCS1V15_SIGN_1024_SHA_1
	bool

config PSA_ACCEL_RSA_PKCS1V15_SIGN_1024_SHA_224
	bool

config PSA_ACCEL_RSA_PKCS1V15_SIGN_1024_SHA_256
	bool

config PSA_ACCEL_RSA_PKCS1V15_SIGN_1024_SHA3_224
	bool

config PSA_ACCEL_RSA_PKCS1V15_SIGN_1024_SHA3_256
	bool

config PSA_ACCEL_RSA_PKCS1V15_SIGN_1024_SHA3_384
	bool

config PSA_ACCEL_RSA_PKCS1V15_SIGN_1024_SHA3_512
	bool

config PSA_ACCEL_RSA_PKCS1V15_SIGN_1024_SHA_384
	bool

config PSA_ACCEL_RSA_PKCS1V15_SIGN_1024_SHA_512
	bool

config PSA_ACCEL_RSA_PKCS1V15_SIGN_1536_SHA_1
	bool

config PSA_ACCEL_RSA_PKCS1V15_SIGN_1536_SHA_224
	bool

config PSA_ACCEL_RSA_PKCS1V15_SIGN_1536_SHA_256
	bool

config PSA_ACCEL_RSA_PKCS1V15_SIGN_1536_SHA3_224
	bool

config PSA_ACCEL_RSA_PKCS1V15_SIGN_1536_SHA3_256
	bool

config PSA_ACCEL_RSA_PKCS1V15_SIGN_1536_SHA3_384
	bool

config PSA_ACCEL_RSA_PKCS1V15_SIGN_1536_SHA3_512
	bool

config PSA_ACCEL_RSA_PKCS1V15_SIGN_1536_SHA_384
	bool

config PSA_ACCEL_RSA_PKCS1V15_SIGN_1536_SHA_512
	bool

config PSA_ACCEL_RSA_PKCS1V15_SIGN_2048_SHA_1
	bool

config PSA_ACCEL_RSA_PKCS1V15_SIGN_2048_SHA_224
	bool

config PSA_ACCEL_RSA_PKCS1V15_SIGN_2048_SHA_256
	bool

config PSA_ACCEL_RSA_PKCS1V15_SIGN_2048_SHA3_224
	bool

config PSA_ACCEL_RSA_PKCS1V15_SIGN_2048_SHA3_256
	bool

config PSA_ACCEL_RSA_PKCS1V15_SIGN_2048_SHA3_384
	bool

config PSA_ACCEL_RSA_PKCS1V15_SIGN_2048_SHA3_512
	bool

config PSA_ACCEL_RSA_PKCS1V15_SIGN_2048_SHA_384
	bool

config PSA_ACCEL_RSA_PKCS1V15_SIGN_2048_SHA_512
	bool

config PSA_ACCEL_RSA_PKCS1V15_SIGN_3072_SHA_1
	bool

config PSA_ACCEL_RSA_PKCS1V15_SIGN_3072_SHA_224
	bool

config PSA_ACCEL_RSA_PKCS1V15_SIGN_3072_SHA_256
	bool

config PSA_ACCEL_RSA_PKCS1V15_SIGN_3072_SHA3_224
	bool

config PSA_ACCEL_RSA_PKCS1V15_SIGN_3072_SHA3_256
	bool

config PSA_ACCEL_RSA_PKCS1V15_SIGN_3072_SHA3_384
	bool

config PSA_ACCEL_RSA_PKCS1V15_SIGN_3072_SHA3_512
	bool

config PSA_ACCEL_RSA_PKCS1V15_SIGN_3072_SHA_384
	bool

config PSA_ACCEL_RSA_PKCS1V15_SIGN_3072_SHA_512
	bool

config PSA_ACCEL_RSA_PKCS1V15_SIGN_4096_SHA_1
	bool

config PSA_ACCEL_RSA_PKCS1V15_SIGN_4096_SHA_224
	bool

config PSA_ACCEL_RSA_PKCS1V15_SIGN_4096_SHA_256
	bool

config PSA_ACCEL_RSA_PKCS1V15_SIGN_4096_SHA3_224
	bool

config PSA_ACCEL_RSA_PKCS1V15_SIGN_4096_SHA3_256
	bool

config PSA_ACCEL_RSA_PKCS1V15_SIGN_4096_SHA3_384
	bool

config PSA_ACCEL_RSA_PKCS1V15_SIGN_4096_SHA3_512
	bool

config PSA_ACCEL_RSA_PKCS1V15_SIGN_4096_SHA_384
	bool

config PSA_ACCEL_RSA_PKCS1V15_SIGN_4096_SHA_512
	bool

config PSA_ACCEL_RSA_PKCS1V15_SIGN_6144_SHA_1
	bool

config PSA_ACCEL_RSA_PKCS1V15_SIGN_6144_SHA_224
	bool

config PSA_ACCEL_RSA_PKCS1V15_SIGN_6144_SHA_256
	bool

config PSA_ACCEL_RSA_PKCS1V15_SIGN_6144_SHA3_224
	bool

config PSA_ACCEL_RSA_PKCS1V15_SIGN_6144_SHA3_256
	bool

config PSA_ACCEL_RSA_PKCS1V15_SIGN_6144_SHA3_384
	bool

config PSA_ACCEL_RSA_PKCS1V15_SIGN_6144_SHA3_512
	bool

config PSA_ACCEL_RSA_PKCS1V15_SIGN_6144_SHA_384
	bool

config PSA_ACCEL_RSA_PKCS1V15_SIGN_6144_SHA_512
	bool

config PSA_ACCEL_RSA_PKCS1V15_SIGN_8192_SHA_1
	bool

config PSA_ACCEL_RSA_PKCS1V15_SIGN_8192_SHA_224
	bool

config PSA_ACCEL_RSA_PKCS1V15_SIGN_8192_SHA_256
	bool

config PSA_ACCEL_RSA_PKCS1V15_SIGN_8192_SHA3_224
	bool

config PSA_ACCEL_RSA_PKCS1V15_SIGN_8192_SHA3_256
	bool

config PSA_ACCEL_RSA_PKCS1V15_SIGN_8192_SHA3_384
	bool

config PSA_ACCEL_RSA_PKCS1V15_SIGN_8192_SHA3_512
	bool

config PSA_ACCEL_RSA_PKCS1V15_SIGN_8192_SHA_384
	bool

config PSA_ACCEL_RSA_PKCS1V15_SIGN_8192_SHA_512
	bool

config PSA_ACCEL_RSA_PSS_1024_SHA_1
	bool

config PSA_ACCEL_RSA_PSS_1024_SHA_224
	bool

config PSA_ACCEL_RSA_PSS_1024_SHA_256
	bool

config PSA_ACCEL_RSA_PSS_1024_SHA3_224
	bool

config PSA_ACCEL_RSA_PSS_1024_SHA3_256
	bool

config PSA_ACCEL_RSA_PSS_1024_SHA3_384
	bool

config PSA_ACCEL_RSA_PSS_1024_SHA3_512
	bool

config PSA_ACCEL_RSA_PSS_1024_SHA_384
	bool

config PSA_ACCEL_RSA_PSS_1024_SHA_512
	bool

config PSA_ACCEL_RSA_PSS_1536_SHA_1
	bool

config PSA_ACCEL_RSA_PSS_1536_SHA_224
	bool

config PSA_ACCEL_RSA_PSS_1536_SHA_256
	bool

config PSA_ACCEL_RSA_PSS_1536_SHA3_224
	bool

config PSA_ACCEL_RSA_PSS_1536_SHA3_256
	bool

config PSA_ACCEL_RSA_PSS_1536_SHA3_384
	bool

config PSA_ACCEL_RSA_PSS_1536_SHA3_512
	bool

config PSA_ACCEL_RSA_PSS_1536_SHA_384
	bool

config PSA_ACCEL_RSA_PSS_1536_SHA_512
	bool

config PSA_ACCEL_RSA_PSS_2048_SHA_1
	bool

config PSA_ACCEL_RSA_PSS_2048_SHA_224
	bool

config PSA_ACCEL_RSA_PSS_2048_SHA_256
	bool

config PSA_ACCEL_RSA_PSS_2048_SHA3_224
	bool

config PSA_ACCEL_RSA_PSS_2048_SHA3_256
	bool

config PSA_ACCEL_RSA_PSS_2048_SHA3_384
	bool

config PSA_ACCEL_RSA_PSS_2048_SHA3_512
	bool

config PSA_ACCEL_RSA_PSS_2048_SHA_384
	bool

config PSA_ACCEL_RSA_PSS_2048_SHA_512
	bool

config PSA_ACCEL_RSA_PSS_3072_SHA_1
	bool

config PSA_ACCEL_RSA_PSS_3072_SHA_224
	bool

config PSA_ACCEL_RSA_PSS_3072_SHA_256
	bool

config PSA_ACCEL_RSA_PSS_3072_SHA3_224
	bool

config PSA_ACCEL_RSA_PSS_3072_SHA3_256
	bool

config PSA_ACCEL_RSA_PSS_3072_SHA3_384
	bool

config PSA_ACCEL_RSA_PSS_3072_SHA3_512
	bool

config PSA_ACCEL_RSA_PSS_3072_SHA_384
	bool

config PSA_ACCEL_RSA_PSS_3072_SHA_512
	bool

config PSA_ACCEL_RSA_PSS_4096_SHA_1
	bool

config PSA_ACCEL_RSA_PSS_4096_SHA_224
	bool

config PSA_ACCEL_RSA_PSS_4096_SHA_256
	bool

config PSA_ACCEL_RSA_PSS_4096_SHA3_224
	bool

config PSA_ACCEL_RSA_PSS_4096_SHA3_256
	bool

config PSA_ACCEL_RSA_PSS_4096_SHA3_384
	bool

config PSA_ACCEL_RSA_PSS_4096_SHA3_512
	bool

config PSA_ACCEL_RSA_PSS_4096_SHA_384
	bool

config PSA_ACCEL_RSA_PSS_4096_SHA_512
	bool

config PSA_ACCEL_RSA_PSS_6144_SHA_1
	bool

config PSA_ACCEL_RSA_PSS_6144_SHA_224
	bool

config PSA_ACCEL_RSA_PSS_6144_SHA_256
	bool

config PSA_ACCEL_RSA_PSS_6144_SHA3_224
	bool

config PSA_ACCEL_RSA_PSS_6144_SHA3_256
	bool

config PSA_ACCEL_RSA_PSS_6144_SHA3_384
	bool

config PSA_ACCEL_RSA_PSS_6144_SHA3_512
	bool

config PSA_ACCEL_RSA_PSS_6144_SHA_384
	bool

config PSA_ACCEL_RSA_PSS_6144_SHA_512
	bool

config PSA_ACCEL_RSA_PSS_8192_SHA_1
	bool

config PSA_ACCEL_RSA_PSS_8192_SHA_224
	bool

config PSA_ACCEL_RSA_PSS_8192_SHA_256
	bool

config PSA_ACCEL_RSA_PSS_8192_SHA3_224
	bool

config PSA_ACCEL_RSA_PSS_8192_SHA3_256
	bool

config PSA_ACCEL_RSA_PSS_8192_SHA3_384
	bool

config PSA_ACCEL_RSA_PSS_8192_SHA3_512
	bool

config PSA_ACCEL_RSA_PSS_8192_SHA_384
	bool

config PSA_ACCEL_RSA_PSS_8192_SHA_512
	bool

config PSA_ACCEL_SHA_1
	bool

config PSA_ACCEL_SHA_224
	bool

config PSA_ACCEL_SHA_256
	bool

config PSA_ACCEL_SHA3_224
	bool

config PSA_ACCEL_SHA3_256
	bool

config PSA_ACCEL_SHA3_384
	bool

config PSA_ACCEL_SHA3_512
	bool

config PSA_ACCEL_SHA_384
	bool

config PSA_ACCEL_SHA_512
	bool

config PSA_ACCEL_SHA_512_224
	bool

config PSA_ACCEL_SHA_512_256
	bool

config PSA_ACCEL_SHAKE256_512
	bool

config PSA_ACCEL_SP800_108_COUNTER_CMAC
	bool

config PSA_ACCEL_SP800_108_COUNTER_HMA_SHA_1
	bool

config PSA_ACCEL_SP800_108_COUNTER_HMA_SHA_224
	bool

config PSA_ACCEL_SP800_108_COUNTER_HMA_SHA_256
	bool

config PSA_ACCEL_SP800_108_COUNTER_HMA_SHA_384
	bool

config PSA_ACCEL_SP800_108_COUNTER_HMA_SHA_512
	bool

config PSA_ACCEL_SPAKE2P_CMAC_SECP_R1_256_SHA_1
	bool

config PSA_ACCEL_SPAKE2P_CMAC_SECP_R1_256_SHA_224
	bool

config PSA_ACCEL_SPAKE2P_CMAC_SECP_R1_256_SHA_256
	bool

config PSA_ACCEL_SPAKE2P_CMAC_SECP_R1_256_SHA_384
	bool

config PSA_ACCEL_SPAKE2P_CMAC_SECP_R1_256_SHA_512
	bool

config PSA_ACCEL_SPAKE2P_HMAC_SECP_R1_256_SHA_1
	bool

config PSA_ACCEL_SPAKE2P_HMAC_SECP_R1_256_SHA_224
	bool

config PSA_ACCEL_SPAKE2P_HMAC_SECP_R1_256_SHA_256
	bool

config PSA_ACCEL_SPAKE2P_HMAC_SECP_R1_256_SHA_384
	bool

config PSA_ACCEL_SPAKE2P_HMAC_SECP_R1_256_SHA_512
	bool

config PSA_ACCEL_SPAKE2P_MATTER
	bool

config PSA_ACCEL_SRP_6_3072_SHA_1
	bool

config PSA_ACCEL_SRP_6_3072_SHA_224
	bool

config PSA_ACCEL_SRP_6_3072_SHA_256
	bool

config PSA_ACCEL_SRP_6_3072_SHA_384
	bool

config PSA_ACCEL_SRP_6_3072_SHA_512
	bool

config PSA_ACCEL_SRP_PASSWORD_HASH
	bool

config PSA_ACCEL_STREAM_CIPHER_CHACHA20
	bool

config PSA_ACCEL_TLS12_ECJPAKE_TO_PMS
	bool

config PSA_ACCEL_TLS12_PRF_SHA_256
	bool

config PSA_ACCEL_TLS12_PRF_SHA_384
	bool

config PSA_ACCEL_TLS12_PSK_TO_MS_SHA_256
	bool

config PSA_ACCEL_TLS12_PSK_TO_MS_SHA_384
	bool

config PSA_ACCEL_XTS_AES_128
	bool

config PSA_ACCEL_XTS_AES_192
	bool

config PSA_ACCEL_XTS_AES_256
	bool

config PSA_ACCEL_XTS_ARIA
	bool

config PSA_ACCEL_XTS_CAMELLIA
	bool

config PSA_ACCEL_XTS_DES
	bool

endmenu
```
