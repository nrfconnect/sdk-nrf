## subsys/nrf_rpc/Kconfig
```kconfig
#
# Copyright (c) 2020 Nordic Semiconductor
#
# SPDX-License-Identifier: LicenseRef-Nordic-5-Clause
#

menu "nRF RPC (Remote Procedure Call) library"

if NRF_RPC

# Zephyr port dependencies selection

config _NRF_RPC_DUMMY_SELECT
	bool
	default y
	select THREAD_CUSTOM_DATA

config NRF_RPC_CBOR
	select ZCBOR
	select ZCBOR_STOP_ON_ERROR

# End of Zephyr port dependencies selection

choice NRF_RPC_TRANSPORT
	prompt "NRF RPC transport"
	default NRF_RPC_IPC_SERVICE

config NRF_RPC_IPC_SERVICE
	bool "nRF RPC over IPC Service"
	select IPC_SERVICE
	select MBOX
	select EVENTS
	help
	  If enabled, selects the IPC Service as a transport layer for the nRF RPC.

config NRF_RPC_UART_TRANSPORT
	bool "nRF RPC over UART"
	select UART_NRFX
	select RING_BUFFER
	select CRC
	help
	  If enabled, selects the UART as a transport layer for the nRF RPC.

endchoice

if NRF_RPC_IPC_SERVICE

# Redefine this symbol here and give it a non-zero default value
# so that the Zephyr system heap is enabled, the nRF IPC IPC service
# depends on it
config HEAP_MEM_POOL_SIZE
	int
	default 2048

config NRF_RPC_IPC_SERVICE_BIND_TIMEOUT_MS
	int "Timeout while waiting for the endpoint to bind in ms"
	range 1 1000
	default 500 if SOC_SERIES_NRF54H
	default 100
	help
	  Time in miliseconds to wait for endpoint binding.
	  This timeout depends on the time to initialize all the remote devices
	  the nRF RPC is going to communicate with.

endif # NRF_RPC_IPC_SERVICE


menu "nRF RPC over UART configuration"
	depends on NRF_RPC_UART_TRANSPORT

config NRF_RPC_UART_MAX_PACKET_SIZE
	int "Maximum packet size"
	default 1536
	help
	  Defines the maximum size of an nRF RPC packet that can be sent or received
	  using the UART transport.

config NRF_RPC_UART_RX_RINGBUF_SIZE
	int "RX ring buffer size"
	default 2048
	help
	  Defines the size of the ring buffer used to relay received bytes between
	  the UART interrupt service routine and the UART transport RX worker thread.

config NRF_RPC_UART_RX_THREAD_STACK_SIZE
	int "RX thread stack size"
	default 4096
	help
	  Defines the stack size of the UART transport RX worker thread. The worker
	  thread is responsible for consuming data received over the UART, and
	  passing decoded nRF RPC packets to the nRF RPC core.

config NRF_RPC_UART_RELIABLE
	bool "UART reliability"
	help
	  Enables acknowledgment functionality for each frame sent over UART.

if NRF_RPC_UART_RELIABLE

config NRF_RPC_UART_ACK_WAITING_TIME
	int "Time window to receive acknowledgment"
	default 50
	help
	   Defines time in milliseconds during which the device waits
	   for acknowledgment for sent data.

config NRF_RPC_UART_TX_ATTEMPTS
	int "Number of transmitting attempts"
	default 3
	help
	   Number of transmitting attempts, after which sender gives up if
	   acknowledgment has not been received yet.

endif # NRF_RPC_UART_RELIABLE

endmenu # "nRF RPC over UART configuration"

config NRF_RPC_THREAD_STACK_SIZE
	int "Stack size of thread from thread pool"
	default 1024
	help
	  Stack size for each thread in local thread pool.

config NRF_RPC_THREAD_PRIORITY
	int "Priority of thread from thread pool"
	default 2
	help
	  Thread priority of each thread in local thread pool.

config NRF_RPC_RESPONSE_TIMEOUT
	int "Response timeout [ms]"
	default -1
	help
	  Maximum time to wait for a response from the peer, in milliseconds.
	  Set to -1 to wait indefinitely.

config NRF_RPC_SERIALIZE_API
	bool "API for serialization"
	default y
	help
	  API for serialization and deserialization of several major CBOR types.

config NRF_RPC_CALLBACK_PROXY
	bool "Proxy functionality for remote callbacks"
	default y
	help
	  Proxy functionality that allows to register callbacks on the local side
	  and to match the invoked callbacks on the remote side to registered
	  callbacks on the local side.

if NRF_RPC_CALLBACK_PROXY

config NRF_RPC_CBKPROXY_OUT_SLOTS
	int "Maximum number of RPC callback proxy output slots"
	default 16
	range 0 16383
	help
	  Output slot is used to save context for one callback that is called
	  on local side, encoded, sent and finally executed on the remote side.
	  Each output slot takes 8 bytes of flash memory. Maximum number of
	  input slots on the remote side should be the same as this value.


config NRF_RPC_CBKPROXY_IN_SLOTS
	int "Maximum number of RPC callback proxy input slots"
	default 16
	range 0 16383
	help
	  Input slot is used to save context for one callback that is called
	  on remote side, encoded, sent and finally executed on the local side.
	  Each output slot takes 8 bytes of RAM memory. Maximum number of
	  output slots on the remote side should be the same as this value.

endif # NRF_RPC_CALLBACK_PROXY

config NRF_RPC_INIT
	bool "Automatically initialize nRF RPC library"
	help
	  Initialize nRF RPC library during the system startup.

module = NRF_RPC
module-str = NRF_RPC
source "$(ZEPHYR_BASE)/subsys/logging/Kconfig.template.log_config"

module = NRF_RPC_TR
module-str = NRF_RPC_TR
source "$(ZEPHYR_BASE)/subsys/logging/Kconfig.template.log_config"

module = NRF_RPC_OS
module-str = NRF_RPC_OS
source "$(ZEPHYR_BASE)/subsys/logging/Kconfig.template.log_config"

if NRF_RPC_CBOR

module = NRF_RPC_CBOR
module-str = NRF_RPC_CBOR
source "$(ZEPHYR_BASE)/subsys/logging/Kconfig.template.log_config"

endif # NRF_RPC_CBOR

if NRF_RPC_INIT

module = NRF_RPC_INIT
module-str = NRF_RPC_INIT
source "$(ZEPHYR_BASE)/subsys/logging/Kconfig.template.log_config"

endif # NRF_RPC_INIT

rsource "rpc_utils/Kconfig"

endif # NRF_RPC

endmenu
```

## subsys/nrf_rpc/crash_gen/Kconfig
```kconfig
#
# Copyright (c) 2024 Nordic Semiconductor
#
# SPDX-License-Identifier: LicenseRef-Nordic-5-Clause
#

menuconfig NRF_RPC_CRASH_GEN
	bool "nRF RPC crash generator"
	depends on NRF_RPC
	depends on NRF_RPC_CBOR
	help
	  nRF RPC crash generating functionalities

if NRF_RPC_CRASH_GEN

choice NRF_RPC_CRASH_GEN_ROLE_CHOICE
	prompt "nRF RPC crash generator role selection"
	default NRF_RPC_CRASH_GEN_CLIENT
	help
	  nRF RPC crash generator role selection

config NRF_RPC_CRASH_GEN_SERVER
	bool "nRF RPC crash generator server role"
	help
	  Enable nRF RPC crash generator server role.

config NRF_RPC_CRASH_GEN_CLIENT
	bool "nRF RPC crash generator client role"
	help
	  Enable nRF RPC crash generator client role.

endchoice

endif # NRF_RPC_CRASH_GEN
```

## subsys/nrf_rpc/dev_info/Kconfig
```kconfig
#
# Copyright (c) 2024 Nordic Semiconductor
#
# SPDX-License-Identifier: LicenseRef-Nordic-5-Clause
#

menuconfig NRF_RPC_DEV_INFO
	bool "nRF RPC device information functionalities"
	depends on NRF_RPC
	depends on NRF_RPC_CBOR
	help
	  nRF RPC device information functionalities

if NRF_RPC_DEV_INFO

choice NRF_RPC_DEV_INFO_ROLE_CHOICE
	prompt "nRF RPC device information role selection"
	default NRF_RPC_DEV_INFO_CLIENT
	help
	  nRF RPC device information role selection

config NRF_RPC_DEV_INFO_SERVER
	bool "nRF RPC device information server role"
	help
	  Enable nRF RPC device information server role.

config NRF_RPC_DEV_INFO_CLIENT
	bool "nRF RPC device information client role"
	help
	  Enable nRF RPC device information client role.

endchoice

config DEV_INFO_RPC_INITIALIZE_NRF_RPC
	bool "Automatically initialize nRF RPC library"
	help
	  Initialize nRF RPC library during the system startup. Disabling this
	  option allow user to initialize it in a different way.

config NRF_RPC_REMOTE_SHELL
	bool "Remote shell"
	depends on NRF_RPC_DEV_INFO_SERVER
	select SHELL
	select SHELL_BACKEND_DUMMY
	default y
	help
	  Enable access to remote shell via NRF_RPC.

config SHELL_BACKEND_DUMMY_BUF_SIZE
	default 1024 if NRF_RPC_REMOTE_SHELL

endif # NRF_RPC_DEV_INFO
```

## subsys/nrf_rpc/rpc_utils/Kconfig
```kconfig
#
# Copyright (c) 2024 Nordic Semiconductor
#
# SPDX-License-Identifier: LicenseRef-Nordic-5-Clause
#

menuconfig NRF_RPC_UTILS
	bool "nRF RPC utility commands [EXPERIMENTAL]"
	select NRF_RPC_CBOR
	select EXPERIMENTAL
	help
	  Enables the "umbrella" library, which implements miscellaneous RPC
	  commands that are too distinct from other commands to be grouped into
	  more specific command libraries.

if NRF_RPC_UTILS

choice NRF_RPC_UTILS_ROLE_CHOICE
	prompt "nRF RPC utilities role selection"
	default NRF_RPC_UTILS_CLIENT

config NRF_RPC_UTILS_CLIENT
	bool "Client"

config NRF_RPC_UTILS_SERVER
	bool "Server"

endchoice

config NRF_RPC_UTILS_DEV_INFO
	bool "Device information"
	help
	  Enables nRF RPC commands for retrieving the remote device traits,
	  such as the firmware version.

config NRF_RPC_UTILS_REMOTE_SHELL
	bool "Remote shell"
	select SHELL if NRF_RPC_UTILS_SERVER
	select SHELL_BACKEND_DUMMY if NRF_RPC_UTILS_SERVER
	help
	  Enables nRF RPC command for executing a shell command on the remote
	  device and getting its output.

config NRF_RPC_UTILS_CRASH_GEN
	bool "Crash generator"
	help
	  Enables nRF RPC commands for generating a crash on the remote device.

config NRF_RPC_UTILS_HEALTH_MONITOR
	bool "RPC Health Monitor support"
	help
	  Enables Health Monitor support over RPC.

config NRF_RPC_UTILS_SYSTEM_HEALTH
	bool "System health"
	help
	  Enables nRF RPC commands for getting the system health information.

if NRF_RPC_UTILS_SYSTEM_HEALTH && NRF_RPC_UTILS_SERVER

config NRF_RPC_UTILS_WATCHDOG_PERIOD
	int "Watchdog period (s)"
	default 10
	depends on NRF_RPC_UTILS_SYSTEM_HEALTH && NRF_RPC_UTILS_SERVER
	help
	  Configures how frequently the nRF RPC utils server kicks watched
	  threads, and how quickly it concludes a thread is hung.

endif # NRF_RPC_UTILS_SYSTEM_HEALTH && NRF_RPC_UTILS_SERVER

config SHELL_BACKEND_DUMMY_BUF_SIZE
	default 1024 if NRF_RPC_UTILS_REMOTE_SHELL && NRF_RPC_UTILS_SERVER

endif # NRF_RPC_UTILS
```

## subsys/nrf_security/Kconfig.legacy
```kconfig
#
# Copyright (c) 2021-2022 Nordic Semiconductor
#
# SPDX-License-Identifier: LicenseRef-Nordic-5-Clause
#

config MBEDTLS_PLATFORM_MEMORY
	bool
	default y

config MBEDTLS_PLATFORM_C
	bool
	default y

config MBEDTLS_MEMORY_C
	bool
	default y

config MBEDTLS_MEMORY_BUFFER_ALLOC_C
	bool
	default y

config MBEDTLS_THREADING_C
	bool "Threading support for Mbed TLS and PSA crypto"
	default y if CC3XX_BACKEND || MBEDTLS_PSA_CRYPTO_C
	depends on MULTITHREADING
	help
	  Threading support is used when PSA crypto is built locally or
	  when legacy APIs implemented using CryptoCell is in use.
	  Note: If this configuration is disabled then PSA crypto APIs
	  aren't thread-safe. This configuration is not used when TF-M is enabled.

config MBEDTLS_BASE64_C
	bool
	default y

config MBEDTLS_ASN1_WRITE_C
	bool
	default y if MBEDTLS_PEM_WRITE_C || MBEDTLS_PK_WRITE_C

config MBEDTLS_ASN1_PARSE_C
	bool
	default y if MBEDTLS_PEM_PARSE_C || MBEDTLS_PK_PARSE_C

# Platform configurations for _ALT defines
config MBEDTLS_PLATFORM_EXIT_ALT
	bool

config MBEDTLS_PLATFORM_FPRINTF_ALT
	bool

config MBEDTLS_PLATFORM_PRINTF_ALT
	bool

config MBEDTLS_PLATFORM_SNPRINTF_ALT
	bool

config MBEDTLS_PLATFORM_SETUP_TEARDOWN_ALT
	bool
	default y if CC3XX_BACKEND || PSA_CRYPTO_DRIVER_CC3XX
	depends on !BUILD_WITH_TFM

config MBEDTLS_THREADING_ALT
	bool
	default y if CC3XX_BACKEND || MBEDTLS_PSA_CRYPTO_C
	depends on !BUILD_WITH_TFM
	depends on MBEDTLS_THREADING_C

# Prompt-less configuration to state what is missing

config CC310_ONLY_PSA_ENABLED
	bool
	default y
	depends on HAS_HW_NRF_CC310 && !PSA_CRYPTO_DRIVER_OBERON

config CC312_ONLY_PSA_ENABLED
	bool
	default y
	depends on HAS_HW_NRF_CC312 && !PSA_CRYPTO_DRIVER_OBERON

config CC310_ONLY_ENABLED
	bool
	default y
	depends on (CC310_BACKEND && !OBERON_BACKEND) || \
		   CC310_ONLY_PSA_ENABLED

config CC312_ONLY_ENABLED
	bool
	default y
	depends on (CC312_BACKEND && !OBERON_BACKEND) || \
		   CC312_ONLY_PSA_ENABLED

config OBERON_ONLY_PSA_ENABLED
	bool
	default y
	depends on (PSA_CRYPTO_DRIVER_OBERON && !PSA_CRYPTO_DRIVER_CC3XX && !PSA_CRYPTO_DRIVER_CRACEN) && \
		   !CC3XX_BACKEND

config OBERON_ONLY_ENABLED
	bool
	default y
	depends on (OBERON_BACKEND && !CC3XX_BACKEND) || \
		    OBERON_ONLY_PSA_ENABLED

menu "Legacy mbed TLS crypto APIs"

config MBEDTLS_MPI_WINDOW_SIZE
	int
	default 6
	range 1 6
	help
	  Maximum window size used for modular exponentiation.
	  The default value of 6 is set to match with the configuration used
	  when building the CryptoCell runtime libraries.

config MBEDTLS_MPI_MAX_SIZE
	int
	prompt "Maximum number of bytes for usable MPIs." if !(CC312_BACKEND || CC310_BACKEND)
	default 256 if CC310_BACKEND
	default 384 if CC312_BACKEND
	default 384 # Needed to support RSA 3072
	range 256 2048


if MBEDTLS_DECLARE_PRIVATE_IDENTIFIERS

config CC310_BACKEND
	bool
	depends on HAS_HW_NRF_CC310 && !BUILD_WITH_TFM && \
		   (PSA_CRYPTO_DRIVER_CC3XX || CC3XX_BACKEND)
	default y
	help
	  Convenience configuration to state explicitly that CryptoCell CC310 is enabled.

config CC312_BACKEND
	bool
	depends on HAS_HW_NRF_CC312 && !BUILD_WITH_TFM && \
		   (PSA_CRYPTO_DRIVER_CC3XX || CC3XX_BACKEND)
	default y
	help
	  Convenience configuration to state explicitly that CryptoCell CC312 is enabled.

config CC3XX_BACKEND_FORCED
	bool

config OBERON_BACKEND_FORCED
	bool

config CC3XX_BACKEND
	bool
	depends on HAS_HW_NRF_CC3XX && !OBERON_BACKEND_FORCED
	prompt "Configuration to enable CryptoCell CC3XX for legacy mbed TLS APIs"
	help
	  This configuration enables legacy mbed TLS APIs using cc3xx.
	  PSA_CRYPTO_DRIVER_CC3XX should be used instead, and will replace this once
	  PSA crypto APIs are standardized.

config OBERON_BACKEND
	bool "Configuration to enable nrf_oberon for legacy mbed TLS APIs"
	select NRF_OBERON
	depends on !(CC3XX_BACKEND_FORCED || CC3XX_BACKEND)
	help
	  This configuration enables legacy mbed TLS APIs using nrf_oberon.
	  PSA_CRYPTO_DRIVER_OBERON should be used instead and will replace this once
	  PSA crypto APIs are standardized.

endif # MBEDTLS_DECLARE_PRIVATE_IDENTIFIERS

config MBEDTLS_MD_C
	bool "MD support"
	default y if MBEDTLS_TLS_LIBRARY

config MBEDTLS_PK_C
	bool "PK support"
	default y if MBEDTLS_TLS_LIBRARY && \
		(PSA_WANT_KEY_TYPE_ECC_PUBLIC_KEY || PSA_WANT_KEY_TYPE_RSA_PUBLIC_KEY)

config MBEDTLS_PKCS5_C
	bool "PKCS5 support"
	default y
	depends on MBEDTLS_MD_C
	depends on MBEDTLS_CIPHER_PADDING_PKCS7

config MBEDTLS_PK_WRITE_C
	bool "PK write support"
	depends on MBEDTLS_PK_C

config MBEDTLS_PK_PARSE_C
	bool "PK parse support"
	default y if MBEDTLS_TLS_LIBRARY
	depends on MBEDTLS_PK_C

config MBEDTLS_PK_PARSE_EC_EXTENDED
	bool "Enhance support for reading EC keys"
	default y
	depends on MBEDTLS_PK_PARSE_C

config MBEDTLS_PEM_PARSE_C
	bool "Support parsing PEM files"
	select MBEDTLS_BASE64_C

config MBEDTLS_PEM_WRITE_C
	bool "Support writing PEM files"
	select MBEDTLS_BASE64_C

endmenu # Legacy mbed TLS crypto APIs
```
