## subsys/nrf_security/Kconfig.psa
```kconfig
#
# Copyright (c) 2021 Nordic Semiconductor
#
# SPDX-License-Identifier: LicenseRef-Nordic-5-Clause
#

if PSA_CRYPTO

config MBEDTLS_PSA_CRYPTO_KEY_ID_ENCODES_OWNER
	bool

rsource "Kconfig.psa.defconfig"

rsource "src/core/Kconfig"

rsource "src/ssf_secdom/Kconfig"

comment "PSA Driver Support"

config MBEDTLS_PSA_CRYPTO_DRIVERS
	bool
	default y

rsource "src/drivers/Kconfig"


menu "PSA API support"

config MBEDTLS_PSA_CRYPTO_SPM
	bool
	help
	  Configation that enables alternate naming of PSA Crypto symbols in
	  scope of TF-M secure build (prefixes with mbedcrypto__).

config MBEDTLS_PSA_CRYPTO_BUILTIN_KEYS
	bool
	default y if HAS_HW_NRF_CRACEN && PSA_CRYPTO_DRIVER_CRACEN
	help
	  Promptless option used to control if the PSA Crypto core
	  should have support for builtin keys or not.

config MBEDTLS_PSA_CRYPTO_STORAGE_C
	bool "PSA storage for persistent keys"
	default y if BUILD_WITH_TFM
	depends on TFM_PARTITION_INTERNAL_TRUSTED_STORAGE || !BUILD_WITH_TFM
	help
	  Corresponds to MBEDTLS_PSA_CRYPTO_STORAGE_C setting in mbed TLS config file.

config MBEDTLS_PSA_KEY_SLOT_COUNT
	int "Number of PSA key slots available"
	default 32
	range 1 65535
	help
	  Describes the number of available PSA key slots. A key slot is used in PSA
	  for each transparent key in use. So this number defines the sum of volatile and
	  transparent keys that we can have open concurrently.
	  The default value comes from MBedTLS.

config PSA_CRYPTO_SYS_INIT
	bool "Invoke psa_crypto_init during system initialization"
	default y
	help
	  Enable a Zephyr SYS_INIT that invokes psa_crypto_init. This
	  allows PSA Crypto API users that run after POST_KERNEL to omit
	  their psa_crypto_init calls.

	  This option can be disabled to allow finer grained control of
	  how an error from psa_crypto_init should be handled. The
	  SYS_INIT will invoke k_oops() when psa_crypto_init fails, which
	  may not be desired behaviour.

config PSA_CRYPTO_DRIVER_ALG_PRNG_TEST
	bool
	help
	  Internal option used for testing. User provided function will be called
	  to get random bytes.

endmenu # PSA API support

endif # PSA_CRYPTO
```

## subsys/nrf_security/Kconfig.psa.defconfig
```kconfig
#
# Copyright (c) 2026 Nordic Semiconductor
#
# SPDX-License-Identifier: LicenseRef-Nordic-5-Clause
#

configdefault PSA_WANT_ALG_HKDF
	default y if \
		(PSA_WANT_ALG_HKDF_EXTRACT || PSA_WANT_ALG_HKDF_EXPAND) && \
		(PSA_CRYPTO_DRIVER_OBERON || PSA_CRYPTO_DRIVER_CRACEN)
```
