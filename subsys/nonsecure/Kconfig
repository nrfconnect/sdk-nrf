## subsys/nrf_security/src/drivers/builtin/Kconfig
```kconfig
#
# Copyright (c) 2021-2022 Nordic Semiconductor
#
# SPDX-License-Identifier: LicenseRef-Nordic-5-Clause
#

menuconfig PSA_CRYPTO_DRIVER_BUILTIN
	bool
	prompt "PSA Builtin" if !PSA_PROMPTLESS
	depends on PSA_CORE_BUILTIN
	# Fix for NCSDK-13536: Enable builtin if nrf_oberon only due to lacking support
	default y if PSA_CRYPTO_DRIVER_OBERON && !PSA_CRYPTO_DRIVER_CC3XX && \
		     (PSA_WANT_ALG_CBC_PKCS7 || PSA_WANT_ALG_CMAC || \
		      PSA_WANT_ALG_HMAC || PSA_WANT_ALG_HKDF)
	# Fix for NCSDK-13536: Enable builtin if SHA-384 or SHA-512 is enabled
	# as CryptoCell or nrf_oberon don't support it.
	default y if (PSA_WANT_ALG_SHA_384 || PSA_WANT_ALG_SHA_512) && \
		     (PSA_WANT_ALG_HMAC || PSA_WANT_ALG_HKDF)
	# nrf_oberon lacks RSA support
	default y if PSA_CRYPTO_DRIVER_OBERON && !PSA_CRYPTO_DRIVER_CC3XX && \
		     (PSA_WANT_ALG_RSA_OAEP || PSA_WANT_ALG_RSA_PKCS1V15_CRYPT || \
		      PSA_WANT_ALG_RSA_PKCS1V15_SIGN || PSA_WANT_ALG_RSA_PSS)
	help
	  Enables PSA builtin support

if PSA_CRYPTO_DRIVER_BUILTIN

config MBEDTLS_PSA_BUILTIN_HAS_KEY_TYPE
	bool
	default y
	depends on MBEDTLS_PSA_BUILTIN_KEY_TYPE_ECC_KEY_PAIR 	|| \
		   MBEDTLS_PSA_BUILTIN_KEY_TYPE_ECC_PUBLIC_KEY 	|| \
		   MBEDTLS_PSA_BUILTIN_KEY_TYPE_RSA_KEY_PAIR 	|| \
		   MBEDTLS_PSA_BUILTIN_KEY_TYPE_RSA_PUBLIC_KEY 	|| \
		   MBEDTLS_PSA_BUILTIN_KEY_TYPE_AES 		|| \
		   MBEDTLS_PSA_BUILTIN_KEY_TYPE_CHACHA20

config MBEDTLS_PSA_BUILTIN_HAS_CIPHER_SUPPORT
	bool
	default y
	depends on MBEDTLS_PSA_BUILTIN_ALG_ECB_NO_PADDING	|| \
		   MBEDTLS_PSA_BUILTIN_ALG_CBC_NO_PADDING	|| \
		   MBEDTLS_PSA_BUILTIN_ALG_CBC_PKCS7		|| \
		   MBEDTLS_PSA_BUILTIN_ALG_CFB 			|| \
		   MBEDTLS_PSA_BUILTIN_ALG_CTR			|| \
		   MBEDTLS_PSA_BUILTIN_ALG_OFB			|| \
		   MBEDTLS_PSA_BUILTIN_ALG_XTS                  || \
		   MBEDTLS_PSA_BUILTIN_ALG_STREAM_CIPHER

config MBEDTLS_PSA_BUILTIN_HAS_AEAD_SUPPORT
	bool
	default y
	depends on MBEDTLS_PSA_BUILTIN_ALG_CCM || \
		   MBEDTLS_PSA_BUILTIN_ALG_GCM || \
		   MBEDTLS_PSA_BUILTIN_ALG_CHACHA20_POLY1305

config MBEDTLS_PSA_BUILTIN_HAS_MAC_SUPPORT
	bool
	default y
	depends on MBEDTLS_PSA_BUILTIN_ALG_CMAC		|| \
		   MBEDTLS_PSA_BUILTIN_ALG_HMAC

config MBEDTLS_PSA_BUILTIN_HAS_HASH_SUPPORT
	bool
	default y
	depends on MBEDTLS_PSA_BUILTIN_ALG_SHA_1	|| \
		   MBEDTLS_PSA_BUILTIN_ALG_SHA_224	|| \
		   MBEDTLS_PSA_BUILTIN_ALG_SHA_256	|| \
		   MBEDTLS_PSA_BUILTIN_ALG_SHA_384	|| \
		   MBEDTLS_PSA_BUILTIN_ALG_SHA_512      || \
		   MBEDTLS_PSA_BUILTIN_ALG_MD5          || \
		   MBEDTLS_PSA_BUILTIN_ALG_RIPEMD160

config MBEDTLS_PSA_BUILTIN_HAS_ASYM_ENCRYPT_SUPPORT
	bool
	default y
	depends on MBEDTLS_PSA_BUILTIN_ALG_RSA_OAEP 		|| \
		   MBEDTLS_PSA_BUILTIN_ALG_RSA_PKCS1V15_CRYPT

config MBEDTLS_PSA_BUILTIN_HAS_ASYM_SIGN_SUPPORT
	bool
	default y
	depends on MBEDTLS_PSA_BUILTIN_ALG_DETERMINISTIC_ECDSA	|| \
		   MBEDTLS_PSA_BUILTIN_ALG_ECDSA 		|| \
		   MBEDTLS_PSA_BUILTIN_ALG_RSA_PKCS1V15_SIGN	|| \
		   MBEDTLS_PSA_BUILTIN_ALG_RSA_PSS

config MBEDTLS_PSA_BUILTIN_HAS_ECC_SUPPORT
	bool
	default y
	depends on MBEDTLS_PSA_BUILTIN_ALG_DETERMINISTIC_ECDSA 	|| \
		   MBEDTLS_PSA_BUILTIN_ALG_ECDSA		|| \
		   MBEDTLS_PSA_BUILTIN_ALG_ECDH

config MBEDTLS_PSA_BUILTIN_HAS_RSA_SUPPORT
	bool
	default y
	depends on MBEDTLS_PSA_BUILTIN_ALG_RSA_PKCS1V15_CRYPT 	|| \
		   MBEDTLS_PSA_BUILTIN_ALG_RSA_PKCS1V15_SIGN	|| \
		   MBEDTLS_PSA_BUILTIN_ALG_RSA_OAEP		|| \
		   MBEDTLS_PSA_BUILTIN_ALG_RSA_PSS

# MBEDTLS_PSA_BUILTIN_ALG_CBC_MAC - Currently not supported

config MBEDTLS_PSA_BUILTIN_ALG_CBC_NO_PADDING
	bool
	prompt "PSA CBC support (without padding) - builtin" if !PSA_PROMPTLESS
	depends on PSA_WANT_ALG_CBC_NO_PADDING
	default y if !PSA_DEFAULT_OFF && \
		     !(PSA_CRYPTO_DRIVER_ALG_CBC_NO_PADDING_CC3XX || \
		       PSA_CRYPTO_DRIVER_ALG_CBC_NO_PADDING_OBERON)

config MBEDTLS_PSA_BUILTIN_ALG_CBC_PKCS7
	bool
	prompt "PSA CBC support (padded with PKCS#7) - builtin" if !PSA_PROMPTLESS
	depends on PSA_WANT_ALG_CBC_PKCS7
	default y if !PSA_DEFAULT_OFF && \
		     !(PSA_CRYPTO_DRIVER_ALG_CBC_PKCS7_CC3XX || \
			   PSA_CRYPTO_DRIVER_ALG_CBC_PKCS7_OBERON)

config MBEDTLS_PSA_BUILTIN_ALG_CCM
	bool
	prompt "PSA AES CCM support - builtin" if !PSA_PROMPTLESS
	depends on PSA_WANT_ALG_CCM
	default y if !PSA_DEFAULT_OFF && \
		     !(PSA_CRYPTO_DRIVER_ALG_CCM_CC3XX || \
		       PSA_CRYPTO_DRIVER_ALG_CCM_OBERON)

config MBEDTLS_PSA_BUILTIN_ALG_CFB
	bool
	prompt "PSA AES CFB support - builtin" if !PSA_PROMPTLESS
	depends on PSA_WANT_ALG_CFB
	default y if !PSA_DEFAULT_OFF

config MBEDTLS_PSA_BUILTIN_ALG_CHACHA20_POLY1305
	bool
	prompt "PSA ChaCha20/Poly1305 support - builtin" if !PSA_PROMPTLESS
	depends on PSA_WANT_ALG_CHACHA20_POLY1305
	default y if !PSA_DEFAULT_OFF && \
		     !(PSA_CRYPTO_DRIVER_ALG_CHACHA20_POLY1305_CC3XX || \
		       PSA_CRYPTO_DRIVER_ALG_CHACHA20_POLY1305_OBERON)

config MBEDTLS_PSA_BUILTIN_ALG_CMAC
	bool
	prompt "PSA AES CMAC support - builtin" if !PSA_PROMPTLESS
	depends on PSA_WANT_ALG_CMAC
	default y if !PSA_DEFAULT_OFF && \
		     !(PSA_CRYPTO_DRIVER_ALG_CMAC_CC3XX)

config MBEDTLS_PSA_BUILTIN_ALG_CTR
	bool
	prompt "PSA AES CTR mode support - builtin" if !PSA_PROMPTLESS
	depends on PSA_WANT_ALG_CTR
	default y if !PSA_DEFAULT_OFF && \
		     !(PSA_CRYPTO_DRIVER_ALG_CTR_CC3XX || \
		       PSA_CRYPTO_DRIVER_ALG_CTR_OBERON)

config MBEDTLS_PSA_BUILTIN_ALG_DETERMINISTIC_ECDSA
	bool
	prompt "PSA ECDSA support (deterministic mode) - builtin" if !PSA_PROMPTLESS
	depends on PSA_WANT_ALG_DETERMINISTIC_ECDSA
	default y if !PSA_DEFAULT_OFF && \
		     !(PSA_CRYPTO_DRIVER_ALG_DETERMINISTIC_ECDSA_CC3XX || \
		       PSA_CRYPTO_DRIVER_ALG_DETERMINISTIC_ECDSA_OBERON)

config MBEDTLS_PSA_BUILTIN_ALG_ECB_NO_PADDING
	bool
	prompt "PSA AES ECB (no padding) - builtin" if !PSA_PROMPTLESS
	depends on PSA_WANT_ALG_ECB_NO_PADDING
	default y if !PSA_DEFAULT_OFF && \
		     !(PSA_CRYPTO_DRIVER_ALG_ECB_NO_PADDING_CC3XX || \
		       PSA_CRYPTO_DRIVER_ALG_ECB_NO_PADDING_OBERON)

config MBEDTLS_PSA_BUILTIN_ALG_ECDH
	bool
	prompt "PSA ECDH support - builtin" if !PSA_PROMPTLESS
	depends on PSA_WANT_ALG_ECDH
	default y if !PSA_DEFAULT_OFF && \
		     !(PSA_CRYPTO_DRIVER_ALG_ECDH_CC3XX || \
		       PSA_CRYPTO_DRIVER_ALG_ECDH_OBERON)

config MBEDTLS_PSA_BUILTIN_ALG_ECDSA
	bool
	prompt "PSA ECDSA support - builtin" if !PSA_PROMPTLESS
	depends on  PSA_WANT_ALG_ECDSA
	default y if !PSA_DEFAULT_OFF && \
		     !(PSA_CRYPTO_DRIVER_ALG_ECDSA_CC3XX || \
		       PSA_CRYPTO_DRIVER_ALG_ECDSA_OBERON)

config MBEDTLS_PSA_BUILTIN_ALG_GCM
	bool
	prompt "PSA AES GCM support - builtin" if !PSA_PROMPTLESS
	depends on PSA_WANT_ALG_GCM
	default y if !PSA_DEFAULT_OFF && \
		     !(PSA_CRYPTO_DRIVER_ALG_GCM_CC3XX || \
		       PSA_CRYPTO_DRIVER_ALG_GCM_OBERON)

config MBEDTLS_PSA_BUILTIN_ALG_HKDF
	bool
	prompt "PSA HKDF support - builtin" if !PSA_PROMPTLESS
	depends on PSA_WANT_ALG_HKDF
	default y if !PSA_DEFAULT_OFF

config MBEDTLS_PSA_BUILTIN_ALG_HMAC
	bool
	prompt "PSA HMAC support - builtin" if !PSA_PROMPTLESS
	depends on PSA_WANT_ALG_HMAC
	default y if !PSA_DEFAULT_OFF && \
		     (PSA_WANT_ALG_HKDF && (PSA_WANT_ALG_SHA_384 || PSA_WANT_ALG_SHA_512)) || \
		     !PSA_CRYPTO_DRIVER_ALG_HMAC_CC3XX

config MBEDTLS_PSA_BUILTIN_ALG_MD5
	bool
	prompt "PSA MD5 support - builtin" if !PSA_PROMPTLESS

config MBEDTLS_PSA_BUILTIN_ALG_OFB
	bool
	prompt "PSA AES OFB mode support - builtin" if !PSA_PROMPTLESS
	depends on PSA_WANT_ALG_OFB
	default y if !PSA_DEFAULT_OFF && \
		     !PSA_CRYPTO_DRIVER_ALG_OFB_CC3XX

# MBEDTLS_PSA_BUILTIN_ALG_PBKDF2_HMAC - Currently not supported

config MBEDTLS_PSA_BUILTIN_ALG_RIPEMD160
	bool
	prompt "PSA ripemd160 support - builtin" if !PSA_PROMPTLESS
	depends on PSA_WANT_ALG_RIPEMD160
	default y if !PSA_DEFAULT_OFF

config MBEDTLS_PSA_BUILTIN_ALG_RSA_OAEP
	bool
	prompt "PSA RSA OAEP support - builtin" if !PSA_PROMPTLESS
	depends on PSA_WANT_ALG_RSA_OAEP
	default y if !PSA_DEFAULT_OFF && \
		     !PSA_CRYPTO_DRIVER_ALG_RSA_OAEP_CC3XX

config MBEDTLS_PSA_BUILTIN_ALG_RSA_PKCS1V15_CRYPT
	bool
	prompt "PSA RSA crypt support (PKCS1V15 mode - builtin" if !PSA_PROMPTLESS
	depends on PSA_WANT_ALG_RSA_PKCS1V15_CRYPT
	default y if !PSA_DEFAULT_OFF && \
	             !PSA_CRYPTO_DRIVER_ALG_RSA_PKCS1V15_CRYPT_CC3XX

config MBEDTLS_PSA_BUILTIN_ALG_RSA_PKCS1V15_SIGN
	bool
	prompt "PSA RSA signature support (PKCS1V15 mode) - builtin" if !PSA_PROMPTLESS
	depends on PSA_WANT_ALG_RSA_PKCS1V15_SIGN
	default y if !PSA_DEFAULT_OFF && \
	             !PSA_CRYPTO_DRIVER_ALG_RSA_PKCS1V15_SIGN_CC3XX

config MBEDTLS_PSA_BUILTIN_ALG_RSA_PSS
	bool
	prompt "PSA RSA (PSS mode) - builtin" if !PSA_PROMPTLESS
	depends on PSA_WANT_ALG_RSA_PSS
	default y if !PSA_DEFAULT_OFF

config MBEDTLS_PSA_BUILTIN_ALG_SHA_1
	bool
	prompt "PSA SHA1 support - builtin" if !PSA_PROMPTLESS
	depends on PSA_WANT_ALG_SHA_1
	default y if !PSA_DEFAULT_OFF && \
		     !(PSA_CRYPTO_DRIVER_ALG_SHA_1_CC3XX || \
		       PSA_CRYPTO_DRIVER_ALG_SHA_1_OBERON)

config MBEDTLS_PSA_BUILTIN_ALG_SHA_224
	bool
	prompt "PSA SHA-224 support - builtin" if !PSA_PROMPTLESS
	depends on PSA_WANT_ALG_SHA_224
	default y if !PSA_DEFAULT_OFF && \
		     !(PSA_CRYPTO_DRIVER_ALG_SHA_224_CC3XX || \
		       PSA_CRYPTO_DRIVER_ALG_SHA_224_OBERON)

config MBEDTLS_PSA_BUILTIN_ALG_SHA_256
	bool
	prompt "PSA SSH-256 support - builtin" if !PSA_PROMPTLESS
	depends on PSA_WANT_ALG_SHA_256
	default y if !PSA_DEFAULT_OFF && \
		     !(PSA_CRYPTO_DRIVER_ALG_SHA_256_CC3XX || \
		       PSA_CRYPTO_DRIVER_ALG_SHA_256_OBERON)

config MBEDTLS_PSA_BUILTIN_ALG_SHA_384
	bool
	prompt "PSA SHA-384 support - builtin" if !PSA_PROMPTLESS
	depends on PSA_WANT_ALG_SHA_384
	default y if !PSA_DEFAULT_OFF && \
		     !(PSA_CRYPTO_DRIVER_ALG_SHA_384_OBERON)

config MBEDTLS_PSA_BUILTIN_ALG_SHA_512
	bool
	prompt "PSA SHA-512 support - builtin" if !PSA_PROMPTLESS
	depends on PSA_WANT_ALG_SHA_512
	default y if !PSA_DEFAULT_OFF && \
	             !PSA_CRYPTO_DRIVER_ALG_SHA_512_OBERON

config MBEDTLS_PSA_BUILTIN_ALG_TLS12_PRF
	bool
	prompt "PSA TLS 1.2 PRF support - builtin" if !PSA_PROMPTLESS
	depends on PSA_WANT_ALG_TLS12_PRF
	default y if !PSA_DEFAULT_OFF

config MBEDTLS_PSA_BUILTIN_ALG_TLS12_PSK_TO_MS
	bool
	prompt "PSA TLS 1.2 PSK to MS support - builtin" if !PSA_PROMPTLESS
	depends on PSA_WANT_ALG_TLS12_PSK_TO_MS
	default y if !PSA_DEFAULT_OFF


config MBEDTLS_PSA_BUILTIN_KEY_TYPE_ECC_KEY_PAIR
	bool
	depends on PSA_WANT_KEY_TYPE_ECC_KEY_PAIR
	default y if !PSA_DEFAULT_OFF && \
		     MBEDTLS_PSA_BUILTIN_HAS_ECC_SUPPORT

config MBEDTLS_PSA_BUILTIN_KEY_TYPE_ECC_PUBLIC_KEY
	bool
	depends on PSA_WANT_KEY_TYPE_ECC_PUBLIC_KEY
	default y if !PSA_DEFAULT_OFF && \
		     MBEDTLS_PSA_BUILTIN_HAS_ECC_SUPPORT

config MBEDTLS_PSA_BUILTIN_KEY_TYPE_RSA_KEY_PAIR
	bool
	depends on PSA_WANT_KEY_TYPE_RSA_KEY_PAIR
	default y if !PSA_DEFAULT_OFF && \
		     MBEDTLS_PSA_BUILTIN_HAS_RSA_SUPPORT

config MBEDTLS_PSA_BUILTIN_KEY_TYPE_RSA_PUBLIC_KEY
	bool
	depends on PSA_WANT_KEY_TYPE_RSA_PUBLIC_KEY
	default y if !PSA_DEFAULT_OFF && \
		     MBEDTLS_PSA_BUILTIN_HAS_RSA_SUPPORT

config MBEDTLS_PSA_BUILTIN_KEY_TYPE_AES
	bool
	depends on PSA_WANT_KEY_TYPE_AES
	default y if !PSA_DEFAULT_OFF && \
		     (MBEDTLS_PSA_BUILTIN_HAS_CIPHER_SUPPORT || \
		      MBEDTLS_PSA_BUILTIN_HAS_AEAD_SUPPORT)

config MBEDTLS_PSA_BUILTIN_KEY_TYPE_CHACHA20
	bool
	depends on PSA_WANT_KEY_TYPE_CHACHA20
	default y if !PSA_DEFAULT_OFF && \
		     MBEDTLS_PSA_BUILTIN_ALG_CHACHA20_POLY1305

config MBEDTLS_PSA_BUILTIN_ALG_STREAM_CIPHER
	bool
	prompt "PSA stream cipher support - builtin" if !PSA_PROMPTLESS
	depends on PSA_WANT_ALG_STREAM_CIPHER
	default y if !PSA_DEFAULT_OFF && \
		     !(PSA_CRYPTO_DRIVER_ALG_STREAM_CIPHER_CC3XX || \
		       PSA_CRYPTO_DRIVER_ALG_STREAM_CIPHER_OBERON)

config MBEDTLS_PSA_BUILTIN_ECC_BRAINPOOL_P_R1_256
	bool
	prompt "PSA ECC Brainpool256r1 support - builtin" if !PSA_PROMPTLESS
	depends on PSA_WANT_ECC_BRAINPOOL_P_R1_256
	default y if !PSA_DEFAULT_OFF && \
		    !PSA_CRYPTO_DRIVER_ECC_BRAINPOOL_P_R1_256_CC3XX

config MBEDTLS_PSA_BUILTIN_ECC_BRAINPOOL_P_R1_384
	bool
	prompt "PSA ECC Brainpool384r1 support - builtin" if !PSA_PROMPTLESS
	depends on PSA_WANT_ECC_BRAINPOOL_P_R1_384

config MBEDTLS_PSA_BUILTIN_ECC_MONTGOMERY_255
	bool
	prompt "PSA ECC Curve25519 support - builtin" if !PSA_PROMPTLESS
	depends on PSA_WANT_ECC_MONTGOMERY_255
	default y if !PSA_DEFAULT_OFF && \
		     !(PSA_CRYPTO_DRIVER_ECC_MONTGOMERY_255_CC3XX ||\
		       PSA_CRYPTO_DRIVER_ECC_MONTGOMERY_255_OBERON)

config MBEDTLS_PSA_BUILTIN_ECC_MONTGOMERY_448
	bool
	prompt "PSA ECC Curve448 support - builtin" if !PSA_PROMPTLESS
	depends on PSA_WANT_ECC_MONTGOMERY_448

config MBEDTLS_PSA_BUILTIN_ECC_SECP_K1_192
	bool
	prompt "PSA ECC secp192k1 support - builtin" if !PSA_PROMPTLESS
	depends on PSA_WANT_ECC_SECP_K1_192
	default y if !PSA_DEFAULT_OFF && \
		    !PSA_CRYPTO_DRIVER_ECC_SECP_K1_192_CC3XX

# MBEDTLS_PSA_BUILTIN_SECP_K1_224 - Currently not supported

config MBEDTLS_PSA_BUILTIN_ECC_SECP_K1_256
	bool
	prompt "PSA ECC secp256k1 support - builtin" if !PSA_PROMPTLESS
	depends on PSA_WANT_ECC_SECP_K1_256
	default y if !PSA_DEFAULT_OFF && \
		    !PSA_CRYPTO_DRIVER_ECC_SECP_K1_256_CC3XX

config MBEDTLS_PSA_BUILTIN_ECC_SECP_R1_192
	bool
	prompt "PSA ECC secp192r1 - builtin" if !PSA_PROMPTLESS
	depends on PSA_WANT_ECC_SECP_R1_192
	default y if !PSA_DEFAULT_OFF && \
		    !PSA_CRYPTO_DRIVER_ECC_SECP_R1_192_CC3XX

config MBEDTLS_PSA_BUILTIN_ECC_SECP_R1_224
	bool
	prompt "PSA ECC secp224r1 - builtin" if !PSA_PROMPTLESS
	depends on PSA_WANT_ECC_SECP_R1_224
	default y if !PSA_DEFAULT_OFF && \
			   !(PSA_CRYPTO_DRIVER_ECC_SECP_R1_224_CC3XX ||\
		         PSA_CRYPTO_DRIVER_ECC_SECP_R1_224_OBERON)

config MBEDTLS_PSA_BUILTIN_ECC_SECP_R1_256
	bool
	prompt "PSA ECC secp256r1 - builtin" if !PSA_PROMPTLESS
	depends on PSA_WANT_ECC_SECP_R1_256
	default y if !PSA_DEFAULT_OFF && \
		     !(PSA_CRYPTO_DRIVER_ECC_SECP_R1_256_CC3XX ||\
		       PSA_CRYPTO_DRIVER_ECC_SECP_R1_256_OBERON)

config MBEDTLS_PSA_BUILTIN_ECC_SECP_R1_384
	bool
	prompt "PSA ECC secp384r1 - builtin" if !PSA_PROMPTLESS
	depends on PSA_WANT_ECC_SECP_R1_384
	default y if !PSA_DEFAULT_OFF && \
		     !(PSA_CRYPTO_DRIVER_ECC_SECP_R1_384_CC3XX || \
		       PSA_CRYPTO_DRIVER_ECC_SECP_R1_384_OBERON)

config MBEDTLS_PSA_BUILTIN_SECP_R1_521
	bool
	prompt "PSA ECC secp521r1 - builtin" if !PSA_PROMPTLESS
	depends on PSA_WANT_ECC_SECP_R1_521

config MBEDTLS_PSA_BUILTIN_ALG_XTS
	bool
	default y if !PSA_DEFAULT_OFF
	prompt "PSA AES XTS mode support - builtin" if !PSA_PROMPTLESS
	depends on PSA_WANT_ALG_XTS

config MBEDTLS_PSA_BUILTIN_AEAD
	bool
	default y
	depends on MBEDTLS_PSA_BUILTIN_ALG_CCM			|| \
		   MBEDTLS_PSA_BUILTIN_ALG_GCM			|| \
		   MBEDTLS_PSA_BUILTIN_ALG_CHACHA20_POLY1305

config MBEDTLS_PSA_BUILTIN_CIPHER
	bool
	default y
	depends on MBEDTLS_PSA_BUILTIN_ALG_ECB_NO_PADDING	|| \
		   MBEDTLS_PSA_BUILTIN_ALG_CBC_NO_PADDING	|| \
		   MBEDTLS_PSA_BUILTIN_ALG_CBC_PKCS7		|| \
		   MBEDTLS_PSA_BUILTIN_ALG_CFB 			|| \
		   MBEDTLS_PSA_BUILTIN_ALG_CTR			|| \
		   MBEDTLS_PSA_BUILTIN_ALG_OFB			|| \
		   MBEDTLS_PSA_BUILTIN_ALG_CTR			|| \
		   MBEDTLS_PSA_BUILTIN_ALG_XTS

config MBEDTLS_PSA_BUILTIN_HASH
	bool
	default y
	depends on MBEDTLS_PSA_BUILTIN_ALG_SHA_1	|| \
		   MBEDTLS_PSA_BUILTIN_ALG_SHA_224	|| \
		   MBEDTLS_PSA_BUILTIN_ALG_SHA_256	|| \
		   MBEDTLS_PSA_BUILTIN_ALG_SHA_384	|| \
		   MBEDTLS_PSA_BUILTIN_ALG_SHA_512	|| \
		   MBEDTLS_PSA_BUILTIN_ALG_RIPEMD160

config MBEDTLS_PSA_BUILTIN_MAC
	bool
	default y
	depends on MBEDTLS_PSA_BUILTIN_ALG_CMAC		|| \
		   MBEDTLS_PSA_BUILTIN_ALG_HKDF		|| \
		   MBEDTLS_PSA_BUILTIN_ALG_HMAC

endif # PSA_CRYPTO_DRIVER_BUILTIN
```
