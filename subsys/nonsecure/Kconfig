## subsys/nrf_security/Kconfig.tls
```kconfig
#
# Copyright (c) 2021-2022 Nordic Semiconductor
#
# SPDX-License-Identifier: LicenseRef-Nordic-5-Clause
#

menuconfig MBEDTLS_X509_LIBRARY
	bool
	prompt "Create mbed TLS x509 library"
	select MBEDTLS_PK_C
	default y if MBEDTLS_PSA_CRYPTO_C && (MBEDTLS_ECDSA_C || MBEDTLS_ECDH_C)
	help
	  Create the mbed x509 library for handling of certificates.

if MBEDTLS_X509_LIBRARY

config MBEDTLS_X509_USE_C
	bool "X.509 core for using certificates."
	default y
	select MBEDTLS_PK_PARSE_C
	help
	  Enable X.509 core for using certificates.

config MBEDTLS_X509_CREATE_C
	bool "X.509 - creating certificates core"
	select MBEDTLS_PK_PARSE_C
	help
	  Enable X.509 core for creating certificates.

config MBEDTLS_X509_CHECK_KEY_USAGE
	bool "X.509 - check key usage"
	default y
	help
	  Enable verification of the key usage extension (CA and leaf certificates).

config MBEDTLS_X509_CHECK_EXTENDED_KEY_USAGE
	bool "X.509 - check extended key usage"
	default y
	help
	  Enable verification of the extendedKeyUsage extension (leaf certificates).

config MBEDTLS_X509_CRL_PARSE_C
	bool "X.509 - CRL parsing"
	default y
	help
	  Enable X.509 CRL parsing.

config MBEDTLS_X509_CSR_PARSE_C
	bool "X.509 - CSR parsing"
	default y
	help
	  Enable X.509 Certificate Signing Requests (CSR) parsing.

config MBEDTLS_X509_CRT_PARSE_C
	bool "X.509 - CTR parsing"
	default y
	help
	  Enable X.509 CTR parsing

config MBEDTLS_X509_CSR_WRITE_C
	bool "X.509 - CSR writing"
	select MBEDTLS_PK_WRITE_C
	help
	  Enable creating X.509 Certificate Signing Requests (CSR).

config MBEDTLS_X509_CRT_WRITE_C
	bool "X.509 - CRT writing"
	help
	  Enable creating X.509 Certificates (CRT).

config MBEDTLS_X509_REMOVE_INFO
	bool "X.509 - Remove info"
	default y
	help
	  Disable mbedtls_x509_*_info() and related APIs.
	  This can save several KB

config MBEDTLS_PKCS7_C
	bool "PKCS#7 core support [EXPERIMENTAL]"
	select EXPERIMENTAL
	help
	  Add support for PKCS #7-formatted signatures.
	  See https://tools.ietf.org/html/rfc2315 for details.
	  This feature is currently experimental.

endif

menuconfig MBEDTLS_TLS_LIBRARY
	bool
	prompt "Create mbed TLS transport layer security library"
	select MBEDTLS_X509_LIBRARY
	imply PSA_WANT_ALG_TLS12_PRF
	imply PSA_WANT_ALG_TLS12_PSK_TO_MS
	default y if MBEDTLS_PSA_CRYPTO_C && (MBEDTLS_ECDSA_C || MBEDTLS_ECDH_C)
	help
	  Create the mbed SSL/TLS library in addition to the mbed crypto
	  library.

if MBEDTLS_TLS_LIBRARY

config MBEDTLS_SSL_CLI_C
	bool "SSL/TLS client code"
	default y
	depends on MBEDTLS_SSL_TLS_C
	help
	  This setting enables SSL/TLS client functionality.
	  Corresponds to MBEDTLS_SSL_CLI_C in mbed TLS config file

config MBEDTLS_SSL_SRV_C
	bool "SSL/TLS server code"
	default y
	depends on MBEDTLS_SSL_TLS_C
	help
	  This setting enables SSL/TLS server functionality.
	  Corresponds to MBEDTLS_SSL_SRV_C in mbed TLS config file.

config MBEDTLS_SSL_TLS_C
	bool
	default y
	depends on MBEDTLS_MD_C
	help
	  Corresponds to MBEDTLS_SSL_TLS_C in mbed TLS config file

config MBEDTLS_SSL_PROTO_TLS1_2
	bool "TLS version 1.2 protocol"
	default y
	depends on (MBEDTLS_SHA1_C || MBEDTLS_SHA256_C || MBEDTLS_SHA512_C) || \
		    MBEDTLS_PSA_CRYPTO_C
	help
	  Enable the TLS 1.2 protocol
	  Corresponds to MBEDTLS_SSL_PROTO_TLS1_2 in mbed TLS config file

if MBEDTLS_SSL_PROTO_TLS1_2

config MBEDTLS_SSL_ENCRYPT_THEN_MAC
	bool
	default y
	help
	  This setting enable support for Encrypt-then-MAC, RFC 7366.
	  Note: This only affects CBC ciphersuites and is useless if none is defined.
	  Corresponds to MBEDTLS_SSL_ENCRYPT_THEN_MAC in mbed TLS config file.

config MBEDTLS_SSL_EXTENDED_MASTER_SECRET
	bool
	default y
	help
	  This setting enables support for RFC 7627: Session Hash and Extended
	  Master Secret Extension. This was introduced as the "proper fix" to
	  the Triple Handshake attacks, but is recommended to always be used.
	  Corresponds to MBEDTLS_SSL_EXTENDED_MASTER_SECRET in mbed TLS config file.

config MBEDTLS_SSL_COOKIE_C
	bool
	prompt "TLS server-side callbacks for session tickets"
	depends on MBEDTLS_SSL_SRV_C
	default y
	help
	  This setting enables TLS server-side callbacks for session tickets

endif # MBEDTLS_SSL_PROTO_TLS1_2

config MBEDTLS_DEBUG_C
	bool
	prompt "Debug functions for TLS"
	select CBPRINTF_PACKAGE_LONGDOUBLE
	help
	  Enable the debug functions for TLS.

config MBEDTLS_DEBUG_LEVEL
	int "mbed TLS default debug level"
	depends on MBEDTLS_DEBUG_C
	default 0
	range 0 4
	help
	  Default mbed TLS debug logging level for Zephyr integration code
	  (from ext/lib/crypto/mbedtls/include/mbedtls/debug.h):
	  0 No debug
	  1 Error
	  2 State change
	  3 Information
	  4 Verbose

config MBEDTLS_MEMORY_DEBUG
	bool "mbed TLS memory debug activation"
	help
	  Enable debugging of buffer allocator memory issues. Automatically
	  prints (to stderr) all (fatal) messages on memory allocation
	  issues. Enables function for 'debug output' of allocated memory.

config MBEDTLS_SSL_PROTO_DTLS
	bool "DTLS"
	depends on MBEDTLS_SSL_PROTO_TLS1_2
	help
	  Enables all version of DTLS

if MBEDTLS_SSL_PROTO_DTLS

config MBEDTLS_SSL_DTLS_ANTI_REPLAY
	bool "Provide DTLS Anti-replay functionality"
	default y
	help
	  Disabling this often constitutes a security risk!
	  See mbedtls_ssl_conf_dtls_anti_replay() for details.

config MBEDTLS_SSL_DTLS_HELLO_VERIFY
	bool "HelloVerifyRequest on DTLS servers"
	default y
	help
	  Enable this to ensure DTLS servers can't be used in certain DoS
	  attacks.

config MBEDTLS_SSL_DTLS_SRTP
	bool "DTLS-SRTP (RFC5764)"

config MBEDTLS_SSL_DTLS_CLIENT_PORT_REUSE
	bool
	prompt "SSL - DTLS client port reuse"
	depends on MBEDTLS_SSL_DTLS_HELLO_VERIFY
	help
	  Enable server-side support for clients that reconnect from the same port.

config MBEDTLS_SSL_DTLS_CONNECTION_ID
	bool
	prompt "SSL - DTLS connection ID"
	help
	  Enable support for the DTLS Connection ID extension which allows to
	  identify DTLS connections across changes in the underlying transport.
	  The Connection ID extension is still in draft state.

config MBEDTLS_SSL_DTLS_BADMAC_LIMIT
	bool
	prompt "SSL - DTLS bad MAC limit"
	help
	  Enable support for a limit of records with bad MAC.

endif # MBEDTLS_SSL_PROTO_DTLS

# This config can be set only for OpenThread's TCAT and CoAPs, because these are isolated cases,
# when X.509 certificate-based handshake is done in an internal network with full trust.
# KRKNWK-20181
config MBEDTLS_SSL_CLI_ALLOW_WEAK_CERTIFICATE_VERIFICATION_WITHOUT_HOSTNAME
	bool
	depends on OPENTHREAD_BLE_TCAT || OPENTHREAD_COAPS
	help
	  Allow weak certificate verification without hostname check.

config MBEDTLS_SSL_ALL_ALERT_MESSAGES
	bool
	prompt "All SSL alert messages"
	default y
	help
	  This setting enables alert messages beingsentin case of failures.
	  Disabling this will enure that no information is given about reasons
	  for failures.
	  Corresponds to MBEDTLS_SSL_ALL_ALERT_MESSAGES in mbed TLS config file.

config MBEDTLS_SSL_CONTEXT_SERIALIZATION
	bool
	prompt "Serialization of TLS conftext structures"
	default y
	help
	  This setting enables serialization of TLS structures, through use of
	  the mbedtls_ssl_context_save() and mbedtls_ssl_context_load().
	  Corresponds to MBEDTLS_SSL_CONTEXT_SERIALIZATION in mbed TLS config file.

config MBEDTLS_SSL_DEBUG_ALL
	bool
	prompt "Debug messages in SSL module for all issues."
	help
	  This setting enable the debug messages in SSL module for all issues.
	  Note: Some debug messages have been enabled to prevent timing attacks.
	  Corresponds to MBEDTLS_SSL_DEBUG_ALL in mbed TLS config file.

config MBEDTLS_SSL_KEEP_PEER_CERTIFICATE
	bool
	prompt "Give acces to peer certificate after handshake"
	default y
	help
	  Provides mbedtls_ssl_get_peer_cert() the ability to give the
	  peer's certificate after completion of handshake. Disabling this
	  reduces RAM usage.
	  Corresponds to MBEDTLS_SSL_KEEP_PEER_CERTIFICATE in mbed TLS config file.

config MBEDTLS_SSL_RENEGOTIATION
	bool
	prompt "SSL - Renegotiation"
	help
	  Enable support for TLS renegotiation.

config MBEDTLS_SSL_MAX_FRAGMENT_LENGTH
	bool
	prompt "SSL - RFC 6066 max_fragment_legth extension"
	help
	  Enable support for RFC 6066 max_fragment_length extension in SSL.

config MBEDTLS_SSL_SESSION_TICKETS
	bool
	prompt "SSL - RFC 5077 session tickets support"
	help
	  Enable support for RFC 5077 session tickets in SSL.

config MBEDTLS_SSL_SERVER_NAME_INDICATION
	bool
	prompt "SSL - RFC 6066 SNI"
	depends on MBEDTLS_X509_CRT_PARSE_C
	help
	  Enable support for RFC 6066 server name indication (SNI) in SSL.

config MBEDTLS_SSL_CACHE_C
	bool
	prompt "SSL - cache"
	help
	  Enable simple SSL cache implementation.

config MBEDTLS_SSL_TICKET_C
	bool
	prompt "SSL - tickets"
	depends on MBEDTLS_CIPHER_C
	help
	  Enable an implementation of TLS server-side callbacks for session tickets.

config MBEDTLS_SSL_EXPORT_KEYS
	bool
	prompt "Support for exporting keys"
	default y
	help
	  Enables support for exporting key block and master secret.

config MBEDTLS_SSL_OUT_CONTENT_LEN
	int
	prompt "Max length for TLS outgoing fragments"
	range 0 16384
	default 900 if OPENTHREAD_NRF_SECURITY || OPENTHREAD_NRF_SECURITY_PSA
	default 16384

config MBEDTLS_SSL_IN_CONTENT_LEN
	prompt "Max length for TLS outgoing fragments"
	int
	range 0 16384
	default 900 if OPENTHREAD_NRF_SECURITY || OPENTHREAD_NRF_SECURITY_PSA
	default 16384


config MBEDTLS_SSL_CIPHERSUITES
	string "SSL - Cipher suites tuning"
	help
	  List of cipher suites to support in SSL/TLS.
	  The cipher suites are given as a comma separated string, and in order of preference.
	  This list can only be used for restricting cipher suites available in the system.
	  Warning: This field has offers no validation checks.
	  MBEDTLS_SSL_CIPHERSUITES setting in mbed TLS config file.

config MBEDTLS_SSL_PROTO_TLS1_3
	bool "Support for TLS 1.3"

if MBEDTLS_SSL_PROTO_TLS1_3

config MBEDTLS_SSL_TLS1_3_COMPATIBILITY_MODE
	bool "TLS1.3 middlebox compatibility mode"
	default y
	help
	  As specified in RFC8446, TLS 1.3 offers a compatibility mode to make a TLS
	  1.3 connection more likely to pass through middle boxes expecting TLS 1.2
	  traffic

config MBEDTLS_SSL_TLS1_3_KEY_EXCHANGE_MODE_PSK_ENABLED
	bool "TLS 1.3 PSK key exchange mode"

config MBEDTLS_SSL_TLS1_3_KEY_EXCHANGE_MODE_EPHEMERAL_ENABLED
	bool "TLS 1.3 ephemeral key exchange mode"

config MBEDTLS_SSL_TLS1_3_KEY_EXCHANGE_MODE_PSK_EPHEMERAL_ENABLED
	bool "TLS 1.3 PSK ephemeral key exchange mode"

endif # MBEDTLS_SSL_PROTO_TLS1_3

config MBEDTLS_SSL_KEYING_MATERIAL_EXPORT
	bool "TLS keying material export support"

menu "TLS/DTL Cipher Suites"

config MBEDTLS_HAS_CBC_CIPHERSUITE_REQUIREMENTS
	bool
	default y
	depends on MBEDTLS_CIPHER_MODE_CBC || PSA_WANT_ALG_CBC_PKCS7

config MBEDTLS_HAS_GCM_CIPHERSUITE_REQUIREMENTS
	bool
	default y
	depends on MBEDTLS_GCM_C || PSA_WANT_ALG_GCM

config MBEDTLS_HAS_CCM_CIPHERSUITE_REQUIREMENTS
	bool
	default y
	depends on MBEDTLS_CCM_C || PSA_WANT_ALG_CCM

config MBEDTLS_HAS_CHACHAPOLY_CIPHERSUITE_REQUIREMENTS
	bool
	default y
	depends on MBEDTLS_CHACHAPOLY_C || PSA_WANT_ALG_CHACHA20_POLY1305

config MBEDTLS_HAS_CIPHER_MODE_CIPHERSUITE_REQUIREMENTS
	bool
	default y
	depends on MBEDTLS_HAS_CBC_CIPHERSUITE_REQUIREMENTS || \
		   MBEDTLS_HAS_CCM_CIPHERSUITE_REQUIREMENTS || \
		   MBEDTLS_HAS_GCM_CIPHERSUITE_REQUIREMENTS || \
		   MBEDTLS_HAS_CHACHAPOLY_CIPHERSUITE_REQUIREMENTS

config MBEDTLS_HAS_ECDH_CIPHERSUITE_REQUIREMENTS
	bool
	default y
	depends on (MBEDTLS_ECP_C && MBEDTLS_ECDH_C && MBEDTLS_SHA256_C) || \
		   (PSA_WANT_ALG_ECDH && MBEDTLS_USE_PSA_CRYPTO)


config MBEDTLS_HAS_ECDSA_CIPHERSUITE_REQUIREMENTS
	bool
	default y
	depends on (MBEDTLS_ECP_C && MBEDTLS_ECDSA_C && MBEDTLS_SHA256_C) || \
		   (PSA_WANT_ALG_ECDSA && PSA_WANT_ALG_SHA_256 && MBEDTLS_USE_PSA_CRYPTO)


config MBEDTLS_HAS_RSA_CIPHERSUITE_REQUIREMENTS
	bool
	default y
	depends on (MBEDTLS_RSA_C && MBEDTLS_PKCS1_V15)

config MBEDTLS_HAS_ECJPAKE_CIPHERSUITE_REQUIREMENTS
	bool
	default y
	depends on (MBEDTLS_ECP_C && MBEDTLS_ECJPAKE_C && MBEDTLS_SHA256_C ) || \
		   (PSA_WANT_ALG_JPAKE && PSA_WANT_ALG_SHA_256 && MBEDTLS_USE_PSA_CRYPTO)

config MBEDTLS_KEY_EXCHANGE_PSK_ENABLED
	bool
	prompt "PSK"
	default y if OPENTHREAD_COAPS || !OPENTHREAD
	depends on MBEDTLS_HAS_CIPHER_MODE_CIPHERSUITE_REQUIREMENTS

config MBEDTLS_KEY_EXCHANGE_DHE_PSK_ENABLED
	bool
	prompt "DHE PSK"
	default y if !OPENTHREAD
	depends on MBEDTLS_HAS_CIPHER_MODE_CIPHERSUITE_REQUIREMENTS && \
		   MBEDTLS_HAS_RSA_CIPHERSUITE_REQUIREMENTS

config MBEDTLS_KEY_EXCHANGE_ECDHE_PSK_ENABLED
	bool
	prompt "ECDHE PSK"
	default y if !OPENTHREAD
	depends on MBEDTLS_HAS_CIPHER_MODE_CIPHERSUITE_REQUIREMENTS && \
		   MBEDTLS_HAS_ECDH_CIPHERSUITE_REQUIREMENTS

config MBEDTLS_KEY_EXCHANGE_RSA_PSK_ENABLED
	bool
	prompt "RSA PSK"
	default y if !OPENTHREAD
	depends on MBEDTLS_HAS_CIPHER_MODE_CIPHERSUITE_REQUIREMENTS && \
		   MBEDTLS_HAS_RSA_CIPHERSUITE_REQUIREMENTS

config MBEDTLS_KEY_EXCHANGE_RSA_ENABLED
	bool
	prompt "RSA"
	default y if !OPENTHREAD
	depends on MBEDTLS_HAS_RSA_CIPHERSUITE_REQUIREMENTS

config MBEDTLS_KEY_EXCHANGE_DHE_RSA_ENABLED
	bool
	prompt "DHE RSA"
	default y if !OPENTHREAD
	depends on MBEDTLS_HAS_CIPHER_MODE_CIPHERSUITE_REQUIREMENTS && \
		   MBEDTLS_HAS_RSA_CIPHERSUITE_REQUIREMENTS

config MBEDTLS_KEY_EXCHANGE_ECDHE_RSA_ENABLED
	bool
	prompt "ECDHE RSA"
	default y if !OPENTHREAD
	depends on MBEDTLS_HAS_CIPHER_MODE_CIPHERSUITE_REQUIREMENTS && \
		   MBEDTLS_HAS_ECDH_CIPHERSUITE_REQUIREMENTS && \
		   MBEDTLS_HAS_RSA_CIPHERSUITE_REQUIREMENTS

config MBEDTLS_KEY_EXCHANGE_ECDHE_ECDSA_ENABLED
	bool
	prompt "ECDHE ECDSA"
	default y if OPENTHREAD_ECDSA || !OPENTHREAD
	depends on MBEDTLS_HAS_CIPHER_MODE_CIPHERSUITE_REQUIREMENTS && \
		   MBEDTLS_HAS_ECDH_CIPHERSUITE_REQUIREMENTS && \
		   MBEDTLS_HAS_ECDSA_CIPHERSUITE_REQUIREMENTS

config MBEDTLS_KEY_EXCHANGE_ECDH_ECDSA_ENABLED
	bool
	prompt "ECDH ECDSA"
	default y if !OPENTHREAD
	depends on MBEDTLS_HAS_CIPHER_MODE_CIPHERSUITE_REQUIREMENTS && \
		   MBEDTLS_HAS_ECDH_CIPHERSUITE_REQUIREMENTS && \
		   MBEDTLS_HAS_ECDSA_CIPHERSUITE_REQUIREMENTS

config MBEDTLS_KEY_EXCHANGE_ECDH_RSA_ENABLED
	bool
	prompt "ECDH RSA"
	default y if !OPENTHREAD
	depends on MBEDTLS_HAS_CIPHER_MODE_CIPHERSUITE_REQUIREMENTS && \
		   MBEDTLS_HAS_ECDH_CIPHERSUITE_REQUIREMENTS && \
		   MBEDTLS_HAS_RSA_CIPHERSUITE_REQUIREMENTS

config MBEDTLS_KEY_EXCHANGE_ECJPAKE_ENABLED
	bool
	prompt "ECJPAKE"
	default y
	depends on MBEDTLS_HAS_ECJPAKE_CIPHERSUITE_REQUIREMENTS

endmenu


endif # MBEDTLS_TLS_LIBRARY
```

## subsys/nrf_security/src/core/Kconfig
```kconfig
#
# Copyright (c) 2023 Nordic Semiconductor
#
# SPDX-License-Identifier: LicenseRef-Nordic-5-Clause
#

choice PSA_CORE
	prompt "PSA Core implementation"

config PSA_CORE_DISABLED
	bool "No PSA core (for SSF crypto client support)"
	depends on DT_HAS_NORDIC_IRONSIDE_CALL_ENABLED

config PSA_CORE_OBERON
	bool "PSA Core implementation - Oberon"
	select PSA_WANT_AES_KEY_SIZE_128
	select PSA_WANT_AES_KEY_SIZE_192
	select PSA_WANT_AES_KEY_SIZE_256
	depends on !DT_HAS_NORDIC_IRONSIDE_CALL_ENABLED

config PSA_CORE_LITE
	bool "PSA core created for tiny footprint"
	depends on SOC_SERIES_NRF54L
	depends on !DT_HAS_NORDIC_IRONSIDE_CALL_ENABLED
	help
	  The PSA core with tiny footprint is created to be used e.g. for bootloader
	  or similar use cases where there are severe size restrictions. This PSA core
	  will only provide limited algorithm support and a limited amount of features
	  from the PSA Crypto key management APIs. Note that PSA core lite uses
	  a custom volatile key store with limited functionality. Also note that
	  PSA core lite is not thread-safe.

endchoice

rsource "lite/Kconfig"
```
