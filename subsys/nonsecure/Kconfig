## subsys/nrf_security/src/drivers/cracen/Kconfig
```kconfig
#
# Copyright (c) 2023 Nordic Semiconductor
#
# SPDX-License-Identifier: LicenseRef-Nordic-5-Clause
#

config HAS_HW_NRF_CRACEN
	def_bool (SOC_SERIES_NRF54L && !SOC_NRF54LS05B) || SOC_SERIES_NRF71

config CRACEN_HW_VERSION_BASE
	def_bool SOC_SERIES_NRF54H || SOC_NRF54L15 || SOC_NRF54L10 || SOC_NRF54L05

config CRACEN_HW_VERSION_LITE
	def_bool SOC_NRF54LM20A || SOC_NRF54LM20B || SOC_NRF54LV10A || SOC_NRF7120_ENGA

config CRACEN_KMU_HW_PRESENT
	def_bool SOC_SERIES_NRF54L || SOC_SERIES_NRF71

config PSA_NEED_CRACEN_MULTIPART_WORKAROUNDS
	def_bool SOC_NRF54LM20A || SOC_NRF54LM20B

config PSA_NEED_CRACEN_CTR_SIZE_WORKAROUNDS
	def_bool PSA_NEED_CRACEN_MULTIPART_WORKAROUNDS || SOC_NRF54LV10A

config PSA_NEED_CRACEN_IKG_INTERRUPT_WORKAROUND
	def_bool SOC_NRF54LM20A || SOC_NRF54LM20B || SOC_NRF54LV10A || SOC_NRF7120_ENGA

config PSA_NEED_CRACEN_RNG_NO_ENTROPY_WORKAROUND
	# TODO: Revisit once pre-silicon targets are added
	def_bool n

# Configure CRACEN_LOG_LEVEL
module = CRACEN
module-str = CRACEN
source "$(ZEPHYR_BASE)/subsys/logging/Kconfig.template.log_config"

if PSA_CRYPTO_DRIVER_CRACEN

config PSA_NEED_CRACEN_ECC_KEY_GEN_PKE
	bool
	default y if PSA_NEED_CRACEN_KEY_TYPE_ECC_KEY_PAIR_GENERATE_SECP_R1 || \
		     PSA_NEED_CRACEN_KEY_TYPE_ECC_KEY_PAIR_GENERATE_SECP_K1 || \
		     PSA_NEED_CRACEN_KEY_TYPE_ECC_KEY_PAIR_GENERATE_BRAINPOOL_P_R1
	help
	  ECC key generation operations that require PK engine.
	  This excludes Montgomery and Twisted Edwards curves which use
	  random generation with bit manipulation instead of PKE operations.

config CRACEN_LOAD_MICROCODE
	bool "Load CRACEN microcode"
	depends on CRACEN_HW_VERSION_BASE
	default y if CRACEN_IKG || \
		     PSA_NEED_CRACEN_ASYMMETRIC_SIGNATURE_DRIVER || \
		     PSA_NEED_CRACEN_ASYMMETRIC_ENCRYPTION_DRIVER || \
		     PSA_NEED_CRACEN_KEY_AGREEMENT_DRIVER || \
		     PSA_NEED_CRACEN_PAKE_DRIVER || \
		     PSA_NEED_CRACEN_KEY_TYPE_RSA_KEY_PAIR_GENERATE || \
		     PSA_NEED_CRACEN_ECC_KEY_GEN_PKE
	help
	  Whether to load the CRACEN microcode on startup.
	  This is required to use the PKE/IKG on nRF54L15,
	  nRF54L10, and nRF54L05. (This is not required
	  when a bootloader has already loaded the microcode.)

config CRACEN_LIB_KMU
	bool "CRACEN KMU library"
	depends on CRACEN_KMU_HW_PRESENT
	select NRFX_RRAMC if !BUILD_WITH_TFM && SOC_SERIES_NRF54L
	select NRFX_MRAMC if !BUILD_WITH_TFM && SOC_SERIES_NRF71
	default y
	help
	  The CRACEN KMU library.

config CRACEN_PROVISION_PROT_RAM_INV_SLOTS_ON_INIT
	bool "Provision protected RAM invalidation slots on boot"
	depends on CRACEN_LIB_KMU
	default y
	help
	  Provision the protected RAM invalidation data in the KMU. This will generate random
	  data and provision the reserved KMU slots with the data that will be used to invalidate
	  the protected RAM after a key is used.
	  When disabled the application is expected to provision the reserved KMU slots 248 and 249
	  manually, otherwise the protected RAM keys will not be usable.

config CRACEN_PROVISION_PROT_RAM_INV_SLOTS_WITH_IMPORT
	bool "Provision protected RAM invalidation slots using psa_import_key"
	depends on CRACEN_LIB_KMU
	help
	  Provision the protected RAM invalidation KMU slots (248,249) in the KMU using a
	  psa_import_key call. The application is required to call psa_import_key with the
	  KMU slot 248. The key material provided is ignored and random data is generated to
	  populate the slots.
	  This is meant to be used by a provisioning image that runs once before the application
	  image is flashed. This is not meant to be used by user applications.

config CRACEN_IKG
	bool "CRACEN IKG"
	help
	  Enable the Cracen Isolated Key Generator.

config CRACEN_IKG_SEED_LOAD
	bool "Load the CRACEN IKG seed"
	depends on CRACEN_LIB_KMU
	default y
	help
	  The IKG seed is used to derive the keys in the IKG.
	  If there is no seed in KMU, it is expected to be generated.
	  Note that this is not required to be used if a bootloader is loading
	  KMU seed.

config CRACEN_IKG_SEED_KMU_SLOT
	int "KMU slot of the CRACEN IKG seed"
	range 0 183
	default 183
	help
	  The CRACEN IKG seed spans over 3 KMU slots:
	  the one defined here and the two subsequent ones.
	  This defines the KMU slot (along with the two following it) to which
	  the IKG seed is provisioned and that is pushed when loading the IKG seed.

config CRACEN_IKG_PERSONALIZED_KEYS
	bool "CRACEN IKG personalized keys"
	help
	  Personalize each IKG-generated key for the associated key owner.
	  If an owner ID is encoded into the mbedtls_svc_key_id_t type,
	  it will be passed to the IKG as a personalization string.

config CRACEN_USE_INTERRUPTS
	bool "Use cracen with interrupts"
	default y
	help
	  Run CRACEN using supported interrupts.
	  If this is turned off CRACEN uses active polling instead,
	  which may have an impact on performance.

config CRACEN_ENABLE_ECC_EXTENDED_COUNTERMEASURES
	def_bool CRACEN_HW_VERSION_LITE
	depends on CRACEN_ENABLE_ECC_COUNTERMEASURES

config CRACEN_ENABLE_ECC_COUNTERMEASURES
	bool "CRACEN ECC countermeasures"
	default y
	help
	  Enable Cracen ECC countermeasures, using scalar randomization
	  and projective coordinate randomization.

	  In nRF54H20, nRF54L05, nRF54L10, and nRF54L15 the countermeasures
	  are available for the following operations:
	  - ECDSA signature generation and public key generation
	  - ECC point multiplication

	  In nRF54LM20X, nRF54LV10A, and nRF7120 the countermeasures the following
	  countermerasures are available in adddition to the above operations:
	  - Montgomery curve multiplication
	  - EdDSA base point multiplication
	  - Edwards point multiplication

rsource 'psa_driver.Kconfig'

endif # PSA_CRYPTO_DRIVER_CRACEN
```

## subsys/nrf_security/src/drivers/cracen/cracen_sw/Kconfig
```kconfig
#
# Copyright (c) 2025 Nordic Semiconductor
#
# SPDX-License-Identifier: LicenseRef-Nordic-5-Clause
#

config CRACEN_SW_CMAC_WORKAROUND
	bool
	default y if PSA_NEED_CRACEN_CMAC && CRACEN_NEED_MULTIPART_WORKAROUNDS

config CRACEN_SW_CTR_AES_WORKAROUND
	bool
	default y if PSA_NEED_CRACEN_CTR_AES && \
		(CRACEN_NEED_MULTIPART_WORKAROUNDS || SOC_NRF54LV10A)
```

## subsys/nrf_security/src/drivers/cracen/ext/Kconfig
```kconfig
#
# Copyright (c) 2023 Nordic Semiconductor
#
# SPDX-License-Identifier: LicenseRef-Nordic-5-Clause
#
config PSA_CRYPTO_DRIVER_CRACEN
	bool "Enable the Cracen PSA driver"
	depends on MBEDTLS_PSA_CRYPTO_C
	depends on CRACEN_HW_PRESENT
	# CRACEN uses the k_event_ API
	select EVENTS
	help
	  PSA crypto driver for the CRACEN HW peripheral.


if PSA_CRYPTO_DRIVER_CRACEN

menu "CRACEN PSA driver"
config PSA_USE_CRACEN_KEY_MANAGEMENT_DRIVER
	bool "Cracen key management driver"
	default y

config PSA_USE_CRACEN_AEAD_DRIVER
	bool "Cracen AEAD driver"
	default y

config PSA_USE_CRACEN_CIPHER_DRIVER
	bool "Cracen cipher driver"
	default y

config PSA_USE_CRACEN_KEY_AGREEMENT_DRIVER
	bool "Cracen key agreement driver"
	default y

config PSA_USE_CRACEN_ASYMMETRIC_ENCRYPTION_DRIVER
	bool "Cracen asymmetric encryption driver"
	default y

config PSA_USE_CRACEN_HASH_DRIVER
	bool "Cracen hash driver"
	default y

config PSA_USE_CRACEN_MAC_DRIVER
	bool "Cracen MAC driver"
	default y

if PSA_USE_CRACEN_KEY_MANAGEMENT_DRIVER

config PSA_USE_CRACEN_KEY_DERIVATION_DRIVER
	bool "Cracen key derivation driver"
	default y

config PSA_USE_CRACEN_PAKE_DRIVER
	bool "Cracen PAKE driver"
	default y

config PSA_USE_CRACEN_ASYMMETRIC_SIGNATURE_DRIVER
	bool "Cracen asymmetric signature driver"
	default y

endif # PSA_USE_CRACEN_KEY_MANAGEMENT_DRIVER

config PSA_USE_CRACEN_CTR_DRBG_DRIVER
	bool
	default y

config CRACEN_LOAD_MICROCODE
	bool
	depends on SOC_SERIES_NRF54LX || SOC_NRF54H20_CPUSEC
	default y
	help
	  Prompt-less configuration to load the CRACEN microcode.
	  This is required to use the PKE/IKG engine. Note that this is not
	  required when a bootloader has already loaded the microcode.

config CRACEN_LIB_KMU
	bool
	depends on SOC_SERIES_NRF54LX
	default y
	help
	  The CRACEN KMU library.

config CRACEN_LOAD_KMU_SEED
	bool
	prompt "Load the CRACEN IKG seed"
	depends on CRACEN_LIB_KMU
	default y
	help
	  Configuration to load a The CRACEN IKG seed value from KMU.
	  The KMU seed is used to give support for key derived from IKG.
	  If there is no seed in KMU, it is expected to be generated.
	  Note that this is not required to be used if a bootloader is loading
	  KMU seed.
config CRACEN_GENERATE_KMU_SEED
	bool
	prompt "Generate CRACEN IKG seed in KMU"
	depends on CRACEN_LIB_KMU
	depends on CRACEN_LOAD_KMU_SEED
	default y
	help
	  This configuration enables generation of the CRACEN IKG seed value used for
	  IKG support. The generated seed is written into KMU (write once).
	  If the seed is already generated and written in KMU, this configuration
	  will have no effect.

endmenu

endif
rsource 'psa_driver.Kconfig'
```
