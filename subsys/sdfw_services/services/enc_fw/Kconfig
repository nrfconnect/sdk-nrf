## subsys/sdfw_services/services/enc_fw/Kconfig
```kconfig
#
# Copyright (c) 2024 Nordic Semiconductor ASA
#
# SPDX-License-Identifier: LicenseRef-Nordic-5-Clause
#

service_name = ENC_FW
service_default_enabled = n
service_id = 0x6A
service_version = 1
service_buffer_size = 64
service_name_str = Encrypted firmware
rsource "../Kconfig.template.service"
```

## subsys/sdfw_services/services/extmem/Kconfig
```kconfig
#
# Copyright (c) 2024 Nordic Semiconductor ASA
#
# SPDX-License-Identifier: LicenseRef-Nordic-5-Clause
#

menuconfig SSF_EXTMEM_SERVICE_ENABLED
	bool "EXTMEM Update service"
	default n
	depends on SDFW_SERVICES_ENABLED

if SSF_EXTMEM_SERVICE_ENABLED

config SSF_EXTMEM_SERVICE_ID
	hex
	default 0x54
	help
	  Service ID for EXTMEM service

config SSF_EXTMEM_SERVICE_VERSION
	int
	default 1
	help
	  Version of EXTMEM service

config SSF_EXTMEM_SERVICE_BUFFER_SIZE
	int "Buffer size for EXTMEM service handler"
	default 128

config SSF_EXTMEM_READ_BUFFER_SIZE
	int "Read buffer size"
	default 4096
	help
	  The size of the memory buffer owned by the remote side that will be used to store data
	  read from external memory device. This determines the largest single read chunk size.

config SSF_EXTMEM_BASE_ADDRESS
	hex "External memory base address"
	default 0x60000000
	help
	  Base address is used when memory mapping feature of the external memory is available.
	  This allows the SDFW to calculate the absolute memory address without communicating with
	  the EXTMEM service provider. The EXTMEM service provider can adjust this value to point
	  into the XIP or EXMEE memory regions. The SDFW will validate if the base
	  address does not belong to memory ranges owned by other domains to prevent data leaks.

module = SSF_EXTMEM_SERVICE
module-str = EXTMEM Update service
source "${ZEPHYR_BASE}/subsys/logging/Kconfig.template.log_config"

endif
```

## subsys/sdfw_services/services/prng/Kconfig
```kconfig
#
# Copyright (c) 2024 Nordic Semiconductor ASA
#
# SPDX-License-Identifier: LicenseRef-Nordic-5-Clause
#

service_name = PRNG
service_default_enabled = y
service_id = 0x70
service_version = 1
service_buffer_size = 128
service_name_str = PRNG Service
rsource "../Kconfig.template.service"
```

## subsys/sdfw_services/services/psa_crypto/Kconfig
```kconfig
#
# Copyright (c) 2024 Nordic Semiconductor ASA
#
# SPDX-License-Identifier: LicenseRef-Nordic-5-Clause
#

service_name = PSA_CRYPTO
service_default_enabled = n
service_id = 0x71
service_version = 2
service_buffer_size = 128
service_name_str = PSA Crypto
rsource "../Kconfig.template.service"

if SSF_PSA_CRYPTO_SERVICE_ENABLED

config SSF_PSA_CRYPTO_SERVICE_OUT_BOUNCE_BUFFERS
	bool "Make sure that all output buffers can be written cache-safe from the crypto engine"
	default y
	depends on DCACHE
	help
		When this option is enabled, the PSA Crypto service will allocate bounce buffers for
		all PSA [inout] and [out] structures that are not aligned to the DCache DataUnit size.
		When this option is disabled, the PSA Crypto service will never use bounce buffers,
		and the application must ensure that the structures are cache-safe.
		The structures are cache-safe if there are no writes locally to any of the DataUnits
		that contain the structure getting written from the remote.

if SSF_PSA_CRYPTO_SERVICE_OUT_BOUNCE_BUFFERS

config SSF_PSA_CRYPTO_SERVICE_OUT_HEAP_SIZE
	int "Size of the heap used to buffer output from PSA function calls"
	default 4096
	help
	  Size of the heap buffer used for out buffer.
	  Reducing the size may trigger PSA_ERROR_INSUFFICIENT_MEMORY in PSA calls.

endif # SSF_PSA_CRYPTO_SERVICE_OUT_BOUNCE_BUFFERS

endif # SSF_PSA_CRYPTO_SERVICE_ENABLED
```

## subsys/sdfw_services/services/reset_evt/Kconfig
```kconfig
#
# Copyright (c) 2024 Nordic Semiconductor ASA
#
# SPDX-License-Identifier: LicenseRef-Nordic-5-Clause
#

service_name = RESET_EVT
service_default_enabled = y
service_id = 0x68
service_version = 1
service_buffer_size = 32
service_name_str = Reset Event Notification
rsource "../Kconfig.template.service"
```

## subsys/sdfw_services/services/sdfw_update/Kconfig
```kconfig
#
# Copyright (c) 2024 Nordic Semiconductor ASA
#
# SPDX-License-Identifier: LicenseRef-Nordic-5-Clause
#

service_name = SDFW_UPDATE
service_default_enabled = y
service_id = 0x69
service_version = 1
service_buffer_size = 64
service_name_str = SDFW Update
rsource "../Kconfig.template.service"

if SSF_SDFW_UPDATE_SERVICE_ENABLED

config SSF_SDFW_UPDATE_TBS_OFFSET
	hex
	default 0x10
	help
	  Offset of TBS data inside the update blob.

config SSF_SDFW_UPDATE_PUBLIC_KEY_OFFSET
	hex
	default 0x110
	help
	  Offset of public key inside the update blob.

config SSF_SDFW_UPDATE_SIGNATURE_OFFSET
	hex
	default 0x130
	help
	  Offset of signature inside the update blob.

config SSF_SDFW_UPDATE_FIRMWARE_OFFSET
	hex
	default 0x170
	help
	  Offset of firmware inside the update blob.

config SSF_SDFW_UPDATE_DOWNLOAD_MAX
	hex
	default 0xf0000
	help
	  Max size of update.

endif # SSF_SDFW_UPDATE_SERVICE_ENABLED
```

## subsys/sdfw_services/services/suit_service/Kconfig
```kconfig
#
# Copyright (c) 2024 Nordic Semiconductor ASA
#
# SPDX-License-Identifier: LicenseRef-Nordic-5-Clause
#

menuconfig SSF_SUIT_SERVICE_ENABLED
	bool "SUIT Update service"
	depends on SDFW_SERVICES_ENABLED
	depends on SUIT_UTILS
	depends on SUIT_METADATA
	depends on ZCBOR_CANONICAL

if SSF_SUIT_SERVICE_ENABLED

config SSF_SUIT_SERVICE_ID
	hex
	default 0x53
	help
	  Service ID for SUIT Update service

config SSF_SUIT_SERVICE_VERSION
	int
	default 1
	help
	  Version of SUIT Update service

config SSF_SUIT_SERVICE_BUFFER_SIZE
	int "Buffer size for SUIT Update service handler"
	default 128

module = SSF_SUIT_SERVICE
module-str = SUIT Update service
source "${ZEPHYR_BASE}/subsys/logging/Kconfig.template.log_config"

endif # SSF_SUIT_SERVICE_ENABLED
```

## subsys/sdfw_services/transport/Kconfig
```kconfig
#
# Copyright (c) 2024 Nordic Semiconductor ASA
#
# SPDX-License-Identifier: LicenseRef-Nordic-5-Clause
#

config SSF_NRF_RPC
	bool
	default y
	imply NRF_RPC
	imply MBOX_NRFX_IDS

if SSF_NRF_RPC
rsource "nrf_rpc/Kconfig"
endif
```

## subsys/sdfw_services/transport/nrf_rpc/Kconfig
```kconfig
#
# Copyright (c) 2024 Nordic Semiconductor ASA
#
# SPDX-License-Identifier: LicenseRef-Nordic-5-Clause
#

config SSF_NRF_RPC_CMD_ID
	hex
	default 0x42
	help
	  nRF_RPC Command ID to use for SDFW Service Framework

config SSF_NRF_RPC_NOTIF_ID
	hex
	default 0x43
	help
	  nRF_RPC Event ID to use for notifications
```

## subsys/secure_storage/Kconfig
```kconfig
# Copyright (c) 2025 Nordic Semiconductor
# SPDX-License-Identifier: LicenseRef-Nordic-5-Clause

# Secure storage subsystem integration into the nRF Connect SDK

if SECURE_STORAGE

# Add the HUK library as the default AEAD key provider when supported.
# It provides the highest level of security.
choice SECURE_STORAGE_ITS_TRANSFORM_AEAD_KEY_PROVIDER
	default SECURE_STORAGE_ITS_TRANSFORM_AEAD_KEY_PROVIDER_HUK_LIBRARY

config SECURE_STORAGE_ITS_TRANSFORM_AEAD_KEY_PROVIDER_HUK_LIBRARY
	bool "Keys derived using the HUK library"
	depends on HW_UNIQUE_KEY_SUPPORTED
	select MPU_ALLOW_FLASH_WRITE if !BUILD_WITH_TFM && !CRACEN_KMU_HW_PRESENT
	select HW_UNIQUE_KEY
	select HW_UNIQUE_KEY_RANDOM
	imply HW_UNIQUE_KEY_WRITE_ON_CRYPTO_INIT

endchoice # SECURE_STORAGE_ITS_TRANSFORM_AEAD_KEY_PROVIDER

config SECURE_STORAGE_ITS_TRANSFORM_AEAD_NONCE_PROVIDER_DEFAULT
	select PSA_WANT_GENERATE_RANDOM if NRF_SECURITY

rsource "compatibility/Kconfig"

endif # SECURE_STORAGE
```

## subsys/secure_storage/compatibility/Kconfig
```kconfig
# Copyright (c) 2025 Nordic Semiconductor
# SPDX-License-Identifier: LicenseRef-Nordic-5-Clause

config SECURE_STORAGE_TRUSTED_STORAGE_COMPATIBILITY
	bool "Trusted storage backward compatibility [EXPERIMENTAL]"
	depends on SECURE_STORAGE_ITS_STORE_IMPLEMENTATION_SETTINGS || \
		SECURE_STORAGE_ITS_STORE_IMPLEMENTATION_CUSTOM
	depends on (SETTINGS_ZMS || SETTINGS_ZMS_LEGACY || \
		(SETTINGS_NVS && !SOC_SERIES_NRF54L)) || \
		SECURE_STORAGE_ITS_STORE_IMPLEMENTATION_CUSTOM
	select EXPERIMENTAL
	select SECURE_STORAGE_64_BIT_UID
	select SECURE_STORAGE_ITS_STORE_SETTINGS_NAME_CUSTOM \
		if SECURE_STORAGE_ITS_STORE_IMPLEMENTATION_SETTINGS
	help
	  Enable to make the Secure storage subsystem compatible with
	  an existing installation that was previously using the Trusted storage library.
	  This allows the Secure storage subsystem to operate and store entries
	  like the Trusted storage library would.

# Replace the upstream AEAD implementation by a Trusted Storage Backward Compatible (TSBC) one.
# The custom option (SECURE_STORAGE_ITS_TRANSFORM_IMPLEMENTATION_CUSTOM) remains usable.
choice SECURE_STORAGE_ITS_TRANSFORM_IMPLEMENTATION
	default SECURE_STORAGE_ITS_TRANSFORM_IMPLEMENTATION_TSBC \
		if SECURE_STORAGE_TRUSTED_STORAGE_COMPATIBILITY

config SECURE_STORAGE_ITS_TRANSFORM_IMPLEMENTATION_TSBC
	bool "ITS transform module implementation compatible with the Trusted storage library"
	depends on SECURE_STORAGE_TRUSTED_STORAGE_COMPATIBILITY
	select PSA_WANT_GENERATE_RANDOM
	select PSA_WANT_KEY_TYPE_CHACHA20
	select PSA_WANT_ALG_CHACHA20_POLY1305

endchoice # SECURE_STORAGE_ITS_TRANSFORM_IMPLEMENTATION

if SECURE_STORAGE_TRUSTED_STORAGE_COMPATIBILITY

if SECURE_STORAGE_ITS_TRANSFORM_IMPLEMENTATION_TSBC

config SECURE_STORAGE_ITS_MAX_DATA_SIZE
	default 256

config SECURE_STORAGE_ITS_TRANSFORM_OUTPUT_OVERHEAD
	# create_flags diff (3) + entry size (4) + nonce (12) + authentication tag (16)
	default 35

# Make the same key providers available as trusted storage.
choice SECURE_STORAGE_ITS_TRANSFORM_TSBC_KEY_PROVIDER
	prompt "AEAD key provider"
	default SECURE_STORAGE_ITS_TRANSFORM_TSBC_KEY_PROVIDER_HUK_LIBRARY

config SECURE_STORAGE_ITS_TRANSFORM_TSBC_KEY_PROVIDER_ENTRY_UID_HASH
	bool "Key provider equivalent to TRUSTED_STORAGE_BACKEND_AEAD_KEY_HASH_UID"
	select PSA_WANT_ALG_SHA_256

config SECURE_STORAGE_ITS_TRANSFORM_TSBC_KEY_PROVIDER_HUK_LIBRARY
	bool "Key provider equivalent to TRUSTED_STORAGE_BACKEND_AEAD_KEY_DERIVE_FROM_HUK"
	depends on HW_UNIQUE_KEY_SUPPORTED
	select HW_UNIQUE_KEY
	select HW_UNIQUE_KEY_RANDOM

endchoice # SECURE_STORAGE_ITS_TRANSFORM_TSBC_KEY_PROVIDER

endif # SECURE_STORAGE_ITS_TRANSFORM_IMPLEMENTATION_TSBC

if SECURE_STORAGE_ITS_STORE_IMPLEMENTATION_SETTINGS

config PSA_PROTECTED_STORAGE_PREFIX
	string "PS entry setting prefix"
	default "ps"

config PSA_INTERNAL_TRUSTED_STORAGE_PREFIX
	string "ITS entry setting prefix"
	default "its"

config SECURE_STORAGE_ITS_STORE_SETTINGS_NAME_MAX_LEN
	default 20

endif # SECURE_STORAGE_ITS_STORE_IMPLEMENTATION_SETTINGS

endif # SECURE_STORAGE_TRUSTED_STORAGE_COMPATIBILITY
```

## subsys/serialization/Kconfig
```kconfig
#
# Copyright (c) 2020 Nordic Semiconductor
#
# SPDX-License-Identifier: LicenseRef-BSD-5-Clause-Nordic
#

menu "Serialization"

if RP_SERIALIZATION

config RP_OS_RSP_WAIT_TIME
	int "Remote procedure response wait time"
	default 5000
	help
	  Remote procedure wait for response maximum time in miliseconds

choice
	prompt "RPMSG device role"
	default RPMSG_REMOTE

config RPMSG_REMOTE
	bool "Remote"

config RPMSG_MASTER
	bool "Master"

endchoice

config RP_TRANS_PRMSG_RX_STACK_SIZE
	int "Stack size of the rpmsg receive thread"
	default 512
	help
	  Stack size for the thread that is responsible for receiving incoming
	  messages from rpmsg.

config RP_TRANS_PRMSG_RX_PRIORITY
	int "Priority of the rpmsg receive thread"
	default 7
	help
	  Priority of the thread that is responsible for receiving incoming
	  messages from rpmsg.

module = RP_SER
module-str = RP_SER
source "${ZEPHYR_BASE}/subsys/logging/Kconfig.template.log_config"

endif # RP_SERIALIZATION

endmenu
```

## subsys/settings/Kconfig
```kconfig
#
# Copyright (c) 2025 Nordic Semiconductor
#
# SPDX-License-Identifier: LicenseRef-Nordic-5-Clause
#

choice SETTINGS_BACKEND

config SETTINGS_ZMS_LEGACY
	bool "Settings ZMS legacy backend [DEPRECATED]"
	depends on ZMS
	select DEPRECATED
	help
	  Use the legacy backend of ZMS for Settings

endchoice

if SETTINGS_ZMS_LEGACY

config SETTINGS_ZMS_NAME_CACHE
	bool "ZMS name lookup cache"
	select SYS_HASH_FUNC32
	help
	  Enable ZMS name lookup cache, used to reduce the Settings name
	  lookup time.

config SETTINGS_ZMS_NAME_CACHE_SIZE
	int "ZMS name lookup cache size"
	default 128
	range 1 $(UINT32_MAX)
	depends on SETTINGS_ZMS_NAME_CACHE
	help
	  Number of entries in Settings ZMS name cache.

config SETTINGS_ZMS_SECTOR_SIZE_MULT
	int "Sector size of the ZMS settings area"
	default 1
	help
	  The sector size to use for the ZMS settings area as a multiple of
	  FLASH_ERASE_BLOCK_SIZE.

config SETTINGS_ZMS_SECTOR_COUNT
	int "Sector count of the ZMS settings area"
	default 8
	help
	  Number of sectors used for the ZMS settings area

endif # SETTINGS_ZMS_LEGACY
```
