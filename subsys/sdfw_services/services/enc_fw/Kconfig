## subsys/suit/Kconfig
```kconfig
#
# Copyright (c) 2020 Nordic Semiconductor ASA
#
# SPDX-License-Identifier: LicenseRef-Nordic-5-Clause
#

rsource "provisioning/Kconfig"

menuconfig SUIT
	bool "Enable SUIT modules"

if SUIT

config SUIT_DFU
	bool "Enable SUIT DFU - the interface for SUIT for the user application"
	depends on !SUIT_PLATFORM_VARIANT_SDFW
	default y if !ZTEST

choice SUIT_PLATFORM_VARIANT
	prompt "SUIT platform implementation variant"
	default SUIT_PLATFORM_VARIANT_APP if !ZTEST

config SUIT_PLATFORM_VARIANT_SDFW
	bool "Set SUIT platform variant to Secure domain"

config SUIT_PLATFORM_VARIANT_APP
	bool "Set SUIT platform variant to application domain"

endchoice # SUIT_PLATFORM_VARIANT

if SUIT_DFU

choice SUIT_DFU_CANDIDATE_PROCESSING_LEVEL
	prompt "Select the level of SUIT candidate processing inside the user application"

config SUIT_DFU_CANDIDATE_PROCESSING_MINIMAL
	bool "Application defaults for minimal SUIT candidate processing"
	help
		This configuration can be used to allow update using SUIT when no interpretation
		of the SUIT envelope is needed by the local domain apart from basic format checking.
		This is equivalent to a situation where it is known that none of the manifests
		(the top manifest nor its dependencies) contains a suit-payload-fetch sequence.
		The only role of the application core is store the SUIT candidate envelope
		followed by passing the control to the Secure Domain.
	imply SUIT_ORCHESTRATOR_APP
	imply SUIT_ORCHESTRATOR_APP_CANDIDATE_PROCESSING
	imply SUIT_ENVELOPE_INFO
	imply SUIT_UTILS
	imply SUIT_METADATA
	imply SSF_SUIT_SERVICE_ENABLED
	imply SUIT_MPI_GENERATE

config SUIT_DFU_CANDIDATE_PROCESSING_FULL
	bool "Application defaults for support of full SUIT envelope processing by the local domain"
	help
		This configuration can be used if processing of the SUIT envelope is needed by the
		local domain. This is equivalent to a situation where one of the manifests
		(the top manifest or its dependencies) may contain a suit-payload-fetch sequence.
		Before passing control to the Secure Domain, the local domain implementation of
		the SUIT DFU module processes the envelope and fetches any additional needed
		data using the registered fetch sources.
	imply SUIT_ORCHESTRATOR_APP
	imply SUIT_ORCHESTRATOR_APP_CANDIDATE_PROCESSING
	imply SUIT_ENVELOPE_INFO
	imply SUIT_UTILS
	imply SUIT_DIGEST
	imply SUIT_CRYPTO
	imply SSF_SUIT_SERVICE_ENABLED
	imply SUIT_PLAT_CHECK_COMPONENT_COMPATIBILITY
	imply SUIT_PLAT_CHECK_CLASSES
	imply SUIT_METADATA
	imply SUIT_CHECK_IMAGE_MATCH
	imply SUIT_STREAM
	imply SUIT_STREAM_FETCH_SOURCE_MGR
	imply SUIT_STREAM_SOURCE_CACHE
	imply SUIT_STREAM_SOURCE_MEMPTR
	imply SUIT_STREAM_SINK_DIGEST
	imply SUIT_STREAM_SINK_MEMPTR
	imply SUIT_CACHE
	imply SUIT_CACHE_RW
	imply SUIT_STREAM_SINK_CACHE
	imply SUIT_STREAM_SINK_FLASH
	imply SUIT_MEMPTR_STORAGE
	imply SUIT_PLATFORM
	imply SUIT_PROCESSOR
	imply SUIT_MPI_GENERATE
	imply SUIT_SINK_SELECTOR

config SUIT_DFU_CANDIDATE_PROCESSING_NONE
	bool "Disable any processing of the SUIT candidate envelope"
	help
		If this configuration is used no processing of the SUIT envelope will be performed.
		It will not be possible to start the update from inside the application using the
		SUIT DFU API.
		In a general use case this Kconfig option will only be use for companion images
		used by the Secure Domain to fetch additional data with the use of the application
		core.
	imply SUIT_ORCHESTRATOR_APP
	imply SUIT_MPI_GENERATE

endchoice # SUIT_APP_ENVELOPE_PROCESSING_LEVEL

config SUIT_STREAMING_REQUESTS_FROM_SDFW_SUPPORT
	bool "Enable support for streaming requests coming from SDFW"
	help
		In some cases when the Secure Domain processes the SUIT manifests may need to fetch
		additional data from outside the device. As the Secure Domain does not have access
		to any transport it needs to communicate with an application (a "companion image")
		running on one of the local domains to fetch data.
		Setting this Kconfig option will enable all the modules needed for
		such a local domain application.
		The implementer of this application needs to initialize the needed subsystems
		using suit_dfu_initialize and register transports as fetch sources.
	imply SUIT_ORCHESTRATOR_APP
	imply SUIT_UTILS
	imply SUIT_METADATA
	imply SSF_SUIT_SERVICE_ENABLED
	imply SUIT_STREAM_FETCH_SOURCE_MGR
	imply SUIT_STREAM_SOURCE_IPC
	imply SUIT_STREAM
	imply SUIT_STREAM_IPC_PROVIDER

endif # SUIT_DFU

config SUIT_ENABLE_DEFAULTS_SDFW
	bool "SDFW SUIT defaults"
	imply SUIT_CRYPTO
	imply SUIT_DEVCONFIG
	imply SUIT_PLAT_CHECK_COMPONENT_COMPATIBILITY
	imply SUIT_PLAT_CHECK_CLASSES
	imply SUIT_AUTHENTICATE
	imply SUIT_DIGEST
	imply SUIT_DIGEST_CACHE
	imply SUIT_CHECK_IMAGE_MATCH
	imply SUIT_MCI
	imply SUIT_METADATA
	imply SUIT_ORCHESTRATOR
	imply SUIT_PLATFORM
	imply SUIT_STREAM
	imply SUIT_STREAM_SINK_MEMPTR
	imply SUIT_STREAM_SINK_FLASH
	imply SUIT_STREAM_SINK_DIGEST
	imply SUIT_STREAM_SINK_RAM
	imply SUIT_STREAM_SINK_SDFW
	imply SUIT_STREAM_SINK_SDFW_RECOVERY
	imply SUIT_STREAM_SOURCE_CACHE
	imply SUIT_STREAM_SOURCE_MEMPTR
	imply SUIT_STREAM_SOURCE_IPC
	imply SUIT_STREAM_IPC_REQUESTOR
	imply SUIT_MEMPTR_STORAGE
	imply SUIT_UTILS
	imply SUIT_CACHE
	imply SUIT_STORAGE
	imply SUIT_SINK_SELECTOR
	imply SUIT_EXECUTION_MODE
	imply SUIT_UPDATE_REBOOT_ENABLED
	imply SUIT_BOOT_RECOVERY_REBOOT_ENABLED

config SUIT_ENABLE_DEFAULTS_SDFW_EXTMEM
	bool "SDFW SUIT defaults with external flash support"
	depends on SUIT_PLATFORM_VARIANT_SDFW
	imply SUIT_STREAM_SOURCE_EXTMEM
	imply SUIT_STREAM_SINK_EXTMEM
	imply SSF_EXTMEM_SERVICE_ENABLED

rsource "cache/Kconfig"
rsource "mci/Kconfig"
rsource "metadata/Kconfig"
rsource "storage/Kconfig"
rsource "orchestrator/Kconfig"
rsource "orchestrator_app/Kconfig"
rsource "memptr_storage/Kconfig"
rsource "platform/Kconfig"
rsource "stream/Kconfig"
rsource "utils/Kconfig"
rsource "envelope_info/Kconfig"
rsource "execution_mode/Kconfig"
rsource "memory_layout/Kconfig"

# Configure SUIT_LOG_LEVEL
module = SUIT
module-str = Software Updates for Internet of Things
source "${ZEPHYR_BASE}/subsys/logging/Kconfig.template.log_config"

endif # SUIT
```

## subsys/suit/app_tools/Kconfig
```kconfig
#
# Copyright (c) 2024 Nordic Semiconductor ASA
#
# SPDX-License-Identifier: LicenseRef-Nordic-5-Clause
#

config SUIT_INVOKE_APP_LOCAL_3_BEFORE_MAIN_APP
	bool "Run recovery before main application on startup"
	help
	  This Kconfig option should be set if the app_local_3 manifest application should be invoked
	  on startup before the main application.
	  This is useful if a companion image (most commonly the same iamge as the recovery application
	  core image) is to be used for checking conditions (such as checking
	  if a button is pressed) and optionally entering the recovery mode.

rsource "recovery_button/Kconfig"
```

## subsys/suit/app_tools/recovery_button/Kconfig
```kconfig
#
# Copyright (c) 2024 Nordic Semiconductor ASA
#
# SPDX-License-Identifier: LicenseRef-Nordic-5-Clause
#

DT_CHOSEN_NCS_RECOVERY_BUTTON := ncs,recovery-button

config SUIT_RECOVERY_BUTTON
	bool "Enable SUIT enter recovery button checking on startup"
	depends on $(dt_chosen_enabled,$(DT_CHOSEN_NCS_RECOVERY_BUTTON))
	default y
	select SSF_SUIT_SERVICE_ENABLED
	select SUIT_INVOKE_APP_LOCAL_3_BEFORE_MAIN_APP
	help
	  This will make the firmware check if the recovery button specified in the
	  device tree is pressed on startup. If it is, the firmware will enter
	  the "foreground update mode", in which the same SUIT manifests are booted
	  as in case of the recovery mode.

config SUIT_RECOVERY_BUTTON_INIT_PRIORITY
	int "SUIT recovery button checking initialization priority"
	default 49
	help
	  Make sure this is larger than SSF_CLIENT_SYS_INIT_PRIORITY
	  and smaller than SPI_INIT_PRIORITY and MSPI_INIT_PRIORITY.
```

## subsys/suit/cache/Kconfig
```kconfig
#
# Copyright (c) 2023 Nordic Semiconductor ASA
#
# SPDX-License-Identifier: LicenseRef-Nordic-5-Clause
#

menuconfig SUIT_CACHE
	bool "Enable SUIT cache support library"
	depends on ZCBOR
	imply SUIT_STREAM_SINK_RAM
	imply SUIT_STREAM

if SUIT_CACHE

config SUIT_CACHE_MAX_CACHES
	int "The maximum number of caches that will be handled"
	range 1 16
	default 8
	help
	  The maximum number of user-defined caches is limited to 15.
	  User defined cache partitions names start at index 1 as suit_cache_0 is predefined.
	  The default value is 8, and the minimum is 1.

config APP_LINK_WITH_SUIT_CACHE_INTERFACE
	bool
	default y

config SUIT_MAX_URI_LENGTH
	int "The maximum number of characters in uri used in fetch operations"
	range 1 512
	default 128
	help
	  This option determines the longest URI that can be read or written from
	  the cache.

config SUIT_CACHE_RW
	bool "Enable write mode for SUIT cache"
	depends on FLASH
	depends on SUIT_UTILS
	depends on !SUIT_PLATFORM_VARIANT_SDFW

config SUIT_CACHE_SDFW_IPUC_ID
	int "IPUC-based parition number, capable of performing SDFW updates"
	depends on SUIT_CACHE_RW
	depends on FLASH_IPUC
	default 254

config SUIT_CACHE_APP_IPUC_ID
	int "IPUC-based parition number, without address restrictions"
	depends on SUIT_CACHE_RW
	depends on FLASH_IPUC
	default 255

endif # SUIT_CACHE
```

## subsys/suit/envelope_info/Kconfig
```kconfig
#
# Copyright (c) 2024 Nordic Semiconductor ASA
#
# SPDX-License-Identifier: LicenseRef-Nordic-5-Clause
#

config SUIT_ENVELOPE_INFO
	bool "SUIT envelope info module"
```

## subsys/suit/events/Kconfig
```kconfig
#
# Copyright (c) 2024 Nordic Semiconductor ASA
#
# SPDX-License-Identifier: LicenseRef-Nordic-5-Clause
#

config SUIT_EVENTS
	bool "Enable SUIT events module"
	select EVENTS

if SUIT_EVENTS

config APP_LINK_WITH_SUIT_EVENTS
	bool
	default y

endif # SUIT_EVENTS
```

## subsys/suit/execution_mode/Kconfig
```kconfig
#
# Copyright (c) 2024 Nordic Semiconductor ASA
#
# SPDX-License-Identifier: LicenseRef-Nordic-5-Clause
#

config SUIT_EXECUTION_MODE
	bool "Enable SUIT execution mode module"
	depends on SUIT_METADATA

config APP_LINK_WITH_SUIT_EXECUTION_MODE
	bool
	default y
```

## subsys/suit/ipuc/Kconfig
```kconfig
#
# Copyright (c) 2025 Nordic Semiconductor ASA
#
# SPDX-License-Identifier: LicenseRef-Nordic-5-Clause
#

config SUIT_IPUC
	bool "Enable in-place updateable components"
	depends on SUIT_METADATA
	help
	  SUIT manifest may instruct the platform that component is inactive, by overriding
	  image-size parameter with value 0. Such component may be updated in place,
	  also memory associated to such component may be utilized for other purposes.

if SUIT_IPUC

choice SUIT_IPUC_IMPL
	prompt "Implementation selection"
	default SUIT_IPUC_IMPL_SDFW if SUIT_PLATFORM_VARIANT_SDFW
	default SUIT_IPUC_IMPL_IPC if SUIT_PLATFORM_VARIANT_APP

config SUIT_IPUC_IMPL_SDFW
	bool "SDFW"
	depends on SUIT_PLATFORM_VARIANT_SDFW

config SUIT_IPUC_IMPL_IPC
	bool "IPC"
	depends on SUIT_PLATFORM_VARIANT_APP
	depends on SSF_SUIT_SERVICE_ENABLED

endchoice

if SUIT_IPUC_IMPL_SDFW

config SUIT_IPUC_SIZE
	int "Maximum number of supported in-place updateable components"
	default 8

endif

endif
```

## subsys/suit/manifest_variables/Kconfig
```kconfig
#
# Copyright (c) 2024 Nordic Semiconductor ASA
#
# SPDX-License-Identifier: LicenseRef-Nordic-5-Clause
#

config SUIT_MANIFEST_VARIABLES
	bool "Enable SUIT manifest-accessible variables support"

if SUIT_MANIFEST_VARIABLES

choice SUIT_MANIFEST_VARIABLES_IMPL
	prompt "Implementation selection"
	default SUIT_MANIFEST_VARIABLES_IMPL_SDFW if SUIT_PLATFORM_VARIANT_SDFW
	default SUIT_MANIFEST_VARIABLES_IMPL_IPC if SUIT_PLATFORM_VARIANT_APP

config SUIT_MANIFEST_VARIABLES_IMPL_SDFW
	bool "SDFW"
	depends on SUIT_STORAGE

config SUIT_MANIFEST_VARIABLES_IMPL_IPC
	bool "IPC"
	depends on SSF_SUIT_SERVICE_ENABLED

endchoice

# Manifest-controlled, NVM-stored variable.
# Can be modified by Application, Radio Manifests
# and by IPC clients running on Application and Radio Domains.

config SUIT_MANIFEST_VARIABLES_NVM_BASE_ID
	int
	default 0

config SUIT_MANIFEST_VARIABLES_NVM_COUNT
	int
	default 8

config SUIT_MANIFEST_VARIABLES_NVM_ACCESS_MASK
	hex
	default 0x0D

# Platform-controlled, RAM-stored variable.
# Manifests and IPC clients are not allowed to modify it.

config SUIT_MANIFEST_VARIABLES_PLAT_VOLATILE_BASE_ID
	int
	default 128

config SUIT_MANIFEST_VARIABLES_PLAT_VOLATILE_COUNT
	int
	default 2

config SUIT_MANIFEST_VARIABLES_PLAT_VOLATILE_ACCESS_MASK
	hex
	default 0x00

# Manifest-controlled, RAM-stored variable.
# Can be modified by Application and Radio Manifests.
# IPC clients are not allowed to modify it.

config SUIT_MANIFEST_VARIABLES_MFST_VOLATILE_BASE_ID
	int
	default 256

config SUIT_MANIFEST_VARIABLES_MFST_VOLATILE_COUNT
	int
	default 4

config SUIT_MANIFEST_VARIABLES_MFST_VOLATILE_ACCESS_MASK
	hex
	default 0x0C

endif
```
