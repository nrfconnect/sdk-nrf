## subsys/shell/Kconfig
```kconfig
#
# Copyright (c) 2019 Nordic Semiconductor
#
# SPDX-License-Identifier: LicenseRef-Nordic-5-Clause
#

menuconfig SHELL_BT_NUS
	bool
	prompt "Shell Bluetooth NUS transport"
	depends on BT
	select SHELL
	select BT_NUS
	select RING_BUFFER
	help
	  Enable shell BT NUS transport.

if SHELL_BT_NUS

module = SHELL_BT_NUS
module-str = Shell over Bluetooth NUS
source "${ZEPHYR_BASE}/subsys/logging/Kconfig.template.log_config"

default-timeout = 100
source "${ZEPHYR_BASE}/subsys/shell/Kconfig.template.shell_log_queue_timeout"

default-size = 10
source "${ZEPHYR_BASE}/subsys/shell/Kconfig.template.shell_log_queue_size"

choice
	prompt "Initial log level limit"
	default SHELL_BT_NUS_INIT_LOG_LEVEL_WRN

config SHELL_BT_NUS_INIT_LOG_LEVEL_DEFAULT
	bool "System limit (LOG_MAX_LEVEL)"

config SHELL_BT_NUS_INIT_LOG_LEVEL_DBG
	bool "Debug"

config SHELL_BT_NUS_INIT_LOG_LEVEL_INF
	bool "Info"

config SHELL_BT_NUS_INIT_LOG_LEVEL_WRN
	bool "Warning"

config SHELL_BT_NUS_INIT_LOG_LEVEL_ERR
	bool "Error"

config SHELL_BT_NUS_INIT_LOG_LEVEL_NONE
	bool "None"

endchoice

config SHELL_BT_NUS_INIT_LOG_LEVEL
	int
	default 0 if SHELL_BT_NUS_INIT_LOG_LEVEL_NONE
	default 1 if SHELL_BT_NUS_INIT_LOG_LEVEL_ERR
	default 2 if SHELL_BT_NUS_INIT_LOG_LEVEL_WRN
	default 3 if SHELL_BT_NUS_INIT_LOG_LEVEL_INF
	default 4 if SHELL_BT_NUS_INIT_LOG_LEVEL_DBG
	default 5 if SHELL_BT_NUS_INIT_LOG_LEVEL_DEFAULT

config SHELL_BT_NUS_TX_RING_BUFFER_SIZE
	int "Set TX ring buffer size"
	default 32
	help
	  Should be increased if long MTU is used since it allows to transfer
	  data in bigger chunks (up to size of the ring buffer).

config SHELL_BT_NUS_RX_RING_BUFFER_SIZE
	int "Set RX ring buffer size"
	default 32
	help
	  RX ring buffer size impacts accepted latency of handling incoming
	  bytes by shell. If shell input is coming from the keyboard then it is
	  usually enough if ring buffer is few bytes (more than one due to
	  escape sequences). However, if bulk data is transferred it may be
	  required to increase it.

endif #SHELL_BT_NUS

menuconfig SHELL_IPC
	bool "Shell IPC transport"
	depends on IPC_SERVICE
	select RING_BUFFER
	help
	  Enable Shell IPC transport

if SHELL_IPC

config SHELL_PROMPT_IPC
	string "Displayed prompt name"
	default "remote_cpu:~$ "
	help
	  Displayed prompt name for IPC service backend.

config SHELL_IPC_ENDPOINT_NAME
	string "Shell IPC Service endpoint name"
	default "remote shell"
	help
	  Shell IPC Service endpoint name

config SHELL_IPC_BACKEND_RX_RING_BUFFER_SIZE
	int "Set RX ring buffer size"
	default 64
	help
	  RX ring buffer size impacts accepted latency of handling incoming
	  bytes by shell. If shell input is coming from the keyboard then it is
	  usually enough if ring buffer is few bytes (more than one due to
	  escape sequences). However, if bulk data is transferred it may be
	  required to increase it.

choice
	prompt "Initial log level limit"
	default SHELL_IPC_INIT_LOG_LEVEL_DEFAULT

config SHELL_IPC_INIT_LOG_LEVEL_DEFAULT
	bool "System limit (LOG_MAX_LEVEL)"

config SHELL_IPC_INIT_LOG_LEVEL_DBG
	bool "Debug"

config SHELL_IPC_INIT_LOG_LEVEL_INF
	bool "Info"

config SHELL_IPC_INIT_LOG_LEVEL_WRN
	bool "Warning"

config SHELL_IPC_INIT_LOG_LEVEL_ERR
	bool "Error"

config SHELL_IPC_INIT_LOG_LEVEL_NONE
	bool "None"

endchoice

config SHELL_IPC_INIT_LOG_LEVEL
	int
	default 0 if SHELL_IPC_INIT_LOG_LEVEL_NONE
	default 1 if SHELL_IPC_INIT_LOG_LEVEL_ERR
	default 2 if SHELL_IPC_INIT_LOG_LEVEL_WRN
	default 3 if SHELL_IPC_INIT_LOG_LEVEL_INF
	default 4 if SHELL_IPC_INIT_LOG_LEVEL_DBG
	default 5 if SHELL_IPC_INIT_LOG_LEVEL_DEFAULT

module = SHELL_IPC
module-str = Shell over the IPC Service
source "${ZEPHYR_BASE}/subsys/logging/Kconfig.template.log_config"

default-timeout = 100
source "${ZEPHYR_BASE}/subsys/shell/Kconfig.template.shell_log_queue_timeout"

default-size = 10
source "${ZEPHYR_BASE}/subsys/shell/Kconfig.template.shell_log_queue_size"

endif #SHELL_IPC

menuconfig SHELL_NFC
	bool "Shell NFC transport"
	depends on NFC_T4T_NRFXLIB
	help
	  Enable NFC T4T ISO-DEP transport layer for shell interface.

if SHELL_NFC

config SHELL_NFC_INIT_PRIORITY
	int "Initialization priority"
	default 0
	range 0 99
	help
	  Initialization priority for NFC backend.

config SHELL_NFC_BACKEND_TX_BUFFER
	int "NFC Tx buffer size"
	default 255
	help
	  Set the NFC ISO-DEP response buffer size. The response buffer size might vary on the
	  NFC Reader device maximum supported frame size. Its size can be
	  SHELL_NFC_BACKEND_TX_RING_BUFFER_SIZE + 1. One byte is used for a packet header.

config SHELL_NFC_BACKEND_TX_RING_BUFFER_SIZE
	int "Shell Tx ring buffer size"
	default 254
	help
	  Set the shell Tx ring buffer size. It collects data from the shell and passes it to the
	  transport interface. It can be increased to transfer data in bigger chunks. To achieve the
	  higher data throughput, the SHELL_NFC_BACKEND_TX_BUFFER Kconfig option must be increased
	  together with it.

config SHELL_NFC_BACKEND_RX_RING_BUFFER_SIZE
	int "Shell Rx ring buffer size"
	default 32
	help
	  RX ring buffer size impacts accepted latency of handling incoming
	  bytes by shell. If shell input is coming from the keyboard then it is
	  usually enough if ring buffer is few bytes (more than one due to
	  escape sequences). However, if bulk data is transferred it may be
	  required to increase it.

choice
	prompt "Initial log level limit"
	default SHELL_NFC_INIT_LOG_LEVEL_NONE

config SHELL_NFC_INIT_LOG_LEVEL_DEFAULT
	bool "System limit (LOG_MAX_LEVEL)"

config SHELL_NFC_INIT_LOG_LEVEL_DBG
	bool "Debug"

config SHELL_NFC_INIT_LOG_LEVEL_INF
	bool "Info"

config SHELL_NFC_INIT_LOG_LEVEL_WRN
	bool "Warning"

config SHELL_NFC_INIT_LOG_LEVEL_ERR
	bool "Error"

config SHELL_NFC_INIT_LOG_LEVEL_NONE
	bool "None"

endchoice

config SHELL_NFC_INIT_LOG_LEVEL
	int
	default 0 if SHELL_NFC_INIT_LOG_LEVEL_NONE
	default 1 if SHELL_NFC_INIT_LOG_LEVEL_ERR
	default 2 if SHELL_NFC_INIT_LOG_LEVEL_WRN
	default 3 if SHELL_NFC_INIT_LOG_LEVEL_INF
	default 4 if SHELL_NFC_INIT_LOG_LEVEL_DBG
	default 5 if SHELL_NFC_INIT_LOG_LEVEL_DEFAULT

module = SHELL_NFC
module-str = Shell over the NFC T4T ISO-DEP
source "${ZEPHYR_BASE}/subsys/logging/Kconfig.template.log_config"

default-timeout = 100
source "${ZEPHYR_BASE}/subsys/shell/Kconfig.template.shell_log_queue_timeout"

default-size = 10
source "${ZEPHYR_BASE}/subsys/shell/Kconfig.template.shell_log_queue_size"


endif # SHELL_NFC
```

## subsys/sm_ipt/Kconfig
```kconfig
#
# Copyright (c) 2021 Nordic Semiconductor
#
# SPDX-License-Identifier: LicenseRef-Nordic-5-Clause
#

menu "SM IPT (Shared Memory Inter-Processor Transport) library"

if SM_IPT

module = SM_IPT_OS
module-str = SM IPT OS
source "${ZEPHYR_BASE}/subsys/logging/Kconfig.template.log_config"

endif # SM_IPT

endmenu
```

## subsys/spm/Kconfig
```kconfig
#
# Copyright (c) 2019 Nordic Semiconductor ASA
#
# SPDX-License-Identifier: LicenseRef-Nordic-5-Clause
#

menu "SPM"

config SPM
	bool "Use Secure Partition Manager [DEPRECATED]"
	depends on !BUILD_WITH_TFM
	select FW_INFO
	select ENTROPY_CC3XX
	select NRF_SOC_SECURE_SUPPORTED
	imply ARM_FIRMWARE_USES_SECURE_ENTRY_FUNCS if SPM_SECURE_SERVICES

if SPM
module=SPM
source "${ZEPHYR_BASE}/../nrf/subsys/partition_manager/Kconfig.template.build_strategy"

config SPM_NS_DEBUG_LOGS_DUMP
	bool "Enable dumping non-secure logs on secure fault"
	depends on SPM_SERVICE_NS_HANDLER_FROM_SPM_FAULT
	help
	  When enabled secure fault handler is calling a non-secure handler to
	  synchronously dump all pending logs. Feature is only for debugging
	  purposes and is considered a security violation. It requires specific
	  spm configuration with SPM_SHARE_CONSOLE_UART and
	  SPM_SERVICE_NS_HANDLER_FROM_SPM_FAULT enabled.

endif


menuconfig IS_SPM
	bool "Current app is SPM"
	default n
	select TRUSTED_EXECUTION_SECURE

if IS_SPM

config SPM_MIN_PARTITION_SIZE
	bool "Use minimimal partition size for SPM"

# Define used by partition_manager.py to deduce size of partition.
# Unable to use the size template due to non-trivial defaults.
config PM_PARTITION_SIZE_SPM
	hex "Flash space reserved for SPM"
	default 0x8000 if SPM_MIN_PARTITION_SIZE
	default 0x10000
	help
	  Flash space set aside for the SPM. Note, the name
	  of this configuration needs to match the requirements set by the
	  script 'partition_manager.py'. See pm.yml.

config PM_PARTITION_SIZE_SPM_SRAM
	hex "RAM reserved for SPM"
	default 0 if !SPM_SECURE_SERVICES
	default 0x8000
	help
	  RAM area set aside for the SPM.

config SPM_BOOT_SILENTLY
	bool "Boot silently"
	default n

config SPM_SHARE_CONSOLE_UART
	bool "Enable sharing console between domains"
	help
	  When enabled, UARTE0 can be used for printing from secure domain
	  after jumping to the non-secure application, e.g. from exception
	  handler. If enabled, zephyr console must be changed do spm_uart.

endif #IS_SPM

if IS_SPM || SPM
config SPM_SECURE_SERVICES
	bool "Enable secure services"
	default y if SPM
	select ARM_FIRMWARE_HAS_SECURE_ENTRY_FUNCS if IS_SPM
	select ARM_FIRMWARE_USES_SECURE_ENTRY_FUNCS if SPM
	help
	  Secure services can be invoked from the Non-Secure Firmware via
	  secure entry functions.
	  Note: Please set this and SPM_SERVICE_* configs from the app, instead
	  of the SPM. This ensures that the values are in sync between the two
	  images.
endif #IS_SPM || SPM

if SPM_SECURE_SERVICES
config SPM_SERVICE_RNG
	bool "Request random numbers"
	default y if SPM
	select NORDIC_SECURITY_BACKEND if IS_SPM

	help
	  The Non-Secure Firmware is not allowed to use the crypto hardware.
	  This service allows it to request random numbers from the SPM.

config SPM_SERVICE_READ
	bool "Read from memory"
	default y if SPM
	help
	  The Non-Secure Firmware is not allowed to read the memory
	  marked as secure. This service allows it to request random
	  read operations within the ranges configured in
	  secure_services.c.

config SPM_SERVICE_REBOOT
	bool "Enable system reset as a secure service"
	default n
	select REBOOT
	help
	  If Non-Secure Firmware is blocked from issuing system reset, this
	  service will allow it to issue a request to do a system reset through
	  a secure service.

config SPM_SERVICE_FIND_FIRMWARE_INFO
	bool "Find firmware info"
	default y if SPM
	help
	  The Non-Secure Firmware is not allowed to read the memory
	  marked as secure. This service allows it to request firmware info
	  about image stored at a given address.

config SPM_SERVICE_S0_ACTIVE
	bool "Enable secure service to check if S0 is active B1 slot"

config SPM_SERVICE_PREVALIDATE
	bool "Prevalidate B1 upgrades (Requires Immutable Bootloader)"
	default n
	select SECURE_BOOT_CRYPTO if IS_SPM
	select SECURE_BOOT_VALIDATION if IS_SPM
	select BL_VALIDATE_FW_EXT_API_ATLEAST_OPTIONAL if IS_SPM
	help
	  The B0 bootloader allows calls into it for prevalidating upgrades of
	  the stage it verifies. The B0 bootloader is in secure memory, so this
	  secure service is needed for the app to access the prevalidation
	  function.

config SPM_SERVICE_BUSY_WAIT
	bool "Busy wait in secure mode (debug function)"
	default y if TEST && SPM
	default n
	help
	  Busy wait in secure mode. Will keep the CPU in secure mode for the
	  duration specified. Use to write tests that require secure mode.

config SPM_SERVICE_NS_HANDLER_FROM_SPM_FAULT
	bool "Call non-secure handler from secure fault context"
	help
	  When enabled, non-secure handler is called from spm fatal error
	  handler. Non-secure handler is registered through secure service API.

if SPM_SERVICE_NS_HANDLER_FROM_SPM_FAULT
comment "*** WARNING ***"
comment "SPM_SERVICE_NS_HANDLER_FROM_SPM_FAULT can only be used for debugging"
endif

endif # SPM_SECURE_SERVICES

if IS_SPM

config SPM_BLOCK_NON_SECURE_RESET
	bool "Block system reset calls from Non-Secure domain"
	default n #FIXME: Remove mention of debugger with regards to reboot in help text when NRF91-313 has been resolved
	help
	  This will block the application running in Non-Secure from being able
	  to issue a system reset of the chip without going through a secure
	  service. If not enabled, a debugger will not be able to issue a
	  system reset while the core is executing Non-Secure code.


config NRF_RTC_TIMER
	depends on NRF_RTC1_SECURE
	help
	  RTC1 cannot be used the system clock driver for SPM if it is not Secure

config CORTEX_M_SYSTICK
	default y if !NRF_RTC1_SECURE
	help
	  Use the Cortex-M SYSTICK timer as the system clock driver since RTC1 is Non-Secure


config NRF_UARTE2_SECURE
	bool
	default y

config NRF_DCNF_SECURE
	bool
	default y

config NRF_CTRLAP_SECURE
	bool
	default y

endif # IS_SPM

# Set new default name for the veneers file.

if ARM_FIRMWARE_USES_SECURE_ENTRY_FUNCS
config ARM_ENTRY_VENEERS_LIB_NAME
	string "Entry Veneers symbol file"
	default "spm/libspmsecureentries.a"
endif

if ARM_FIRMWARE_HAS_SECURE_ENTRY_FUNCS
config ARM_ENTRY_VENEERS_LIB_NAME
	string "Entry Veneers symbol file"
	default "libspmsecureentries.a"
endif

endmenu # SPM
```
