## subsys/suit/storage/Kconfig
```kconfig
#
# Copyright (c) 2023 Nordic Semiconductor ASA
#
# SPDX-License-Identifier: LicenseRef-Nordic-5-Clause
#

menuconfig SUIT_STORAGE
	bool "Enable SUIT storage module"
	depends on ZCBOR
	depends on ZCBOR_CANONICAL
	depends on SUIT_METADATA
	depends on SUIT_UTILS
	depends on FLASH
	depends on SUIT_PLATFORM_VARIANT_SDFW

if SUIT_STORAGE

config SUPPORT_SUIT_STORAGE_LAYOUT_SOC
	bool
	default y if SOC_SERIES_NRF54HX || SOC_SERIES_NRF92X

config SUPPORT_SUIT_STORAGE_LAYOUT_TEST
	bool

choice SUIT_STORAGE_LAYOUT
	prompt "MCU-specific layout of the SUIT storage"
	default SUIT_STORAGE_LAYOUT_SOC if SUPPORT_SUIT_STORAGE_LAYOUT_SOC
	default SUIT_STORAGE_LAYOUT_TEST if SUPPORT_SUIT_STORAGE_LAYOUT_TEST

config SUIT_STORAGE_LAYOUT_SOC
	bool "SoC default"
	depends on SUPPORT_SUIT_STORAGE_LAYOUT_SOC
	select PSA_WANT_ALG_SHA_256 if SUIT_CRYPTO

config SUIT_STORAGE_LAYOUT_TEST
	bool "Tests"
	depends on SUPPORT_SUIT_STORAGE_LAYOUT_TEST
	help
	  Configuration to be used for running SUIT tests

endchoice # SUIT_STORAGE_LAYOUT

config SUIT_STORAGE_N_UPDATE_REGIONS
	int "Maximum number of memory regions, describing the update candidate"
	default 7
	help
	  The memory region may describe SUIT envelope as well as the SUIT cache.

config SUIT_STORAGE_N_ENVELOPES
	int "Number of envelopes, possible to store in SUIT storage"
	default 11 if SOC_SERIES_NRF54HX
	default 13 if SOC_SERIES_NRF92X
	default 5 if SOC_NRF52840
	default 5 if SOC_POSIX
	help
	  Since it is not supported to reserve more memory after the device
	  is deployed, use larger value than it is necessary.

	  For nRF54H20 the following envelopes may be defined:
	    - Nordic Top
	    - SecDom: firmware + recovery
	    - SysCtlr: firmware
	    - Radio: recovery
	    - Radio: firmware (A)
	    - Radio: firmware (B)
	    - ROOT
	    - Application: recovery
	    - Application: firmware (A)
	    - Application: firmware (B)
	    - Application: user data

	  For debug and test platforms (POSIX, nRF52840) the following envelopes may be defined:
	    - ROOT
	    - Application: recovery
	    - Application: firmware (A)
	    - Application: firmware (B)
	    - Application: user data

config SUIT_STORAGE_ENVELOPE_SIZE
	int "The maximum size of envelope that can be stored in a single SUIT storage slot"
	default 2048

config SUIT_STORAGE_CONFIG_SIZE
	int "The size of the SUIT configuration area, stored inside the SUIT storage partition"
	default 128

endif # SUIT_STORAGE
```

## subsys/suit/stream/Kconfig
```kconfig
#
# Copyright (c) 2023 Nordic Semiconductor ASA
#
# SPDX-License-Identifier: LicenseRef-Nordic-5-Clause
#

menuconfig SUIT_STREAM
	bool "Enable SUIT stream module"

if SUIT_STREAM

config SUIT_STREAM_SINK_COMPONENT_MEM_SUPPORTED
	bool
	help
	  Helper symbol indicating that a sink backend
	  for MEM component is implemented.

config SUIT_STREAM_SINK_CACHE
	bool "Enable SUIT cache sink"
	depends on SUIT_CACHE_RW
	depends on SUIT_STREAM_SINK_FLASH

config SUIT_STREAM_SINK_MEMPTR
	bool "Enable memory pointer storage sink"
	depends on SUIT_MEMPTR_STORAGE

config SUIT_STREAM_SINK_FLASH
	bool "Enable NVM storage sink"
	depends on FLASH
	depends on SUIT_UTILS
	depends on SUIT_MEMPTR_STORAGE
	select SUIT_STREAM_SINK_COMPONENT_MEM_SUPPORTED

config SUIT_STREAM_SINK_RAM
	bool "Enable RAM buffer sink"
	select SUIT_STREAM_SINK_COMPONENT_MEM_SUPPORTED

config SUIT_STREAM_SINK_EXTMEM
	bool "Enable external memory sink"
	select SUIT_STREAM_SINK_COMPONENT_MEM_SUPPORTED

menuconfig SUIT_STREAM_SINK_SDFW
	bool "Enable SDFW sink"
	depends on SUIT_UTILS
	depends on SOC_SERIES_NRF54HX
	select PSA_WANT_ALG_SHA_512
	select SUIT_STREAM_SINK_DIGEST

if SUIT_STREAM_SINK_SDFW

config SUIT_SDFW_UPDATE_SIGNED_MANIFEST_OFFSET
	hex "Offset between start of the SDFW update candidate image and Signed Manifest section"
	default 0

config SUIT_SDFW_UPDATE_DIGEST_OFFSET
	hex "Offset between start of the SDFW update candidate image and SM.TBS.FW.DIGEST section"
	default 0x20

config SUIT_SDFW_UPDATE_PUBLIC_KEY_OFFSET
	hex "Offset between start of the SDFW update candidate image and Public Key section"
	default 0x100

config SUIT_SDFW_UPDATE_SIGNATURE_OFFSET
	hex "Offset between start of the SDFW update candidate image and Signature section"
	default 0x120

config SUIT_SDFW_UPDATE_FIRMWARE_OFFSET
	hex "Offset between start of the SDFW update candidate image and Firmware section"
	default 0x160

config SUIT_SDFW_UPDATE_MAX_SIZE
	hex "Maximum size of SDFW update"
	range 0x00000080 0x000FD000
	default 0x000FD000
	help
	  Range is based on documentation of register UROT.SM.TBS.LAYOUT.USLOT.MAX

endif # SUIT_STREAM_SINK_SDFW

menuconfig SUIT_STREAM_SINK_SDFW_RECOVERY
	bool "Enable SDFW Recovery sink"
	depends on SUIT_UTILS
	depends on SOC_SERIES_NRF54HX
	select PSA_WANT_ALG_SHA_512
	select SUIT_STREAM_SINK_DIGEST

if SUIT_STREAM_SINK_SDFW_RECOVERY

config SUIT_SDFW_RECOVERY_UPDATE_SIGNED_MANIFEST_OFFSET
	hex "Offset between start of the SDFW Recovery update candidate image and Signed Manifest section"
	default 0

config SUIT_SDFW_RECOVERY_UPDATE_DIGEST_OFFSET
	hex "Offset between start of the SDFW Recovery update candidate image and SM.TBS.FW.DIGEST section"
	default 0x20

config SUIT_SDFW_RECOVERY_UPDATE_PUBLIC_KEY_OFFSET
	hex "Offset between start of the SDFW Recovery update candidate image and Public Key section"
	default 0x100

config SUIT_SDFW_RECOVERY_UPDATE_SIGNATURE_OFFSET
	hex "Offset between start of the SDFW Recovery update candidate image and Signature section"
	default 0x120

config SUIT_SDFW_RECOVERY_UPDATE_FIRMWARE_OFFSET
	hex "Offset between start of the SDFW Recovery update candidate image and Firmware section"
	default 0x160

config SUIT_SDFW_RECOVERY_UPDATE_MAX_SIZE
	hex "Maximum size of SDFW Recovery update"
	range 0x00000080 0x000FD000
	default 0x000FD000
	help
	  Range is based on documentation of register UROT.SM.TBS.LAYOUT.RSLOT.MAX

endif # SUIT_STREAM_SINK_SDFW_RECOVERY

config SUIT_STREAM_SINK_DIGEST
	bool "Enable digest sink"
	select PSA_WANT_ALG_SHA_256 if SOC_FAMILY_NORDIC_NRF

if SUIT_STREAM_SINK_DIGEST
	config SUIT_STREAM_SINK_DIGEST_CONTEXT_COUNT
	int "Maximum number of contexts"
	default 1
endif # SUIT_STREAM_SINK_DIGEST

config SUIT_STREAM_SOURCE_CACHE
	bool "Enable SUIT cache source"
	depends on SUIT_CACHE

config SUIT_STREAM_SOURCE_MEMPTR
	bool "Enable memory pointer storage source"

config SUIT_STREAM_FETCH_SOURCE_MGR
	bool "Fetch source manager"

config SUIT_STREAM_FETCH_MAX_SOURCES
	int "The maximum number of fetch sources to be able to be registered by fetch source manager"
	default 3
	depends on SUIT_STREAM_FETCH_SOURCE_MGR

config SUIT_STREAM_SOURCE_EXTMEM
	bool "Enable external memory storage source"

config SUIT_STREAM_SOURCE_FLASH
	bool "Enable flash memory storage source"
	depends on FLASH

menuconfig SUIT_STREAM_SOURCE_IPC
	bool "Enable feeding images from external sources to SDFW"

if SUIT_STREAM_SOURCE_IPC

config SUIT_STREAM_IPC_REQUESTOR
	bool "Part of functionality executed in SDFW"

config SUIT_STREAM_IPC_REQUESTOR_MAX_CHUNKS
	int "The maximum number of image chunks simultaneously enqueable by requestor"
	default 3
	depends on SUIT_STREAM_IPC_REQUESTOR

config SUIT_STREAM_IPC_PROVIDER
	bool "Part of functionality executed on App Core"
	depends on SUIT_STREAM_FETCH_SOURCE_MGR

config SUIT_STREAM_IPC_PROVIDER_BUFFERS
	int "The number of buffers supported by provider. For optimal performance should be equal to CONFIG_SUIT_STREAM_IPC_REQUESTOR_MAX_CHUNKS"
	default 3
	depends on SUIT_STREAM_IPC_PROVIDER

config SUIT_STREAM_IPC_PROVIDER_BUFFER_SIZE
	int "Size of single buffer in bytes"
	default 8192
	depends on SUIT_STREAM_IPC_PROVIDER

config SUIT_STREAM_IPC_STREAMER_REQUESTING_PERIOD
	int "Image request repetition period in milliseconds"
	range 100 10000
	default 1000

config SUIT_STREAM_IPC_STREAMER_CHUNK_TIMEOUT
	int "Max streamer provider inactivity before timeout in milliseconds"
	range 1000 60000
	default 10000

endif # SUIT_STREAM_SOURCE_IPC

endif # SUIT_STREAM
```

## subsys/suit/utils/Kconfig
```kconfig
#
# Copyright (c) 2023 Nordic Semiconductor ASA
#
# SPDX-License-Identifier: LicenseRef-Nordic-5-Clause
#

config SUIT_UTILS
	bool "Enable SUIT utilities"
	depends on ZCBOR
	depends on ZCBOR_CANONICAL

if SUIT_UTILS

config APP_LINK_WITH_SUIT_UTILS
	bool
	default y if SUIT

endif # SUIT_UTILS
```

## subsys/suit/validator/Kconfig
```kconfig
#
# Copyright (c) 2024 Nordic Semiconductor ASA
#
# SPDX-License-Identifier: LicenseRef-Nordic-5-Clause
#

menuconfig SUIT_VALIDATOR
	bool "Enable SUIT validator module"
	depends on SUIT_METADATA

if SUIT_VALIDATOR

config SUPPORT_SUIT_VALIDATOR_IMPL_SDFW
	bool
	default y if (SOC_SERIES_NRF54HX || SOC_SERIES_NRF92X) && SUIT_PLATFORM_VARIANT_SDFW

choice SUIT_VALIDATOR_IMPL
	prompt "SUIT validator implementation"
	default SUIT_VALIDATOR_IMPL_SDFW if SUPPORT_SUIT_VALIDATOR_IMPL_SDFW
	default SUIT_VALIDATOR_IMPL_CUSTOM

config SUIT_VALIDATOR_IMPL_SDFW
	bool "Secure domain"
	depends on SUPPORT_SUIT_VALIDATOR_IMPL_SDFW

config SUIT_VALIDATOR_IMPL_CUSTOM
	bool "Custom"

endchoice # SUIT_VALIDATOR_IMPL

endif # SUIT_VALIDATOR
```

## subsys/tfm/Kconfig
```kconfig
#
# Copyright (c) 2020 Nordic Semiconductor ASA
#
# SPDX-License-Identifier: LicenseRef-BSD-5-Clause-Nordic
#

config PM_SINGLE_IMAGE
	bool
	default y if BUILD_WITH_TFM
```

## subsys/trusted_storage/Kconfig
```kconfig
#
# Copyright (c) 2018 - 2023 Nordic Semiconductor
#
# SPDX-License-Identifier: LicenseRef-Nordic-5-Clause
#

# Secure storage subsystem configuration options

menuconfig TRUSTED_STORAGE
	bool "Trusted Storage"
	depends on !BUILD_WITH_TFM
	help
	  The secure storage subsystem allows its users to store in a secure
	  way data ensuring data integrity and confidentially by using AEAD
	  algorithms. It supports several secure implementation back-ends to
	  provide various levels of trust depending on the device security
	  features.

if TRUSTED_STORAGE
module = TRUSTED_STORAGE
module-str = trusted_storage
source "subsys/logging/Kconfig.template.log_config"


menuconfig PSA_PROTECTED_STORAGE
	bool "Protected Storage"
	help
	  The Protected Storage is designed to store critical assets.
	  It supports several storage back-ends and several secure
	  implementation back-ends to provide various levels of trust.

if PSA_PROTECTED_STORAGE

config PSA_PROTECTED_STORAGE_PREFIX
	string "Protected Storage object prefix"
	default "ps"
	help
	  This defines the prefix for Protected Storage object names.

endif # PSA_PROTECTED_STORAGE

menuconfig PSA_INTERNAL_TRUSTED_STORAGE
	bool "Internal Trusted Storage"
	default y
	help
	  The Internal Trusted Storage is designed to store critcal assets that
	  must be placed inside internal flash. Some examples of assets that
	  require this are replay protection values for external storage and
	  keys for use by components of the PSA Root of Trust.

if PSA_INTERNAL_TRUSTED_STORAGE

config PSA_INTERNAL_TRUSTED_STORAGE_PREFIX
	string "Internal Trusted Storage object prefix"
	depends on PSA_INTERNAL_TRUSTED_STORAGE
	default "its"
	help
	  This defines the prefix for Internal Trusted Storage object names.

endif # PSA_INTERNAL_TRUSTED_STORAGE

choice TRUSTED_STORAGE_BACKEND
	prompt "Secure storage backend"
	default TRUSTED_STORAGE_BACKEND_AEAD
	help
	  The backend that handles encryption, authentication or other means of
	  validation of the stored assets.

menuconfig TRUSTED_STORAGE_BACKEND_AEAD
	bool "Use AEAD scheme"
	help
	  Use an AEAD scheme to encrypt the asset data and authenticate its
	  data including the meta data.

if TRUSTED_STORAGE_BACKEND_AEAD

config TRUSTED_STORAGE_BACKEND_AEAD_MAX_DATA_SIZE
	int "AEAD backend maximum storage size"
	default 256
	help
	  This defines the maximum data size that can be stored.

choice TRUSTED_STORAGE_BACKEND_AEAD_CRYPTO
	prompt "AEAD algorithm crypto backend"
	default TRUSTED_STORAGE_BACKEND_AEAD_CRYPTO_PSA_CHACHAPOLY
	help
	  Decides which implementation to be used to perform the AEAD crypto
	  operations.

config TRUSTED_STORAGE_BACKEND_AEAD_CRYPTO_PSA_CHACHAPOLY
	bool "PSA ChaChaPoly"
	select PSA_WANT_ALG_CHACHA20_POLY1305
	help
	  Use PSA Crypto API's with the ChaChaPoly-1305 AEAD algorithm.

endchoice # TRUSTED_STORAGE_BACKEND_AEAD_CRYPTO

choice TRUSTED_STORAGE_BACKEND_AEAD_NONCE
	prompt "AEAD nonce implementation"
	default TRUSTED_STORAGE_BACKEND_AEAD_NONCE_PSA_SEED_COUNTER
	help
	  Implementation to provide a AEAD nonce.

config TRUSTED_STORAGE_BACKEND_AEAD_NONCE_PSA_SEED_COUNTER
	bool "PSA Nonce Seed + Counter"
	select PSA_WANT_GENERATE_RANDOM
	help
	  Use PSA Crypto for Nonce initial random seed, then incrementing
	  nonce for each AEAD encryption.

config TRUSTED_STORAGE_BACKEND_AEAD_NONCE_CUSTOM
	bool "Custom"
	help
	  Use custom implementation for AEAD Nonce provider.

endchoice # TRUSTED_STORAGE_BACKEND_AEAD_NONCE

choice TRUSTED_STORAGE_BACKEND_AEAD_KEY
	prompt "AEAD Key implementation"
	default TRUSTED_STORAGE_BACKEND_AEAD_KEY_DERIVE_FROM_HUK
	help
	  Implementation to provide the AEAD keys.

config TRUSTED_STORAGE_BACKEND_AEAD_KEY_HASH_UID
	bool "Hash of UID"
	select PSA_WANT_ALG_SHA_256
	help
	  Use SHA-256 hash of UID as key, this option does not provide a very high
	  level of security and therefor is not recommended and should only be used
	  if it is impossible to use the HUK.

config TRUSTED_STORAGE_BACKEND_AEAD_KEY_DERIVE_FROM_HUK
	bool "HUK + UID"
	select HW_UNIQUE_KEY
	select HW_UNIQUE_KEY_RANDOM
	select PM_SINGLE_IMAGE
	depends on HW_UNIQUE_KEY_SUPPORTED
	help
	  Use the Hardware Unique Key (HUK) with the UID as label to derive a
	  new key.

config TRUSTED_STORAGE_BACKEND_AEAD_KEY_CUSTOM
	bool "Custom"
	help
	  Use custom implementation for AEAD key provider.

endchoice # TRUSTED_STORAGE_BACKEND_AEAD_KEY

endif # TRUSTED_STORAGE_BACKEND_AEAD

endchoice # TRUSTED_STORAGE_BACKEND

choice TRUSTED_STORAGE_STORAGE_BACKEND
	prompt "Storage backend"
	default TRUSTED_STORAGE_STORAGE_BACKEND_SETTINGS
	help
	  Implementation used to store the assets

config TRUSTED_STORAGE_STORAGE_BACKEND_SETTINGS
	bool "Settings storage backend"
	depends on SETTINGS_NVS
	help
	  Use the Settings subsystem with NVS to store the assets

config TRUSTED_STORAGE_STORAGE_BACKEND_CUSTOM
	bool "Custom storage backend"
	help
	  Use a custom-made backend to store data in the non-volatile memory.

endchoice # CONFIG_TRUSTED_STORAGE_STORAGE_BACKEND

endif # TRUSTED_STORAGE
```

## subsys/uart_async_adapter/Kconfig
```kconfig
#
# Copyright (c) 2024 Nordic Semiconductor
#
# SPDX-License-Identifier: LicenseRef-Nordic-5-Clause
#

menuconfig UART_ASYNC_ADAPTER
	bool "Enable UART async adapter [EXPERIMENTAL]"
	select EXPERIMENTAL
	select SERIAL_SUPPORT_ASYNC
	depends on SERIAL_SUPPORT_INTERRUPT
	help
	  Enables asynchronous adapter for UART drives that supports only
	  IRQ interface.

if UART_ASYNC_ADAPTER

module = UART_ASYNC_ADAPTER
module-str = UART Async Adapter
source "${ZEPHYR_BASE}/subsys/logging/Kconfig.template.log_config"

endif
```
