## subsys/suit/mci/Kconfig
```kconfig
#
# Copyright (c) 2023 Nordic Semiconductor ASA
#
# SPDX-License-Identifier: LicenseRef-Nordic-5-Clause
#

menuconfig SUIT_MCI
	bool "Enable SUIT Manifest Configuration Information module"
	depends on SUIT_METADATA
	depends on SUIT_EXECUTION_MODE

if SUIT_MCI

config SUPPORT_SUIT_MCI_IMPL_SDFW
	bool
	default y if (SOC_SERIES_NRF54HX || SOC_SERIES_NRF92X) && SUIT_PLATFORM_VARIANT_SDFW

choice SUIT_MCI_IMPL
	prompt "MCI implementation"
	default SUIT_MCI_IMPL_SDFW if SUPPORT_SUIT_MCI_IMPL_SDFW
	default SUIT_MCI_IMPL_CUSTOM

config SUIT_MCI_IMPL_SDFW
	bool "Secure domain"
	depends on SUPPORT_SUIT_MCI_IMPL_SDFW

config SUIT_MCI_IMPL_CUSTOM
	bool "Custom"

endchoice # SUIT_MCI_IMPL

endif # SUIT_MCI
```

## subsys/suit/memory_layout/Kconfig
```kconfig
#
# Copyright (c) 2024 Nordic Semiconductor ASA
#
# SPDX-License-Identifier: LicenseRef-Nordic-5-Clause
#

config SUIT_MEMORY_LAYOUT_EXTMEM_ADDRESS_RANGE_START
	hex
	default 0x60000000 if SOC_SERIES_NRF54HX
	default 0x12000000 if SOC_NRF52840
	default 0x0 if BOARD_NATIVE_POSIX
	help
	  Start address of the extended memory range.
	  This value is SOC specific and is not meant to be changed.

config SUIT_MEMORY_LAYOUT_EXTMEM_ADDRESS_RANGE_SIZE
	hex
	default 0x40000000 if SOC_SERIES_NRF54HX
	default 0x8000000 if SOC_NRF52840
	default 0x0 if BOARD_NATIVE_POSIX
	help
	  Size of the extended memory range.
	  This value is SOC specific and is not meant to be changed.
```

## subsys/suit/memptr_storage/Kconfig
```kconfig
#
# Copyright (c) 2023 Nordic Semiconductor ASA
#
# SPDX-License-Identifier: LicenseRef-Nordic-5-Clause
#

menuconfig SUIT_MEMPTR_STORAGE
	bool "Enable module for holding pointer to the memory"

if SUIT_MEMPTR_STORAGE

config SUIT_MAX_NUMBER_OF_INTEGRATED_PAYLOADS
	int "The maximum number of envelope reference components that will be handled"
	range 0 255
	help
		Index is of type uint8_t, which restricts number of components of this type to 255.
		Default value is 8 and minimal 0. Where 0 means that Envelope Reference component is disabled.
	default 8

endif # SUIT_MEMPTR_STORAGE
```

## subsys/suit/metadata/Kconfig
```kconfig
#
# Copyright (c) 2023 Nordic Semiconductor ASA
#
# SPDX-License-Identifier: LicenseRef-Nordic-5-Clause
#

menuconfig SUIT_METADATA
	bool "Enable SUIT Manifest Metadata types and conversion utilities"

if SUIT_METADATA

config APP_LINK_WITH_SUIT_METADATA
	bool
	default y

endif # SUIT_METADATA
```

## subsys/suit/orchestrator/Kconfig
```kconfig
#
# Copyright (c) 2023 Nordic Semiconductor ASA
#
# SPDX-License-Identifier: LicenseRef-Nordic-5-Clause
#

menuconfig SUIT_ORCHESTRATOR
	bool "Enable SUIT orchestrator module"
	depends on SUIT_CRYPTO
	depends on SUIT_PROCESSOR
	depends on SUIT_STORAGE
	depends on SUIT_UTILS
	depends on SUIT_MCI
	depends on SUIT_METADATA
	depends on SUIT_PLATFORM_VARIANT_SDFW

if SUIT_ORCHESTRATOR

config SUIT_UPDATE_REBOOT_ENABLED
	bool "Reboot the system after successful execution of the update path"
	depends on REBOOT

config SUIT_BOOT_RECOVERY_REBOOT_ENABLED
	bool "Reboot the system after unsuccessful execution of the boot path"
	depends on REBOOT

config APP_LINK_WITH_SUIT_ORCHESTRATOR_INTERFACE
	bool
	default y

endif # SUIT_ORCHESTRATOR
```

## subsys/suit/orchestrator_app/Kconfig
```kconfig
#
# Copyright (c) 2024 Nordic Semiconductor ASA
#
# SPDX-License-Identifier: LicenseRef-Nordic-5-Clause
#

menuconfig SUIT_ORCHESTRATOR_APP
	bool "Enable SUIT application orchestrator"
	depends on SUIT_PLATFORM_VARIANT_APP

if SUIT_ORCHESTRATOR_APP

config SUIT_ORCHESTRATOR_APP_CANDIDATE_PROCESSING
	bool "Enable processing of the candidate envelope by the SUIT application orchestrator"
	depends on SUIT_ENVELOPE_INFO

config SUIT_CLEANUP_ON_INIT
	bool "Performs cleanup on DFU and DFU cache partitions as part of initialization"
	depends on SUIT_ORCHESTRATOR_APP_CANDIDATE_PROCESSING
	default y

endif # SUIT_ORCHESTRATOR_APP
```

## subsys/suit/platform/Kconfig
```kconfig
#
# Copyright (c) 2023 Nordic Semiconductor ASA
#
# SPDX-License-Identifier: LicenseRef-Nordic-5-Clause
#

menuconfig SUIT_PLATFORM
	bool "Enable SUIT component implementations"
	depends on SUIT_PROCESSOR
	depends on SUIT_UTILS
	depends on SUIT_MEMPTR_STORAGE

if SUIT_PLATFORM

config SUIT_DEVCONFIG
	bool "Enable manifest authorization and installation"
	depends on SUIT_STORAGE
	depends on SUIT_MCI
	depends on SUIT_METADATA

config SUIT_DIGEST
	bool "Enable digest calculation"
	depends on SUIT_STREAM_SINK_DIGEST

config MAX_NUMBER_OF_MANIFEST_CLASS_IDS
	int  "Maximum number of supported manifest class IDs that can be handled"
	range 1 200
	default 11 if SOC_SERIES_NRF54HX
	default 5 if SOC_NRF52840
	default 5 if SOC_POSIX
	help
		Check SUIT_STORAGE_N_ENVELOPES

if SUIT_PLATFORM_VARIANT_SDFW
rsource "sdfw/Kconfig"
endif # SUIT_PLATFORM_VARIANT_SDFW

rsource "sink_selector/Kconfig"
endif # SUIT_PLATFORM

config SUIT_CRYPTO
	bool "Enable crypto backend, suitable for SUIT components"
	imply MBEDTLS if !SOC_FAMILY_NORDIC_NRF
	imply NRF_SECURITY if SOC_FAMILY_NORDIC_NRF
	imply MBEDTLS_ENABLE_HEAP if SOC_FAMILY_NORDIC_NRF
	imply ENTROPY_GENERATOR
	imply PSA_CRYPTO_DRIVER_CRACEN
	imply PSA_WANT_ALG_PURE_EDDSA
	select PSA_WANT_KEY_TYPE_ECC_KEY_PAIR_IMPORT
	select PSA_WANT_KEY_TYPE_ECC_KEY_PAIR_EXPORT
	select PSA_WANT_KEY_TYPE_ECC_KEY_PAIR_GENERATE
	imply PSA_WANT_ECC_TWISTED_EDWARDS_255


if MBEDTLS && SOC_POSIX

# Make sure that PSA API compatibility layer is enabled
config MBEDTLS_PSA_CRYPTO_C
	bool
	default y

# Instruct mbedTLS to use Zephyr entropy
config MBEDTLS_ZEPHYR_ENTROPY
	bool
	default y

config SUIT_DEFAULT_MBEDTLS_CONFIG
	bool "Use default mbedTLS configuration file"
	default y
	select MBEDTLS_USER_CONFIG_ENABLE

config MBEDTLS_USER_CONFIG_FILE
	default "user-tls-conf.h" if SUIT_DEFAULT_MBEDTLS_CONFIG
endif

config SUIT_CHECK_IMAGE_MATCH
	bool "Enable image digest verification"
	depends on SUIT_CRYPTO
	depends on SUIT_DIGEST
	depends on SUIT_STREAM
	depends on SUIT_STREAM_SINK_DIGEST
	depends on SUIT_STREAM_SOURCE_MEMPTR

config SUIT_PLAT_CHECK_COMPONENT_COMPATIBILITY
	bool "Enable component ID check against supported manifest class IDs"
	depends on SUIT_UTILS
	depends on SUIT_METADATA

config SUIT_PLAT_CHECK_CLASSES
	bool "Enable vendor/class/device class ID checks"
	depends on SUIT_PLAT_CHECK_COMPONENT_COMPATIBILITY
```

## subsys/suit/platform/sdfw/Kconfig
```kconfig
#
# Copyright (c) 2024 Nordic Semiconductor ASA
#
# SPDX-License-Identifier: LicenseRef-Nordic-5-Clause
#

config SUIT_DEVCONFIG
	bool "Enable manifest authorization and installation"
	depends on SUIT_STORAGE
	depends on SUIT_MCI
	depends on SUIT_METADATA

config SUIT_DIGEST_CACHE
	bool "Enable digest caching"
	depends on SUIT_DIGEST

if SUIT_DIGEST_CACHE

config SUIT_DIGEST_CACHE_SIZE
	int "Maximum number of entries in the digest cache"
	default 16

endif

config SUIT_IPUC
	bool "Enable in-place updateable components"
	help
	  SUIT manifest may instruct the platform that component is inactive, by overriding
	  image-size parameter with value 0. Such component may be updated in place,
	  also memory associated to such component may be utilized for other purposes.

if SUIT_IPUC

config SUIT_IPUC_SIZE
	int "Maximum number of supported in-place updateable components"
	default 8
endif

config SUIT_AUTHENTICATE
	bool "Enable message/data authentication"
	depends on SUIT_CRYPTO
	depends on SUIT_PLAT_CHECK_COMPONENT_COMPATIBILITY
	select PSA_WANT_ALG_SHA_256 if SOC_FAMILY_NORDIC_NRF
	select PSA_WANT_ALG_SHA_512 if SOC_FAMILY_NORDIC_NRF
	select PSA_WANT_ALG_ECDSA if SOC_FAMILY_NORDIC_NRF
	select PSA_WANT_KEY_TYPE_ECC_KEY_PAIR_IMPORT if SOC_FAMILY_NORDIC_NRF
	select PSA_WANT_KEY_TYPE_ECC_KEY_PAIR_EXPORT if SOC_FAMILY_NORDIC_NRF
	select PSA_WANT_KEY_TYPE_ECC_KEY_PAIR_GENERATE if SOC_FAMILY_NORDIC_NRF
	select PSA_WANT_ECC_SECP_R1_256 if SOC_FAMILY_NORDIC_NRF
	select PSA_WANT_ECC_TWISTED_EDWARDS_255 if SOC_FAMILY_NORDIC_NRF
```

## subsys/suit/platform/sink_selector/Kconfig
```kconfig
#
# Copyright (c) 2023 Nordic Semiconductor ASA
#
# SPDX-License-Identifier: LicenseRef-Nordic-5-Clause
#

config SUIT_SINK_SELECTOR
	bool "Enable SUIT sink_selector module"
	depends on SUIT_STREAM
```

## subsys/suit/provisioning/Kconfig
```kconfig
#
# Copyright (c) 2024 Nordic Semiconductor
#
# SPDX-License-Identifier: LicenseRef-Nordic-5-Clause
#

menu "SUIT provisioning"

config SUIT_MPI_GENERATE
	bool "Generate SUIT Manifest Provisioning Information binary"
	default y if SOC_SERIES_NRF54HX
	default y if SOC_SERIES_NRF92X

if SUIT_MPI_GENERATE

rsource "soc/Kconfig.nrf54h20"
rsource "soc/Kconfig.nrf9280"

endif # SUIT_MPI_GENERATE

endmenu
```

## subsys/suit/provisioning/soc/Kconfig.nrf54h20
```kconfig
#
# Copyright (c) 2024 Nordic Semiconductor
#
# SPDX-License-Identifier: LicenseRef-Nordic-5-Clause
#

#
# WARNING:
#  All addresses and sizes in this file must be sunchronized with the SUIT storage address
#  defined in the Device Tree.
#  Any modification of those values require alignment in the SDFW.
#  Contents of the MPI (vendor name, class name, policies) may be modified by the
#  product vendor.
#

config SUIT_MPI_SOC_NRF54H20
	bool
	default y if SOC_SERIES_NRF54HX

if SUIT_MPI_SOC_NRF54H20

manifest=ROOT
manifest-class=nRF54H20_sample_root
manifest-downgrade-prevention-enabled=n
manifest-independent-updates=y
manifest-signature-check=DISABLED
manifest-mpi-offset=0x2000

menu "Root manifest configuration"

# Define as a regular config, so it is impossible to disable generation of the
# ROOT manifest configuration.
config SUIT_MPI_$(manifest)
	bool
	default y

rsource "Kconfig.template.manifest_config"

endmenu

manifest=APP_RECOVERY
manifest-class=nRF54H20_app_recovery
manifest-downgrade-prevention-enabled=n
manifest-independent-updates=y
manifest-signature-check=DISABLED
manifest-mpi-offset=0x2030

menuconfig  SUIT_MPI_$(manifest)
	bool "Application recovery manifest configuration"

rsource "Kconfig.template.manifest_config"

manifest=APP_LOCAL_1
manifest-class=nRF54H20_sample_app
manifest-downgrade-prevention-enabled=n
manifest-independent-updates=n
manifest-signature-check=DISABLED
manifest-mpi-offset=0x2060

menuconfig  SUIT_MPI_$(manifest)
	bool "Application local (1) manifest configuration"
	default y

rsource "Kconfig.template.manifest_config"

manifest=APP_LOCAL_2
manifest-class=nRF54H20_sample_app_local_2
manifest-downgrade-prevention-enabled=n
manifest-independent-updates=n
manifest-signature-check=DISABLED
manifest-mpi-offset=0x2090

menuconfig  SUIT_MPI_$(manifest)
	bool "Application local (2) manifest configuration"

rsource "Kconfig.template.manifest_config"

manifest=APP_LOCAL_3
manifest-class=nRF54H20_sample_app_local_3
manifest-downgrade-prevention-enabled=n
manifest-independent-updates=n
manifest-signature-check=DISABLED
manifest-mpi-offset=0x20c0

menuconfig  SUIT_MPI_$(manifest)
	bool "Application local (3) manifest configuration"

rsource "Kconfig.template.manifest_config"

config SUIT_MPI_APP_AREA_PATH
	string "Path to the file with all application domain MPI configurations"
	default "suit_mpi_application_merged.hex"

config SUIT_MPI_APP_AREA_OFFSET
	hex
	default 0x2000
	help
	  Offset of the application domain MPI configurations
	  The offset is calulated from the beginnig of the SUIT storage

config SUIT_MPI_APP_AREA_SIZE
	hex
	default 0x0f0
	help
	  Size of the application domain MPI configurations

manifest=RAD_RECOVERY
manifest-class=nRF54H20_rad_recovery
manifest-downgrade-prevention-enabled=n
manifest-independent-updates=n
manifest-signature-check=DISABLED
manifest-mpi-offset=0x1000

menuconfig  SUIT_MPI_$(manifest)
	bool "Radio recovery manifest configuration"

rsource "Kconfig.template.manifest_config"

manifest=RAD_LOCAL_1
manifest-class=nRF54H20_sample_rad
manifest-downgrade-prevention-enabled=n
manifest-independent-updates=n
manifest-signature-check=DISABLED
manifest-mpi-offset=0x1030

menuconfig  SUIT_MPI_$(manifest)
	bool "Radio local (1) manifest configuration"
	default y

rsource "Kconfig.template.manifest_config"

manifest=RAD_LOCAL_2
manifest-class=nRF54H20_sample_rad_local_2
manifest-downgrade-prevention-enabled=n
manifest-independent-updates=n
manifest-signature-check=DISABLED
manifest-mpi-offset=0x1060

menuconfig  SUIT_MPI_$(manifest)
	bool "Radio local (2) manifest configuration"

rsource "Kconfig.template.manifest_config"

config SUIT_MPI_RAD_AREA_PATH
	string "Path to the file with all radio domain MPI configurations"
	default "suit_mpi_radio_merged.hex"

config SUIT_MPI_RAD_AREA_OFFSET
	hex
	default 0x1000
	help
	  Offset of the radio domain MPI configurations
	  The offset is calulated from the beginnig of the SUIT storage

config SUIT_MPI_RAD_AREA_SIZE
	hex
	default 0x90
	help
	  Size of the radio domain MPI configurations

config SUIT_MPI_SLOT_SIZE
	hex
	default 0x30
	help
	  Size of each MPI configuration slot

endif # SUIT_MPI_SOC_NRF54H20
```

## subsys/suit/provisioning/soc/Kconfig.template.manifest_config
```kconfig
#
# Copyright (c) 2024 Nordic Semiconductor
#
# SPDX-License-Identifier: LicenseRef-Nordic-5-Clause
#

if SUIT_MPI_$(manifest)

config SUIT_MPI_$(manifest)_VENDOR_NAME
	string "Vendor name to generate vendor UUID"
	default "nordicsemi.com"

config SUIT_MPI_$(manifest)_CLASS_NAME
	string "Vendor name to generate class UUID"
	default "$(manifest-class)"

config SUIT_MPI_$(manifest)_DOWNGRADE_PREVENTION
	bool "Enable downgrade prevention policy"
	default $(manifest-downgrade-prevention-enabled)

config SUIT_MPI_$(manifest)_INDEPENDENT_UPDATE
	bool "Enable independent updateability policy"
	default $(manifest-independent-updates)

choice "SUIT_MPI_$(manifest)_SIGNATURE_CHECK"
	prompt "Manifest digest signature check"
	default SUIT_MPI_$(manifest)_SIGNATURE_CHECK_$(manifest-signature-check)

config SUIT_MPI_$(manifest)_SIGNATURE_CHECK_DISABLED
	bool "Disabled"
	help
	  Do not require or verify manifest digest signature check

config SUIT_MPI_$(manifest)_SIGNATURE_CHECK_ENABLED_ON_UPDATE
	bool "Enabled on update"
	help
	  Require and verify manifest digest signature check on update

config SUIT_MPI_$(manifest)_SIGNATURE_CHECK_ENABLED_ON_UPDATE_AND_BOOT
	bool "Enabled on update and boot"
	help
	  Require and verify manifest digest signature check on update and boot

endchoice # SUIT_MPI_$(manifest)_SIGNATURE_CHECK

config SUIT_MPI_$(manifest)_OFFSET
	hex # Constant for all devices using Nordic's SDFW
	default $(manifest-mpi-offset)

config SUIT_MPI_$(manifest)_PATH
	string "Path to the output MPI HEX file"
	default "suit_mpi_$(manifest).hex"

endif # SUIT_MPI_$(manifest)
```
