## subsys/net/dect/rpc/Kconfig
```kconfig
#
# Copyright (c) 2026 Nordic Semiconductor ASA
#
# SPDX-License-Identifier: LicenseRef-Nordic-5-Clause
#

menuconfig DECT_NR_RPC
	bool "DECT NR+ over RPC [EXPERIMENTAL]"
	select NRF_RPC
	select NRF_RPC_CBOR
	select EXPERIMENTAL
	help
	  EXPERIMENTAL: Use a DECT NR+ Zephyr net_if on an external MCU (no DECT NR+ modem on
	  that chip): the client mirrors the server's DECT NR+ interface over nRF RPC;
	  the server runs the DECT NR+ modem and stack.

if DECT_NR_RPC

config DECT_NR_RPC_UART_TRANSPORT
	bool "Use UART transport for DECT RPC"
	depends on NRF_RPC_UART_TRANSPORT
	default y
	help
	  Use UART to communicate between DECT NR+ RPC client and server.

choice DECT_NR_RPC_ROLE_CHOICE
	prompt "DECT NR+ over RPC role"
	default DECT_NR_RPC_SERVER if NET_L2_DECT
	default DECT_NR_RPC_CLIENT
	help
	  Select client or server role for this image. Default is server when
	  NET_L2_DECT is enabled, otherwise client.

config DECT_NR_RPC_CLIENT
	bool "DECT NR+ over RPC client"
	help
	  net_if on this core, no DECT NR+ modem. Application sees a DECT NR+
	  net_if; send/recv go over DECT NR+ RPC.

config DECT_NR_RPC_SERVER
	bool "DECT NR+ over RPC server"
	depends on NET_L2_DECT
	help
	  Runs DECT NR+ L2 and DECT NR+ modem on this core; forwards packets to/from the client.
	  Receives raw IPv6 from client and injects into DECT NR+ L2 send path;
	  forwards DECT NR+ receive traffic to client.

endchoice

config DECT_NR_RPC_NET_IF
	bool "DECT NR+ over RPC network interface"
	default y
	help
	  Client: enables IF_SEND/IF_RECEIVE decoders and creates the Zephyr DECT NR+
	  network interface. Server: enables the RPC bridge (IF_SEND, IF_GET_ADDRS, IF_STATUS,
	  PING, shell, forwarding) in dect_rpc_if.c.
	  This must be enabled on both client and server for a working link.

if DECT_NR_RPC_NET_IF

config DECT_NR_RPC_MAX_IP_PKT
	int "Max IPv6 packet size tunneled over RPC (bytes)"
	range 500 1500
	default 1500
	help
	  Maximum raw IPv6 payload size for IF_SEND (client to server) and
	  IF_RECEIVE (server to client). The server RX memory pool uses one buffer of this
	  size per slot. Default matches the maximum CONFIG_NET_L2_DECT_MTU (1500).
	  Set the same value on the client and server; use the server's
	  CONFIG_NET_L2_DECT_MTU if you use a lower L2 MTU (for example 1280).

endif # DECT_NR_RPC_NET_IF

config DECT_NR_RPC_SHELL
	bool "DECT L2 shell over RPC (server)"
	depends on DECT_NR_RPC_SERVER && GETOPT_LONG
	select DECT_L2_SHELL_LIB
	select DECT_L2_SHELL_RPC
	help
	  Run DECT L2 shell commands remotely over RPC. Client sends subcmd and
	  args; server runs the same DECT L2 shell and returns captured output.
	  Server-side DECT L2 shell has priority: remote shell RPC is rejected
	  while a DECT L2 shell command is running on the server locally.

config DECT_NR_RPC_SERVER_SHELL_RPC_INIT
	bool "Shell command dect_rpc_init on server (when RPC not auto-init)"
	depends on DECT_NR_RPC_SERVER && SHELL
	depends on !NRF_RPC_INIT
	default y
	help
	  Register shell command dect_rpc_init so the user can initialize RPC
	  when the client is connected over UART (avoids boot timeout when no client).

if DECT_NR_RPC_CLIENT

config DECT_NR_RPC_CLIENT_SHELL
	bool "DECT NR+ RPC shell on client"
	depends on SHELL && DECT_NR_RPC_NET_IF
	help
	  Expose shell commands "dect status" and "dect run <subcmd> [args...]" to request
	  DECT status or run DECT L2 shell commands on the server over RPC.

config DECT_NR_RPC_CLIENT_SHELL_RPC_INIT
	bool "Shell dect rpc init/ping on client (when RPC not auto-init)"
	depends on DECT_NR_RPC_CLIENT_SHELL
	depends on !NRF_RPC_INIT
	default y
	help
	  Register "dect rpc init" so the user can call nrf_rpc_init() from the
	  shell when the DECT NR+ server is connected over UART (typical when
	  CONFIG_NRF_RPC_INIT is disabled). Disable on relay FT when main()

endif # DECT_NR_RPC_CLIENT

if DECT_NR_RPC_NET_IF && DECT_NR_RPC_CLIENT

config NET_INTERFACE_NAME_LEN
	default 9
	depends on NET_INTERFACE_NAME

config DECT_NR_RPC_CLIENT_IFACE_NAME
	string "DECT NR+ RPC client interface logical name"
	default "rpc-dect"
	help
	  Logical name passed to net_if_set_name() when CONFIG_NET_INTERFACE_NAME
	  is enabled.

config DECT_NR_RPC_AUTO_SYNC
	bool "Auto-sync addresses a few seconds after RPC init"
	default y
	help
	  Run one address sync from server shortly after DECT NR+ RPC init completes.
	  Delay is set by DECT_NR_RPC_AUTO_SYNC_DELAY_SEC. "dect sync" remains available for
	  manual sync.

config DECT_NR_RPC_AUTO_SYNC_DELAY_SEC
	int "Delay (seconds) after DECT NR+ RPC init before auto-sync"
	depends on DECT_NR_RPC_AUTO_SYNC
	default 3
	help
	  Seconds to wait after DECT NR+ RPC init before running the first address sync.

config DECT_NR_RPC_ADDR_SYNC_INTERVAL_SEC
	int "Periodic address sync interval (seconds)"
	default 10
	help
	  Interval at which the client syncs IPv6 addresses and prefixes from the server,
	  so the client net_if mirrors the server DECT NR+ iface.
	  Set to 0 to disable periodic sync.

config DECT_NR_RPC_CONN_MGR
	bool "Connection Manager on DECT NR+ RPC client"
	default y
	select NET_CONNECTION_MANAGER
	help
	  Register a conn_mgr connectivity backend on the RPC client net_if.
	  conn_mgr_if_connect() / disconnect() are sent to the server over RPC
	  (DECT_RPC_CMD_CONNECT / DISCONNECT); the server runs conn_mgr on the real DECT NR+ modem
	  interface. conn_mgr_monitor raises NET_EVENT_L4_* on the client from mirrored IPv6
	  addresses and interface up state.
	  DECT NR+ association policy (auto-connect, persistence, timeouts) is
	  configured on the server via NET_L2_DECT_CONN_MGR_* only. The client
	  binding does not auto-connect or auto-down the DECT NR+ tunnel iface.

endif # DECT_NR_RPC_NET_IF && DECT_NR_RPC_CLIENT

if DECT_NR_RPC_SERVER

config DECT_NR_RPC_SERVER_CLIENT_IDLE_TIMEOUT_SEC
	int "Idle time before RPC client session is cleared (seconds)"
	range 0 3600
	default 120
	help
	  When non-zero, the server clears the active RPC client session if no client
	  command is received within the configured idle period. Local DECT L2 RX processing resumes
	  until the client sends traffic again. Set to 0 to keep the session until reboot.

config DECT_NR_RPC_SERVER_EVT_QUEUE_LEN
	int "Server-to-client event queue depth"
	range 4 64
	default 16
	help
	  Depth of the message queue for IF_RECEIVE and IF_LINK_STATE events sent to the RPC client.
	  IF_ADDRS_CHANGED notifications are coalesced separately from this queue.

config DECT_NR_RPC_SERVER_EVT_PACING_MS
	int "Milliseconds to pause after each DECT NR+ server-to-client RPC event"
	range 0 500
	default 20 if NRF_RPC_UART_RELIABLE
	default 0
	help
	  Pause after DECT NR+ RPC server-originated DECT NR+ RPC events.
	  Applies after DECT NR+ IF_LINK_STATE and DECT NR+ IF_ADDRS_CHANGED.
	  After DECT NR+ IF_RECEIVE: only when CONFIG_NRF_RPC_UART_RELIABLE (default
	  20 ms for HDLC ACK breathing room). When reliable is off, DECT NR+ IF_RECEIVE is not
	  paced here (bulk traffic); default 0 disables pacing.

endif # DECT_NR_RPC_SERVER

module=NET_DECT_RPC
module-str=DECT NR+ RPC
source "${ZEPHYR_BASE}/subsys/logging/Kconfig.template.log_config"

endif # DECT_NR_RPC
```

## subsys/net/l2_dect/Kconfig
```kconfig
# Copyright (c) 2025 Nordic Semiconductor ASA
#
# SPDX-License-Identifier: LicenseRef-Nordic-5-Clause

menuconfig NET_L2_DECT
	bool "L2 DECT NR+ Connectivity"
	depends on DECT_MDM
	help
	  Enable support for DECT NR+ Net L2.

if NET_L2_DECT

config NET_L2_DECT_MTU
	int "DECT NR+ L2 MTU (bytes)"
	default 1280
	range 500 1500
	help
	  Maximum Transmission Unit for the DECT NR+ network interface. The
	  default (1280) equals the IPv6 minimum MTU (RFC 2460). Increase only
	  if the underlying core network and DECT NR+ peer support larger payloads.

config NET_L2_DECT_MGMT
	bool "DECT NR+ Net Management support"
	depends on NET_IPV6
	select NET_MGMT
	select NET_MGMT_EVENT
	select NET_MGMT_EVENT_INFO
	help
	  Enable support for DECT NR+ Net Management interface.

config NET_L2_DECT_BR
	bool "Border router support for DECT NR+"
	default y if NET_L2_ETHERNET || MODEM_CELLULAR
	select NET_ROUTING if NET_IPV6 && NET_ROUTE
	help
	  Fixed Terminal (FT) could act also as a DECT NR+ border router:
	  it obtains an IPv6 delegated prefix on a "sink" uplink and extends
	  connectivity to Portable Terminals (PTs) on DECT NR+.
	  The sink may be cellular (PPP / MODEM_CELLULAR) or Ethernet
	  (NET_L2_ETHERNET). Only one sink type is used at a time.
	  When NET_IPV6 and NET_ROUTE are enabled, selects IPv6 routing support needed
	  for forwarding between the sink and DECT NR+.

config NET_L2_DECT_BR_IPV6_SINK_PREFIX96
	bool "Promote delegated /64 sink prefix to /96 using transmitter long RD ID"
	default y
	depends on NET_L2_DECT_BR
	help
	  Append this FT's DECT transmitter long RD ID into bits 64-95 of the
	  delegated /64 uplink prefix, so the DECT NR+ interface uses a /96
	  (delegated /64 + RD id). The /64 handed to the modem is unaffected.
	  Disable for a flat /64 DECT prefix layout (pre-/96 behavior).

config NET_L2_DECT_BR_IPV6_SINK_ROUTE96
	bool "IPv6 /96 connected route on DECT NR+ Sink"
	default y
	depends on NET_L2_DECT_BR_IPV6_SINK_PREFIX96 && NET_ROUTE && NET_IPV6_NBR_CACHE
	help
	  Install a high-preference /96 connected route + matching neighbor
	  entry on the DECT NR+ iface for the promoted /96, so locally originated
	  or forwarded packets to PTs egress DECT instead of matching a shorter
	  prefix on the uplink. Sink-agnostic (Ethernet and cellular). Disable
	  if you supply your own routes or use a flat /64 layout.

config NET_L2_DECT_ULA
	bool "ULA /64 on DECT (prefix + derived address)"
	default y
	depends on NET_IPV6
	help
	  ULA /64 base plus on-link /96 and host address on DECT after association
	  (NET_L2_DECT_ULA_PREFIX). Disabled: link-local and delegated globals only.

config NET_L2_DECT_ULA_PREFIX
	string "ULA /64 base"
	default "fdde:ad00:0000::"
	depends on NET_L2_DECT_ULA
	depends on NET_IPV6
	help
	  RFC 4193 fd ULA /64, IID zero (e.g. fdde:ad00:0000::). Bytes 8..15 cleared
	  on parse.
	  DECT: /96 = this /64 + peer long RD id; host = /96 + link-local bytes
	  12..15. PT: parent RD id; FT: own transmitter RD id.
	  Ethernet RAs to the tethered PC use the upper /64 of the PT ULA on dect0,
	  not the DECT /96.
	  Empty string: skip. Default is lab-only; use a unique global ID in production.

module=NET_L2_DECT_BR
module-str=DECT NR+ L2 Border Router / Sink
source "${ZEPHYR_BASE}/subsys/logging/Kconfig.template.log_config"

module=NET_L2_DECT
module-str=DECT NR+ L2
source "${ZEPHYR_BASE}/subsys/logging/Kconfig.template.log_config"

module=NET_L2_DECT_MGMT
module-str=DECT NR+ L2 management
source "${ZEPHYR_BASE}/subsys/logging/Kconfig.template.log_config"

endif # NET_L2_DECT

rsource "Kconfig.conn_mgr"
```

## subsys/net/lib/aws_fota/Kconfig
```kconfig
# Copyright (c) 2019 Nordic Semiconductor
#
# SPDX-License-Identifier: LicenseRef-Nordic-5-Clause
#

menuconfig AWS_FOTA
	bool "AWS Jobs FOTA library"
	select AWS_JOBS
	select CJSON_LIB
	select HTTP_PARSER_URL
	depends on FOTA_DOWNLOAD
	depends on !BOARD_QEMU_X86
	default y if AWS_IOT

if AWS_FOTA

config AWS_FOTA_PAYLOAD_SIZE
	int "MQTT payload reception buffer size for AWS IoT Jobs messages"
	default 4096
	help
	  A job message that does not fit in this buffer is dropped and the job is failed.
	  A job with a presigned URL needs about 2 kB or more, because the URL contains
	  a security token.

config AWS_FOTA_DOWNLOAD_SECURITY_TAG
	int "Security tag to be used for downloads"
	default -1


module=AWS_FOTA
module-str=AWS Jobs FOTA
source "$(ZEPHYR_BASE)/subsys/logging/Kconfig.template.log_config"

endif # AWS_FOTA
```

## subsys/net/lib/aws_iot/Kconfig
```kconfig
#
# Copyright (c) 2022 Nordic Semiconductor
#
# SPDX-License-Identifier: LicenseRef-Nordic-5-Clause
#

module = AWS_IOT
module-prompt = "AWS IoT library"
orsource "../Kconfig.cloud_$(CLOUD_SERVICE_SELECTOR)"

menuconfig $(module)
	bool
	prompt "AWS IoT library" if !CLOUD_SERVICE_MUTUAL_EXCLUSIVE
	select MQTT_HELPER
	select MQTT_LIB_TLS

if AWS_IOT

config AWS_IOT_BROKER_HOST_NAME
	string "AWS IoT server hostname"

config AWS_IOT_CLIENT_ID_STATIC
	string "Static client id"
	default "my-thing"

config AWS_IOT_CLIENT_ID_MAX_LEN
	int "Maximum length of client id"
	default 40

config AWS_IOT_CONNECT_TIMEOUT_SECONDS
	int "Connect timeout in seconds"
	default 30

config AWS_IOT_AUTO_DEVICE_SHADOW_REQUEST
	bool "Request the device shadow automatically upon a connection to AWS"
	default y

config AWS_IOT_RESUBSCRIBE_ON_SESSION_PRESENT
	bool "Subscribe to topics on every connection, also when a session is resumed"
	help
	  By default, the library does not send its subscription lists when the
	  broker reports in the CONNACK that a previous session is present. It then
	  relies on the broker to have kept the subscriptions of that session.
	  If the resumed session does not hold all of them, the device stays
	  connected and can publish, but it no longer receives messages on the
	  missing topics, such as shadow deltas or application topics, and no error
	  is reported. Enable this option to subscribe on every connection.
	  Subscribing again to a topic replaces the existing subscription, so the
	  messages that the broker has queued for the session are still delivered.

config AWS_IOT_TOPIC_GET_ACCEPTED_SUBSCRIBE
	bool "Subscribe to get accepted shadow topic, $aws/things/<thing-name>/shadow/get/accepted"

config AWS_IOT_TOPIC_GET_REJECTED_SUBSCRIBE
	bool "Subscribe to get rejected shadow topic, $aws/things/<thing-name>/shadow/get/rejected"

config AWS_IOT_TOPIC_UPDATE_ACCEPTED_SUBSCRIBE
	bool "Subscribe to update accepted shadow topic, $aws/things/<thing-name>/shadow/update/accepted"

config AWS_IOT_TOPIC_UPDATE_REJECTED_SUBSCRIBE
	bool "Subscribe to update rejected shadow topic, $aws/things/<thing-name>/shadow/update/rejected"

config AWS_IOT_TOPIC_UPDATE_DELTA_SUBSCRIBE
	bool "Subscribe to update delta shadow topic, $aws/things/<thing-name>/shadow/update/delta"

config AWS_IOT_TOPIC_DELETE_ACCEPTED_SUBSCRIBE
	bool "Subscribe to delete accepted shadow topic, $aws/things/<thing-name>/shadow/delete/accepted"

config AWS_IOT_TOPIC_DELETE_REJECTED_SUBSCRIBE
	bool "Subscribe to delete rejected shadow topic, $aws/things/<thing-name>/shadow/delete/rejected"

module = AWS_IOT
module-str = AWS IoT
source "$(ZEPHYR_BASE)/subsys/logging/Kconfig.template.log_config"

endif # AWS_IOT
```
