## subsys/net/lib/nrf7120_fw_ext/Kconfig
```kconfig
# Copyright (c) 2026 Nordic Semiconductor ASA
# SPDX-License-Identifier: LicenseRef-Nordic-5-Clause

if WIFI_NRF71

config WIFI_NRF71_PATCH
	bool "Include nRF7120 Wi-Fi ROM patches in the application image"
	depends on !IS_BOOTLOADER_IMG
	help
	  The Wi-Fi ROM patches are placed at fixed internal NVM addresses
	  required by the Wi-Fi Core. When MCUboot is enabled, the merged image
	  including the application and the Wi-Fi ROM patches is signed and
	  delivered as part of standard firmware updates.

	  Note: The regular ELF-derived artifacts do not contain Wi-Fi patch
	  data. Only the merged output used for programming and signing
	  includes the patches.

if WIFI_NRF71_PATCH

choice WIFI_NRF71_PATCH_VERSION
	prompt "nRF7120 Wi-Fi ROM patch version"
	default WIFI_NRF71_PATCH_VERSION_0_1_0
	help
	  Out-of-tree modules can add further choice entries here, each with
	  a matching WIFI_NRF71_PATCH_DIR default below.

config WIFI_NRF71_PATCH_VERSION_0_1_0
	bool "0.1.0"

endchoice

config WIFI_NRF71_PATCH_DIR
	string
	default "$(ZEPHYR_NRFXLIB_MODULE_DIR)/nrf71_wifi/bins/0.1.0" if WIFI_NRF71_PATCH_VERSION_0_1_0
	help
	  Release directory containing manifest.json, the patch binaries, and
	  nrf7120_wifi_patch.dtsi. The selected patch must be accompanied by
	  this overlay in the application's devicetree.

endif # WIFI_NRF71_PATCH

endif # WIFI_NRF71
```

## subsys/net/lib/ready_resolve/Kconfig
```kconfig
#
# Copyright (c) 2026 Nordic Semiconductor ASA
#
# SPDX-License-Identifier: LicenseRef-Nordic-5-Clause
#

menuconfig READY_RESOLVE
	bool "Ready resolver"
	depends on NET_SOCKETS
	depends on NET_IPV4 || NET_IPV6
	select NET_CONNECTION_MANAGER if !(NRF_MODEM_LIB && NET_SOCKETS_OFFLOAD)
	help
	  Resolve a host name for the address families that are up and
	  iterate over the resulting addresses.

if READY_RESOLVE

config READY_RESOLVE_TRACK_MODEM
	def_bool NRF_MODEM_LIB && NET_SOCKETS_OFFLOAD && !NRF_MODEM_LIB_NET_IF
	help
	  Track connectivity by querying the modem, on nRF91 Series devices
	  without the modem network interface.

config READY_RESOLVE_TRACK_CONN_MGR
	def_bool NET_CONNECTION_MANAGER && !READY_RESOLVE_TRACK_MODEM
	help
	  Track connectivity through connection manager events.

config READY_RESOLVE_MODEM_POLL_INTERVAL_MS
	int "Modem readiness poll interval (ms)"
	depends on READY_RESOLVE_TRACK_MODEM
	default 1000
	help
	  How often ready_resolve_wait_change() queries the modem.

module = READY_RESOLVE
module-str = Ready resolver
source "subsys/logging/Kconfig.template.log_config"

endif # READY_RESOLVE
```

## subsys/net/lib/tls_credentials_keygen_kmu/Kconfig
```kconfig
#
# Copyright (c) 2026 Nordic Semiconductor ASA
#
# SPDX-License-Identifier: LicenseRef-Nordic-5-Clause
#

# Store the generated keys in the KMU on devices that have one.
choice TLS_CREDENTIALS_KEYGEN_KEY_STORE
	default TLS_CREDENTIALS_KEYGEN_KEY_STORE_CUSTOM if CRACEN_KMU
endchoice

menuconfig TLS_CREDENTIALS_KEYGEN_KMU
	bool "Store the generated TLS keys in the KMU [EXPERIMENTAL]"
	depends on TLS_CREDENTIALS_KEYGEN_KEY_STORE_CUSTOM
	depends on CRACEN_KMU
	default y
	select EXPERIMENTAL
	help
	  Key store of the TLS credentials key generation (TLS_CREDENTIALS_KEYGEN) that stores the
	  generated private keys in the CRACEN Key Management Unit (KMU). The keys are not stored
	  in the flash, and they can only be used by CRACEN.

	  The library owns the KMU slots that are set with TLS_CREDENTIALS_KEYGEN_KMU_SLOT_FIRST
	  and TLS_CREDENTIALS_KEYGEN_KMU_KEY_COUNT. A key in these slots that no security tag is
	  registered for is destroyed when a new key is generated.

if TLS_CREDENTIALS_KEYGEN_KMU

choice TLS_CREDENTIALS_KEYGEN_KMU_SCHEME
	prompt "KMU key usage scheme"
	default TLS_CREDENTIALS_KEYGEN_KMU_SCHEME_ENCRYPTED

config TLS_CREDENTIALS_KEYGEN_KMU_SCHEME_ENCRYPTED
	bool "Encrypted"
	select PSA_WANT_KEY_TYPE_AES
	select PSA_WANT_AES_KEY_SIZE_256
	select PSA_WANT_ALG_GCM
	select PSA_WANT_ALG_CMAC
	select PSA_WANT_ALG_ECB_NO_PADDING
	select PSA_WANT_ALG_SP800_108_COUNTER_CMAC
	help
	  The key is stored encrypted with a key that is derived from the CRACEN IKG seed. The
	  seed must be provisioned. A key uses 4 KMU slots for P-256 and 5 KMU slots for P-384.

config TLS_CREDENTIALS_KEYGEN_KMU_SCHEME_RAW
	bool "Raw"
	help
	  The key is stored in plaintext in the KMU. A key uses 2 KMU slots for P-256 and 3 KMU
	  slots for P-384.

endchoice

config TLS_CREDENTIALS_KEYGEN_KMU_SLOT_FIRST
	int "First KMU slot"
	range 0 179
	default 100
	help
	  First KMU slot of the keys. Each key uses a block of slots that fits the largest enabled
	  key type. The slots must not be used by anything else. On nRF71 Series devices, the
	  Wi-Fi keys use the KMU slots from NRF_WIFI_KMU_SLOT_MIN.

config TLS_CREDENTIALS_KEYGEN_KMU_KEY_COUNT
	int "Number of keys"
	range 1 36
	default 2
	help
	  Maximum number of generated keys, one for each security tag.

endif # TLS_CREDENTIALS_KEYGEN_KMU
```

## subsys/nrf_security/Kconfig
```kconfig
#
# Copyright (c) 2019-2022 Nordic Semiconductor
#
# SPDX-License-Identifier: LicenseRef-Nordic-5-Clause
#

config PSA_CRYPTO
	default y if DT_HAS_ZEPHYR_PSA_CRYPTO_RNG_ENABLED \
		&& !IS_BOOTLOADER_IMG && GEN_ISR_TABLES

choice PSA_CRYPTO_PROVIDER
	default PSA_CRYPTO_PROVIDER_SSF if HAS_IRONSIDE_SE_CALL
	default PSA_CRYPTO_PROVIDER_CUSTOM if SOC_FAMILY_NORDIC_NRF && ARM

config PSA_CRYPTO_PROVIDER_SSF
	bool "SDFW Service Framework (SSF)"
	depends on HAS_IRONSIDE_SE_CALL

endchoice # PSA_CRYPTO_PROVIDER

config PSA_CRYPTO_PROVIDER_CUSTOM
	depends on !BUILD_WITH_TFM
	select MBEDTLS_PSA_CRYPTO_C

menu "nRF Security"

config NRF_SECURITY
	def_bool y
	depends on PSA_CRYPTO_PROVIDER_CUSTOM || BUILD_WITH_TFM || PSA_CRYPTO_PROVIDER_SSF
	depends on SOC_FAMILY_NORDIC_NRF && ARM

# Include Nordic-only PSA configurations
rsource "Kconfig.psa.nordic"

if NRF_SECURITY

# Include TLS/DTLS and x509 configurations
rsource "Kconfig.tls"

# Include TF-PSA-Crypto configurations
rsource "Kconfig.tf-psa-crypto"

# Include PSA Crypto configurations
rsource "Kconfig.psa"

# Include legacy Mbed TLS configurations
rsource "Kconfig.tf-psa-crypto.deprecated"

endif # NRF_SECURITY

endmenu # nRF Security
```

## subsys/nrf_security/Kconfig.platform
```kconfig
#
# Copyright (c) 2026 Nordic Semiconductor ASA
#
# SPDX-License-Identifier: LicenseRef-Nordic-5-Clause
#

config PSA_CORE_LITE_SUPPORTED
	def_bool \
		SOC_SERIES_NRF52 || \
		SOC_SERIES_NRF53 || \
		SOC_SERIES_NRF54L || \
		SOC_SERIES_NRF71 || \
		SOC_SERIES_NRF91
	help
	  Promptless Kconfig option indicating support for the PSA core lite implementation.

config HAS_HW_NRF_CRACEN
	def_bool \
		(SOC_SERIES_NRF54L && !SOC_NRF54LS05A && !SOC_NRF54LS05B) || \
		SOC_SERIES_NRF71
	help
	  Promptless Kconfig option indicating that the full CRACEN accelerator is available.

config HAS_HW_NRF_CRACEN_TRNG
	def_bool \
		HAS_HW_NRF_CRACEN || \
		SOC_NRF54LS05A || \
		SOC_NRF54LS05B
	help
	  Promptless Kconfig option indicating that the CRACEN TRNG is available,
	  including for devices that do not expose the full CRACEN accelerator.

config CRACEN_HW_VERSION_BASE
	def_bool \
		SOC_SERIES_NRF54H || \
		SOC_NRF54L15 || \
		SOC_NRF54L10 || \
		SOC_NRF54L05
	help
	  Promptless Kconfig option indicating the base CRACEN hardware implementation.

config CRACEN_HW_VERSION_LITE
	def_bool \
		SOC_NRF54LM20A || \
		SOC_NRF54LM20B || \
		SOC_NRF54LC10A || \
		SOC_NRF54LV10A || \
		SOC_NRF7120_ENGA
	help
	  Promptless Kconfig option indicating the lite CRACEN hardware implementation.

config CRACEN_KMU_USES_RRAMC
	def_bool SOC_SERIES_NRF54L
	help
	  Promptless Kconfig option indicating that CRACEN KMU provisioning uses RRAMC.

config CRACEN_KMU_USES_MRAMC
	def_bool SOC_SERIES_NRF71
	help
	  Promptless Kconfig option indicating that CRACEN KMU provisioning uses MRAMC.

config CRACEN_SMALL_PRNG_POOL
	bool
	help
	  Promptless Kconfig option enabling the reduced-memory CRACEN PRNG pool.

config PSA_NEED_CRACEN_MULTIPART_WORKAROUNDS
	def_bool \
		SOC_NRF54LM20A || \
		SOC_NRF54LM20B
	help
	  Promptless Kconfig option enabling CRACEN multipart operation workarounds.

config PSA_NEED_CRACEN_CTR_SIZE_WORKAROUNDS
	def_bool \
		PSA_NEED_CRACEN_MULTIPART_WORKAROUNDS || \
		SOC_NRF54LC10A || \
		SOC_NRF54LV10A
	help
	  Promptless Kconfig option enabling CRACEN CTR size workarounds.

config PSA_NEED_CRACEN_IKG_INTERRUPT_WORKAROUND
	def_bool \
		SOC_NRF54LM20A || \
		SOC_NRF54LM20B || \
		SOC_NRF54LC10A || \
		SOC_NRF54LV10A || \
		SOC_NRF7120_ENGA
	help
	  Promptless Kconfig option enabling the CRACEN IKG interrupt workaround.

config PSA_NEED_CRACEN_MEMORY_ACCESS_WORKAROUND
	def_bool \
		SOC_NRF54LM20A || \
		SOC_NRF54LM20B
	help
	  Promptless Kconfig option enabling CRACEN memory access workarounds.

config PSA_NEED_CRACEN_RNG_NO_ENTROPY_WORKAROUND
	bool
	help
	  Promptless Kconfig option enabling the CRACEN no-entropy workaround.
	  Selected by platforms without an entropy source, such as emulator
	  targets used for platform testing.
```

## subsys/nrf_security/Kconfig.tf-psa-crypto.deprecated
```kconfig
#
# Copyright (c) 2026 Nordic Semiconductor
#
# SPDX-License-Identifier: LicenseRef-Nordic-5-Clause
#

config MBEDTLS_DECLARE_PRIVATE_IDENTIFIERS
	select DEPRECATED

if MBEDTLS_DECLARE_PRIVATE_IDENTIFIERS

config MBEDTLS_ECP_C
	bool "ECC - Elliptic Curve Cryptography [DEPRECATED]"
	select DEPRECATED
	select PSA_WANT_KEY_TYPE_ECC_KEY_PAIR_BASIC
	select PSA_WANT_KEY_TYPE_ECC_KEY_PAIR_IMPORT
	select PSA_WANT_KEY_TYPE_ECC_KEY_PAIR_EXPORT
	select PSA_WANT_KEY_TYPE_ECC_KEY_PAIR_GENERATE
	select PSA_WANT_KEY_TYPE_ECC_KEY_PAIR_DERIVE
	select MBEDTLS_BIGNUM_C

config MBEDTLS_BIGNUM_C
	bool "Prime number generation [DEPRECATED]"
	select DEPRECATED

endif # MBEDTLS_DECLARE_PRIVATE_IDENTIFIERS
```

## subsys/nrf_security/src/drivers/cracen/Kconfig.hybrid_verify
```kconfig
#
# Copyright (c) 2026 Nordic Semiconductor
#
# SPDX-License-Identifier: LicenseRef-Nordic-5-Clause
#

config CRACEN_HYBRID_VERIFY
	bool "CRACEN hybrid ML-DSA and ECDSA verification"
	depends on !BUILD_WITH_TFM
	depends on PSA_NEED_CRACEN_ECDSA || PSA_NEED_CRACEN_DETERMINISTIC_ECDSA
	help
	  Enable cracen_hybrid_verify(), which starts an ECDSA verification
	  before an ML-DSA verification over the same message and collects
	  its result. This way, the PKE and the CryptoMaster run in
	  parallel instead of idling one while the other runs.

	  ML-DSA support in the PSA configuration is not required. The
	  ML-DSA public key is passed to cracen_hybrid_verify() as a buffer
	  and not through a PSA key slot, so the ML-DSA verification code and
	  the SHAKE128 and SHAKE256 functions it uses are built internally
	  for the parameter sets selected below.

if CRACEN_HYBRID_VERIFY

config CRACEN_HYBRID_VERIFY_ML_DSA_44
	bool "ML-DSA-44 support in hybrid verification"
	help
	  Support the ML-DSA-44 parameter set in cracen_hybrid_verify().
	  Both ML-DSA (PSA_ALG_ML_DSA) and deterministic ML-DSA
	  (PSA_ALG_DETERMINISTIC_ML_DSA) verification are enabled for this
	  parameter set.

config CRACEN_HYBRID_VERIFY_ML_DSA_65
	bool "ML-DSA-65 support in hybrid verification"
	help
	  Support the ML-DSA-65 parameter set in cracen_hybrid_verify().
	  Both ML-DSA (PSA_ALG_ML_DSA) and deterministic ML-DSA
	  (PSA_ALG_DETERMINISTIC_ML_DSA) verification are enabled for this
	  parameter set.

config CRACEN_HYBRID_VERIFY_ML_DSA_87
	bool "ML-DSA-87 support in hybrid verification"
	help
	  Support the ML-DSA-87 parameter set in cracen_hybrid_verify().
	  Both ML-DSA (PSA_ALG_ML_DSA) and deterministic ML-DSA
	  (PSA_ALG_DETERMINISTIC_ML_DSA) verification are enabled for this
	  parameter set.

config NEED_CRACEN_HYBRID_VERIFY_ML_DSA
	def_bool y
	depends on CRACEN_HYBRID_VERIFY_ML_DSA_44 || \
		   CRACEN_HYBRID_VERIFY_ML_DSA_65 || \
		   CRACEN_HYBRID_VERIFY_ML_DSA_87

config NEED_CRACEN_HYBRID_VERIFY_SHAKE128
	def_bool y
	depends on NEED_CRACEN_HYBRID_VERIFY_ML_DSA

config NEED_CRACEN_HYBRID_VERIFY_SHAKE256
	def_bool y
	depends on NEED_CRACEN_HYBRID_VERIFY_ML_DSA

config NEED_CRACEN_HYBRID_VERIFY_XOF
	def_bool y
	depends on NEED_CRACEN_HYBRID_VERIFY_ML_DSA

endif # CRACEN_HYBRID_VERIFY
```

## subsys/platform_metrics/Kconfig
```kconfig
#
# Copyright (c) 2026 Nordic Semiconductor ASA
#
# SPDX-License-Identifier: LicenseRef-Nordic-5-Clause
#

menuconfig PLATFORM_METRICS
	bool "Subsystem to monitor platform operating conditions"
	help
	  Enable monitoring of platform operating conditions (battery
	  voltage, die temperature) that other subsystems can use to
	  trigger recalibration, reconfiguration, or other adaptive
	  behavior. Each enabled channel collects live data through its
	  own work item.

if PLATFORM_METRICS

menuconfig PLATFORM_METRICS_DIE_TEMP_MONITOR
	bool "Monitor die temperature"
	select SENSOR
	select SENSOR_ASYNC_API
	help
	  Reads via the Zephyr sensor RTIO API from the device pointed to by
	  the `nordic,platform-metrics-die-temp-sensor` devicetree chosen
	  node. Falls back to the SoC's own die temperature sensor
	  (nodelabel `temp`) when no chosen override is present, so this
	  works out of the box on the DK. Boards with their own ambient
	  temperature sensor can override the chosen node instead of
	  touching this driver.

if PLATFORM_METRICS_DIE_TEMP_MONITOR

config PLATFORM_METRICS_DIE_TEMP_MONITOR_INTERVAL_MS
	int "Die temperature measurement interval (ms)"
	default 10000
	help
	  Interval between die temperature measurements in milliseconds.

endif # PLATFORM_METRICS_DIE_TEMP_MONITOR

config PLATFORM_METRICS_BATTERY_VOLTAGE_MONITOR
	bool "Monitor battery voltage"

config PLATFORM_METRICS_LOG_LEVEL
	int "Logging level in the platform metrics monitor"
	default LOG_DEFAULT_LEVEL
	depends on LOG
	help
	  Sets the logging level for the platform metrics monitor.

config PLATFORM_METRICS_DIE_TEMP_DEFAULT_VALUE
	int "Die temperature default value (centi-degC)"
	default 2500
	help
	  Default value when PLATFORM_METRICS_DIE_TEMP_MONITOR=n. 2500 = 25.00 C.

config PLATFORM_METRICS_BATTERY_VOLTAGE_DEFAULT_VALUE
	int "Battery voltage default value (mV)"
	default 3300
	help
	  Default value when PLATFORM_METRICS_BATTERY_VOLTAGE_MONITOR=n. 3300 = 3.3 V.

config PLATFORM_METRICS_SNAPSHOT_INTERVAL_MS
	int "Snapshot interval (ms)"
	default 10000
	help
	  How often a snapshot is captured from every
	  enabled channel.

endif # PLATFORM_METRICS
```
