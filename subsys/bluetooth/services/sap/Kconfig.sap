## subsys/bluetooth/services/sap/Kconfig.sap
```kconfig
#
# Copyright (c) 2026 Nordic Semiconductor ASA
#
# SPDX-License-Identifier: LicenseRef-Nordic-5-Clause
#

menuconfig BT_SAP
	bool "Secure Application Pairing (SAP) library"
	depends on BT
	depends on BT_CONN
	depends on BT_SMP
	select BT_NRF_SERVICES
	select MBEDTLS if !BUILD_WITH_TFM
	select MBEDTLS_PSA_CRYPTO_C if !BUILD_WITH_TFM
	select PSA_CRYPTO
	select PSA_WANT_GENERATE_RANDOM
	select PSA_WANT_ALG_SHA_256
	select PSA_WANT_ALG_ECDSA
	select PSA_WANT_ALG_ECDH
	select PSA_WANT_ALG_HKDF
	select PSA_WANT_ALG_HMAC
	select PSA_WANT_ALG_GCM
	select PSA_WANT_KEY_TYPE_AES
	select PSA_WANT_KEY_TYPE_DERIVE
	select PSA_WANT_KEY_TYPE_RAW_DATA
	select PSA_WANT_KEY_TYPE_ECC_PUBLIC_KEY
	select PSA_WANT_KEY_TYPE_ECC_KEY_PAIR_IMPORT
	select PSA_WANT_KEY_TYPE_ECC_KEY_PAIR_GENERATE
	select PSA_WANT_KEY_TYPE_ECC_KEY_PAIR_EXPORT
	select PSA_WANT_ECC_SECP_R1_256
	help
	  Build the Secure Application Pairing protocol library. SAP provides
	  certificate-backed mutual authentication, ECDH/HKDF session key
	  derivation, and AES-GCM application framing. Applications provide
	  callbacks for authentication transport, secure frames, payload
	  delivery, and session state events.

if BT_SAP

config BT_SAP_MAX_CONTEXTS
	int "Maximum SAP context count"
	range 1 4
	default 2
	help
	  Maximum number of concurrently initialized SAP contexts. Most
	  applications use one context for the local role, while unit tests and
	  dual-role samples may need two contexts in one image.

config BT_SAP_UNSAFE_PROTOCOL_TRACE
	bool "Unsafe SAP protocol hexdump trace"
	depends on LOG
	help
	  Enable verbose hexdumps of SAP authentication and secure transport
	  frames. This is intended only for controlled protocol tests because it
	  can expose authentication material and decrypted application payloads.

config BT_SAP_MAX_PEERS
	int "Maximum SAP peer count"
	range 1 BT_MAX_CONN
	default BT_MAX_CONN
	help
	  Maximum number of concurrent SAP sessions stored in one SAP context.
	  This defaults to the configured Bluetooth connection limit so SAP
	  does not reserve more session slots than the host can connect.

config BT_SAP_MAX_APP_PAYLOAD_SIZE
	int "Maximum SAP application payload size"
	range 1 512
	default 128
	help
	  Maximum plaintext application payload size accepted by the SAP secure
	  frame API. SAP frames are not fragmented by the library. GATT
	  transports must negotiate an ATT MTU of at least SAP_REQUIRED_ATT_MTU,
	  which grows with this value when secure frames become larger than
	  authentication frames.

module = BT_SAP
module-str = Secure Application Pairing library
source "subsys/logging/Kconfig.template.log_config"

endif
```

## subsys/bootloader/bl_storage/Kconfig
```kconfig
#
# Copyright (c) 2020 Nordic Semiconductor ASA
#
# SPDX-License-Identifier: LicenseRef-Nordic-5-Clause
#

config SECURE_BOOT_STORAGE
	bool "Library for accessing the bootloader storage"
	select NRFX_RRAMC if SOC_SERIES_NRF54L && !TRUSTED_EXECUTION_NONSECURE && \
			!SOC_FLASH_NRF_RRAM && !SOC_FLASH_NRF_RRAM_UICR
	imply SOC_FLASH_NRF_RRAM_UICR if SOC_SERIES_NRF54L && !TRUSTED_EXECUTION_NONSECURE && \
			SOC_FLASH_NRF_RRAM
```

## subsys/event_manager_proxy/Kconfig
```kconfig
#
# Copyright (c) 2022 Nordic Semiconductor
#
# SPDX-License-Identifier: LicenseRef-Nordic-5-Clause
#

menuconfig EVENT_MANAGER_PROXY
	depends on APP_EVENT_MANAGER
	bool "Event manager proxy"
	depends on IPC_SERVICE
	select EVENTS
	select APP_EVENT_MANAGER_PROVIDE_EVENT_SIZE
	select APP_EVENT_MANAGER_POSTPROCESS_HOOKS
	help
	  Event manager proxy would take care of passing the events between the different cores.

if EVENT_MANAGER_PROXY

config EVENT_MANAGER_PROXY_CH_COUNT
	int "Number of IPC instances to be used"
	range 1 32
	default 1
	help
	  Number of the communication channels to be supported.
	  It covers the information with how many cores we wish to communicate.

config EVENT_MANAGER_PROXY_BIND_TIMEOUT_MS
	int "Timeout while waiting for the endpoint to bind in ms"
	range 1 5000
	default 100
	help
	  Miliseconds to wait for endpoint binding.
	  This timeout depends on the time to initialize all the cores
	  the event proxy manager is going to communicate.

config EVENT_MANAGER_PROXY_SEND_RETRIES
	int "Number IPC transmission retries"
	range 0 100
	default 5
	help
	  Number of retries if an error occurs when transmitting event to the core.

config EVENT_MANAGER_PROXY_RX_BUFFER_SLOT_COUNT
	int "Number of RX buffers"
	default 32
	help
	  It is used by IPC service backend that supports RX buffer hold functionality.
	  Number of slots used to hold RX IPC buffers. If all slots are used then
	  new events are copied into a buffer allocated from the heap.

endif # EVENT_MANAGER_PROXY
```

## subsys/mgmt/mcumgr/grp/img_mgmt/Kconfig
```kconfig
#
# Copyright (c) 2025 Nordic Semiconductor ASA
#
# SPDX-License-Identifier: LicenseRef-Nordic-5-Clause
#

menu "Additional MCUmgr image management group functionality"

config MCUMGR_GRP_IMG_NRF
	bool "Use an extended version of the image management implementation"
	depends on MCUMGR_GRP_IMG
	default y if MCUMGR_GRP_IMG_TOO_LARGE_BOOTLOADER_INFO
	default y if NCS_MCUBOOT_BOOTLOADER_SIGN_MERGED_BINARY
	help
	  Enables use of an extended version of the image management implementation that adds
	  Nordic-specific functionalities.

if MCUMGR_GRP_IMG_NRF

config MCUMGR_GRP_IMG_QSPI_XIP_SPLIT_IMAGE
	bool "QSPI XIP Split image mode"
	depends on MCUBOOT_BOOTLOADER_MODE_DIRECT_XIP
	help
	  This option should not be selected by users and should automatically be selected by
	  sysbuild if needed. This enables selecting the correct slot when running a QSPI XIP
	  split image application in DirectXIP mode.

config MCUMGR_GRP_IMG_QSPI_XIP_SPLIT_COCONFIRM
	bool "QSPI XIP split image uses application SMP confirm policy"
	depends on MCUMGR_GRP_IMG
	default y if MCUBOOT_QSPI_XIP_IMAGE_NUMBER > -1
	help
	  When the application is split between internal flash and external QSPI XIP, MCUboot
	  exposes the external portion as a separate updateable image. MCUmgr normally treats
	  only the internal image (MCUBOOT_APPLICATION_IMAGE_NUMBER) as the "active" image for
	  confirm and slot-active policy. Enable this to treat the QSPI XIP image
	  (MCUBOOT_QSPI_XIP_IMAGE_NUMBER) as part of the running application: allow confirming
	  its primary slot and include it in hash-less image confirm.

endif # MCUMGR_GRP_IMG_NRF

endmenu

if MCUMGR_GRP_IMG && SOC_FLASH_NRF_RRAM

# Ensure that flash_flatten is done in chunks that are large enough for keeping speed performance on RRAM devices
# Perfectly, this value should be set to the value of (NRF_RRAM_WRITE_BUFFER_SIZE * 16).
configdefault FLASH_FILL_BUFFER_SIZE
	default 256

# Ensure that buffering is setup for the target device to achieve the maximum RRAM write speed.
configdefault NRF_RRAM_WRITE_BUFFER_SIZE
	default 16 if SOC_NRF54LV10A || SOC_NRF54LC10A
	default 8 if SOC_NRF54LS05A || SOC_NRF54LS05B
	default 32

endif # MCUMGR_GRP_IMG && SOC_FLASH_NRF_RRAM
```

## subsys/mpsl/antsw/Kconfig
```kconfig
#
# Copyright (c) 2026 Nordic Semiconductor ASA
#
# SPDX-License-Identifier: LicenseRef-Nordic-5-Clause
#

config MPSL_NRF71_ANTSW
	bool "nRF71 antenna switch control for Wi-Fi and short-range [EXPERIMENTAL]"
	select EXPERIMENTAL
	depends on SOC_SERIES_NRF71
	depends on MPSL
	depends on DT_HAS_NORDIC_NRF71_ANTSW_ENABLED
	depends on DT_HAS_NORDIC_NRF_PWR_ANTSWC_ENABLED
	depends on !TRUSTED_EXECUTION_NONSECURE
	depends on !MPSL_DYNAMIC_INTERRUPTS
	default y
	help
	  Use the ANTSWC peripheral to arbitrate access to the shared 2.4 GHz
	  antenna between Wi-Fi and short-range protocols.
```

## subsys/mpsl/log/Kconfig
```kconfig
#
# Copyright (c) 2026 Nordic Semiconductor ASA
#
# SPDX-License-Identifier: LicenseRef-Nordic-5-Clause
#

config MPSL_LOG_HANDLER
	bool "MPSL library logging handler [EXPERIMENTAL]"
	select EXPERIMENTAL
	depends on SOC_SERIES_NRF54L || SOC_SERIES_BSIM_NRF54LX
	depends on MPSL
	help
	  Enables the tokenized log handler shared by MPSL and the libraries
	  built on top of it (for example the SoftDevice Controller).
	  Each library contributes its own message table;
	  this handler resolves and prints them.

config MPSL_LOG
	bool "MPSL library logging [EXPERIMENTAL]"
	depends on MPSL
	depends on SOC_SERIES_NRF54L || SOC_SERIES_BSIM_NRF54LX
	select MPSL_LOG_HANDLER
	select EXPERIMENTAL
	help
	  Enable MPSL's own tokenized log message table, printed through the
	  shared log handler (see MPSL_LOG_HANDLER).

config MPSL_LOG_HANDLER_BUILTIN
	bool "Built-in MPSL logging handler"
	depends on MPSL_LOG_HANDLER
	depends on LOG
	default y
	help
	  Default handler using a separate thread and log FIFO, printing
	  through the Zephyr logging subsystem (requires LOG).
	  Disable to provide a custom handler in the application, for example
	  for special size or performance requirements.
	  This handler can be used as a reference.

if MPSL_LOG_HANDLER_BUILTIN

config MPSL_LOG_PRINT_LEVEL
	int "MPSL log print level"
	default 3
	range 0 4
	help
	  Log message severity printed by the built-in handler.

config MPSL_LOG_FIFO_SIZE
	int "MPSL log FIFO size"
	default 32
	range 1 1024
	help
	  Number of log messages that can be enqueued before dropping.

config MPSL_LOG_THREAD_STACK_SIZE
	int "MPSL log thread stack size"
	default 512
	help
	  Stack size for the thread that drains the log FIFO and prints messages.

endif # MPSL_LOG_HANDLER_BUILTIN
```
