## subsys/bootloader/Kconfig
```kconfig
#
# Copyright (c) 2018 Nordic Semiconductor ASA
#
# SPDX-License-Identifier: LicenseRef-Nordic-5-Clause
#

menu "Bootloader"

config SECURE_BOOT
	bool "Use Secure Bootloader"
	depends on !IS_SECURE_BOOTLOADER
	select FW_INFO
	select SW_VECTOR_RELAY if SOC_SERIES_NRF51
	help
	  Set this option to enable the first stage bootloader which
	  verifies the signature of the app.

if SECURE_BOOT

config SB_MONOTONIC_COUNTER_IS_ENABLED
	bool "HW monotonic version counter is enabled in the build (informative only, do not change)"
	help
	  This option is set by sysbuild if SB_CONFIG_SECURE_BOOT_MONOTONIC_COUNTER is set.
	  Do not edit this option manually.

endif # SECURE_BOOT

config PM_PARTITION_SIZE_PROVISION
	hex
	default 0x280 if SOC_SERIES_NRF91 || SOC_NRF5340_CPUAPP # Stored in OTP region
	# Monotonic counter slot takes 4 bytes on nRF54L Series
	default 0x460 if SOC_NRF54L15_CPUAPP || SOC_NRF54L05_CPUAPP || SOC_NRF54L10_CPUAPP || \
			 SOC_NRF54LV10A_ENGA_CPUAPP || SOC_NRF54LM20A_ENGA_CPUAPP
	default 0x280 if SOC_NRF5340_CPUNET # Second instance stored in internal flash of NET
	default FPROTECT_BLOCK_SIZE
	prompt "Flash space reserved for PROVISION" if !(SOC_NRF9160 || SOC_NRF5340_CPUAPP || \
							 SOC_NRF54L15_CPUAPP || SOC_NRF54L05_CPUAPP || \
							 SOC_NRF54L10_CPUAPP || SOC_NRF54LV10A_ENGA_CPUAPP || \
							 SOC_NRF54LM20A_ENGA_CPUAPP)
help
	  Flash space set aside for the PROVISION partition.

config B0_MIN_PARTITION_SIZE
	bool "Use minimimum partition size"

config PM_PARTITION_SIZE_B0_IMAGE
	hex "Flash space reserved for B0_IMAGE"
	default 0x8000 if !B0_MIN_PARTITION_SIZE && (SOC_SERIES_NRF91 || SOC_NRF5340_CPUAPP || SOC_NRF52840)
	default 0x7800 if !B0_MIN_PARTITION_SIZE && (SOC_NRF5340_CPUNET)
	default FPROTECT_BLOCK_SIZE if SOC_SERIES_NRF91 || SOC_NRF5340_CPUAPP
	default 0x3800 if SOC_NRF5340_CPUNET
	default 0x7800 if SOC_NRF54L15_CPUAPP || SOC_NRF54L05_CPUAPP || SOC_NRF54L10_CPUAPP || \
			  SOC_NRF54LV10A_ENGA_CPUAPP || SOC_NRF54LM20A_ENGA_CPUAPP
	default 0x7000 if !B0_MIN_PARTITION_SIZE
	default 0x4000
	help
	  Flash space set aside for the B0_IMAGE partition.

menuconfig IS_SECURE_BOOTLOADER
	bool "Current app is bootloader"
	select SECURE_BOOT_VALIDATION
	select SECURE_BOOT_STORAGE
	select SW_VECTOR_RELAY if SOC_SERIES_NRF51
	imply NRFX_NVMC if !SOC_SERIES_NRF54L
	help
	  This option is set by the first stage bootloader app to include all
	  files and set all the options required.

if IS_SECURE_BOOTLOADER

config SB_BPROT_IN_DEBUG
	bool "Block protect in debug"
	default y
	depends on (HAS_HW_NRF_BPROT || HAS_HW_NRF_MPU)

config SB_CLEANUP_RAM
	bool "Perform RAM cleanup"
	depends on !FW_INFO_PROVIDE_ENABLE
	depends on !MPU_STACK_GUARD
	depends on CPU_CORTEX_M4 || CPU_CORTEX_M33
	help
	  Sets contents of memory to 0 before jumping to application.

config SB_INFINITE_LOOP_AFTER_RAM_CLEANUP
	bool "Infinite loop after RAM cleanup"
	depends on SB_CLEANUP_RAM
	help
	  Verification option that keeps execution in infinite loop after
	  RAM cleanup has been performed.

config SB_DISABLE_SELF_RWX_SUPPORTED
	bool
	default y if SOC_NRF54L15_CPUAPP || SOC_NRF54L05_CPUAPP || SOC_NRF54L10_CPUAPP
	default y if SOC_NRF54LV10A_ENGA_CPUAPP
	default y if SOC_NRF54LM20A_ENGA_CPUAPP

config SB_DISABLE_SELF_RWX
	bool "Disable read and execution on self NVM"
	depends on SB_DISABLE_SELF_RWX_SUPPORTED && !FPROTECT_ALLOW_COMBINED_REGIONS
	help
	  Sets RRAMC's BOOTCONF region protection before jumping to application.
	  It disables reads writes and execution memory area which holds NSIB.

config SB_DISABLE_NEXT_W
	bool "Disable writes for next stage"
	depends on SB_DISABLE_SELF_RWX_SUPPORTED && !FPROTECT
	help
	  NSIB disables writes on next stage in bootloading chain.
	  It uses RRAMC's region 4 and is limited to 31KB for nRF54L15, nRF54L10 and nRF54L05
	  and to 127KB for nRF54LV10a and nRF54LM20a.

config SB_MONOTONIC_COUNTER_ROLLBACK_PROTECTION
	bool "HW monotonic version counter rollback protection (informative only, do not change)"
	help
	  This option is set by sysbuild if SB_CONFIG_SECURE_BOOT_MONOTONIC_COUNTER is set.
	  Do not edit this option manually.
	  If it is enabled, the secure bootloader prevents FW_INFO_FIRMWARE_VERSION
	  from being decremented for an image.
	  Images that do not meet this requirement will be rejected and not booted.

endif # IS_SECURE_BOOTLOADER

config IS_BOOTLOADER_IMG
	bool
	default y if IS_SECURE_BOOTLOADER || MCUBOOT
	help
	  Helper symbol which is set when the current image is a bootloader. This includes mcuboot
	  and the secure bootloader.

config NRF53_UPGRADE_NETWORK_CORE
	bool "Support updating nRF53 Network Core application"
	default y
	depends on SOC_NRF5340_CPUAPP
	depends on BOOTLOADER_MCUBOOT
	help
	  Enables support for updating the application on the nRF53 Network
	  core.

config NRF53_ENFORCE_IMAGE_VERSION_EQUALITY
	bool "Enforce the equality between APP and NET core image versions"
	depends on NRF53_UPGRADE_NETWORK_CORE
	help
	  When enabled, MCUboot proceeds with the image swapping only if both the application core and
	  the network core updates have been downloaded and they have the same version.

rsource "bl_crypto/Kconfig"
rsource "bl_validation/Kconfig"
rsource "bl_storage/Kconfig"

config MCUBOOT_COMPRESSED_IMAGE_SUPPORT_ENABLED
	bool "MCUboot compressed image support"
	help
	  This is a Kconfig which is informative only, the value should not be changed.

config MCUBOOT_BOOTLOADER_SIGNATURE_TYPE_ED25519
	bool "Use ED25519 signature"
	help
	  This is a Kconfig which is informative only, the value should not be changed.

config MCUBOOT_BOOTLOADER_SIGNATURE_TYPE_PURE
	bool "Signature is verified over an image rather than sha of an image"
	help
	  This is a Kconfig which is informative only, the value should not be changed.

config NCS_MCUBOOT_BOOTLOADER_SIGN_MERGED_BINARY
	bool "Sign merged binary instead of individual images (informative only, do not change)"
	help
	  This is a Kconfig which is informative only, the value should not be changed.

config NCS_MCUBOOT_MANIFEST_UPDATES
	bool "Manifest-based updates (informative only, do not change)"
	help
	  When enabled, supports transactional updates using manifests.
	  This is a Kconfig which is informative only, the value should not be changed.

if NCS_MCUBOOT_MANIFEST_UPDATES

config NCS_MCUBOOT_IMGTOOL_APPEND_MANIFEST
	bool "MCUboot append manifest (informative only, do not change)"
	help
	  Append common manifest while signing the image.
	  This is a Kconfig which is informative only, the value should not be changed.

config NCS_MCUBOOT_MANIFEST_IMAGE_INDEX
	int "Index of the image that must include manifest (informative only, do not change)"
	help
	  Specifies the index of the image that must include the manifest.
	  This is a Kconfig which is informative only, the value should not be changed.

endif # NCS_MCUBOOT_MANIFEST_UPDATES

endmenu
```

## subsys/bootloader/bl_crypto/Kconfig
```kconfig
#
# Copyright (c) 2018 Nordic Semiconductor ASA
#
# SPDX-License-Identifier: LicenseRef-Nordic-5-Clause
#

menuconfig SECURE_BOOT_CRYPTO
	bool
	prompt "Secure Boot Crypto"
	depends on IS_SECURE_BOOTLOADER || MCUBOOT || ZTEST
	select FW_INFO
	select NRF_OBERON

if (SECURE_BOOT_CRYPTO)

config SB_ECDSA_SECP256R1
	bool

config SB_ED25519
	bool

config SB_RSA_PSS2048
	bool

config SB_SHA256
	bool

config SB_SHA512
	bool

config SB_SIGNATURE_LEN
	int
	default 64 if SB_ECDSA_SECP256R1
	default 64 if SB_ED25519
	default 256 if SB_RSA_PSS2048

config SB_PUBLIC_KEY_LEN
	int
	default 64 if SB_ECDSA_SECP256R1
	default 32 if SB_ED25519
	default 256 if SB_RSA_PSS2048

config SB_HASH_LEN
	def_int 64 if SB_SHA512
	def_int 32 if !SB_CRYPTO_NONE

choice SB_CRYPTO_SIG
	prompt "Firmware verification Algorithm"
	default SB_CRYPTO_NO_ECDSA_SECP256R1 if !IS_SECURE_BOOTLOADER || SB_VALIDATE_FW_HASH
	default SB_CRYPTO_CC310_ECDSA_SECP256R1 if HAS_HW_NRF_CC310
	default SB_CRYPTO_OBERON_ECDSA_SECP256R1
	help
	  Crypto implementation to use for signature verification of firmware in Bootloader.

config SB_CRYPTO_OBERON_ECDSA_SECP256R1
	bool "Software ECDSA secp256r1"
	select SB_ECDSA_SECP256R1
	help
	  Software implementation of ECDSA with NIST curve secp256r1.

config SB_CRYPTO_CC310_ECDSA_SECP256R1
	bool "Hardware ECDSA secp256r1" if HAS_HW_NRF_CC310
	select NRF_CC310_BL
	select SB_ECDSA_SECP256R1
	help
	  Hardware implementation of ECDSA with NIST curve secp256r1.

config SB_CRYPTO_CLIENT_ECDSA_SECP256R1
	bool "Use another image's ECDSA secp256r1 implementation"
	select BL_SECP256R1_EXT_API_AT_LEAST_REQUIRED
	select SB_ECDSA_SECP256R1
	help
	  Using EXT_APIs from fw_info.

config SB_CRYPTO_NO_ECDSA_SECP256R1
	bool "secp256r1 without validation"
	select SB_ECDSA_SECP256R1
	help
	  Requires that a secp256r1 signature be present in the image but does no validation.

config SB_CRYPTO_PSA_ED25519
	bool "PSA ed25519 support"
	depends on NRF_SECURITY
	depends on CRACEN_LIB_KMU
	select SB_ED25519
	# Below depends on PSA_CORE_LITE
	select PSA_CORE_LITE_NSIB_ED25519_OPTIMIZATIONS
	select PSA_WANT_ALG_SHA_512
	select PSA_WANT_ALG_PURE_EDDSA
	select PSA_WANT_ECC_TWISTED_EDWARDS_255
	help
	  Use PSA crypto for ed25519 support.

	#config SB_CRYPTO_OBERON_RSA_2048
	#	bool #"Software RSA-PSS 2048-bits"
	#	select NRF_OBERON
	#	select SB_RSA_PSS2048
	#	help
	#	  Software implementation of RSASSA-PSS, 2048-bits.
	#	  Not available yet.

	#config SB_CRYPTO_CC310_RSA_2048
	#	bool #"Hardware RSA-PSS 2048-bits" if HAS_HW_NRF_CC310
	#	select NRF_CC310_BL
	#	select SB_RSA_PSS2048
	#	help
	#	  Hardware implementation of RSASSA-PSS, 2048-bits.
	#	  Not available yet.

endchoice

config SB_CRYPTO_KMU_KEYS_REVOCATION
	bool "Auto revoke previous gen key"
	depends on SB_CRYPTO_PSA_ED25519
	default y
	help
	  Automatically revoke previous generation key upon new valid key usage.

choice PSA_CORE
	default PSA_CORE_LITE if SB_CRYPTO_PSA_ED25519
	help
	  This is copy of PSA_CORE choice from NRF Security Kconfig, as the
	  only way to select an element from choice is to override default
	  for it.

endchoice

choice SB_CRYPTO_HASH
	prompt "Hashing Implementation"
	default SB_CRYPTO_NONE if SB_CRYPTO_PSA_ED25519
	default SB_CRYPTO_NO_SHA256 if !IS_SECURE_BOOTLOADER
	default SB_CRYPTO_CC310_SHA256 if HAS_HW_NRF_CC310
	default SB_CRYPTO_OBERON_SHA256
	help
	  Crypto implementation to use for hash generation in Bootloader.

config SB_CRYPTO_OBERON_SHA256
	bool "Software SHA256"
	select SB_SHA256
	help
	  Software implementation of SHA256.

config SB_CRYPTO_CC310_SHA256
	bool "Hardware SHA256" if HAS_HW_NRF_CC310
	select NRF_CC310_BL
	select SB_SHA256
	help
	  Hardware implementation of SHA256.

config SB_CRYPTO_CLIENT_SHA256
	bool "Use another image's SHA256 implementation"
	select BL_SHA256_EXT_API_AT_LEAST_REQUIRED
	select SB_SHA256
	help
	  Using EXT_APIs from fw_info.

config SB_CRYPTO_NO_SHA256
	bool "SHA256 without validation"
	help
	  Requires that a SHA256 hash be present in the image but does no validation.

config SB_CRYPTO_NONE
	bool "None"
	help
	  No hash will be present in the image.

config SB_CRYPTO_PSA_SHA512
	bool "PSA SHA512 support"
	depends on NRF_SECURITY
	select SB_SHA512
	select PSA_WANT_ALG_SHA_512
	select PSA_WANT_ALG_PURE_EDDSA
	select PSA_WANT_ECC_TWISTED_EDWARDS_255
	select PSA_WANT_KEY_TYPE_ECC_KEY_PAIR_IMPORT
	help
	  Use PSA crypto for SHA512 support.

endchoice

EXT_API = BL_ROT_VERIFY
id = 0x1001
flags = 2
ver = 1
source "$(ZEPHYR_NRF_MODULE_DIR)/subsys/fw_info/Kconfig.template.fw_info_ext_api"

if SB_SHA256
EXT_API = BL_SHA256
id = 0x1002
flags = 0
ver = 1
source "$(ZEPHYR_NRF_MODULE_DIR)/subsys/fw_info/Kconfig.template.fw_info_ext_api"
endif

if SB_ECDSA_SECP256R1
EXT_API = BL_SECP256R1
id = 0x1003
flags = 1
ver = 1
source "$(ZEPHYR_NRF_MODULE_DIR)/subsys/fw_info/Kconfig.template.fw_info_ext_api"
endif

module = SB_CRYPTO
module-str = secure boot crypto
source "subsys/logging/Kconfig.template.log_config"

endif # SECURE_BOOT_CRYPTO
```

## subsys/bootloader/bl_monotonic_counters/Kconfig
```kconfig
#
# Copyright (c) 2020 Nordic Semiconductor ASA
#
# SPDX-License-Identifier: LicenseRef-Nordic-5-Clause
#

config BL_MONOTONIC_COUNTERS
	bool "Library for monotonic counters"
	default y if SECURE_BOOT_STORAGE
	default y if MCUBOOT_HW_DOWNGRADE_PREVENTION
```

## subsys/bootloader/bl_purse/Kconfig
```kconfig
#
# Copyright (c) 2020 Nordic Semiconductor ASA
#
# SPDX-License-Identifier: LicenseRef-BSD-5-Clause-Nordic
#

config SECURE_BOOT_PURSE
	bool "Functions for accessing the provisioning data"
	depends on SECURE_BOOT_CRYPTO
```

## subsys/bootloader/bl_validation/Kconfig
```kconfig
#
# Copyright (c) 2019 Nordic Semiconductor ASA
#
# SPDX-License-Identifier: LicenseRef-BSD-5-Clause-Nordic
#

menu "Secure Boot firmware validation"

config SECURE_BOOT_VALIDATION
	bool "Enable Secure Boot validation code"
	select FW_INFO
	depends on SECURE_BOOT_CRYPTO

config SB_VALIDATION_INFO_MAGIC
	hex "Magic word used for validation info structs (32 bits)."
	default 0x86518483
	help
	  Magic word value specific to validation info structs (after firmware).
	  For more info, see FW_INFO_MAGIC_COMMON.

config SB_VALIDATION_POINTER_MAGIC
	hex "Magic word used for validation info pointer structs (32 bits)."
	default 0x6919b47e
	help
	  Magic word value specific to validation info pointer structs.
	  For more info, see FW_INFO_MAGIC_COMMON.

config SB_VALIDATION_INFO_CRYPTO_ID
	int
	range 0 255
	default 1 # if SB_ECDSA_SECP256R1 && SB_SHA256
	help
	  The algorithm used for signing the firmware (8 bits).
	  Used to ensure compatibility.
	  For more info, see FW_INFO_MAGIC_COMMON.

config SB_VALIDATION_INFO_VERSION
	int "Version number of the fw_validation_info* structs (8 bits)."
	range 0 255
	default 2
	help
	  Used to ensure binary compatibility.
	  For more info, see FW_INFO_MAGIC_COMMON.

config SB_VALIDATION_METADATA_OFFSET
	int "Offset at which to store validation metadata."
	default 0
	help
	  Must be either 0 or larger than the size of the application. If 0,
	  the metadata is appended directly after the application image,
	  aligned to the closest word.

if SECURE_BOOT_VALIDATION

EXT_API = BL_VALIDATE_FW
id = 0x1101
flags = 3
ver = 1
source "${ZEPHYR_BASE}/../nrf/subsys/fw_info/Kconfig.template.fw_info_ext_api"

endif # SECURE_BOOT_VALIDATION

endmenu
```

## subsys/bootloader/c_runtime_setup/Kconfig
```kconfig
#
# Copyright (c) 2018 Nordic Semiconductor ASA
#
# SPDX-License-Identifier: LicenseRef-BSD-5-Clause-Nordic
#

choice
	prompt "C runtime setup selection"
	default SB_C_RUNTIME_SETUP_VARIANT_MDK
	config SB_C_RUNTIME_SETUP_VARIANT_CUSTOM
		bool "Custom C runtime setup"
	config SB_C_RUNTIME_SETUP_VARIANT_ZEPHYR
		bool "Zephyr C runtime setup"
	config SB_C_RUNTIME_SETUP_VARIANT_MDK
		bool "MDK C runtime setup"
		select SB_VENDOR_SYSTEM_INIT
endchoice

config SB_VENDOR_SYSTEM_INIT
	bool "Boot with chip specific initialization"
```
