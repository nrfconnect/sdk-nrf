## subsys/bluetooth/services/fast_pair/fp_storage/Kconfig.fp_storage
```kconfig
#
# Copyright (c) 2022 Nordic Semiconductor ASA
#
# SPDX-License-Identifier: LicenseRef-Nordic-5-Clause
#

config BT_FAST_PAIR_STORAGE
	bool
	default y
	select SETTINGS
	help
	  Add Fast Pair storage source files.

if BT_FAST_PAIR_STORAGE

config BT_FAST_PAIR_STORAGE_MANAGER
	bool
	default y
	help
	  Add Fast Pair storage manager source files.

config BT_FAST_PAIR_STORAGE_USER_RESET_ACTION
	bool "Enable user reset action during factory reset"
	help
	  Enable user reset action that executes together with the Fast Pair factory reset
	  operation within the bt_fast_pair_factory_reset API function. To define the user reset
	  action, you need to override the weak function definition of the
	  bt_fast_pair_factory_reset_user_action_perform symbol. Optionally, you can override the
	  bt_fast_pair_factory_reset_user_action_prepare symbol if you want an earlier notification
	  that the reset operation is due to begin.

config BT_FAST_PAIR_STORAGE_OWNER_ACCOUNT_KEY
	bool
	help
	  Enable support for the Owner Account Key in the Storage module.

choice BT_FAST_PAIR_STORAGE_AK_BACKEND
	prompt "Account Key storage backend selection"
	help
	  Select the Fast Pair Account Key storage backend.

config BT_FAST_PAIR_STORAGE_AK_BACKEND_STANDARD
	bool "Account Key storage standard backend"
	depends on !BT_FAST_PAIR_STORAGE_OWNER_ACCOUNT_KEY
	help
	  Select Account Key storage standard backend. It allows for storing multiple Account Keys.
	  It doesn't support Owner Account Key storage so it can not be used with
	  BT_FAST_PAIR_STORAGE_OWNER_ACCOUNT_KEY.

config BT_FAST_PAIR_STORAGE_AK_BACKEND_MINIMAL
	bool "Account Key storage minimal backend"
	depends on BT_FAST_PAIR_STORAGE_OWNER_ACCOUNT_KEY
	help
	  Select Account Key storage minimal backend. It allows for storing only one Account Key,
	  that is assumed to be an Owner Account Key.

endchoice

config BT_FAST_PAIR_STORAGE_ACCOUNT_KEY_MAX
	int "Maximum number of stored Account Keys"
	range 5 10 if BT_FAST_PAIR_STORAGE_AK_BACKEND_STANDARD
	default 5 if BT_FAST_PAIR_STORAGE_AK_BACKEND_STANDARD
	range 1 1 if BT_FAST_PAIR_STORAGE_AK_BACKEND_MINIMAL
	help
	  Maximum number of stored account keys. According to Fast Pair specification, it should be
	  at least equal to 5. It can not be larger than 10, because then Account Key Filter length
	  would not fit in the "field length and type" data field specified in the non-discoverable
	  advertising packet. Locator tags are a special use-case that relies on only 1 Account Key
	  (the Owner Account Key).

config BT_FAST_PAIR_STORAGE_EXPOSE_PRIV_API
	bool "Expose private API"
	depends on !BT_FAST_PAIR
	help
	  Expose Fast Pair storage's private data structures, definitions and functionalities.
	  The option could be used by unit tests to prepopulate settings with mocked data.

config BT_FAST_PAIR_STORAGE_PN
	bool
	help
	  Add Fast Pair storage source files for Personalized Name extension.

if BT_FAST_PAIR_STORAGE_PN

config BT_FAST_PAIR_STORAGE_PN_LEN_MAX
	int "Maximum length of stored Fast Pair Personalized Name"
	range 64 1024
	default 64
	help
	  Maximum length of stored Fast Pair Personalized Name. According to Fast Pair
	  specification, it should be at least equal to 64.

endif # BT_FAST_PAIR_STORAGE_PN

config BT_FAST_PAIR_STORAGE_FMDN_CLOCK
	bool
	help
	  Add Fast Pair storage source files for the Beacon Clock used in the FMDN extension.

config BT_FAST_PAIR_STORAGE_FMDN_EIK
	bool
	help
	  Add Fast Pair storage source files for the EIK used in the FMDN extension.

module = FP_STORAGE
module-str = Fast Pair storage library
source "${ZEPHYR_BASE}/subsys/logging/Kconfig.template.log_config"

endif # BT_FAST_PAIR_STORAGE
```

## subsys/bluetooth/services/fast_pair/use_case/Kconfig
```kconfig
#
# Copyright (c) 2024 Nordic Semiconductor ASA
#
# SPDX-License-Identifier: LicenseRef-Nordic-5-Clause
#

choice BT_FAST_PAIR_USE_CASE
	prompt "Use case selection"
	default BT_FAST_PAIR_USE_CASE_UNKNOWN
	help
	  Select the Fast Pair use case to configure the Fast Pair features and extensions
	  that satisfy the device feature requirements from the Google Fast Pair specification:
	  https://developers.google.com/nearby/fast-pair/specifications/devicefeaturerequirement.
	  The use case selection should match the device type selection for your Fast Pair Model
	  in the Google Nearby Console.

config BT_FAST_PAIR_USE_CASE_UNKNOWN
	bool "Unknown use case"
	help
	  Select the unknown Fast Pair use case. This use case configuration is neutral and is the
	  default choice selection. The unknown use case does not enable any Fast Pair features and
	  extensions or impose restrictions on Fast Pair Kconfig options.

config BT_FAST_PAIR_USE_CASE_INPUT_DEVICE
	bool "Input device use case [EXPERIMENTAL]"
	select EXPERIMENTAL
	select BT_FAST_PAIR_GATT_SERVICE_MODEL_ID
	select BT_FAST_PAIR_PN
	select BT_FAST_PAIR_REQ_PAIRING
	select BT_FAST_PAIR_SUBSEQUENT_PAIRING
	select BT_DIS
	select BT_DIS_FW_REV
	imply BT_FAST_PAIR_BOND_MANAGER
	help
	  Select the input device Fast Pair use case. Input device is a Human Interface Device
	  (HID) such as a mouse, keyboard, remote control or a gaming pad that lets the user
	  interact with electronic devices such as a PC, TV or a console. This Kconfig option
	  configures the Fast Pair features and extensions to provide the best UX for the input
	  device use case. This option is experimental, as the input device feature requirements
	  are not yet defined in the Google Fast Pair specification.

config BT_FAST_PAIR_USE_CASE_LOCATOR_TAG
	bool "Locator tag use case"
	select BT_FAST_PAIR_FMDN
	select BT_FAST_PAIR_FMDN_DULT
	select BT_FAST_PAIR_USE_CASE_UNSUPPORTED_BOND_MANAGER
	select BT_FAST_PAIR_USE_CASE_UNSUPPORTED_GATT_SERVICE_MODEL_ID
	select BT_FAST_PAIR_USE_CASE_UNSUPPORTED_SUBSEQUENT_PAIRING
	select BT_FAST_PAIR_USE_CASE_UNSUPPORTED_PN
	select BT_FAST_PAIR_USE_CASE_UNSUPPORTED_BN
	help
	  Select the locator tag Fast Pair use case. Locator tag is a small electronic device that
	  can be attached to an object or a person, and is designed to help locate them in case
	  they are missing. This Kconfig option configures the Fast Pair features and extensions
	  to satisfy the locator tag device feature requirements from the Google Fast Pair
	  specification:
	  https://developers.google.com/nearby/fast-pair/specifications/devicefeaturerequirement/devicefeaturerequirement_locatortags.

config BT_FAST_PAIR_USE_CASE_MOUSE
	bool "Mouse use case [EXPERIMENTAL]"
	select EXPERIMENTAL
	select BT_FAST_PAIR_GATT_SERVICE_MODEL_ID
	select BT_FAST_PAIR_PN
	select BT_FAST_PAIR_REQ_PAIRING
	select BT_FAST_PAIR_SUBSEQUENT_PAIRING
	select BT_DIS
	select BT_DIS_FW_REV
	imply BT_FAST_PAIR_BOND_MANAGER
	help
	  Select the mouse Fast Pair use case. Mouse is a Human Interface Device (HID) that lets
	  the user interact with electronic devices such as a PC. This Kconfig option configures
	  the Fast Pair features and extensions to provide the best UX for the mouse use case.
	  This option is experimental, as the mouse feature requirements are not yet defined
	  in the Google Fast Pair specification.

endchoice

# Collection of unsupported Fast Pair features that can be selected by the use case Kconfig.
config BT_FAST_PAIR_USE_CASE_UNSUPPORTED_BOND_MANAGER
	bool
	depends on !BT_FAST_PAIR_BOND_MANAGER

config BT_FAST_PAIR_USE_CASE_UNSUPPORTED_GATT_SERVICE_MODEL_ID
	bool
	depends on !BT_FAST_PAIR_GATT_SERVICE_MODEL_ID

config BT_FAST_PAIR_USE_CASE_UNSUPPORTED_SUBSEQUENT_PAIRING
	bool
	depends on !BT_FAST_PAIR_SUBSEQUENT_PAIRING

config BT_FAST_PAIR_USE_CASE_UNSUPPORTED_PN
	bool
	depends on !BT_FAST_PAIR_PN

config BT_FAST_PAIR_USE_CASE_UNSUPPORTED_BN
	bool
	depends on !BT_FAST_PAIR_BN
```

## subsys/bluetooth/services/fast_pair/use_case/locator_tag/Kconfig
```kconfig
#
# Copyright (c) 2024 Nordic Semiconductor ASA
#
# SPDX-License-Identifier: LicenseRef-Nordic-5-Clause
#

config BT_FAST_PAIR_LOCATOR_TAG_FP_ADV
	bool "Enable the Fast Pair advertising module"
	select BT_ADV_PROV
	select BT_ADV_PROV_FAST_PAIR
	depends on BT_FAST_PAIR_FMDN
	help
	  Enable the Fast Pair advertising module that is tailored for the locator tag use case.
	  The module manages the Fast Pair advertising set and the Fast Pair connections that are
	  derived from it. It also implements the locator tag requirements for the Fast Pair
	  advertising define in the FMDN specification:
	  https://developers.google.com/nearby/fast-pair/specifications/extensions/fmdn#locator-tag.
```

## subsys/bluetooth/services/ras/Kconfig.ras
```kconfig
#
# Copyright (c) 2024 Nordic Semiconductor ASA
#
# SPDX-License-Identifier: LicenseRef-Nordic-5-Clause
#

menuconfig BT_RAS
	bool "Ranging Service"
	depends on BT_CHANNEL_SOUNDING
	select BT_NRF_SERVICES
	help
	  Bluetooth GATT Ranging Service modules - RREQ and RRSP.

if BT_RAS

rsource "rreq/Kconfig.ras_rreq"
rsource "rrsp/Kconfig.ras_rrsp"

config BT_RAS_MAX_ANTENNA_PATHS
	int "Maximum number of antenna paths supported"
	default 4
	range 1 4
	help
	  The number of antenna paths per step that can be stored inside RAS.
	  Must match the supported CS capabilities of the local device.
	  This affects the per-instance memory usage of RAS.

config BT_RAS_MODE_3_SUPPORTED
	bool "Support storing Mode 3 CS steps"
	default y
	help
	  If enabled, RAS will allocate memory for storing Mode 3 CS steps.
	  Must match the supported CS capabilities of the local device.
	  This affects the per-instance memory usage of RAS.

# CONFIG_BT_CHANNEL_SOUNDING_REASSEMBLY_BUFFER_SIZE is declared in Zephyr and also
# here for a second time, to set a different range for the CS subevent result reassembly
# buffer. Default values are also set based on RAS configs to help users reduce RAM usage.
config BT_CHANNEL_SOUNDING_REASSEMBLY_BUFFER_SIZE
	int "Subevent result reassembly buffer size"
	depends on BT_CHANNEL_SOUNDING
	range 239 4800
	default 1920 if BT_RAS_MAX_ANTENNA_PATHS=1 && !BT_RAS_MODE_3_SUPPORTED
	default 2560 if BT_RAS_MAX_ANTENNA_PATHS=2 && !BT_RAS_MODE_3_SUPPORTED
	default 3200 if BT_RAS_MAX_ANTENNA_PATHS=3 && !BT_RAS_MODE_3_SUPPORTED
	default 3840 if BT_RAS_MAX_ANTENNA_PATHS=4 && !BT_RAS_MODE_3_SUPPORTED
	default 2880 if BT_RAS_MAX_ANTENNA_PATHS=1 && BT_RAS_MODE_3_SUPPORTED
	default 3520 if BT_RAS_MAX_ANTENNA_PATHS=2 && BT_RAS_MODE_3_SUPPORTED
	default 4160 if BT_RAS_MAX_ANTENNA_PATHS=3 && BT_RAS_MODE_3_SUPPORTED
	default 4800
	help
	  When the results for a CS subevent cannot fit into a single HCI event,
	  it will be split up into multiple events and consequently, reassembled into a
	  full CS subevent. This config sets the size of the reassembly buffer.


endif # BT_RAS
```

## subsys/bluetooth/services/ras/rreq/Kconfig.ras_rreq
```kconfig
#
# Copyright (c) 2024 Nordic Semiconductor ASA
#
# SPDX-License-Identifier: LicenseRef-Nordic-5-Clause
#

menuconfig BT_RAS_RREQ
	bool "GATT Ranging Requester Client"
	select BT_GATT_DM
	select BT_GATT_CLIENT

if BT_RAS_RREQ

module = BT_RAS_RREQ
module-str = RAS_RREQ
source "$(ZEPHYR_BASE)/subsys/logging/Kconfig.template.log_config"

config BT_RAS_RREQ_MAX_ACTIVE_CONN
	int "Number of simultaneously supported RREQ instances"
	default BT_MAX_CONN
	range 1 BT_MAX_CONN
	help
	  The number of simultaneous connections with an instance of RAS RREQ.

endif # BT_RAS_RREQ
```

## subsys/bluetooth/services/ras/rrsp/Kconfig.ras_rrsp
```kconfig
#
# Copyright (c) 2024 Nordic Semiconductor ASA
#
# SPDX-License-Identifier: LicenseRef-Nordic-5-Clause
#

menuconfig BT_RAS_RRSP
	bool "GATT Ranging Responder Server"

if BT_RAS_RRSP

config BT_RAS_RRSP_AUTO_ALLOC_INSTANCE
	bool "Automatically allocate RRSP instances to new connections"
	default y
	help
	  Automatically allocate RRSP instances to new connections.

config BT_RAS_RRSP_MAX_ACTIVE_CONN
	int "Number of simultaneously supported RRSP instances"
	default BT_MAX_CONN
	range 1 BT_MAX_CONN
	help
	  The number of simultaneous connections with an instance of RAS RRSP.

config BT_RAS_RRSP_RD_BUFFERS_PER_CONN
	int "Number of ranging data buffers per connection"
	default 1
	range 1 10
	help
	  The number of ranging procedures that can be stored inside RRSP at the same time.

module = BT_RAS_RRSP
module-str = RAS_RRSP
source "$(ZEPHYR_BASE)/subsys/logging/Kconfig.template.log_config"

endif # BT_RAS_RRSP
```

## subsys/bluetooth/services/wifi_prov/Kconfig.wifi_prov
```kconfig
#
# Copyright (c) 2022 Nordic Semiconductor ASA
#
# SPDX-License-Identifier: LicenseRef-Nordic-5-Clause
#
menuconfig BT_WIFI_PROV
	bool "Enable Wi-Fi provisioning service"
	select BT_NRF_SERVICES
	depends on NANOPB
	depends on NET_L2_WIFI_MGMT
	depends on WIFI_CREDENTIALS

if BT_WIFI_PROV

module = BT_WIFI_PROV
module-str = WIFI_PROV
source "${ZEPHYR_BASE}/subsys/logging/Kconfig.template.log_config"

endif # BT_WIFI_PROV
```
