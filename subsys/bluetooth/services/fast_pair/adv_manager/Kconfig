## subsys/bootloader/debug/Kconfig
```kconfig
#
# Copyright (c) 2018 Nordic Semiconductor ASA
#
# SPDX-License-Identifier: LicenseRef-BSD-5-Clause-Nordic
#

config SECURE_BOOT_DEBUG
	bool "Enable Debug"

if SECURE_BOOT_DEBUG
choice
	prompt "Output"
	default SB_DEBUG_PORT_SEGGER_RTT
	config SB_DEBUG_PORT_SEGGER_RTT
		bool "SEGGER RTT"
	config SB_DEBUG_PORT_UART
		bool "UART"
endchoice

config SB_DEBUG_PRINTF_BUF_LEN
	int "Debug print buffer (bytes)"
	default 120

if SB_DEBUG_PORT_SEGGER_RTT
menu "SEGGER RTT Options"
config SB_SEGGER_RTT_MAX_NUM_UP_BUFFERS
	int "Maximum number of up-buffers"
	default 3

config SB_SEGGER_RTT_MAX_NUM_DOWN_BUFFERS
	int "Maximum number of down-buffers"
	default 3

config SB_SEGGER_RTT_BUFFER_SIZE_UP
	int "Size of the buffer for terminal output of target, up to host"
	default 1024

config SB_SEGGER_RTT_BUFFER_SIZE_DOWN
	int "Size of the buffer for terminal input of target, from host"
	default 16

config SB_SEGGER_RTT_PRINTF_BUFFER_SIZE
	int "Size of buffer for RTT printf to bulk-send chars via RTT"
	default 64

choice
	prompt "Mode for pre-initialized terminal channel (buffer 0)"
	default SB_SEGGER_RTT_MODE_NO_BLOCK_SKIP
	config SB_SEGGER_RTT_MODE_NO_BLOCK_SKIP
		bool "Skip. Do not block, output nothing."

	config SB_SEGGER_RTT_MODE_NO_BLOCK_TRIM
		bool "Trim: Do not block, output as much as fits."

	config SB_SEGGER_RTT_MODE_BLOCK_IF_FIFO_FULL
		bool "Block: Wait until there is space in the buffer."
endchoice

config SB_SEGGER_RTT_MODE
	int
	default 2 if SEGGER_RTT_MODE_BLOCK_IF_FIFO_FULL
	default 1 if SEGGER_RTT_MODE_NO_BLOCK_TRIM
	default 0

config SB_SEGGER_RTT_MEMCPY_USE_BYTELOOP
	bool "Use a simple byte-loop instead of standard memcpy"
endmenu
endif # SB_DEBUG_PORT_SEGGER_RTT
endif #SECURE_BOOT_DEBUG
```

## subsys/bootloader/fprotect/Kconfig
```kconfig
#
# Copyright (c) 2018 Nordic Semiconductor ASA
#
# SPDX-License-Identifier: LicenseRef-BSD-5-Clause-Nordic
#

# Hidden config for enabling flash protection

config SB_FLASH_PROTECT
	bool
```

## subsys/bootloader/fw_metadata/Kconfig
```kconfig
#
# Copyright (c) 2018 Nordic Semiconductor ASA
#
# SPDX-License-Identifier: LicenseRef-BSD-5-Clause-Nordic
#

menu "Firmware Metadata Options"

config SB_VALIDATION_METADATA_OFFSET
	int "Offset to store validation metadata at."
	default 0
	help
	  Must be either 0 or larger than size of application. If 0 is set,
	  the metadata will be appended directly after the application image,
	  aligned to closest word.

config SB_FIRMWARE_INFO_OFFSET
	hex "The location of firmware info inside firmware."
	default 0x800
	help
	  Note that all space between the vector table and this address will be
	  unused.

config SB_FIRMWARE_VERSION
	int "Version number of the firmware."
	default 1

config SB_MAGIC_COMMON
	hex "Magic word used for all structs (32 bits)."
	default 0x281ee6de
	help
	  There are 3 different metadata structs (see fw_metadata.h). They each
	  have their own magic word composed of 3 u32_t values. One of the
	  u32_ts is a compatibility id constructed from SB_HARDWARE_ID,
	  SB_INFO_VERSION, SB_CRYPTO_ALGORITHM, and SB_CUSTOM_COMPATIBILITY_ID.
	  The other two u32_ts are defined in SB_MAGIC_COMMON (common to
	  all structs), and in one of SB_MAGIC_FIRMWARE_INFO,
	  SB_MAGIC_VALIDATION_INFO, and SB_MAGIC_POINTER.
	  The bootloader expects a certain value for each struct, and if it
	  attempts to read a struct without a matching magic word, the struct
	  will be rejected. The config values here apply both to this build of
	  the bootloader, and to the metadata constructed for the app.
	  Refer to fw_metadata.cmake to see how the magic words are composed.

config SB_MAGIC_FIRMWARE_INFO
	hex "Magic word for firmware info structs (32 bits)."
	default 0x8fcebb4c
	help
	  Magic word value specific to firmware info structs (inside firmware).
	  For more info, see SB_MAGIC_COMMON.

config SB_MAGIC_VALIDATION_INFO
	hex "Magic word used for validation info structs (32 bits)."
	default 0x86518483
	help
	  Magic word value specific to validation info structs (after firmware).
	  For more info, see SB_MAGIC_COMMON.

config SB_MAGIC_POINTER
	hex "Magic word used for validation info pointer structs (32 bits)."
	default 0x6919b47e
	help
	  Magic word value specific to validation info pointer structs.
	  For more info, see SB_MAGIC_COMMON.

config SB_HARDWARE_ID
	int "The SOC a firmware is built to run on (8 bits)."
	range 0 255
	default 51 if SOC_SERIES_NRF51X
	default 52 if SOC_SERIES_NRF52X
	default 91 if SOC_SERIES_NRF91X
	help
	  Used to ensure binary compatibility.
	  For more info, see SB_MAGIC_COMMON.

config SB_INFO_VERSION
	int "Version number of the fw_*_info structs (8 bits)."
	range 0 255
	default 1
	help
	  Used to ensure binary compatibility.
	  For more info, see SB_MAGIC_COMMON.

config SB_CRYPTO_ALGORITHM
	int
	range 0 255
	default 1 if SB_ECDSA
	default 2 if SB_RSA
	help
	  The algorithm used for signing the firmware (8 bits).
	  Used to ensure compatibility.
	  For more info, see SB_MAGIC_COMMON.

config SB_CUSTOM_COMPATIBILITY_ID
	int "Compatibility ID for user-defined purposes (8 bits)."
	default 0
	help
	  User defined value.
	  Used to ensure compatibility between bootloader and metadata.
	  For more info, see SB_MAGIC_COMMON.

config SB_MAGIC_LEN
	int
	default 12
	help
	  Total length of magic words (in bytes).
	  For more info, see SB_MAGIC_COMMON.

endmenu
```

## subsys/caf/Kconfig
```kconfig
#
# Copyright (c) 2021 Nordic Semiconductor ASA
#
# SPDX-License-Identifier: LicenseRef-Nordic-5-Clause
#

menuconfig CAF
	bool "Common Application Framework"
	select APP_EVENT_MANAGER
	select CAF_MODULE_STATE_EVENTS
	help
	  Enable Common Application Framework for use with the application.

if CAF
rsource "events/Kconfig"
rsource "modules/Kconfig"
endif # CAF
```

## subsys/caf/events/Kconfig
```kconfig
#
# Copyright (c) 2021 Nordic Semiconductor ASA
#
# SPDX-License-Identifier: LicenseRef-Nordic-5-Clause
#

menu "Event options"

config CAF_PM_EVENTS
	bool "Enable power management events"
	help
	  Enable support for power management events.
	  If this config is enabled, predefined modules can create power management events.

config CAF_INIT_LOG_POWER_DOWN_EVENTS
	bool "Log power down events"
	depends on CAF_PM_EVENTS
	depends on LOG
	default y

config CAF_INIT_LOG_WAKE_UP_EVENTS
	bool "Log wake up events"
	depends on CAF_PM_EVENTS
	depends on LOG
	default y

config CAF_BLE_COMMON_EVENTS
	bool "Enable BLE common events"
	help
	  Enable support for BLE common events.

config CAF_INIT_LOG_BLE_PEER_EVENTS
	bool "Log BLE peer events"
	depends on CAF_BLE_COMMON_EVENTS
	depends on LOG
	default y

config CAF_INIT_LOG_BLE_PEER_SEARCH_EVENTS
	bool "Log BLE peer search events"
	depends on CAF_BLE_COMMON_EVENTS
	depends on LOG
	default y

config CAF_INIT_LOG_BLE_ADV_DATA_UPDATE_EVENTS
	bool "Log BLE advertising data update events"
	depends on CAF_BLE_COMMON_EVENTS
	depends on LOG
	default y

config CAF_INIT_LOG_BLE_PEER_OPERATION_EVENTS
	bool "Log BLE peer operation events"
	depends on CAF_BLE_COMMON_EVENTS
	depends on LOG
	default y

config CAF_INIT_LOG_BLE_PEER_CONN_PARAMS_EVENTS
	bool "Log BLE peer connection parameters events"
	depends on CAF_BLE_COMMON_EVENTS
	depends on LOG
	default y

config CAF_BLE_SMP_TRANSFER_EVENTS
	bool "Enable BLE SMP events"
	help
	  Enable support for BLE SMP transfer events.

config CAF_INIT_LOG_BLE_SMP_TRANSFER_EVENTS
	bool "Log BLE SMP transfer events"
	depends on CAF_BLE_SMP_TRANSFER_EVENTS
	depends on LOG
	default y

config CAF_BUTTON_EVENTS
	bool "Enable button events"
	help
	  Enable support for button events.

config CAF_INIT_LOG_BUTTON_EVENTS
	bool "Log button events"
	depends on CAF_BUTTON_EVENTS
	depends on LOG
	default y

config CAF_CLICK_EVENTS
	bool "Enable click events"
	help
	  Enable support for click events.

config CAF_INIT_LOG_CLICK_EVENTS
	bool "Log click events"
	depends on CAF_CLICK_EVENTS
	depends on LOG
	default y

config CAF_LED_EVENTS
	bool "Enable LED events"
	help
	  Enable support for LED event.

config CAF_INIT_LOG_LED_EVENTS
	bool "Log LED events"
	depends on CAF_LED_EVENTS
	depends on LOG
	default y
	help
	  Log LED events used to change LED operating mode and color.

config CAF_INIT_LOG_LED_READY_EVENTS
	bool "Log LED ready event"
	depends on CAF_LED_EVENTS
	depends on LOG
	default y
	help
	  Log LED events used to notify that LED is ready for next stream
	  effect.

config CAF_NET_STATE_EVENTS
	bool "Enable network state events"
	help
	  Enable support for network state events.

config CAF_INIT_LOG_NET_STATE_EVENTS
	bool "Log network state events"
	depends on CAF_NET_STATE_EVENTS
	depends on LOG
	default y
	help
	  Log network state events.

rsource "Kconfig.factory_reset_event"
rsource "Kconfig.force_power_down_event"
rsource "Kconfig.keep_alive_event"
rsource "Kconfig.module_state_event"
rsource "Kconfig.power_manager_event"
rsource "Kconfig.sensor_event"

endmenu
```

## subsys/caf/events/Kconfig.factory_reset_event
```kconfig
#
# Copyright (c) 2021 Nordic Semiconductor
#
# SPDX-License-Identifier: LicenseRef-Nordic-5-Clause
#

config CAF_FACTORY_RESET_EVENTS
	bool "Enable factory reset events"
	help
	  Enable the event that informs the system that factory reset was requested.

config CAF_INIT_LOG_FACTORY_RESET_EVENTS
	bool "Log factory reset events"
	depends on LOG
	depends on CAF_FACTORY_RESET_EVENTS
	default y
	help
	  Log the factory reset events.
```

## subsys/caf/events/Kconfig.force_power_down_event
```kconfig
#
# Copyright (c) 2021 Nordic Semiconductor
#
# SPDX-License-Identifier: LicenseRef-Nordic-5-Clause
#

config CAF_FORCE_POWER_DOWN_EVENTS
	bool "Enable force Power down event"
	help
	  Enable power manager event to put the device into power down mode when processed.
	  It means the power down would be processed without the delay that is
	  normally applied inside power manager.
	  The event would be send only if the power manager is in IDLE state.
	  The power down event would be send ignoring the fact if any of the modules
	  requires ACTIVE state.
	  The reasult of such situation would be powering down the device to SUSPENDED state.
	  To avoid this the user is responsible in clearing all power ACTIVE requirements
	  before sending this event.
	  The event is here to support very specyfic requirement when the device
	  has to limit is power usage no matter what.
	  The possible usage scenarios are:
	  - Reaction to USB SUSPEND on bus powered device
	  - Reaction to power loss if we have for example to disable LEDs to keep power
	    to do some important jobs before we lost all the power stored in system.

config CAF_INIT_LOG_FORCE_POWER_DOWN_EVENTS
	bool "Log force power down event"
	depends on LOG
	depends on CAF_FORCE_POWER_DOWN_EVENTS
	default y
	help
	  Log the force power down event.
```

## subsys/caf/events/Kconfig.keep_alive_event
```kconfig
#
# Copyright (c) 2021 Nordic Semiconductor
#
# SPDX-License-Identifier: LicenseRef-Nordic-5-Clause
#

config CAF_KEEP_ALIVE_EVENTS
	bool "Enable keep alive events"
	help
	  This enables keep alive event.
	  This event is processed by power manager and reschedule power down timer.
	  It works only if power manager is in IDLE state.
	  It cannot wake up the device from any sleep states.

config CAF_INIT_LOG_KEEP_ALIVE_EVENTS
	bool "Log power manager keep alive events"
	depends on LOG
	depends on CAF_KEEP_ALIVE_EVENTS
	default y
	help
	  Log the keep alive events.
```
