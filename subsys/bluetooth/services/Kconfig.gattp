## subsys/bluetooth/services/Kconfig.gattp
```kconfig
#
# Copyright (c) 2021 Nordic Semiconductor ASA
#
# SPDX-License-Identifier: LicenseRef-Nordic-5-Clause
#

menuconfig BT_GATTP
	bool "Generic Attribute Profile"
	select BT_NRF_SERVICES
	help
	  Enable Generic Attribute Profile. It can be used to receive
	  service changed indications from a connected peer.

if BT_GATTP

module = BT_GATTP
module-str = GATT Profile
source "${ZEPHYR_BASE}/subsys/logging/Kconfig.template.log_config"

endif # BT_GATTP
```

## subsys/bluetooth/services/Kconfig.hids
```kconfig
#
# Copyright (c) 2019 Nordic Semiconductor ASA
#
# SPDX-License-Identifier: LicenseRef-Nordic-5-Clause
#

menuconfig BT_HIDS
	bool "Human Interface Device service"
	select BT_NRF_SERVICES
	select BT_GATT_POOL
	select BT_GATT_DYNAMIC_DB
	help
	  Enable BLE GATT Human Interface Device service.

if BT_HIDS

config BT_HIDS_MAX_CLIENT_COUNT
	int "Maximum HIDS clients"
	default 1
	range 1 BT_MAX_CONN
	help
	 The maximum number of devices that HID can connect to.

config BT_HIDS_ATTR_MAX
	int "Maximum number of GATT attribute descriptors"
	default 30
	range 0 50
	help
	  Maximum number of GATT attribute descriptors that can be set for HIDS.

config BT_HIDS_INPUT_REP_MAX
	int "Maximum number of HIDS Input Report descriptors"
	default 5
	range 0 10
	help
	  Maximum number of HIDS Input Reports that can be set for HIDS.

config BT_HIDS_OUTPUT_REP_MAX
	int "Maximum number of HIDS Output Report descriptors"
	default 5
	range 0 10
	help
	  Maximum number of HIDS Output Reports that can be set for HIDS.

config BT_HIDS_FEATURE_REP_MAX
	int "Maximum number of HIDS Feature Report descriptors"
	default 5
	range 0 10
	help
	  Maximum number of HIDS Feature Reports that can be set for HIDS.

choice BT_HIDS_DEFAULT_PERM
	prompt "Default permissions used for HID attributes"
	default BT_HIDS_DEFAULT_PERM_RW
	help
	  Default permissions for HID characteristic attributes
	  used when no permission is set for the report.
	  Used also for boot reports.

config BT_HIDS_DEFAULT_PERM_RW
	bool "Read and write allowed"

config BT_HIDS_DEFAULT_PERM_RW_ENCRYPT
	bool "Require encryption for access"

config BT_HIDS_DEFAULT_PERM_RW_AUTHEN
	bool "Require encryption using authenticated link-key for access"

endchoice

module = BT_HIDS
module-str = HIDS
source "${ZEPHYR_BASE}/subsys/logging/Kconfig.template.log_config"

endif # BT_HIDS
```

## subsys/bluetooth/services/Kconfig.hids_c
```kconfig
#
# Copyright (c) 2019 Nordic Semiconductor ASA
#
# SPDX-License-Identifier: LicenseRef-BSD-5-Clause-Nordic
#

menuconfig BT_GATT_HIDS_C
	bool "HID service client"
	select BT_NRF_SERVICES
	help
	  Enable HID GATT Human Interface Device service client.

if BT_GATT_HIDS_C

module = BT_GATT_HIDS_C
module-str = HIDS Client
source "${ZEPHYR_BASE}/subsys/logging/Kconfig.template.log_config"

config BT_GATT_HIDS_C_REPORTS_MAX
	int "Maximum number of reports supported"
	default 8
	help
	  The number of reports supported by all the HIDS clients used.
	  The report pool would be common to all HIDS client objects created.

endif # BT_GATT_HIDS_C
```

## subsys/bluetooth/services/Kconfig.hogp
```kconfig
#
# Copyright (c) 2019 Nordic Semiconductor ASA
#
# SPDX-License-Identifier: LicenseRef-Nordic-5-Clause
#

menuconfig BT_HOGP
	bool "HID service client"
	select BT_NRF_SERVICES
	help
	  Enable HID GATT Human Interface Device service client.

if BT_HOGP

module = BT_HOGP
module-str = HIDS Client
source "${ZEPHYR_BASE}/subsys/logging/Kconfig.template.log_config"

config BT_HOGP_REPORTS_MAX
	int "Maximum number of reports supported"
	default 8
	help
	  The number of reports supported by all the HIDS clients used.
	  The report pool would be common to all HIDS client objects created.

endif # BT_HOGP
```

## subsys/bluetooth/services/Kconfig.hrs_client
```kconfig
#
# Copyright (c) 2021 Nordic Semiconductor ASA
#
# SPDX-License-Identifier: LicenseRef-Nordic-5-Clause
#

menuconfig BT_HRS_CLIENT
	bool "Heart Rate Service client"
	select BT_NRF_SERVICES
	help
	  Enable Heart Rate Service client

if BT_HRS_CLIENT

config BT_HRS_CLIENT_RR_INTERVALS_COUNT
	int "RR Intervals count"
	default 10
	help
	  Maximum number of intervals which can be stored during
	  receiving Heart Rate Measurement notification or read operation.


module = BT_HRS_CLIENT
module-str = HRS Client
source "${ZEPHYR_BASE}/subsys/logging/Kconfig.template.log_config"

endif # BT_HRS_CLIENT
```

## subsys/bluetooth/services/Kconfig.ias
```kconfig
#
# Copyright (c) 2021 Nordic Semiconductor ASA
#
# SPDX-License-Identifier: LicenseRef-Nordic-5-Clause
#

menuconfig BT_NRF_IAS
	bool "Immediate Alert Service"
	select BT_NRF_SERVICES
	help
	  Enable Immediate Alert Service

if BT_NRF_IAS

module = BT_NRF_IAS
module-str = NRF_IAS
source "${ZEPHYR_BASE}/subsys/logging/Kconfig.template.log_config"

endif # BT_NRF_IAS
```

## subsys/bluetooth/services/Kconfig.latency
```kconfig
#
# Copyright (c) 2019 Nordic Semiconductor ASA
#
# SPDX-License-Identifier: LicenseRef-Nordic-5-Clause
#

config BT_LATENCY
	bool "Latency service"
	select BT_NRF_SERVICES
	help
	 Enable Nordic GATT Latency BLE service.

if BT_LATENCY

module = BT_LATENCY
module-str = LATENCY
source "${ZEPHYR_BASE}/subsys/logging/Kconfig.template.log_config"

endif # BT_LATENCY
```

## subsys/bluetooth/services/Kconfig.latency_c
```kconfig
#
# Copyright (c) 2019 Nordic Semiconductor ASA
#
# SPDX-License-Identifier: LicenseRef-Nordic-5-Clause
#

config BT_LATENCY_CLIENT
	bool "Latency service client"
	select BT_NRF_SERVICES
	select BT_GATT_DM
	select BT_GATT_CLIENT
	help
	 Enable Nordic GATT Latency client.

if BT_LATENCY_CLIENT

module = BT_LATENCY_CLIENT
module-str = LATENCY Client
source "${ZEPHYR_BASE}/subsys/logging/Kconfig.template.log_config"

endif # BT_LATENCY_CLIENT
```

## subsys/bluetooth/services/Kconfig.lbs
```kconfig
#
# Copyright (c) 2019 Nordic Semiconductor ASA
#
# SPDX-License-Identifier: LicenseRef-Nordic-5-Clause
#

menuconfig BT_LBS
	bool "Led Button service"
	select BT_NRF_SERVICES
	help
	  Enable Led Button service.

if BT_LBS

config BT_LBS_POLL_BUTTON
	bool
	default n
	prompt "Support button state polling"
	help
	  Enable support for button state polling
	  (button state change notify always supported)

module = BT_LBS
module-str = LBS
source "${ZEPHYR_BASE}/subsys/logging/Kconfig.template.log_config"

endif # BT_LBS
```

## subsys/bluetooth/services/Kconfig.link
```kconfig
menuconfig BT_LINK_CTX_MANAGER
	bool
	prompt "Link Context Manager library"
	default n
	help
	  Enable Link Context Manager library

if BT_LINK_CTX_MANAGER

config BT_LINK_CTX_MANAGER_MEM_BUF_ALIGN
	int "Memory slab buffer alignment"
	default 4
	help
	 The memory buffer must be aligned to an N-byte boundary,
	 where N is a power of 2 larger than 2 (i.e. 4, 8, 16, …).

module = BT_LINK_CTX_MANAGER
module-str = Ble link ctx manager
source "${ZEPHYR_BASE}/subsys/logging/Kconfig.template.log_config"

endif # BT_LINK_CTX_MANAGER
```

## subsys/bluetooth/services/Kconfig.lls
```kconfig
#
# Copyright (c) 2021 Nordic Semiconductor ASA
#
# SPDX-License-Identifier: LicenseRef-Nordic-5-Clause
#

menuconfig BT_NRF_LLS
	bool "link lost Service"
	select BT_NRF_SERVICES
	help
	  Enable link lost Service

if BT_NRF_LLS

module = BT_NRF_LLS
module-str = NRF_LLS
source "${ZEPHYR_BASE}/subsys/logging/Kconfig.template.log_config"

endif # BT_NRF_LLS
```

## subsys/bluetooth/services/Kconfig.mds
```kconfig
#
# Copyright (c) 2022 Nordic Semiconductor ASA
#
# SPDX-License-Identifier: LicenseRef-Nordic-5-Clause
#

menuconfig BT_MDS
	bool "Memfault Diagnostic service"
	depends on !MEMFAULT_HTTP_ENABLE
	select BT_NRF_SERVICES
	help
	 Enable GATT Memfault Diagnostic BLE service.

if BT_MDS

config BT_MDS_MAX_URI_LENGTH
	int "Maiximum URI length"
	default 64
	help
	  Maximum URI length where diagnostic data should be forwarded to.

choice BT_MDS_PERM
	prompt "Characteristic attributes permition"
	default BT_MDS_PERM_RW_ENCRYPT if BT_SMP
	default BT_MDS_PERM_RW
	help
	  Default permissions for Memfault Diagnostic characteristic attributes.

config BT_MDS_PERM_RW
	bool "Read and write allowed"

config BT_MDS_PERM_RW_ENCRYPT
	bool "Require encryption for access"
	depends on BT_SMP

config BT_MDS_PERM_RW_AUTHEN
	bool "Require encryption using authenticated link-key for access"
	depends on BT_SMP

endchoice

config BT_MDS_PIPELINE_COUNT
	int "Number of chunks pipelined in the Bluetooth stack"
	default 2
	range 1 BT_CONN_TX_MAX
	help
	  Number of the Memfault chunks pipelined in the Bluetooth stack. Pipelining chunks in the
	  Bluetooth stack reduces latency related to delivering subsequent data to the stack.

config BT_MDS_DATA_POLL_INTERVAL
	int "Data poll interval"
	default 60000
	help
	  Memfault data poll interval in milliseconds. If there is any memfault data it will
	  be send after each interval expiration.

module = BT_MDS
module-str = MDS
source "${ZEPHYR_BASE}/subsys/logging/Kconfig.template.log_config"

endif # BT_MDS
```

## subsys/bluetooth/services/Kconfig.nsms
```kconfig
#
# Copyright (c) 2023 Nordic Semiconductor ASA
#
# SPDX-License-Identifier: LicenseRef-Nordic-5-Clause
#

config BT_NSMS
	bool "Nordic Status Message service"
	select BT_NRF_SERVICES
	help
	  Enable Nordic Status Message service.

if BT_NSMS

module = BT_NSMS
module-str = NSMS
source "${ZEPHYR_BASE}/subsys/logging/Kconfig.template.log_config"

endif # BT_NSMS
```

## subsys/bluetooth/services/Kconfig.nus
```kconfig
#
# Copyright (c) 2019 Nordic Semiconductor ASA
#
# SPDX-License-Identifier: LicenseRef-Nordic-5-Clause
#

config BT_NUS
	bool "Nordic UART service"
	select BT_NRF_SERVICES
	help
	  Enable Nordic UART service.
if BT_NUS

config BT_NUS_AUTHEN
	bool "Require encryption and authentication for access"
	depends on BT_SMP
	help
	  Enable encrypted and authenticated connection requirements for Nordic UART service.

module = BT_NUS
module-str = NUS
source "${ZEPHYR_BASE}/subsys/logging/Kconfig.template.log_config"

endif # BT_NUS
```

## subsys/bluetooth/services/Kconfig.nus_c
```kconfig
#
# Copyright (c) 2019 Nordic Semiconductor ASA
#
# SPDX-License-Identifier: LicenseRef-BSD-5-Clause-Nordic
#

menuconfig BT_GATT_NUS_C
	bool "Nordic UART service client"
	select BT_NRF_SERVICES
	help
	  Enable BLE GATT Nordic UART service client.

if BT_GATT_NUS_C

module = BT_GATT_NUS_C
module-str = NUS Client
source "${ZEPHYR_BASE}/subsys/logging/Kconfig.template.log_config"

endif # BT_GATT_NUS_C
```

## subsys/bluetooth/services/Kconfig.nus_client
```kconfig
#
# Copyright (c) 2019 Nordic Semiconductor ASA
#
# SPDX-License-Identifier: LicenseRef-Nordic-5-Clause
#

menuconfig BT_NUS_CLIENT
	bool "Nordic UART service client"
	select BT_NRF_SERVICES
	help
	  Enable BLE GATT Nordic UART service client.

if BT_NUS_CLIENT

module = BT_NUS_CLIENT
module-str = NUS Client
source "${ZEPHYR_BASE}/subsys/logging/Kconfig.template.log_config"

endif # BT_NUS_CLIENT
```

## subsys/bluetooth/services/Kconfig.ots
```kconfig
#
# Copyright (c) 2020 Nordic Semiconductor ASA
#
# SPDX-License-Identifier: LicenseRef-BSD-5-Clause-Nordic
#

config BT_GATT_OTS
	bool "Object Transfer Service"
	select BT_NRF_SERVICES
	select BT_L2CAP_DYNAMIC_CHANNEL
	select BT_GATT_DYNAMIC_DB
	select BT_SMP
	help
	  Enable Object Transfer Service.

if BT_GATT_OTS

config BT_GATT_OTS_MAX_INST_CNT
	int "Maximum number of available OTS instances"
	default 1

config BT_GATT_OTS_MAX_OBJ_CNT
	int "Maximum number of objects that server can store"
	default 5

config BT_GATT_OTS_SECONDARY_SVC
	bool "Register OTS as Secondary Service"

config BT_GATT_OTS_OACP_READ_SUPPORT
	bool "Support OACP Read Operation"
	default y

config BT_GATT_OTS_OLCP_GO_TO_SUPPORT
	bool "Support OLCP Go To Operation"
	default y

config BT_GATT_OTS_L2CAP_CHAN_RX_MTU
	int "Size of RX MTU for Object Transfer Channel"
	default BT_L2CAP_RX_MTU if BT_HCI_ACL_FLOW_CONTROL
	default 23
	range 23 BT_L2CAP_RX_MTU if BT_HCI_ACL_FLOW_CONTROL
	range 23 BT_RX_BUF_LEN

module = BT_GATT_OTS
module-str = OTS
source "${ZEPHYR_BASE}/subsys/logging/Kconfig.template.log_config"

endif # BT_GATT_OTS
```

## subsys/bluetooth/services/Kconfig.rscs
```kconfig
#
# Copyright (c) 2021 Nordic Semiconductor ASA
#
# SPDX-License-Identifier: LicenseRef-Nordic-5-Clause
#

menuconfig BT_RSCS
	bool "Running Speed and Cadence Service"
	select BT_NRF_SERVICES
	help
	  Enable Running Speed and Cadence Service

if BT_RSCS

module = BT_RSCS
module-str = RSCS
source "${ZEPHYR_BASE}/subsys/logging/Kconfig.template.log_config"

endif # BT_RSCS
```

## subsys/bluetooth/services/Kconfig.template.hids.sci_mode
```kconfig
#
# Copyright (c) 2026 Nordic Semiconductor ASA
#
# SPDX-License-Identifier: LicenseRef-Nordic-5-Clause
#
# Kconfig variable template for one HID SCI mode. Set before sourcing:
#   MODE              Symbol segment, e.g. DEFAULT, FAST, LOW_POWER, FULL_RANGE
#   MODE_PRETTY       Label for prompts (e.g. Default, Fast, Low_Power, Full_Range)
#   sci_interval_min_default
#                     — min interval (125 us units) default; range low is always 3
#   sci_interval_max_default
#                     — max interval (125 us units) default
#   sci_subrate_min_default, sci_subrate_max_default
#   sci_max_peripheral_latency_default
#   sci_continuation_number_default
#   sci_supervision_timeout_10ms_default
#

menu "HID SCI: $(MODE_PRETTY) mode"

config BT_HIDS_SCI_$(MODE)_INTERVAL_MIN_125US
	int "Minimum connection interval (125 microsecond units)"
	default $(sci_interval_min_default)
	range 3 32000
	help
	  Minimum connection interval in 125 microsecond units (LE connection interval
	  quantum), matching struct bt_conn_le_conn_rate_param.interval_min_125us.

config BT_HIDS_SCI_$(MODE)_INTERVAL_MAX_125US
	int "Maximum connection interval (125 microsecond units)"
	default $(sci_interval_max_default)
	range BT_HIDS_SCI_$(MODE)_INTERVAL_MIN_125US 32000
	help
	  Maximum connection interval in 125 microsecond units (LE connection interval
	  quantum), matching struct bt_conn_le_conn_rate_param.interval_max_125us.

config BT_HIDS_SCI_$(MODE)_SUBRATE_MIN
	int "Subrate factor minimum"
	default $(sci_subrate_min_default)
	range 1 500
	help
	  Minimum subrate factor for SCI $(MODE_PRETTY) mode.

config BT_HIDS_SCI_$(MODE)_SUBRATE_MAX
	int "Subrate factor maximum"
	default $(sci_subrate_max_default)
	range BT_HIDS_SCI_$(MODE)_SUBRATE_MIN 500
	help
	  Maximum subrate factor for SCI $(MODE_PRETTY) mode.

config BT_HIDS_SCI_$(MODE)_MAX_LATENCY
	int "Maximum peripheral latency"
	default $(sci_max_peripheral_latency_default)
	range 0 499
	help
	  Maximum peripheral latency for SCI $(MODE_PRETTY) mode.

config BT_HIDS_SCI_$(MODE)_CONTINUATION_NUM
	int "Continuation number"
	default $(sci_continuation_number_default)
	range 0 499
	help
	  Continuation number for SCI $(MODE_PRETTY) mode.

config BT_HIDS_SCI_$(MODE)_SUPERVISION_TIMEOUT_10MS
	int "Supervision timeout (units of 10 ms)"
	default $(sci_supervision_timeout_10ms_default)
	range 10 3200
	help
	  Link supervision timeout for SCI $(MODE_PRETTY) mode.

endmenu
```

## subsys/bluetooth/services/Kconfig.throughput
```kconfig
#
# Copyright (c) 2019 Nordic Semiconductor ASA
#
# SPDX-License-Identifier: LicenseRef-Nordic-5-Clause
#

config BT_THROUGHPUT
	bool "Throughput service"
	select BT_NRF_SERVICES
	help
	 Enable Nordic GATT throughput BLE service.

if BT_THROUGHPUT

module = BT_THROUGHPUT
module-str = THROUGHPUT
source "${ZEPHYR_BASE}/subsys/logging/Kconfig.template.log_config"

endif # BT_THROUGHPUT
```
