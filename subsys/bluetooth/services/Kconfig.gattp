## subsys/bluetooth/services/alexa_gadgets/Kconfig.gadgets
```kconfig
#
# Copyright (c) 2020 Nordic Semiconductor ASA
#
# SPDX-License-Identifier: LicenseRef-Nordic-5-Clause
#

config BT_ALEXA_GADGETS
	bool "Alexa Gadgets service"
	select BT_NRF_SERVICES
	help
	  Enable Alexa Gadgets service.

if BT_ALEXA_GADGETS

module = BT_ALEXA_GADGETS
module-str = ALEXA GADGETS SERVICE
source "${ZEPHYR_BASE}/subsys/logging/Kconfig.template.log_config"

endif # BT_ALEXA_GADGETS

menuconfig BT_ALEXA_GADGETS_PROFILE
	bool "Enable Alexa Gadgets profile"
	select BT_ALEXA_GADGETS
	select BT_SMP
	select HWINFO
	select TINYCRYPT_SHA256
	help
	  Enable Alexa Gadgets profile.

if BT_ALEXA_GADGETS_PROFILE

module = BT_ALEXA_GADGETS_PROFILE
module-str = ALEXA GADGETS PROFILE
source "${ZEPHYR_BASE}/subsys/logging/Kconfig.template.log_config"

config BT_ALEXA_GADGETS_MODEL_NAME
	string "Alexa Gadget device model name"
	default "BLE Gadget"
	help
	  Alexa Gadget model name. Not a token allocated by Amazon.

config BT_ALEXA_GADGETS_DEVICE_DESCRIPTION
	string "Alexa Gadget device description"
	default "Nordic DK"
	help
	  Short device description.

config BT_ALEXA_GADGETS_AMAZON_ID
	string "Alexa Gadget Amazon ID"
	default "1234567890"
	help
	  Device type identifier allocated by Amazon.

config BT_ALEXA_GADGETS_DEVICE_SECRET
	string "Alexa Gadget device secret"
	default "1234567890"
	help
	  Device secret allocated by Amazon.
	  As this is considered a secret value,
	  enable flash readback protection accordingly.


config BT_ALEXA_GADGETS_TRANSACTION_BUF_SIZE
	int "Alexa Gadgets maximum transaction size"
	default 600
	help
	  Maximum size of a single transaction.
	  This should be big enough to cover the Discovery handshake,
	  which is normally the largest transaction.
	  Note that capability count, device name, model name, etc. affects this.

config BT_ALEXA_GADGETS_OTA
	bool "Enable Alexa Gadgets OTA protocol"
	select BOOTLOADER_MCUBOOT
	help
	  Enable Alexa Gadgets OTA protocol.

menu "Alexa Gadget capabilities"

config BT_ALEXA_GADGETS_CAPABILITY_ALERTS
	bool "Enable Alerts capability"
	help
	  Enable support for Alerts capability.

config BT_ALEXA_GADGETS_CAPABILITY_NOTIFICATIONS
	bool "Enable Notifications capability"
	help
	  Enable support for Notifications capability.

config BT_ALEXA_GADGETS_CAPABILITY_STATELISTENER
	bool "Enable StateListener capability"
	help
	  Enable support for StateListener capability.

config BT_ALEXA_GADGETS_CAPABILITY_MUSICDATA
	bool "Enable MusicData capability"
	help
	  Enable support for Music Data capability.

config BT_ALEXA_GADGETS_CAPABILITY_SPEECHDATA
	bool "Enable SpeechData capability"
	help
	  Enable support for SpeechData capability.

config BT_ALEXA_GADGETS_CAPABILITY_CUSTOM
	bool "Enable Custom capability"
	help
	  Enable support for SpeechData capability.

config BT_ALEXA_GADGETS_CAPABILITY_CUSTOM_NAMESPACE
	string "Set Custom capability interface name"
	default "Custom.MyCustomInterface"
	depends on BT_ALEXA_GADGETS_CAPABILITY_CUSTOM
	help
	  Specify name of the custom interface.

endmenu

config APP_LINK_WITH_ALEXA_GADGETS_PROTO
	bool "Link 'app' with Alexa Gadgets Proto headers"
	default y
	help
	  Add Alexa Gadgets Proto header files to the 'app' include path.

endif # BT_ALEXA_GADGETS_PROFILE
```

## subsys/bluetooth/services/cgms/Kconfig.cgms
```kconfig
#
# Copyright (c) 2022 Nordic Semiconductor ASA
#
# SPDX-License-Identifier: LicenseRef-Nordic-5-Clause
#

menuconfig BT_CGMS
	bool "Enable GATT continuous glucose service"
	select EXPERIMENTAL
	select BT_NRF_SERVICES

if BT_CGMS

config BT_CGMS_MAX_MEASUREMENT_RECORD
	int "Maximum number of stored records"
	default 100
	help
	  The maximum number of stored measurement records. This value
	  should be large enough to hold measurements that are generated
	  in a session.

module = BT_CGMS
module-str = CGMS
source "${ZEPHYR_BASE}/subsys/logging/Kconfig.template.log_config"

endif # BT_CGMS
```

## subsys/bluetooth/services/esl/Kconfig.esl
```kconfig
#
# Copyright (c) 2022 Nordic Semiconductor ASA
#
# SPDX-License-Identifier: LicenseRef-Nordic-5-Clause
#

menuconfig BT_ESL
	bool "Nordic ESL service"
	select EXPERIMENTAL
	select BT_EAD
	select SETTINGS
	select BT_GATT_POOL
	help
	  Enable Nordic ESL service.

if BT_ESL
rsource "Kconfig.esl.defaults"

config BT_ESL_DISPLAY_MAX
	int "Maximum number of display elements"
	default 0
	range 0 255
	help
	  Maximum number of display element device.

config BT_ESL_IMAGE_AVAILABLE
	bool "ESL peripheral can display image"
	help
	  ESL has capability to display image, should expose characteristic

config ESL_DISPLAY_WIDTH
	int "Display witdh"
	default 240
	range 0 65535
	help
		pixels each row could be displayed

config ESL_DISPLAY_HEIGHT
	int "Display height"
	default 240
	range 0 65535
	help
		how many columns could be displayed

config ESL_DISPLAY_COLOR_DEPTH
	int "Display depth of bytes"
	default 2
	range 0 3

config ESL_DISPLAY_TYPE
	int "Display Type assigned number"
	default 1
	range 1 12
	help
		SIG Assigned number https://bitbucket.org/bluetooth-SIG/registry/pull-requests/132/request-for-assigned-numbers-for-published?link_source=email
		* display_types:
		- name: black white
			value: 0x01
		- name: three gray scale
			value: 0x02
		- name: four gray scale
			value: 0x03
		- name: eight gray scale
			value: 0x04
		- name: sixteen gray scale
			value: 0x05
		- name: red black white
			value: 0x06
		- name: yellow black white
			value: 0x07
		- name: red yellow black white
			value: 0x08
		- name: seven color
			value: 0x09
		- name: sixteen color
			value: 0x0A
		- name: full RGB
			value: 0x0B"

config ESL_IMAGE_FILE_SIZE
	int "Image object max size"
	default 4096
	range 0 102400
	help
	  how many bytes of each image, width x height x color bit depth

config ESL_IMAGE_BUFFER_SIZE
	int "Buffer size to store image data from OTS or storage backend"
	default 1024
	range 0 16484
	  help
	   The size should be choose depending on BT_ESL_STORAGE_BACKEND.
	   Should be the same size of ESL_IMAGE_FILE_SIZE if choose fs which is capiable to read/write offset. e.g.:ESL_OTS_NVS.
	   Should be equal or large than L2CAP RX MTU or width of panel if choose fs which is capable to read/write offset. e.g.:ESL_OTS_LFS.

config BT_ESL_IMAGE_MAX
	int "Maximum number of image could be stored and displayed"
	default 0
	range 0 255
	help
	  Maximum number of image could be stored and displayed, equal to Max_Image_Index + 1

config BT_ESL_SENSOR_MAX
	int "Maximum number of sensor elements"
	default 0
	range 0 255
	help
	  Maximum number of sensor element device.

config BT_ESL_VENDOR_SPECIFIC_SUPPORT
	bool "ESL TAG has vendor-specific sensor or OP support"
	select BT_DIS

config BT_ESL_LED_MAX
	int "Maximum number of led elements"
	default 0
	range 0 255
	help
	  Maximum number of led element device.

config BT_ESL_LED_INDICATION
	bool "Use last LED as Tag state indication"
	help
	  Use last LED as indication, fast blink while advertising, one blink while receiving sync packet, on while ACL

choice BT_ESL_STORAGE_BACKEND
	prompt "Default storage backend for image store"
	default ESL_OTS_NVS
	help
	  Default filesystem or flash storage to store image
	config ESL_OTS_NVS
		bool "Use Non-Volatile Storage (NVS) with internal flash to store Image"

	config ESL_OTS_LFS
		bool "Use Littlefs with external flash to store Image"
		select FILE_SYSTEM
		select FILE_SYSTEM_LITTLEFS

endchoice # BT_ESL_STORAGE_BACKEND

config BT_ESL_COND_SERVICE_REQUIRED
	bool "Service Needed for sensor support"
	help
		Enable service needed bit in basic state. For IOP test.

config BT_ESL_ATTR_MAX
	int "Maximum number of GATT attribute descriptors"
	default 50
	range 0 255
	help
	  Maximum number of GATT attribute descriptors that can be set for HIDS.

choice BT_ESL_PERM
	prompt "Default permissions used for ESL attributes"
	default BT_ESL_DEFAULT_PERM_RW_ENCRYPT
	help
	  Default permissions for ESL characteristic attributes
	  used when no permission is set for the report.
	  Used also for boot reports.

	config BT_ESL_DEFAULT_PERM_RW
		bool "Read and write allowed"

	config BT_ESL_DEFAULT_PERM_RW_ENCRYPT
		bool "Require encryption for access"

	config BT_ESL_DEFAULT_PERM_RW_AUTHEN
		bool "Require encryption using authenticated link-key for access"

endchoice # BT_ESL_PERM

config BT_ESL_MAX_QUEUED_TIMED_COMMANDS
	int "The maximum number of queued timed commands for an instance in the future."
	default 1
	range 0 255
	help
		Equal to TSPX_max_queued_timed_commands

config ESL_SHELL
	bool "Enable ESL Shell"
	select SHELL
	help
	  Enable ESL Shell for testing.

config ESL_SYNC_COUNT
	int "Number of PA sync or receive count before entering synced mode"
	range 1 20
	help
	  Count before entering synced mode.

config BT_ESL_DEMO_SECURITY
	bool "DEMO security level"
	help
	  Enable this, bonding data will be auto clear after disconnect

config BT_ESL_FORGET_PROVISION_DATA
	bool "Not to save data provsion by AP"
	help
	  Enable this, AP key, Response Key, ESL address won't be saved

config BT_ESL_UNSYNCHRONIZED_TIMEOUT
	int "Seconds before entering unsynchronized state"
	range 1 3600
	default 3600
	help
	  ESL Service 2.7.3.3 Synchronized state defines 60 minutes before ESL transitions to the Unsynchronized state if an ESL does not receive a valid ESL message in a synchronization.
	  For development purpose change this value.

config BT_ESL_UNASSOCIATED_TIMEOUT
	int "Secondes before entering unassociated state"
	range 1 3600
	default 3600
	help
	  ESL Service 2.7.3.5 Unsynchronized state defines 60 minutes if the ESL is not moved to the Updating state for 60 minutes, then the ESL shall transition to the Unassociated state.
	  For development purpose change this value.

module = BT_ESL
module-str = ESL
source "${ZEPHYR_BASE}/subsys/logging/Kconfig.template.log_config"

endif # BT_ESL
```

## subsys/bluetooth/services/esl/Kconfig.esl_client
```kconfig
#
# Copyright (c) 2022 Nordic Semiconductor ASA
#
# SPDX-License-Identifier: LicenseRef-Nordic-5-Clause
#


menuconfig BT_ESL_CLIENT
	bool "Nordic ESL service client"
	select EXPERIMENTAL
	select BT_EAD
	select SETTINGS
	help
	  Enable BLE GATT Nordic ESL service client.

if BT_ESL_CLIENT
rsource "Kconfig.esl_client.defaults"

config BT_ESL_PERIPHERAL_MAX
	int "How many ESL devices can be ACL connected at the same time by this AP"
	default BT_MAX_CONN
	help
	  Specify Max ESL peripheral can be connected.

config ESL_IMAGE_FILE_SIZE
	int "Image object max size"
	default 20480
	range 0 102400
	help
	  how many bytes of each image, should align to 4KB if lfs in internal flash

config BT_ESL_MAX_PAIRED
	int "How many ESL devices can be bonded by this AP"
	default BT_MAX_PAIRED

config ESL_CLIENT_SHELL
	bool "Enable ESL client Shell"
	default y
	select SHELL
	help
	  Enable ESL client Shell for testing.

config ESL_PAWR_INTERVAL_MIN
	int "Minimum advertising interval for periodic advertising."
	range 6 65535
	help
	  Periodic_Advertising_Interval_Min of 7.8.61 LE Set Periodic Advertising Parameters command[V2]

config ESL_PAWR_INTERVAL_MAX
	int "Maximum advertising interval for periodic advertising."
	range 6 65535
	help
	  Periodic_Advertising_Interval_Max of 7.8.61 LE Set Periodic Advertising Parameters command[V2]

config ESL_CLIENT_MAX_GROUP
	int "Number of subevents. How many groups of ESL in AP."
	range 1 128
	help
	  Num_Subevents of 7.8.61 LE Set Periodic Advertising Parameters command[V2]

config ESL_SUBEVENT_INTERVAL
	int "Time between the subevents of PAwR"
	range 6 255
	help
	  Subevent_Interval of 7.8.61 LE Set Periodic Advertising Parameters command[V2]

config ESL_RESPONSE_SLOT_DELAY
	int "Time between the advertising packet in a subevent and the first response slot"
	range 1 254
	help
	  Response_Slot_Delay of 7.8.61 LE Set Periodic Advertising Parameters command[V2]

config ESL_RESPONSE_SLOT_SPACING
	int "Time between response slots"
	range 2 255
	help
	  Response_Slot_Spacing of 7.8.61 LE Set Periodic Advertising Parameters command[V2]

config ESL_NUM_RESPONSE_SLOTS
	int "Number of subevent response slots."
	range 1 128
	help
	  Num_Response_Slots of 7.8.61 LE Set Periodic Advertising Parameters command[V2]

config ESL_CLIENT_MAX_RESPONSE_SLOT_BUFFER
	int "buffer how many response data single subevent"
	range 1 23
	help
	  Maximun response of ESL is floor((48-1)/2) = 23

config ESL_CLIENT_DEFAULT_ESL_ID
	hex "default ESL_ID for IOP. Equal to TSPX_esl_id."
	default 0
	range 0 0xFE

config ESL_CLIENT_DEFAULT_GROUP_ID
	hex "default ESL_ID for IOP. Equal to TSPX_group_id."
	default 0
	range 0 0x7F

config BT_ESL_MAX_QUEUED_TIMED_COMMANDS
	int "The maximum number of queued timed commands for an instant in the future."
	default 1
	range 1 1
	help
	  Equal to TSPX_max_queued_timed_commands

config BT_ESL_SCAN_REPORT_INTERVAL
	int "The interval AP report scanned TAG list"
	range 10 120
	help
	  Periodic send URC message to show list of advertising TAG scanned.

config BT_ESL_TAG_STORAGE
	bool "Save tag information to storage"
	help
	  Save tag information to flash when connected can search tag information.
	  TODO:Encrypt filename and content.

config BT_ESL_DEMO_SECURITY
	bool "DEMO security level"
	help
	  Enable this, bonding data will be auto clear after disconnect

config BT_ESL_LED_INDICATION
	bool "Use LEDs as AP state indication"
	help
	  Use LEDs as indication.
	  LED1 solid on when AP is powered up.
	  LED1 blinks when AP is scanning and onboarding tag.
	  LED2 solid on when AP connect to a tag.
	  LED3 blinks when AP is sending ESL PAwR command to tag.

module = BT_ESL_CLIENT
module-str = ESL Client
source "${ZEPHYR_BASE}/subsys/logging/Kconfig.template.log_config"
endif # BT_ESL_CLIENT
```
