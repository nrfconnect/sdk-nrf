## subsys/bluetooth/services/Kconfig.bas_client
```kconfig
#
# Copyright (c) 2019 Nordic Semiconductor ASA
#
# SPDX-License-Identifier: LicenseRef-Nordic-5-Clause
#

menuconfig BT_BAS_CLIENT
	bool "Battery service client"
	select BT_NRF_SERVICES
	help
	  Enable Battery Service Client.

if BT_BAS_CLIENT

module = BT_BAS_CLIENT
module-str = BAS Client
source "${ZEPHYR_BASE}/subsys/logging/Kconfig.template.log_config"

endif # BT_BAS_CLIENT
```

## subsys/bluetooth/services/Kconfig.bms
```kconfig
#
# Copyright (c) 2020 Nordic Semiconductor ASA
#
# SPDX-License-Identifier: LicenseRef-Nordic-5-Clause
#

menuconfig BT_BMS
	bool "Bond Management Service"
	select BT_NRF_SERVICES
	depends on !BT_KEYS_OVERWRITE_OLDEST

if BT_BMS

module = BT_BMS
module-str = BMS
source "${ZEPHYR_BASE}/subsys/logging/Kconfig.template.log_config"

endif # BT_BMS
```

## subsys/bluetooth/services/Kconfig.bms_srv
```kconfig
#
# Copyright (c) 2020 Nordic Semiconductor ASA
#
# SPDX-License-Identifier: LicenseRef-BSD-5-Clause-Nordic
#

menuconfig BT_GATT_BMS_SRV
	bool "Bond Management Service"
	select BT_NRF_SERVICES
	depends on !BT_KEYS_OVERWRITE_OLDEST

if BT_GATT_BMS_SRV

module = BT_GATT_BMS_SRV
module-str = BMS_SRV
source "${ZEPHYR_BASE}/subsys/logging/Kconfig.template.log_config"

endif # BT_GATT_BMS_SRV
```

## subsys/bluetooth/services/Kconfig.cts_client
```kconfig
#
# Copyright (c) 2020 Nordic Semiconductor ASA
#
# SPDX-License-Identifier: LicenseRef-Nordic-5-Clause
#

menuconfig BT_CTS_CLIENT
	bool "Current Time Service client"
	select BT_NRF_SERVICES
	help
	  Enable Current Time Service client.

if BT_CTS_CLIENT

module = BT_CTS_CLIENT
module-str = CTS Client
source "${ZEPHYR_BASE}/subsys/logging/Kconfig.template.log_config"

endif # BT_CTS_CLIENT
```

## subsys/bluetooth/services/Kconfig.ddfs
```kconfig
#
# Copyright (c) 2022 Nordic Semiconductor ASA
#
# SPDX-License-Identifier: LicenseRef-Nordic-5-Clause
#

menuconfig BT_DDFS
	bool "Direction and Distance Finding Service [EXPERIMENTAL]"
	select BT_NRF_SERVICES
	select EXPERIMENTAL
	help
	  Enable Direction and Distance Finding Service

if BT_DDFS

module = BT_DDFS
module-str = DDFS
source "${ZEPHYR_BASE}/subsys/logging/Kconfig.template.log_config"

endif # BT_DDFS
```

## subsys/bluetooth/services/Kconfig.dfu_smp
```kconfig
#
# Copyright (c) 2019 Nordic Semiconductor ASA
#
# SPDX-License-Identifier: LicenseRef-Nordic-5-Clause
#

menuconfig BT_DFU_SMP
	bool "DFU SMP service client"
	select BT_NRF_SERVICES
	help
	  Enable GATT DFU SMP Service Client.

if BT_DFU_SMP

module = BT_DFU_SMP
module-str = DFU SMP Client
source "${ZEPHYR_BASE}/subsys/logging/Kconfig.template.log_config"

endif # BT_DFU_SMP
```

## subsys/bluetooth/services/Kconfig.dfu_smp_c
```kconfig
#
# Copyright (c) 2019 Nordic Semiconductor ASA
#
# SPDX-License-Identifier: LicenseRef-BSD-5-Clause-Nordic
#

menuconfig BT_GATT_DFU_SMP_C
	bool "DFU SMP service client"
	select BT_NRF_SERVICES
	help
	  Enable GATT DFU SMP Service Client.

if BT_GATT_DFU_SMP_C

module = BT_GATT_DFU_SMP_C
module-str = DFU SMP Client
source "${ZEPHYR_BASE}/subsys/logging/Kconfig.template.log_config"

endif # BT_GATT_DFU_SMP_C
```

## subsys/bluetooth/services/Kconfig.dis
```kconfig
menuconfig NRF_BT_DIS
	bool "Device Information service"
	select NRF_BT_SVC_COMMON
	help
		Enable BLE GATT Device Information service.
		Version extendted with additional services and more settings in Kconfig.

if NRF_BT_DIS

config NRF_BT_DIS_MODEL
	string "Model name"
	default SOC
	help
	  The string that describes the device model inside Device Information Service.

config NRF_BT_DIS_MANUFACTURER
	string "Manufacturer name"
	default "Manufacturer"
	help
	  The string that describes the device manufacturer inside Device Information Service.


config NRF_BT_PNP_CHAR
	bool "Enable PnP_ID characteristic"
	default y
	help
	   Enable PnP_ID characteristic in Device Information Service.

if NRF_BT_PNP_CHAR

config NRF_BT_PNP_VENDOR_ID_SOURCE
	int "Vendor ID source"
	range 1 2
	default 1
	help
	  The Vendor ID Source field designates which organization assigned the value used in the Vendor ID field value.
	  The possible values are:
	  - 1 Bluetooth SIG, the Vendor ID was assigned by the Bluetooth SIG
	  - 2 USB IF, the Vendor ID was assigned by the USB IF

config NRF_BT_PNP_VENDOR_ID
	hex "Vendor ID"
	range 0 0xFFFF
	default 0
	help
	  The Vendor ID field is intended to uniquely identify the vendor of the device.
	  This field is used in conjunction with Vendor ID Source field,
	  which determines which organization assigned the Vendor ID field value.
	  Note: The Bluetooth Special Interest Group assigns Device ID Vendor ID,
	  and the USB Implementer’s Forum assigns Vendor IDs,
	  either of which can be used for the Vendor ID field value.
	  Device providers should procure the Vendor ID from the USB Implementer’s Forum
	  or the Company Identifier from the Bluetooth SIG.

config NRF_BT_PNP_PRODUCT_ID
	hex "Product ID"
	range 0 0xFFFF
	default 0
	help
	  The Product ID field is intended to distinguish between different products made by the vendor
	  identified with the Vendor ID field. The vendors themselves manage Product ID field values.

config NRF_BT_PNP_PRODUCT_VER
	hex "Product Version"
	range 0 0xFFFF
	default 1
	help
	  The Product Version field is a numeric expression identifying the device release number in Binary-Coded Decimal.
	  This is a vendor-assigned value, which defines the version of the product identified by the Vendor ID and Product ID fields.
	  This field is intended to differentiate between versions of products with identical Vendor IDs and Product IDs.
	  The value of the field value is 0xJJMN for version JJ.M.N
	  (JJ – major version number, M – minor version number, N – sub-minor version number);
	  e.g., version 2.1.3 is represented with value 0x0213 and version 2.0.0 is represented with a value of 0x0200.
	  When upward-compatible changes are made to the device, it is recommended that the minor version number be incremented.
	  If incompatible changes are made to the device, it is recommended that the major version number be incremented.
	  The sub-minor version is incremented for bug fixes.

endif # NRF_BT_PNP_CHAR

endif # NRF_BT_DIS
```

## subsys/bluetooth/services/Kconfig.gadgets
```kconfig
#
# Copyright (c) 2019 Nordic Semiconductor ASA
#
# SPDX-License-Identifier: LicenseRef-BSD-5-Clause-Nordic
#

config BT_GADGETS
	bool "Gadgets service"
	select BT_NRF_SERVICES
	help
	  Enable Gadgets service.

if BT_GADGETS

module = BT_GADGETS
module-str = GADGETS
source "${ZEPHYR_BASE}/subsys/logging/Kconfig.template.log_config"

endif # BT_GADGETS
```
