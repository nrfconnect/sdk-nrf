## subsys/bluetooth/gatt/Kconfig
```kconfig
menu "NRF BLE Gatt services"

config BLE_GATT_NUS
	bool "BLE Gatt NUS (Nordic Usart Service"
	default n
endmenu
```

## subsys/bluetooth/host/Kconfig
```kconfig
#
# Copyright (c) 2025 Nordic Semiconductor
#
# SPDX-License-Identifier: LicenseRef-Nordic-5-Clause
#

if BT_HCI

config BT_HOST_NORDIC
	bool "nRF Connect SDK Bluetooth Host"
	default y
	help
	  Enable the nRF Connect SDK Bluetooth Host.

endif # BT_HCI
```

## subsys/bluetooth/mesh/Kconfig
```kconfig
#
# Copyright (c) 2019 Nordic Semiconductor ASA
#
# SPDX-License-Identifier: LicenseRef-Nordic-5-Clause
#

if BT_MESH

menu "Bluetooth Mesh"

if BT_MESH_SETTINGS_WORKQ

config BT_MESH_SETTINGS_WORKQ_STACK_SIZE
	default 1400

endif

if SOC_SERIES_NRF54L

config BT_MESH_ADV_STACK_SIZE
	default 2048

endif # SOC_SERIES_NRF54L

if !BUILD_WITH_TFM

# NLC profile or DFU distributor role support requires more netkeys and appkeys
# thus more HEAP is needed by MEBEDTLS to accommodate minimum number of keys.
config MBEDTLS_HEAP_SIZE
	default 2048 if BT_MESH_DFD_SRV
	default 1152 if BT_MESH_NLC_PERF_BASELINE
	default 1024

if BT_SETTINGS

config BT_MESH_SECURE_STORAGE
	bool
	default y
	imply TRUSTED_STORAGE
	imply MBEDTLS_PSA_CRYPTO_STORAGE_C

choice TRUSTED_STORAGE_BACKEND_AEAD_KEY
	default TRUSTED_STORAGE_BACKEND_AEAD_KEY_HASH_UID if SOC_SERIES_NRF52

endchoice # TRUSTED_STORAGE_BACKEND_AEAD_KEY

config BT_MESH_CRYPTO_KEY_INITIALIZER
	bool
	default y if TRUSTED_STORAGE_BACKEND_AEAD_KEY_DERIVE_FROM_HUK
	imply HW_UNIQUE_KEY_WRITE_ON_CRYPTO_INIT if HW_UNIQUE_KEY_SUPPORTED

endif # BT_SETTINGS

endif # !BUILD_WITH_TFM

if BT_MESH_ADV_EXT

# Set the optimal advertiser configuration to improve performance of the Relay, GATT and Friend
# features.
#
# <num of adv sets> = 1 (local msgs) + 2 (relay msgs) + 1 (GATT advs) + 1 (Friend msgs)
config BT_EXT_ADV_MAX_ADV_SET
	default 5

config BT_MESH_RELAY_ADV_SETS
	depends on BT_MESH_RELAY
	default 2

config BT_MESH_ADV_EXT_GATT_SEPARATE
	depends on BT_MESH_GATT_SERVER
	default y

config BT_MESH_ADV_EXT_FRIEND_SEPARATE
	depends on BT_MESH_FRIEND
	default y

if BT_MESH_RELAY

config BT_MESH_RELAY_RETRANSMIT_COUNT
	default 0

config BT_MESH_RELAY_BUF_COUNT
	default 10

endif # BT_MESH_RELAY

endif

# Provides baseline performance requirements for NLC profiles.
# Automatically enabled when any NLC profile is selected.
config BT_MESH_NLC_PERF_BASELINE
	bool
	select BT_MESH_COMP_PAGE_2
	select BT_MESH_COMP_PAGE_1

# Provides strict performance requirements needed for some NLC profiles.
# Automatically enabled when relevant NLC profiles are selected.
# Includes all baseline requirements plus additional strict requirements.
config BT_MESH_NLC_PERF_STRICT
	bool
	select BT_MESH_NLC_PERF_BASELINE

menu "NLC Profile performance configuration"

config BT_MESH_NLC_PERF_SCENE_SELECTOR
	bool "Basic Scene Selector NLC profile performance configuration"
	select BT_MESH_NLC_PERF_BASELINE

config BT_MESH_NLC_PERF_DIMMING_CONTROL
	bool "Dimming Control NLC profile performance configuration"
	select BT_MESH_NLC_PERF_BASELINE

config BT_MESH_NLC_PERF_ENERGY_MONITOR
	bool "Energy Monitor NLC profile performance configuration"
	select BT_MESH_NLC_PERF_BASELINE

config BT_MESH_NLC_PERF_OCCUPANCY_SENSOR
	bool "Occupancy Sensor NLC profile performance configuration"
	select BT_MESH_NLC_PERF_BASELINE

config BT_MESH_NLC_PERF_AMBIENT_LIGHT_SENSOR
	bool "Ambient Light Sensor NLC profile performance configuration"
	select BT_MESH_NLC_PERF_BASELINE

config BT_MESH_NLC_PERF_LIGHTNESS_CTRL
	bool "Basic Lightness Controller NLC profile performance configuration"
	select BT_MESH_NLC_PERF_STRICT

config BT_MESH_NLC_PERF_HVAC_INTEGRATION
	bool "HVAC Integration NLC profile performance configuration"
	select BT_MESH_NLC_PERF_STRICT

endmenu

config BT_MESH_NLC_PERF_DEFAULT
	bool "Default NLC profile performance configuration [DEPRECATED]"
	select DEPRECATED
	select BT_MESH_NLC_PERF_BASELINE
	help
	  This option is deprecated. Use individual profile options instead.
	  Enables performance configurations required for the Basic Scene Selector,
	  Dimming Control, Energy Monitor, Occupancy Sensor, and Ambient Light
	  Sensor NLC profiles.

config BT_MESH_NLC_PERF_CONF
	bool "NLC performance configurations [DEPRECATED]"
	select DEPRECATED
	select BT_MESH_NLC_PERF_BASELINE

# Note: _STRICT configs must have precedence over _BASELINE.
config BT_MESH_CRPL
	default 255 if BT_MESH_NLC_PERF_STRICT
	default 32 if BT_MESH_NLC_PERF_BASELINE
	range 255 65535 if BT_MESH_NLC_PERF_STRICT
	range 32 65535 if BT_MESH_NLC_PERF_BASELINE

config BT_MESH_MODEL_GROUP_COUNT
	default 32 if BT_MESH_NLC_PERF_STRICT
	range 32 4096 if BT_MESH_NLC_PERF_STRICT

config BT_MESH_MSG_CACHE_SIZE
	default 64 if BT_MESH_NLC_PERF_BASELINE
	range 64 65535 if BT_MESH_NLC_PERF_BASELINE

config BT_MESH_APP_KEY_COUNT
	default 3 if BT_MESH_NLC_PERF_BASELINE
	range 3 4096 if BT_MESH_NLC_PERF_BASELINE

config BT_MESH_SUBNET_COUNT
	default 2 if BT_MESH_NLC_PERF_BASELINE
	range 2 4096 if BT_MESH_NLC_PERF_BASELINE

config BT_MESH_PROXY_FILTER_SIZE
	default 8 if BT_MESH_NLC_PERF_BASELINE
	range 8 32767 if BT_MESH_NLC_PERF_BASELINE

config BT_MESH_KEY_IMPORTER
	bool "Use key importer"
	help
	  Use key importer to read out the keys stored in settings subsystem
	  and import them into PSA internal trusted storage. This is required if
	  a provisioned device is still going to stay provisioned after changing
	  from an image using TinyCrypt to an image that uses PSA crypto.

config BT_MESH_KEY_IMPORTER_PRIO
	int "Initialization priority for key importer"
	depends on BT_MESH_KEY_IMPORTER
	default KERNEL_INIT_PRIORITY_DEFAULT
	help
	  The key importer is initialized before the main application. It is initialized
	  using system initialization macro with application level.

rsource "Kconfig.models"
rsource "Kconfig.dk_prov"
rsource "shell/Kconfig"
rsource "Kconfig.rpl"

endmenu

endif # BT_MESH
```

## subsys/bluetooth/mesh/Kconfig.dk_prov
```kconfig
#
# Copyright (c) 2019 Nordic Semiconductor
#
# SPDX-License-Identifier: LicenseRef-Nordic-5-Clause
#

menuconfig BT_MESH_DK_PROV
	bool "Bluetooth Mesh provisioning handler for Nordic DKs"
	depends on HWINFO
	help
	  Basic implementation of a Bluetooth Mesh provisioning handler for the
	  nRF5x development kits. Configures the UUID and handles some basic OOB
	  methods. Used in samples as a reference implementation for
	  provisioning handlers.

if BT_MESH_DK_PROV

config BT_MESH_DK_PROV_OOB_BLINK
	bool "Blink output OOB method"
	depends on DK_LIBRARY
	default y

config BT_MESH_DK_PROV_OOB_BUTTON
	bool "Button input OOB method"
	depends on DK_LIBRARY
	default y

config BT_MESH_DK_PROV_OOB_LOG
	bool "Log based OOB methods"
	depends on LOG_PRINTK
	default y

config BT_MESH_DK_LEGACY_UUID_GEN
	bool "Use legacy generation of UUID"
	help
	  Use legacy generation of UUID. For most platforms this will generate UUIDs
	  with trailing zeros.

config BT_MESH_DK_PROV_PB_GATT_DISCONNECT
	bool "Force disconnect after PB-GATT provisioning"
	depends on BT_MESH_PB_GATT
	help
	  Force disconnect mesh connections after provisioning to ensure
	  the apps reconnects via Proxy service. This is a workaround for
	  apps that do not properly close PB-GATT connection after provisioning,
	  especially after DFU. Enable this option if the app has trouble
	  transitioning from PB-GATT to Proxy after provisioning.

config BT_MESH_DK_PROV_PB_GATT_DISCONNECT_DELAY_MS
	int "Delay before forcing PB-GATT disconnect (ms)"
	depends on BT_MESH_DK_PROV_PB_GATT_DISCONNECT
	default 500
	range 100 5000
	help
	  Time in milliseconds to wait after provisioning completion before
	  forcing the PB-GATT disconnect. This delay allows the provisioning
	  completion message to be sent before disconnecting. A typical
	  value is 500ms.

module = BT_MESH_DK_PROV
module-str = DK BT mesh provisioning library
source "$(ZEPHYR_BASE)/subsys/logging/Kconfig.template.log_config"

endif # BT_MESH_DK_PROV
```
