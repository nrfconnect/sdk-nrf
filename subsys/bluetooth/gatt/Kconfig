## subsys/bluetooth/mesh/Kconfig.sensor
```kconfig
#
# Copyright (c) 2020 Nordic Semiconductor ASA
#
# SPDX-License-Identifier: LicenseRef-Nordic-5-Clause
#

config BT_MESH_SENSOR
	bool

menu "Bluetooth Mesh Sensors"
	visible if BT_MESH_SENSOR

config BT_MESH_SENSOR_USE_LEGACY_SENSOR_VALUE
	bool "Use legacy sensor_value in Sensor APIs"
	default y if BT_MESH_SENSOR
	select DEPRECATED
	help
	  Enables the legacy Sensor APIs using sensor_value for sensor
	  value representation. If this is not selected, the APIs will use
	  bt_mesh_sensor_value for representation which can accurately represent
	  any raw sensor value. This option is deprecated and will be removed in
	  a future version.

config BT_MESH_SENSOR_LABELS
	bool "Enable Sensor labels"
	help
	  Controls the availability of sensor labels for channels and units

config BT_MESH_SENSOR_ALL_TYPES
	bool "Force all sensor types to be known"
	default y if BT_MESH_SENSOR_CLI
	help
	  Forces all sensor types to be included in the build. This is
	  useful if the set of sensor types that will be used is unknown at
	  compile time, but increases ROM usage by about 3.5kB (4kB if labels
	  are enabled).

config BT_MESH_SENSOR_CHANNELS_MAX
	int "Max sensor channels"
	default 5
	help
	  Max number of channels in a single sensor. Matches the largest known
	  number by default.

config BT_MESH_SENSOR_CHANNEL_ENCODED_SIZE_MAX
	int "Max sensor channel encoded length"
	default 4
	help
	  Longest encoded representation of a single sensor channel.
	  Matches the largest known size by default.

endmenu
```

## subsys/bluetooth/mesh/shell/Kconfig
```kconfig
#
# Copyright (c) 2022 Nordic Semiconductor ASA
#
# SPDX-License-Identifier: LicenseRef-Nordic-5-Clause
#

if BT_MESH_SHELL

config BT_MESH_SHELL_ONOFF_CLI
	bool "OnOff client shell support"
	depends on BT_MESH_ONOFF_CLI
	default y
	help
	  Generic onoff client shell support.

config BT_MESH_SHELL_LVL_CLI
	bool "Level client shell support"
	depends on BT_MESH_LVL_CLI
	default y
	help
	  Generic level client shell support.

config BT_MESH_SHELL_DTT_CLI
	bool "Default Transition time client shell support"
	depends on BT_MESH_DTT_CLI
	default y
	help
	  Transition time client shell support.

config BT_MESH_SHELL_PONOFF_CLI
	bool "Power onoff client shell support"
	depends on BT_MESH_PONOFF_CLI
	default y
	help
	  Power onoff client shell support.

config BT_MESH_SHELL_PLVL_CLI
	bool "Power level client shell support"
	depends on BT_MESH_PLVL_CLI
	default y
	help
	  Power level client shell support.

config BT_MESH_SHELL_BATTERY_CLI
	bool "Battery client shell support"
	depends on BT_MESH_BATTERY_CLI
	default y
	help
	  Battery client shell support.

config BT_MESH_SHELL_LOC_CLI
	bool "Location client shell support"
	depends on BT_MESH_LOC_CLI
	default y
	help
	  Location client shell support.

config BT_MESH_SHELL_PROP_CLI
	bool "Property client shell support"
	depends on BT_MESH_PROP_CLI
	default y
	help
	  Property client shell support.

config BT_MESH_SHELL_LIGHTNESS_CLI
	bool "Light lightness client shell support"
	depends on BT_MESH_LIGHTNESS_CLI
	default y
	help
	  Light lightness client shell support.

config BT_MESH_SHELL_LIGHT_CTL_CLI
	bool "Light CTL client shell support"
	depends on BT_MESH_LIGHT_CTL_CLI
	default y
	help
	  Light CTL client shell support.

config BT_MESH_SHELL_LIGHT_HSL_CLI
	bool "Light HSL client shell support"
	depends on BT_MESH_LIGHT_HSL_CLI
	default y
	help
	  Light HSL client shell support.

config BT_MESH_SHELL_LIGHT_XYL_CLI
	bool "Light XYL client shell support"
	depends on BT_MESH_LIGHT_XYL_CLI
	default y
	help
	  Light XYL client shell support.

config BT_MESH_SHELL_LIGHT_CTRL_CLI
	bool "Light LC client shell support"
	depends on BT_MESH_LIGHT_CTRL_CLI
	default y
	help
	   Light LC client shell support.

config BT_MESH_SHELL_TIME_CLI
	bool "Time client shell support"
	depends on BT_MESH_TIME_CLI
	default y
	help
	  Time client shell support.

config BT_MESH_SHELL_SCENE_CLI
	bool "Scene client shell support"
	depends on BT_MESH_SCENE_CLI
	default y
	help
	  Scene client shell support.

config BT_MESH_SHELL_SCHEDULER_CLI
	bool "Scheduler client shell support"
	depends on BT_MESH_SCHEDULER_CLI
	default y
	help
	   Scheduler client shell support.

config BT_MESH_SHELL_SENSOR_CLI
	bool "Sensor client shell support"
	depends on BT_MESH_SENSOR_CLI
	default y
	help
	   Sensor client shell support.

if BT_MESH_SHELL_SENSOR_CLI

config BT_MESH_SHELL_SENSOR_CLI_MAX_SENSORS
	int "Maximum numbers of sensors for shell"
	default 8
	range 1 47
	help
	   Maximum number of sensor per sensor server supported by the shell module.

config BT_MESH_SHELL_SENSOR_CLI_MAX_SETTINGS
	int "Maximum numbers of settings for shell"
	default 8
	range 1 189
	help
	   Maximum number of settings per sensor supported by the shell module.

config BT_MESH_SHELL_SENSOR_CLI_MAX_COLUMNS
	int "Maximum numbers of columns for shell"
	default 8
	range 1 126
	help
	   Maximum number of columns per sensor supported by the shell module.

endif # BT_MESH_SHELL_SENSOR_CLI

config BT_MESH_SHELL_DM_CLI
	bool "Distance Measurement Client shell support"
	depends on BT_MESH_DM_CLI
	default y
	help
	   Distance Measurement Client shell support.

endif # BT_MESH_SHELL
```

## subsys/bluetooth/mesh/vnd/Kconfig
```kconfig
#
# Copyright (c) 2021 Nordic Semiconductor ASA
#
# SPDX-License-Identifier: LicenseRef-Nordic-5-Clause
#

menu "Vendor models"

config BT_MESH_VENDOR_MODELS
	bool
	select BT_MESH_NRF_MODELS
	help
	  Vendor model modules, required by all Nordic-provided vendor models

menuconfig BT_MESH_SILVAIR_ENOCEAN_SRV
	bool "Silvair EnOcean Proxy Server"
	select BT_MESH_VENDOR_MODELS
	select BT_MESH_ONOFF_CLI
	select BT_MESH_LVL_CLI
	select BT_ENOCEAN
	depends on BT_MESH_DTT_SRV
	help
	  Enable Mesh Silvair EnOcean Proxy Server model.

if BT_MESH_SILVAIR_ENOCEAN_SRV

config BT_MESH_SILVAIR_ENOCEAN_AUTO_COMMISSION
	bool "Automatically commission"
	help
	  Automatically commission/decommission EnOcean switches.

endif

config BT_MESH_DM_CLI
	bool "Distance Measurement Client"
	select BT_MESH_VENDOR_MODELS
	select EXPERIMENTAL
	depends on DM_MODULE
	help
	  Enable Distance Measurement Client model.

config BT_MESH_DM_SRV
	bool "Distance Measurement Server"
	select BT_MESH_VENDOR_MODELS
	select EXPERIMENTAL
	depends on DM_MODULE
	depends on NEWLIB_LIBC
	help
	  Enable Distance Measurement Server model.

if BT_MESH_DM_SRV

config BT_MESH_DM_SRV_DEFAULT_TTL
	int "Default distance measurement Time to Live"
	default 0
	help
	  Default Time to Live for distance measurement attempt.
	  The value of '1' is an invalid value and shall not be used.

config BT_MESH_DM_SRV_DEFAULT_TIMEOUT
	int "Default distance measurement timeout"
	default 20
	range 10 100
	help
	  Default timeout for distance measurement attempt, in 100 milliseconds steps.

config BT_MESH_DM_SRV_REFLECTOR_DELAY
	int "Reflector start delay"
	default 0
	help
	  Distance measurement reflector role start delay in microseconds.

config BT_MESH_DM_SRV_INITIATOR_RANGING_WINDOW_US
	int "Ranging window for the initiator in microseconds"
	default 50000
	help
	  Ranging window for the initiator in microseconds.

config BT_MESH_DM_SRV_REFLECTOR_RANGING_WINDOW_US
	int "Ranging window for the reflector in microseconds"
	default 70000
	help
	  Ranging window for the reflector in microseconds.

endif

endmenu
```

## subsys/bluetooth/rpc/Kconfig
```kconfig
#
# Copyright (c) 2021 Nordic Semiconductor ASA
#
# SPDX-License-Identifier: LicenseRef-Nordic-5-Clause
#

config BT_RPC
	bool "Bluetooth over RPC [EXPERIMENTAL]"
	default y if BT_RPC_STACK
	select NRF_RPC
	select NRF_RPC_CBOR
	select EXPERIMENTAL
	depends on BT
	depends on !BT_ISO_UNICAST
	depends on !BT_ISO_BROADCAST
	depends on !BT_MESH
	depends on !BT_AUDIO
	depends on !BT_HCI_RAW
	depends on !BT_DF
	depends on !BT_OTS
	depends on !BT_CLASSIC
	help
	  Enables Bluetooth serialization over RPC

if BT_RPC

choice BT_RPC_ROLE_CHOICE
	prompt "Bluetooth over RPC role selection"
	default BT_RPC_CLIENT if BT_RPC_STACK
	default BT_RPC_HOST
	help
	  Select the device role for Bluetooth over RPC. The default role is
	  a client role.

config BT_RPC_CLIENT
	bool "Bluetooth over RPC Client"
	depends on BT_RPC_STACK
	help
	  Bluetooth Low Energy API will use nRF RPC library to access host on
	  the remote core.

config BT_RPC_HOST
	bool "Bluetooth over RPC Host"
	help
	  Bluetooth Low Energy API will use nRF RPC library to provide API for
	  client on the remote core.

endchoice

config BT_RPC_INITIALIZE_NRF_RPC
	bool "Automatically initialize nRF RPC library"
	default y
	help
	  Initialize nRF RPC library during the system startup. Disabling this
	  option allow user to initialize it in a different way.

config BT_RPC_GATT_SRV_MAX
	int "Maximum number of GATT services"
	default 4
	range 0 64
	help
	  Maximum number of GATT services that BT_RPC client can define and register on a host.
	  It must be at least equal to sum of static and dynamic services which you plan to register
	  on a client.

module = BT_RPC
module-str = BLE over nRF RPC
source "${ZEPHYR_BASE}/subsys/logging/Kconfig.template.log_config"

if BT_RPC_CLIENT

config HEAP_MEM_POOL_SIZE
	default 4096

config BT_DRIVERS
	bool "Bluetooth Drivers"
	default n

endif # BT_RPC_CLIENT

if BT_RPC_HOST

config BT_RPC_GATT_BUFFER_SIZE
	int "Size of the buffer for GATT data"
	default 2048
	help
	  The GATT buffer is used to keep GATT services data from client on a host.
	  The GATT attributes are allocated on this buffer and registered to the BLE stack.

endif # BT_RPC_HOST

config BT_RPC_INTERNAL_FUNCTIONS
	bool "Internal functions"
	default n
	help
	  Enable functionality required for internal purposes e.g. testing.

endif # BT_RPC

choice BT_STACK_SELECTION

config BT_RPC_STACK
	bool "Bluetooth over RPC Client"
	help
	  Bluetooth serialized stack

endchoice

# BLE configuration copy. It is necessary to keep configuration copy since
# BLE header files have dependencies to it and original samples or application
# might use it.
if BT_RPC_STACK

config BT_CENTRAL
	bool "Central Role support"
	select BT_OBSERVER
	select BT_CONN
	help
	  Select this for LE Central role support.

config BT_PERIPHERAL
	bool "Peripheral Role support"
	select BT_BROADCASTER
	select BT_CONN
	help
	  Select this for LE Peripheral role support.

config BT_OBSERVER
	bool "Observer Role support"
	help
	  Select this for LE Observer role support.

menu "Broadcaster"
	visible if !BT_PERIPHERAL

config BT_BROADCASTER
	bool "Broadcaster Role support"
	default y if !BT_OBSERVER
	help
	  Select this for LE Broadcaster role support.

endmenu

config BT_CONN
	bool

config BT_MAX_CONN
	int "Maximum number of simultaneous connections"
	depends on BT_CONN
	range 1 64
	default 1
	help
	  Maximum number of simultaneous Bluetooth connections
	  supported.

if BT_CONN

config BT_REMOTE_VERSION
	bool "Remote version fetching"
	# Enable if building a Controller-only build
	default y if BT_HCI_RAW
	help
	  Enable this to get access to the remote version through
	  the remote_version_available callback. The host will automatically ask
	  the remote device after the connection has been established.

config BT_PHY_UPDATE
	bool "PHY Update"
	default y
	help
	  Enable support for Bluetooth 5.0 PHY Update Procedure.

config BT_DATA_LEN_UPDATE
	bool "Data Length Update"
	default y
	help
	  Enable support for Bluetooth v4.2 LE Data Length Update procedure.

endif # BT_CONN

source "$(ZEPHYR_BASE)/subsys/bluetooth/Kconfig.adv"
source "$(ZEPHYR_BASE)/subsys/bluetooth/Kconfig.logging"
source "$(ZEPHYR_BASE)/subsys/bluetooth/services/Kconfig"
source "$(ZEPHYR_BASE)/subsys/bluetooth/common/Kconfig"
source "$(ZEPHYR_BASE)/subsys/bluetooth/host/Kconfig"
source "$(ZEPHYR_BASE)/subsys/bluetooth/crypto/Kconfig"
source "$(ZEPHYR_BASE)/subsys/bluetooth/shell/Kconfig"

endif # BT_RPC_STACK
```

## subsys/bluetooth/rpc/client/Kconfig
```kconfig
#
# Copyright (c) 2018 Nordic Semiconductor
#
# SPDX-License-Identifier: LicenseRef-BSD-5-Clause-Nordic
#

menuconfig BT_RPC_CLIENT
	bool "nRF RPC client for BLE API"
	help
	  Bluetooth Low Energy API over nRF PRC library.

if BT_RPC_CLIENT

endif # BT_RPC_CLIENT
```

## subsys/bluetooth/rpc/common/Kconfig
```kconfig
#
# Copyright (c) 2018 Nordic Semiconductor
#
# SPDX-License-Identifier: LicenseRef-BSD-5-Clause-Nordic
#

if BT_RPC_HOST || BT_RPC_CLIENT

config CBKPROXY_OUT_SLOTS
	int "Maximum number of RPC callback proxy output slots"
	default 16
	range 0 16383
	help
	  Output slot is used to save context for one callback that is called
	  on local side, encoded, send and finally executed on the remote side.
	  Each output slot takes 8 bytes of flash memory. Maximum number of
	  input slots on the remote side should be the same as this value.


config CBKPROXY_IN_SLOTS
	int "Maximum number of RPC callback proxy input slots"
	default 16
	range 0 16383
	help
	  Input slot is used to save context for one callback that is called
	  on remote side, encoded, send and finally executed on the local side.
	  Each output slot takes 8 bytes of RAM memory. Maximum number of
	  output slots on the remote side should be the same as this value.


endif # BT_RPC_HOST || BT_RPC_CLIENT
```

## subsys/bluetooth/rpc/host/Kconfig
```kconfig
#
# Copyright (c) 2018 Nordic Semiconductor
#
# SPDX-License-Identifier: LicenseRef-BSD-5-Clause-Nordic
#

menuconfig BT_RPC_HOST
	bool "nRF RPC host for BLE API"
	help
	  Bluetooth Low Energy API over nRF PRC library.

if BT_RPC_HOST

endif # BT_RPC_HOST
```

## subsys/bluetooth/services/Kconfig
```kconfig
#
# Copyright (c) 2019 Nordic Semiconductor ASA
#
# SPDX-License-Identifier: LicenseRef-Nordic-5-Clause
#

menu "Bluetooth Services"

config BT_NRF_SERVICES
	bool
	help
	  Common Bluetooth GATT Services support modules, required by all Nordic
	  Services.

rsource "Kconfig.ams_client"
rsource "Kconfig.ancs_client"
rsource "Kconfig.bas_client"
rsource "Kconfig.bms"
rsource "Kconfig.cts_client"
rsource "Kconfig.dfu_smp"
rsource "Kconfig.gattp"
rsource "Kconfig.hids"
rsource "Kconfig.hogp"
rsource "Kconfig.lbs"
rsource "Kconfig.nsms"
rsource "Kconfig.nus"
rsource "Kconfig.nus_client"
rsource "Kconfig.rscs"
rsource "Kconfig.throughput"
rsource "Kconfig.latency"
rsource "Kconfig.latency_c"
rsource "Kconfig.hrs_client"
rsource "Kconfig.ddfs"
rsource "Kconfig.mds"
rsource "cgms/Kconfig.cgms"
rsource "fast_pair/Kconfig.fast_pair"

endmenu
```

## subsys/bluetooth/services/Kconfig.ams_client
```kconfig
#
# Copyright (c) 2021 Nordic Semiconductor ASA
#
# SPDX-License-Identifier: LicenseRef-Nordic-5-Clause
#

menuconfig BT_AMS_CLIENT
	bool "Apple Media Service client"
	select BT_NRF_SERVICES
	help
	  Enable Apple Media Service client.

if BT_AMS_CLIENT

module = BT_AMS_CLIENT
module-str = AMS Client
source "${ZEPHYR_BASE}/subsys/logging/Kconfig.template.log_config"

endif # BT_AMS_CLIENT
```

## subsys/bluetooth/services/Kconfig.ancs_client
```kconfig
#
# Copyright (c) 2021 Nordic Semiconductor ASA
#
# SPDX-License-Identifier: LicenseRef-Nordic-5-Clause
#

menuconfig BT_ANCS_CLIENT
	bool "Apple Notification Center Service client"
	select BT_NRF_SERVICES
	help
	  Enable Apple Notification Center Service client.

if BT_ANCS_CLIENT

config BT_ANCS_CLIENT_CP_BUFF_SIZE
	int "Control Point transmit buffer size"
	default 160
	range 20 65535
	help
	  Transmit buffer size for Control Point characteristic.

module = BT_ANCS_CLIENT
module-str = ANCS Client
source "${ZEPHYR_BASE}/subsys/logging/Kconfig.template.log_config"

endif # BT_ANCS_CLIENT
```

## subsys/bluetooth/services/Kconfig.bas_c
```kconfig
#
# Copyright (c) 2019 Nordic Semiconductor ASA
#
# SPDX-License-Identifier: LicenseRef-BSD-5-Clause-Nordic
#

menuconfig BT_GATT_BAS_C
	bool "Battery service client"
	select BT_NRF_SERVICES
	help
	  Enable Battery Service Client.

if BT_GATT_BAS_C

module = BT_GATT_BAS_C
module-str = BAS Client
source "${ZEPHYR_BASE}/subsys/logging/Kconfig.template.log_config"

endif # BT_GATT_BAS_C
```
