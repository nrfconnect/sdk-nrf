## subsys/net/lib/nrf_cloud/Kconfig
```kconfig
# Copyright (c) 2018 Nordic Semiconductor
#
# SPDX-License-Identifier: LicenseRef-Nordic-5-Clause
#

config NRF_CLOUD
	bool "nRF Cloud support"
	help
	  Enable configuration options for nRF Cloud.

if NRF_CLOUD

menu "nRF Cloud"

menu "Transport"

rsource "Kconfig.nrf_cloud_mqtt"

if NRF_CLOUD_MQTT

config NRF_CLOUD_HOST_NAME
	string "nRF Cloud server hostname"
	default "mqtt.nrfcloud.com"
	help
	  Used for MQTT

endif # NRF_CLOUD_MQTT

rsource "Kconfig.nrf_cloud_coap"

endmenu # "Transport"

menu "Credentials"

config NRF_CLOUD_SEC_TAG
	int "Security tag to use for nRF Cloud connection"
	default 16842753

if NRF_CLOUD_MQTT || NRF_CLOUD_PGPS || MODEM_JWT || NRF_CLOUD_COAP

config NRF_CLOUD_PROVISION_CERTIFICATES
	bool "Install credentials for nRF Cloud connection"
	select EXPERIMENTAL
	default y if BOARD_QEMU_X86
	imply MBEDTLS_PEM_PARSE_C
	imply MBEDTLS_PEM_WRITE_C
	help
	  Enable run-time provisioning of certificates from the
	  certificates header file selected by using NRF_CLOUD_CERTIFICATES_FILE
	  Please note that this option stores your device's private key in unprotected memory.
	  It is not secure, and for testing purposes only.

if NRF_CLOUD_PROVISION_CERTIFICATES

config NRF_CLOUD_PROVISION_CA_CERT
	bool "Install the CA certificate"
	default y

config NRF_CLOUD_PROVISION_CLIENT_CERT
	bool "Install the client certificate"
	default y

config NRF_CLOUD_PROVISION_PRV_KEY
	bool "Install the private key"
	default y

config NRF_CLOUD_CERTIFICATES_FILE
	string "nRF Cloud certificates"
	default "../include/nrf_cloud-certs.h"
	help
	  The default path for a header file that contains definitions for certificates that are
	  used during run-time provisioning of TLS credentials.
	  By default, the library expects the credentials to be in
	  Privacy Enhanced Mail (PEM) format. See "nrf_cloud-certs.h" for a template.

endif # NRF_CLOUD_PROVISION_CERTIFICATES

config NRF_CLOUD_CHECK_CREDENTIALS
	bool "Check if nRF Cloud credentials are present"

choice NRF_CLOUD_CREDENTIALS_MGMT
	prompt "Select how credentials are managed"
	depends on NRF_CLOUD_CHECK_CREDENTIALS || NRF_CLOUD_PROVISION_CERTIFICATES
	default NRF_CLOUD_CREDENTIALS_MGMT_MODEM if NRF_MODEM_LIB
	default NRF_CLOUD_CREDENTIALS_MGMT_TLS_CRED if !NRF_MODEM_LIB

config NRF_CLOUD_CREDENTIALS_MGMT_MODEM
	depends on NRF_MODEM_LIB
	select MODEM_KEY_MGMT
	imply AT_SHELL_UNESCAPE_LF if AT_SHELL
	bool "Credentials are managed by the modem"

config NRF_CLOUD_CREDENTIALS_MGMT_TLS_CRED
	bool "Credentials are managed by the TLS credentials module"
	select TLS_CREDENTIALS
endchoice

config NRF_CLOUD_CREDENTIALS_KEYGEN
	bool "Generate the device private key and CSR on-device using PSA [EXPERIMENTAL]"
	depends on NRF_CLOUD_CREDENTIALS_MGMT_TLS_CRED
	select EXPERIMENTAL
	select TLS_CREDENTIALS
	select MBEDTLS
	select MBEDTLS_PK_C
	select MBEDTLS_PK_PARSE_C
	select MBEDTLS_PK_WRITE_C
	select MBEDTLS_ASN1_WRITE_C
	select MBEDTLS_X509_CREATE_C
	select MBEDTLS_X509_CSR_WRITE_C
	select PSA_WANT_KEY_TYPE_ECC_KEY_PAIR_GENERATE
	select PSA_WANT_KEY_TYPE_ECC_PUBLIC_KEY
	select PSA_WANT_ALG_ECDSA
	select PSA_WANT_ALG_SHA_256
	select PSA_WANT_ECC_SECP_R1_256
	help
	  Generate the nRF Cloud device private key on-device using the PSA
	  Crypto API. The key is created as a persistent, non-exportable ECC
	  P-256 key stored securely through the selected secure storage backend
	  and is referenced for TLS by its PSA key id
	  (TLS_CREDENTIAL_PRIVATE_KEY_PSA), so the private key never leaves the
	  device. A matching Certificate Signing Request (CSR) can be produced
	  for submission to nRF Cloud. The key is re-registered with the TLS
	  credentials module on every boot during nrf_cloud initialization.

config NRF_CLOUD_CREDENTIALS_KEYGEN_VERIFY
	bool "Export the on-device public key for verification"
	depends on NRF_CLOUD_CREDENTIALS_KEYGEN
	default y
	help
	  Provide an API (and shell command) to export the public key of the
	  on-device key pair. The private key is non-exportable, so this public
	  key is used by host tooling to verify that the on-device key matches
	  the installed device certificate. Disable to save a small amount of
	  code if key verification is not needed.

config NRF_CLOUD_CREDENTIALS_KEYGEN_SHELL
	bool "Shell commands for on-device key and CSR generation [EXPERIMENTAL]"
	depends on NRF_CLOUD_CREDENTIALS_KEYGEN
	depends on SHELL
	select EXPERIMENTAL
	select BASE64
	help
	  Add 'nrf_cloud_cred' shell commands (keygen, csr, and delete, plus
	  pubkey when NRF_CLOUD_CREDENTIALS_KEYGEN_VERIFY is enabled) that drive
	  the on-device key generation, CSR creation, and public key export
	  implemented in the nRF Cloud credentials module.

endif # NRF_CLOUD_MQTT || NRF_CLOUD_PGPS || MODEM_JWT || NRF_CLOUD_COAP

config NRF_CLOUD_JWT_SOURCE_CUSTOM
	bool "Custom JWT creation and signing [EXPERIMENTAL]"
	select EXPERIMENTAL
	select TLS_CREDENTIALS
	select BASE64
	select APP_JWT
	help
	  JWTs are created and signed by the nRF Cloud library, not the modem.
	  The signing key is obtained from the TLS credentials module.

config NRF_CLOUD_AWS_CA_CERT_SIZE_THRESHOLD
	int "Root CA size above which AWS cert is likely present"
	default 1150
	help
	  This value is necessarily inexact as the underlying PEM data varies
	  a bit in size when credentials are rotated or replaced. This is useful
	  to determine if a sectag likely contains only an AWS root CA
	  certificate.

config NRF_CLOUD_COAP_CA_CERT_SIZE_THRESHOLD
	int "Root CA size above which a CoAP cert is likely present"
	default 550
	help
	  This necessarily inexact value is useful to determine if a sectag
	  likely contains only a CoAP root CA certificate.

endmenu # "Credentials"

rsource "Kconfig.nrf_cloud_client_id"

rsource "Kconfig.nrf_cloud_fota"

rsource "Kconfig.nrf_cloud_location"

rsource "Kconfig.nrf_cloud_shadow_info"

config NRF_CLOUD_PRINT_DETAILS
	bool "Log info about cloud connection"
	default y
	help
	  Log at the INF level the device ID.

config NRF_CLOUD_VERBOSE_DETAILS
	bool "Log more info about cloud connection"
	depends on NRF_CLOUD_PRINT_DETAILS
	default y if NRF_CLOUD_PRINT_DETAILS
	help
	  Log at INF level the protocol, sec tag, host name, and team ID,
	  in addition to device ID.

config NRF_CLOUD_DOWNLOADS
	bool
	default y
	depends on NRF_CLOUD_FOTA || NRF_CLOUD_PGPS || NRF_CLOUD_FOTA_POLL
	help
	  Enable nRF Cloud file downloads for FOTA and P-GPS.

choice NRF_CLOUD_DOWNLOADS_PROTOCOL
	prompt "nRF Cloud file download protocol"
	depends on NRF_CLOUD_DOWNLOADS
	default NRF_CLOUD_COAP_DOWNLOADS if NRF_CLOUD_COAP

config NRF_CLOUD_COAP_DOWNLOADS
	bool "CoAP"
	depends on NRF_CLOUD_COAP
	select DOWNLOADER_TRANSPORT_COAP
	help
	  Use nRF Cloud CoAP's proxy download resource to download files for FOTA and P-GPS.
	  When enabled, the Kconfig option COAP_EXTENDED_OPTIONS_LEN_VALUE must be increased
	  from the default value. Safe values are 80 for P-GPS and 192 for FOTA.

config NRF_CLOUD_HTTPS_DOWNLOADS
	bool "HTTPS"
	help
	  Use HTTPS to download files for FOTA and P-GPS over MQTT.

endchoice

module=NRF_CLOUD
module-str=nRF Cloud
source "subsys/logging/Kconfig.template.log_config"

endmenu # "nRF Cloud"

endif # NRF_CLOUD
```

## subsys/net/lib/nrf_cloud/Kconfig.nrf_cloud_agnss
```kconfig
# Copyright (c) 2021 Nordic Semiconductor
#
# SPDX-License-Identifier: LicenseRef-Nordic-5-Clause
#

menuconfig NRF_CLOUD_AGNSS
	bool "nRF Cloud Assisted GNSS (A-GNSS)"
	depends on MODEM_INFO
	depends on MODEM_INFO_ADD_NETWORK
	select CJSON_LIB

if NRF_CLOUD_AGNSS

config NRF_CLOUD_AGNSS_FILTERED_RUNTIME
	bool "Allow runtime control of filtered ephemerides mode"
	depends on NRF_CLOUD_AGNSS_FILTERED
	help
	  Allow runtime settings in nrf_cloud_rest_agnss_request structure
	  to configure filtered mode and related elevation mask. Otherwise,
	  NRF_CLOUD_AGNSS_FILTERED and NRF_CLOUD_AGNSS_ELEVATION_MASK set
	  the request parameters directly.

config NRF_CLOUD_AGNSS_FILTERED
	bool "Request only visible satellite ephemerides"
	help
	  Normally A-GNSS requests ephemerides for all GPS constellation
	  satellites. Setting this option reduces that set to only
	  satellites at or above the threshold elevation angle.

config NRF_CLOUD_AGNSS_ELEVATION_MASK
	int "Minimum elevation angle for visible satellites"
	default 5
	depends on NRF_CLOUD_AGNSS_FILTERED
	help
	  This sets the threshold elevation angle in A-GNSS cloud requests.
	  It constrains which satellite ephemerides are included in the
	  assistance data returned by the cloud.

endif # NRF_CLOUD_AGNSS
```

## subsys/net/lib/nrf_cloud/Kconfig.nrf_cloud_agps
```kconfig
# Copyright (c) 2021 Nordic Semiconductor
#
# SPDX-License-Identifier: LicenseRef-Nordic-5-Clause
#

menuconfig NRF_CLOUD_AGPS
	bool "nRF Cloud Assisted GPS (A-GPS)"
	depends on MODEM_INFO
	depends on MODEM_INFO_ADD_NETWORK
	select CJSON_LIB

if NRF_CLOUD_AGPS

config NRF_CLOUD_AGPS_FILTERED_RUNTIME
	bool "Allow runtime control of filtered ephemerides mode"
	depends on NRF_CLOUD_AGPS_FILTERED
	help
	  Allow runtime settings in nrf_cloud_rest_agps_request structure
	  to configure filtered mode and related elevation mask. Otherwise,
	  NRF_CLOUD_AGPS_FILTERED and NRF_CLOUD_AGPS_ELEVATION_MASK set
	  the request parameters directly.

config NRF_CLOUD_AGPS_FILTERED
	bool "Request only visible satellite ephemerides"
	help
	  Normally A-GPS requests ephemerides for all GPS constellation
	  satellites. Setting this option reduces that set to only
	  satellites at or above the threshold elevation angle.

config NRF_CLOUD_AGPS_ELEVATION_MASK
	int "Minimum elevation angle for visible satellites"
	default 5
	depends on NRF_CLOUD_AGPS_FILTERED
	help
	  This sets the threshold elevation angle in A-GPS cloud requests.
	  It constrains which satellite ephemerides are included in the
	  assistance data returned by the cloud.

endif # NRF_CLOUD_AGPS
```

## subsys/net/lib/nrf_cloud/Kconfig.nrf_cloud_alert
```kconfig
# Copyright (c) 2023 Nordic Semiconductor
#
# SPDX-License-Identifier: LicenseRef-Nordic-5-Clause
#

menuconfig NRF_CLOUD_ALERT
	bool "nRF Cloud Alert System"

if NRF_CLOUD_ALERT

config NRF_CLOUD_ALERT_SEQ_ALWAYS
	bool "Always include the sequence number in the alert message"
	default y
	help
	  If set, send the seq field regardless of whether the ts field
	  is set.  If not set, only send the seq field when ts is not
	  available.

endif # NRF_CLOUD_ALERT

module = NRF_CLOUD_ALERT
module-str = nRF Cloud Alert
source "subsys/logging/Kconfig.template.log_config"
```

## subsys/net/lib/nrf_cloud/Kconfig.nrf_cloud_alerts
```kconfig
# Copyright (c) 2023 Nordic Semiconductor
#
# SPDX-License-Identifier: LicenseRef-Nordic-5-Clause
#

menuconfig NRF_CLOUD_ALERTS
	bool "nRF Cloud Alert System"

if NRF_CLOUD_ALERTS

config NRF_CLOUD_ALERTS_SEQ_ALWAYS
	bool "Always include the sequence number in the alert message"
	default y
	help
	  If set, send the seq field regardless of whether the ts field
	  is set.  If not set, only send the seq field when ts is not
	  available.

endif # NRF_CLOUD_ALERTS

module = NRF_CLOUD_ALERTS
module-str = nRF Cloud Alerts
source "subsys/logging/Kconfig.template.log_config"
```

## subsys/net/lib/nrf_cloud/Kconfig.nrf_cloud_cell_pos
```kconfig
# Copyright (c) 2021 Nordic Semiconductor
#
# SPDX-License-Identifier: LicenseRef-Nordic-5-Clause
#

config NRF_CLOUD_CELL_POS
	bool "Enable nRF Cloud Cellular Positioning over MQTT"
	imply FPU
	depends on MODEM_INFO
	depends on MODEM_INFO_ADD_NETWORK
	depends on NRF_CLOUD_MQTT
	select CJSON_LIB
```

## subsys/net/lib/nrf_cloud/Kconfig.nrf_cloud_client_id
```kconfig
# Copyright (c) 2021 Nordic Semiconductor
#
# SPDX-License-Identifier: LicenseRef-Nordic-5-Clause
#

menu "Client ID (nRF Cloud Device ID)"
choice NRF_CLOUD_CLIENT_ID_SRC
	prompt "Client ID Source"
	default NRF_CLOUD_CLIENT_ID_SRC_INTERNAL_UUID if SOC_NRF9160
	default NRF_CLOUD_CLIENT_ID_SRC_MDM_DEVICE_UUID

config NRF_CLOUD_CLIENT_ID_SRC_INTERNAL_UUID
	bool "Modem internal UUID value (JWT iss)"
	depends on NRF_MODEM_LIB && SOC_NRF9160
	select MODEM_JWT
	help
	  Use the modem's internal UUID, extracted from the iss claim of a
	  modem-signed JWT via modem_jwt_get_uuids(). This is the default for
	  nRF9160 and preserves backward compatibility with field devices
	  provisioned through older nrfcloud-utils flows, which derived the
	  Device ID from the same JWT iss UUID.
	  Requires modem firmware v1.3.0 or later.

config NRF_CLOUD_CLIENT_ID_SRC_MDM_DEVICE_UUID
	bool "Modem device UUID value (AT%DEVICEUUID)"
	depends on NRF_MODEM_LIB && !SOC_NRF9160
	help
	  Use the modem's device UUID via the AT%DEVICEUUID command, with no
	  MODEM_JWT dependency. This is the default for nRF91x1 and future
	  SoCs. Supported by:
	    mfw_nrf91x1 (v2.0.0 or later)
	    mfw_nrf9151-ntn
	    mfw-nr+_nrf91x1 (v2.0.0 or later)

config NRF_CLOUD_CLIENT_ID_SRC_COMPILE_TIME
	bool "Compile time value"

config NRF_CLOUD_CLIENT_ID_SRC_RUNTIME
	bool "Runtime value"
	help
	  NULL-terminated client ID string must be set using the provided library function.
	  For MQTT, this can also be set with library initialization function.

config NRF_CLOUD_CLIENT_ID_SRC_IMEI
	bool "IMEI based value [DEPRECATED: use the default UUID source]"
	depends on NRF_MODEM_LIB
	select DEPRECATED
	help
	  Deprecated. Use the default UUID source for new applications.
	  Fleet operators with IMEI-provisioned devices already in the field
	  may continue to use this option.

config NRF_CLOUD_CLIENT_ID_SRC_HW_ID
	bool "Hardware ID based value [DEPRECATED: use the default UUID source]"
	depends on HW_ID_LIBRARY
	select DEPRECATED
	help
	  Deprecated. Use the default UUID source for new applications.

endchoice

if NRF_CLOUD_CLIENT_ID_SRC_IMEI
config NRF_CLOUD_CLIENT_ID_PREFIX
	string "Prefix used when constructing the client ID from the IMEI"
	default "nrf-"
	help
	  The nrf- prefix is reserved on nRF Connect for Cloud for official Nordic
	  devices (e.g. the nRF9160 DK or the Thingy:91).
	  In case you wish to use nrf_cloud with your own devices you need to modify
	  the prefix used to generate the client ID from the IMEI.
endif

if NRF_CLOUD_CLIENT_ID_SRC_COMPILE_TIME
config NRF_CLOUD_CLIENT_ID
	string "Client ID used for connection to nRF Cloud"
	default "my-client-id"
endif
endmenu
```
