## subsys/net/lib/nrf_cloud/Kconfig.nrf_cloud_pgps
```kconfig
# Copyright (c) 2021 Nordic Semiconductor
#
# SPDX-License-Identifier: LicenseRef-Nordic-5-Clause
#

menuconfig NRF_CLOUD_PGPS
	bool "nRF Cloud Predicted GPS (P-GPS)"
	depends on MODEM_INFO
	depends on MODEM_INFO_ADD_NETWORK
	depends on DATE_TIME
	imply DOWNLOADER
	select STREAM_FLASH_ERASE
	select SETTINGS
	select CJSON_LIB

if NRF_CLOUD_PGPS

config NRF_CLOUD_PGPS_REQUEST_UPON_INIT
	bool "Request required P-GPS data upon initialization"
	default y
	help
	  If this option is enabled, the P-GPS library init function will
	  request P-GPS data from the cloud for three reasons:
	  if no P-GPS data has previously been stored to flash,
	  if only some of the predictions are in storage,
	  or if the replacement threshold is reached.

config NRF_CLOUD_PGPS_NUM_PREDICTIONS
	int "Desired number of predictions"
	range 2 42
	default 42
	help
	  This value, together with the prediction period, determines the
	  overall timespan that the GPS predictions will cover. The
	  default values allows for one week of predictions. Odd numbers
	  are not allowed.

config NRF_CLOUD_PGPS_REPLACEMENT_THRESHOLD
	int "Number of predictions remaining before fetching more"
	range 0 40
	default 0
	help
	  When set to 0, no attempt will be made to update the prediction
	  set from the cloud until all predictions have expired. When set
	  to an even number less than or equal to
	  NRF_CLOUD_PGPS_NUM_PREDICTIONS - 2, any expired predictions will be
	  replaced with predictions following the last remaining valid
	  prediction. Odd numbers are not allowed.

config NRF_CLOUD_PGPS_DOWNLOAD_FRAGMENT_SIZE
	int "Fragment size for P-GPS downloads"
	range 128 1500
	default 1500
	help
	  Due to the finite size of the nrf9160 modem's TLS buffer, this
	  value needs to be small enough to leave room for the HTTP
	  headers.

choice NRF_CLOUD_PGPS_TRANSPORT
	prompt "nRF Cloud P-GPS transport for requests and responses"
	default NRF_CLOUD_PGPS_TRANSPORT_MQTT if NRF_CLOUD_MQTT
	default NRF_CLOUD_PGPS_TRANSPORT_NONE

config NRF_CLOUD_PGPS_TRANSPORT_NONE
	bool "Application-provided transport"
	help
	  Enabling this option will make the nRF Cloud P-GPS library not request
	  or receive data from nRF Cloud when its APIs are called. This will
	  instead let it be up to the user to request, receive and process P-GPS
	  data.

config NRF_CLOUD_PGPS_TRANSPORT_MQTT
	bool "MQTT transport"
	depends on NRF_CLOUD_MQTT
	depends on NRF_CLOUD_PGPS_DOWNLOAD_TRANSPORT_HTTP
	help
	  Use nRF Cloud library's MQTT implementation to send requests for P-GPS
	  data and receive responses. Responses indicate where the device can
	  download predictions from, using the NRF_CLOUD_PGPS_DOWNLOAD_TRANSPORT.

endchoice # NRF_CLOUD_PGPS_TRANSPORT

choice NRF_CLOUD_PGPS_DOWNLOAD_TRANSPORT
	prompt "nRF Cloud P-GPS download transport"
	default NRF_CLOUD_PGPS_DOWNLOAD_TRANSPORT_HTTP

config NRF_CLOUD_PGPS_DOWNLOAD_TRANSPORT_HTTP
	bool "Transport P-GPS prediction data over HTTP(S)"
	help
	  Enabling this option will make the nRF Cloud P-GPS library use the
	  downloader library to download prediction data.

config NRF_CLOUD_PGPS_DOWNLOAD_TRANSPORT_CUSTOM
	bool "Transport P-GPS data using application-supplied transport"
	help
	  Enabling this option bypasses the built-in HTTP(S) transport and
	  replaces it with an application-specific transport for downloading
	  prediction data.

endchoice # NRF_CLOUD_PGPS_DOWNLOAD_TRANSPORT

config NRF_CLOUD_PGPS_SOCKET_RETRIES
	int "Number of times to retry a P-GPS download"
	default 2
	help
	  This sets the maximum number of times to retry a download.

choice NRF_CLOUD_PGPS_STORAGE
	prompt "nRF Cloud P-GPS persistent storage location"
#TODO: Add MCUBOOT_BOOTLOADER_MODE_RAM_LOAD once included via next upmerge
	default NRF_CLOUD_PGPS_STORAGE_PARTITION if MCUBOOT_BOOTLOADER_MODE_DIRECT_XIP || MCUBOOT_BOOTLOADER_MODE_DIRECT_XIP_WITH_REVERT
	default NRF_CLOUD_PGPS_STORAGE_MCUBOOT_SECONDARY if BOARD_THINGY91_NRF9160_NS
	help
	  The P-GPS subsystem requires a contiguous section of flash memory in
	  which to store predictions. The amount required is 2048 bytes times
	  the number of predictions set by NRF_CLOUD_PGPS_NUM_PREDICTIONS.
	  If mcuboot DFU is enabled, default to NRF_CLOUD_PGPS_STORAGE_PARTITION.
	  Otherwise, P-GPS will prevent a successful mcuboot update, causing it
	  to revert to the previous image.

config NRF_CLOUD_PGPS_STORAGE_PARTITION
	bool "Define P-GPS subsystem flash partition"
	help
	  If set, allocates flash for storing predictions.

config NRF_CLOUD_PGPS_STORAGE_MCUBOOT_SECONDARY
	bool "Reuse MCUboot secondary partition for P-GPS storage"
	depends on BOOTLOADER_MCUBOOT
	depends on IMG_MANAGER
#TODO: Add MCUBOOT_BOOTLOADER_MODE_RAM_LOAD once included via next upmerge
	depends on !MCUBOOT_BOOTLOADER_MODE_DIRECT_XIP && !MCUBOOT_BOOTLOADER_MODE_DIRECT_XIP_WITH_REVERT
	help
	  If set, use the secondary MCUboot partition to also store P-GPS data.
	  Note that when a FOTA job executes, this data will be lost and will
	  have to be downloaded again after the FOTA job is complete. This is
	  not compatible with FOTA updates of MUCboot itself, which is possible
	  when SECURE_BOOT is enabled.

config NRF_CLOUD_PGPS_STORAGE_CUSTOM
	bool "Use application-provided location and size in flash"
	help
	  The application is responsible for providing the location in flash
	  in which to store P-GPS data.  The location must be aligned to a
	  flash page boundary (4096 bytes), and the size must be at least 2048
	  bytes times NRF_COUND_PGPS_NUM_PREDICTIONS.

endchoice # NRF_CLOUD_PGPS_STORAGE

if NRF_CLOUD_PGPS_STORAGE_PARTITION

config NRF_CLOUD_PGPS_PARTITION_SIZE
	hex "Size of flash partition for P-GPS data storage"
	default 0x15000
	help
	  This must be at least 2048 bytes times NRF_CLOUD_PGPS_NUM_PREDICTIONS.

config NRF_CLOUD_PGPS_PARTITION_ALIGN
	hex "Align P-GPS partition to flash block boundary"
	default $(dt_node_int_prop_hex,$(DT_CHOSEN_ZEPHYR_FLASH),erase-block-size)

endif # NRF_CLOUD_PGPS_STORAGE_PARTITION

endif # NRF_CLOUD_PGPS
```

## subsys/net/lib/nrf_cloud/Kconfig.nrf_cloud_rest
```kconfig
# Copyright (c) 2021 Nordic Semiconductor
#
# SPDX-License-Identifier: LicenseRef-Nordic-5-Clause
#

menuconfig NRF_CLOUD_REST
	bool "nRF Cloud REST"
	select CJSON_LIB
	select REST_CLIENT

if NRF_CLOUD_REST

config NRF_CLOUD_REST_HOST_NAME
	string "nRF Cloud REST API hostname"
	default "api.nrfcloud.com"

config NRF_CLOUD_REST_AUTOGEN_JWT
	bool "nRF Cloud REST autogenerate JWTs"
	depends on MODEM_JWT
	help
		Enables the nRF Cloud REST library JWT autogeneration feature,
		which will generate JWT tokens automatically when they are not provided.
		This will incur some extra heap cost.

config NRF_CLOUD_REST_AUTOGEN_JWT_VALID_TIME_S
	int "nRF Cloud REST autogenerated JWT valid lifetime (seconds)"
	default 300
	depends on NRF_CLOUD_REST_AUTOGEN_JWT

config NRF_CLOUD_REST_FRAGMENT_SIZE
	int "Fragment size for REST API downloads"
	range 128 1700
	default 1700

module = NRF_CLOUD_REST
module-str = nRF Cloud REST
source "subsys/logging/Kconfig.template.log_config"

endif # NRF_CLOUD_REST
```

## subsys/net/lib/nrf_cloud/Kconfig.nrf_cloud_shadow_info
```kconfig
# Copyright (c) 2023 Nordic Semiconductor
#
# SPDX-License-Identifier: LicenseRef-Nordic-5-Clause
#

menu "Device Shadow"

config NRF_CLOUD_DEVICE_STATUS_ENCODE_VOLTAGE
	bool "Include the (battery) voltage when encoding device status"
	depends on MODEM_INFO
	depends on MODEM_INFO_ADD_DEVICE
	default y

# Select the info sections that will be automatically added to the device's
# shadow when connecting to nRF Cloud with MQTT or CoAP.
menu "Send shadow info sections on initial connect (MQTT/CoAP)"

if NRF_CLOUD_MQTT || NRF_CLOUD_COAP

config NRF_CLOUD_SEND_DEVICE_STATUS
	bool "Send device status on initial connection"
	depends on MODEM_INFO
	depends on MODEM_INFO_ADD_DEVICE
	default y if NRF_CLOUD_FOTA
	help
	  Add "deviceInfo" section containing hardware and firmware version information.

config NRF_CLOUD_SEND_DEVICE_STATUS_NETWORK
	bool "Send network status information on initial connection"
	depends on MODEM_INFO
	depends on MODEM_INFO_ADD_NETWORK
	help
	  Add "networkInfo" section containing network connection information.

config NRF_CLOUD_SEND_DEVICE_STATUS_SIM
	bool "Send SIM card information on initial connection"
	depends on MODEM_INFO
	depends on MODEM_INFO_ADD_SIM
	help
	  Add "simInfo" section containing SIM card information.

config NRF_CLOUD_SEND_DEVICE_STATUS_CONN_INF
	bool "Send connection information on initial connection"
	default y
	help
	  Add "connectionInfo" section indication how the device is connecting to nRF Cloud.

config NRF_CLOUD_SEND_SERVICE_INFO_FOTA
	bool "Send FOTA service info on initial connection"
	default y if NRF_CLOUD_FOTA
	help
	  Add supported FOTA types to the "serviceInfo" section.
	  If your application does not support certain FOTA types, this option should be disabled and the application should set its supported FOTA types in the shadow.
	  Supported types are based on Kconfig values:
	    NRF_CLOUD_FOTA_TYPE_APP_SUPPORTED
	    NRF_CLOUD_FOTA_TYPE_BOOT_SUPPORTED
	    NRF_CLOUD_FOTA_TYPE_MODEM_DELTA_SUPPORTED
	    NRF_CLOUD_FOTA_TYPE_MODEM_FULL_SUPPORTED

endif # NRF_CLOUD_MQTT || NRF_CLOUD_COAP

config NRF_CLOUD_SEND_SHADOW_INFO
	bool
	default y if (NRF_CLOUD_SEND_DEVICE_STATUS || \
		      NRF_CLOUD_SEND_DEVICE_STATUS_NETWORK || \
		      NRF_CLOUD_SEND_DEVICE_STATUS_SIM || \
		      NRF_CLOUD_SEND_DEVICE_STATUS_CONN_INF || \
		      NRF_CLOUD_SEND_SERVICE_INFO_FOTA)
	help
	  This symbol is y when at least one option to send an info section is enabled.

config NRF_CLOUD_SEND_SHADOW_INFO_ON_CONNECT
	bool "Send shadow info sections on initial connect"
	default y if NRF_CLOUD_SEND_SHADOW_INFO
	help
	  When enabled, the selected info sections will be sent to nRF Cloud and added to the
	  device's shadow on the initial connection. If disabled, the application must trigger
	  sending the info sections by calling nrf_cloud_shadow_info_send().

endmenu

endmenu
```

## subsys/net/lib/nrf_provisioning/Kconfig
```kconfig
#
# Copyright (c) 2023 Nordic Semiconductor
#
# SPDX-License-Identifier: LicenseRef-Nordic-5-Clause
#

menuconfig NRF_PROVISIONING
	bool "nRF Provisioning"
	depends on NRF_MODEM_LIB
	depends on SETTINGS
	depends on MODEM_ATTEST_TOKEN
	imply FCB

if NRF_PROVISIONING

config NRF_PROVISIONING_AUTO_START_ON_INIT
	bool "Start provisioning automatically on initialization"
	help
	  Start the client automatically after the client is initialized in the
	  nrf_provisioning_init() function.

config NRF_PROVISIONING_SCHEDULED
	bool "Scheduled provisioning"
	depends on NRF_PROVISIONING_AUTO_START_ON_INIT
	help
	  Activate scheduled provisioning. The client will try to perform provisioning
	  at a given interval set by CONFIG_NRF_PROVISIONING_INTERVAL_S.

config NRF_PROVISIONING_VALID_DATE_TIME_TIMEOUT_SECONDS
	int "Time to wait for valid date-time in seconds"
	default 60
	help
	  Time to wait for valid date-time before starting provisioning. The provisioning library
	  depends on JWT generation, which requires a valid date-time.

config NRF_PROVISIONING_MODEM_STATE_WAIT_TIMEOUT_SECONDS
	int "Modem state wait timeout in seconds"
	default 120
	help
	  Timeout for waiting for the modem to enter the desired connectivity state.

config NRF_PROVISIONING_INTERVAL_S
	int "Maximum provisioning interval in seconds"
	default 86400

config NRF_PROVISIONING_SPREAD_S
	int "Provisioning time spread in seconds"
	default 0

config NRF_PROVISIONING_SHELL
	bool "Shell utilities"
	depends on SHELL
	help
	  Activate shell module that provides nRF Provisioning commands to the console.

config NRF_PROVISIONING_WITH_CERT
	bool "Include the certificate"
	default y
	help
	  Includes the root certificate used by the server side and provisions it if needed.

config NRF_PROVISIONING_ROOT_CA_SEC_TAG
	int "Root CA for nRF Cloud Identity Service - security tag"
	default 189298

config NRF_PROVISIONING_SAVE_CMD_ID
	bool "Save the latest command id to storage"
	help
	  Saves the latest command id to storage after successful Finished command.

config NRF_PROVISIONING_CUSTOM_AT
	bool "Custom AT commands"
	depends on AT_CMD_CUSTOM
	help
	  Activate custom AT commands.

config NRF_PROVISIONING_SETTINGS_STORAGE_PATH
	string "Settings storage path for provisioning"
	default "provisioning"

config NRF_PROVISIONING_RX_BUF_SZ
	int "RX buffer size"
	default 1024

config NRF_PROVISIONING_TX_BUF_SZ
	int "TX buffer size"
	default 2048

config NRF_PROVISIONING_JWT_SEC_TAG
	int "Provision Service's security tag, private Device Identity key used by default"
	default 0

config NRF_PROVISIONING_JWT_MAX_VALID_TIME_S
	int "Maximum JWT valid lifetime (seconds)"
	range 0 360
	default 300

config NRF_PROVISIONING_PROVIDE_ATTESTATION_TOKEN
	bool "Provide attestation token when unauthorized"
	default y
	help
	  Unauthorized errors occur when the device is not yet claimed on
	  nRF Cloud. Provide attestation in the library callback token when unauthorized.

config NRF_PROVISIONING_STACK_SIZE
	int "nRF Provisioning Stack size"
	default 4096 if NRF_PROVISIONING_LOG_LEVEL_DBG
	default 2048
	help
	  Stack size for the nRF Provisioning thread.

config NRF_PROVISIONING_INITIAL_BACKOFF
	int "Initial backoff time in seconds"
	default 60
	help
	  Initial time for exponential backoff in seconds. The time is doubled
	  after each failed (busy or timeout) attempt to connect to the server.
	  The maximum time is 86400 seconds (24 hours).

rsource "Kconfig.nrf_provisioning_http"

rsource "Kconfig.nrf_provisioning_coap"

module=NRF_PROVISIONING
module-str=nRF Provisioning
source "subsys/logging/Kconfig.template.log_config"

endif
```

## subsys/net/lib/nrf_provisioning/Kconfig.nrf_provisioning_at
```kconfig
#
# Copyright (c) 2023 Nordic Semiconductor
#
# SPDX-License-Identifier: LicenseRef-Nordic-5-Clause
#

menuconfig NRF_PROVISIONING_AT
	bool "nRF Provisioning authentication bearer attestation token"
	select EXPERIMENTAL

if NRF_PROVISIONING_AT

config NRF_PROVISIONING_AT_ATTESTTOKEN_MAX_LEN
	int "Maximum length of the token"
	range 256 256
	default 256

endif
```

## subsys/net/lib/nrf_provisioning/Kconfig.nrf_provisioning_attesttoken
```kconfig
#
# Copyright (c) 2023 Nordic Semiconductor
#
# SPDX-License-Identifier: LicenseRef-Nordic-5-Clause
#

config NRF_PROVISIONING_ATTESTTOKEN
	bool "nRF Provisioning authentication bearer attestation token"
	select EXPERIMENTAL
```

## subsys/net/lib/nrf_provisioning/Kconfig.nrf_provisioning_cbor
```kconfig
#
# Copyright (c) 2023 Nordic Semiconductor
#
# SPDX-License-Identifier: LicenseRef-Nordic-5-Clause
#
menuconfig NRF_PROVISIONING_CBOR
	bool "nRF Provisioning CBOR content format"
	select EXPERIMENTAL
	depends on ZCBOR

if NRF_PROVISIONING_CBOR

config NRF_PROVISIONING_CBOR_RECORDS
	int "Maximum number of CBOR records that can be encoded or decoded at a time"
	default 10

endif
```

## subsys/net/lib/nrf_provisioning/Kconfig.nrf_provisioning_coap
```kconfig
# Copyright (c) 2023 Nordic Semiconductor
#
# SPDX-License-Identifier: LicenseRef-Nordic-5-Clause
#

menuconfig NRF_PROVISIONING_COAP
	bool "nRF Provisioning COAP"
	imply COAP
	imply COAP_CLIENT

if NRF_PROVISIONING_COAP

config NRF_PROVISIONING_COAP_HOSTNAME
	string "nRF Provisioning COAP API hostname"
	default "coap.nrfcloud.com"

config NRF_PROVISIONING_COAP_PORT
	string "Provision Service's port"
	default "5684"

config NRF_PROVISIONING_COAP_DTLS_SESSION_CACHE
	bool "DTLS session cache usage"
	default y

config NRF_PROVISIONING_COAP_TIMEOUT_SECONDS
	int "CoAP request timeout in seconds"
	default 30
	help
	  Timeout waiting for CoAP requests

rsource "Kconfig.nrf_provisioning_codec"

endif
```
