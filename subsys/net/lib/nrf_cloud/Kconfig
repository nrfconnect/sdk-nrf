## subsys/net/lib/nrf_provisioning/Kconfig.nrf_provisioning_codec
```kconfig
#
# Copyright (c) 2023 Nordic Semiconductor
#
# SPDX-License-Identifier: LicenseRef-Nordic-5-Clause
#
menuconfig NRF_PROVISIONING_CODEC
	bool "nRF Provisioning codec"
	select EXPERIMENTAL
	imply NRF_MODEM_LIB
	imply NRF_PROVISIONING_AT

if NRF_PROVISIONING_CODEC

config NRF_PROVISIONING_CODEC_AT_CMD_LEN
	int "AT command maximum length"
	default 1792

config NRF_PROVISIONING_CODEC_RX_SZ_START
	int "Default RX buff size, increased automatically up to 4K if necessary"
	range 64 4096
	default 512

rsource "Kconfig.nrf_provisioning_cbor"

endif
```

## subsys/net/lib/nrf_provisioning/Kconfig.nrf_provisioning_http
```kconfig
#
# Copyright (c) 2023 Nordic Semiconductor
#
# SPDX-License-Identifier: LicenseRef-Nordic-5-Clause
#

menuconfig NRF_PROVISIONING_HTTP
	bool "nRF Provisioning HTTP"
	select EXPERIMENTAL
	imply REST_CLIENT

if NRF_PROVISIONING_HTTP

config NRF_PROVISIONING_HTTP_HOSTNAME
	string "nRF Provisioning HTTP API hostname"
	default "provisioning-http.nrfcloud.com"

config NRF_PROVISIONING_HTTP_PORT
	int "Provision Service's port"
	default 443

config NRF_PROVISIONING_HTTP_TIMEOUT_MS
	int "Provision Service's timeout for HTTP connection"
	default 30000

rsource "Kconfig.nrf_provisioning_codec"

endif
```

## subsys/net/lib/nrf_provisioning/Kconfig.nrf_provisioning_jwt
```kconfig
#
# Copyright (c) 2023 Nordic Semiconductor
#
# SPDX-License-Identifier: LicenseRef-Nordic-5-Clause
#

menuconfig NRF_PROVISIONING_JWT
	bool "nRF Provisioning authentication bearer JWT"
	select EXPERIMENTAL
	imply MODEM_JWT
	imply NRF_PROVISIONING_AT

if NRF_PROVISIONING_JWT

config NRF_PROVISIONING_JWT_SEC_TAG
	int "Provision Service's security tag, private Device Identity key used by default"
	default 0

config NRF_PROVISIONING_JWT_MAX_VALID_TIME_S
	int "Maximum JWT valid lifetime (seconds)"
	range 0 604800
	default 300

endif
```

## subsys/net/lib/rest_client/Kconfig
```kconfig
# Copyright (c) 2021 Nordic Semiconductor
#
# SPDX-License-Identifier: LicenseRef-Nordic-5-Clause
#

menuconfig REST_CLIENT
	bool "REST client library"
	select HTTP_CLIENT

if REST_CLIENT

config REST_CLIENT_REQUEST_TIMEOUT
	int "REST request timeout, in seconds"
	default 60
	help
	  Sets the default timeout duration in seconds to wait for socket connection
	  creation and data transfer. The timeout is set individually for these phases
	  meaning REST request can take longer than this given timeout.
	  To disable, set the timeout duration to 0.

config REST_CLIENT_SCKT_TLS_SESSION_CACHE_IN_USE
	bool "TLS session cache usage"
	default y
	help
	  TLS session cache, disable or enable.

module=REST_CLIENT
module-dep=LOG
module-str=Log level for REST Client lib
module-help=Enables REST Client log messages.
source "${ZEPHYR_BASE}/subsys/logging/Kconfig.template.log_config"

endif # REST_CLIENT
```

## subsys/net/lib/softap_wifi_provision/Kconfig
```kconfig
#
# Copyright (c) 2024 Nordic Semiconductor ASA
#
# SPDX-License-Identifier: LicenseRef-Nordic-5-Clause
#

menuconfig SOFTAP_WIFI_PROVISION
	bool "SoftAP Wi-Fi provision library [EXPERIMENTAL]"
	select EXPERIMENTAL
	depends on NANOPB
	depends on NRF70_AP_MODE
	depends on WIFI_NM_WPA_SUPPLICANT_AP
	depends on SMF
	depends on NET_DHCPV4_SERVER
	depends on TLS_CREDENTIALS
	depends on WIFI_CREDENTIALS
	depends on HTTP_PARSER
	depends on HTTP_PARSER_URL
	depends on NET_SOCKETS_SOCKOPT_TLS
	depends on !NET_CONFIG_AUTO_INIT
	depends on !NET_CONFIG_SETTINGS

if SOFTAP_WIFI_PROVISION

config SOFTAP_WIFI_PROVISION_SERVER_CERTIFICATE_REGISTER
	bool "Register server certificate"
	default y
	help
	  If this option is enabled, a self-signed server certificate
	  will be registered to TLS credentials storage when provisioning starts.

config SOFTAP_WIFI_PROVISION_SERVER_CERTIFICATES_FOLDER
	string "Server certificate folder"
	depends on SOFTAP_WIFI_PROVISION_SERVER_CERTIFICATE_REGISTER
	default "certs"
	help
	  The default path for the folder that contains the server certificate,
	  relative to the application source directory.
	  By default, the library expects the credentials to be in
	  Privacy Enhanced Mail (PEM) format.

config SOFTAP_WIFI_PROVISION_RESPONSE_BUFFER_SIZE
	int "Response buffer size"
	default 512

config SOFTAP_WIFI_PROVISION_TCP_RECV_BUF_SIZE
	int "TCP receive buffer size"
	default 256

config SOFTAP_WIFI_PROVISION_SCAN_RESULT_BUFFER_SIZE
	int "Scan result buffer size"
	default 512

config SOFTAP_WIFI_PROVISION_THREAD_STACK_SIZE
	int "Thread stack size"
	default 4096

config SOFTAP_WIFI_PROVISION_URL_MAX_SIZE
	int "URL max size"
	default 32

config SOFTAP_WIFI_PROVISION_BODY_MAX_SIZE
	int "HTTP body max size"
	default 256

config SOFTAP_WIFI_PROVISION_SSID
	string "SSID"
	default "nrf-wifiprov"
	help
	  The default SSID of the Wi-Fi network that the device will broadcast in softAP mode.

config SOFTAP_WIFI_PROVISION_SOCKET_CLOSE_ON_COMPLETION
	bool "Close socket on completion"
	default y
	help
	  If this option is disabled, the socket will be kept open after provisioning has completed.
	  This will keep mDNS SD running, allowing the device to be discovered by other devices
	  on the registered hostname.

config SOFTAP_WIFI_PROVISION_CERTIFICATE_SEC_TAG
	int "TLS credentials storage security tag"
	default 88

config SOFTAP_WIFI_PROVISION_TCP_PORT
	int "TCP port number"
	default 443

config SOFTAP_WIFI_PROVISION_IPV4_ADDRESS
	string "IPv4 address"
	default "192.168.0.1"
	help
	  Network interface static IPv4 address. DHCPv4 will assign addresses starting from
	  this address to connecting DHCPv4 clients.

config SOFTAP_WIFI_PROVISION_IPV4_NETMASK
	string "IPv4 address"
	default "255.255.255.0"

config SOFTAP_WIFI_PROVISION_MESSAGE_QUEUE_ENTRIES
	int "Message queue entries"
	default 5

module = SOFTAP_WIFI_PROVISION
module-str = SoftAP Wi-Fi provision
source "${ZEPHYR_BASE}/subsys/logging/Kconfig.template.log_config"

endif # SOFTAP_WIFI_PROVISION
```
