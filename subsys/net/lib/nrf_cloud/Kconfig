## subsys/net/lib/nrf_cloud/Kconfig.nrf_cloud_coap
```kconfig
# Copyright (c) 2023 Nordic Semiconductor
#
# SPDX-License-Identifier: LicenseRef-Nordic-5-Clause
#

menuconfig NRF_CLOUD_COAP
	bool "nRF Cloud COAP"
	select CJSON_LIB
	select ZCBOR
	select COAP
	select COAP_EXTENDED_OPTIONS_LEN
	select COAP_CLIENT
	select EXPERIMENTAL
	select LTE_PROPRIETARY_PSM_REQ if (SOC_NRF9161_LACA || SOC_NRF9151_LACA || SOC_NRF9131_LACA)

if NRF_CLOUD_COAP

config NRF_CLOUD_COAP_SERVER_HOSTNAME
	string "CoAP server hostname"
	default "coap.nrfcloud.com"

config NRF_CLOUD_COAP_SEC_TAG
	int "Security tag for credentials"
	default NRF_CLOUD_SEC_TAG

config NRF_CLOUD_COAP_SERVER_PORT
	int "CoAP server port"
	default 5684

config NRF_CLOUD_COAP_KEEPOPEN
	bool "Enable SO_KEEPOPEN to prevent unnecessary socket closures"
	default y
	depends on SOC_NRF9161_LACA || SOC_NRF9151_LACA || SOC_NRF9131_LACA
	help
	  Improve benefit from using DTLS Connection ID by keeping the socket
	  open when temporary LTE PDN connection loss occurs.

if WIFI

config NRF_CLOUD_COAP_SEND_SSIDS
	bool "Include access point SSIDs with scan results"
	default n
	help
	  The nRF Cloud Wi-Fi location service does not require the human-
	  readable SSIDs in order to determine the device location. It does
	  require the access point MAC addresses. By not including SSIDs
	  the amount of data sent to the cloud is greatly reduced.

endif # WIFI

config NRF_CLOUD_COAP_DOWNLOADS
	bool "Download files using CoAP instead of HTTP"
	depends on NRF_CLOUD_COAP
	select EXPERIMENTAL
	help
	  Use nRF Cloud CoAP's proxy download resource to download files for FOTA and P-GPS.
	  When enabled, the Kconfig option COAP_EXTENDED_OPTIONS_LEN_VALUE must be increased
	  from the default value. Safe values are 80 for P-GPS and 192 for FOTA.

module = NRF_CLOUD_COAP
module-str = nRF Cloud COAP
source "subsys/logging/Kconfig.template.log_config"

endif # NRF_CLOUD_COAP
```

## subsys/net/lib/nrf_cloud/Kconfig.nrf_cloud_fota
```kconfig
# Copyright (c) 2021 Nordic Semiconductor
#
# SPDX-License-Identifier: LicenseRef-Nordic-5-Clause
#

menuconfig NRF_CLOUD_FOTA
	bool "Enable nRF Cloud MQTT FOTA library"
	select FOTA_DOWNLOAD
	select FOTA_DOWNLOAD_PROGRESS_EVT
	select DFU_TARGET
	select DOWNLOAD_CLIENT
	select REBOOT
	select CJSON_LIB
	select SETTINGS
	default y if NRF_CLOUD_MQTT

if NRF_CLOUD_FOTA
config NRF_CLOUD_FOTA_AUTO_START_JOB
	bool "Start FOTA job automatically"
	default y
	help
	  When enabled, the FOTA update job is started immediately upon receipt
	  of the job information from nRF Cloud.
	  When disabled, the application is responsible for starting the job.

config NRF_CLOUD_FOTA_PROGRESS_PCT_INCREMENT
	int "Percentage increment at which FOTA download progress is reported"
	range 0 100
	default 10
	help
	  0 disables progress report.

config NRF_CLOUD_FOTA_DOWNLOAD_FRAGMENT_SIZE
	int "Fragment size for FOTA downloads"
	range 128 1700
	default 1700

config NRF_CLOUD_FOTA_BLE_DEVICES
	bool "Enable API for FOTA of BLE devices"
	depends on BT

module = NRF_CLOUD_FOTA
module-str = nRF Cloud FOTA
source "subsys/logging/Kconfig.template.log_config"

endif # NRF_CLOUD_FOTA

config FOTA_USE_NRF_CLOUD_SETTINGS_AREA
	bool "Use the same settings area as the nRF Cloud FOTA library"
	default y
	help
	  Using the same settings area as the nRF Cloud FOTA library will
	  allow this sample to perform application-FOTA updates to applications
	  built with CONFIG_NRF_CLOUD_FOTA enabled.

config FOTA_SETTINGS_NAME
	depends on !FOTA_USE_NRF_CLOUD_SETTINGS_AREA
	string "Settings identifier for the FOTA support library"
	default "nrf_cloud_fota_poll"
	help
	  The root settings identifier for this application.
	  For application-FOTA, this value should also be found in your target application
	  so that the FOTA status can be properly reported to nRF Cloud.

config FOTA_SETTINGS_KEY_PENDING_JOB
	depends on !FOTA_USE_NRF_CLOUD_SETTINGS_AREA
	string "Settings item key for pending FOTA job info"
	default "pending_job"
	help
	  The settings item key where pending FOTA job info will be stored.
	  For application-FOTA, this value should also be found in your target application
	  so that the FOTA status can be properly reported to nRF Cloud.

config FOTA_DL_TIMEOUT_MIN
	int "The time (minutes) allotted for a FOTA download to complete"
	default REST_FOTA_DL_TIMEOUT_MIN if NRF_CLOUD_REST
	default 15
	help
	  If the FOTA download does not complete in the allotted time,
	  the download will be cancelled and the job status will be
	  set as failed.

if NRF_CLOUD_REST

config REST_FOTA_DL_TIMEOUT_MIN
	int "The time (minutes) allotted for a FOTA download to complete"
	default 30

endif # NRF_CLOUD_REST

menuconfig NRF_CLOUD_FOTA_FULL_MODEM_UPDATE
	bool "Enable full modem FOTA updates"
	select NRF_MODEM_LIB
	select ZCBOR
	select DFU_TARGET
	select DFU_TARGET_FULL_MODEM
	select DFU_TARGET_STREAM
	select STREAM_FLASH_ERASE
	select STREAM_FLASH
	select FLASH
	select MBEDTLS_SHA256_C
	select FMFU_FDEV
	select OBERON_BACKEND
	select NORDIC_SECURITY_BACKEND
	default n
	help
	  Requires flash device of at least 4MB.

if NRF_CLOUD_FOTA_FULL_MODEM_UPDATE
config NRF_CLOUD_FOTA_FULL_MODEM_UPDATE_BUF_SIZE
	int "Size of buffer used for stream flash writing full modem updates"
	range 512 4096
	default 4096
endif # NRF_CLOUD_FOTA_FULL_MODEM_UPDATE

config NRF_CLOUD_FOTA_POLL
	bool "Enable FOTA job polling helpers"
	help
	  When enabled, nRF Cloud FOTA job polling helpers will be built.  These
	  functions make it easy to request, download, and handle modem, boot,
	  and application FOTA updates when using the REST or CoAP interfaces
	  to nRF Cloud.

if NRF_CLOUD_FOTA_POLL

module = NRF_CLOUD_FOTA_POLL
module-str = nRF Cloud FOTA Poll
source "subsys/logging/Kconfig.template.log_config"

endif # NRF_CLOUD_FOTA_POLL
```

## subsys/net/lib/nrf_cloud/Kconfig.nrf_cloud_location
```kconfig
# Copyright (c) 2022 Nordic Semiconductor
#
# SPDX-License-Identifier: LicenseRef-Nordic-5-Clause
#

menu "Location"

menu "Cellular/Wi-Fi"

config NRF_CLOUD_LOCATION
	bool "Enable nRF Cloud Location (cellular and/or Wi-Fi) over MQTT"
	imply FPU
	depends on NRF_CLOUD_MQTT
	select CJSON_LIB

config NRF_CLOUD_LOCATION_ANCHOR_LIST
	bool "Include the list of anchor names when receiving location results from the callback"
	depends on NRF_CLOUD_LOCATION
	depends on WIFI
	select NRF_CLOUD_LOCATION_PARSE_ANCHORS

config NRF_CLOUD_LOCATION_ANCHOR_LIST_BUFFER_SIZE
	int "Size of the buffer to contain the anchor name list"
	depends on NRF_CLOUD_LOCATION_ANCHOR_LIST
	default 185
	help
	  The maximum length of an anchor name is 32 characters.
	  Anchor names are returned to the user in a singly-linked list,
	  which requires 37 bytes for each anchor name on a 32-bit system.

config NRF_CLOUD_LOCATION_PARSE_ANCHORS
	bool "Parse anchor data in location result"
	help
	  If enabled, the anchor buffer in the result structure must be properly initialized.

choice NRF_CLOUD_WIFI_LOCATION_ENCODE_OPT
	prompt "Encoding options for Wi-Fi location requests"
	default NRF_CLOUD_WIFI_LOCATION_ENCODE_OPT_MAC_RSSI

config NRF_CLOUD_WIFI_LOCATION_ENCODE_OPT_MAC_ONLY
	bool "Encode only the MAC address"
	help
	  The MAC address is the only required parameter.

config NRF_CLOUD_WIFI_LOCATION_ENCODE_OPT_MAC_RSSI
	bool "Encode the MAC address and the RSSI value"
	help
	  The RSSI value may improve location accuracy.

config NRF_CLOUD_WIFI_LOCATION_ENCODE_OPT_ALL
	bool "Encode all available parameters"
	help
		This option increases the memory required for creating requests.
		It also increases the amount of data sent to nRF Cloud.
endchoice

endmenu

rsource "Kconfig.nrf_cloud_agnss"

rsource "Kconfig.nrf_cloud_pgps"

if NRF_CLOUD_AGNSS || NRF_CLOUD_PGPS

module = NRF_CLOUD_GPS
module-str = nRF Cloud GPS Assistance
source "subsys/logging/Kconfig.template.log_config"

endif

endmenu
```

## subsys/net/lib/nrf_cloud/Kconfig.nrf_cloud_log
```kconfig
# Copyright (c) 2023 Nordic Semiconductor
#
# SPDX-License-Identifier: LicenseRef-Nordic-5-Clause
#

config NRF_CLOUD_LOG_DIRECT
	bool "nRF Cloud direct logging"
	default y
	depends on NRF_CLOUD_MQTT || NRF_CLOUD_REST || NRF_CLOUD_COAP
	select CBPRINTF_LIBC_SUBSTS if !NRF_CLOUD_LOG_BACKEND
	help
	  Enable direct log message transfer to the cloud. If
	  NRF_CLOUD_LOG_BACKEND is enabled, these messages will be
	  routed there, where buffering will occur. Otherwise, they will
	  be sent directly to the cloud, with the assumption that a valid
	  network connection is available.

menuconfig NRF_CLOUD_LOG_BACKEND
	bool "nRF Cloud logging system"
	depends on NRF_CLOUD_MQTT || NRF_CLOUD_REST
	depends on LOG_MODE_DEFERRED
	depends on !LOG_MODE_MINIMAL
	select RING_BUFFER
	help
	  If set, send Zephyr logging messages to the cloud. Log level
	  can be controlled from the cloud via the AWS shadow.

if NRF_CLOUD_LOG_BACKEND

config NRF_CLOUD_LOG_SEQ_ALWAYS
	bool "Always include the sequence number in log messages"
	default y
	help
	  If set, send the seq field regardless of whether the ts field
	  is set.  If not set, only send the seq field when ts is not
	  available.

config NRF_CLOUD_LOG_RING_BUF_SIZE
	int "Size of buffer for log output before network transfer"
	default 2048
	help
	  Set size in bytes for buffer for log output system to combine log
	  messages before it uploads to nRF Cloud.

backend = NRF_CLOUD
backend-str = nrf_cloud
source "subsys/logging/Kconfig.template.log_format_config"

endif # NRF_CLOUD_LOG_BACKEND

config NRF_CLOUD_LOG_OUTPUT_LEVEL
	int "Only log entries less than or equal to this will be sent"
	range 0 4
	default 1
	help
	  Set overall log level for nRF Cloud logging. Set to 0 to
	  disable. Applies to both NRF_CLOUD_LOG_BACKEND and NRF_CLOUD_LOG_DIRECT.
	  Log messages with a log level larger than this will be ignored.
	  Can be overridden at runtime from the cloud.

config NRF_CLOUD_LOG_BUF_SIZE
	int "Number of bytes to buffer in RAM before flushing"
	default 256
	help
	  Set size in bytes for buffer for log output system before it flushes.

module = NRF_CLOUD_LOG
module-str = nRF Cloud Log
source "subsys/logging/Kconfig.template.log_config"
```

## subsys/net/lib/nrf_cloud/Kconfig.nrf_cloud_mqtt
```kconfig
# Copyright (c) 2021 Nordic Semiconductor
#
# SPDX-License-Identifier: LicenseRef-Nordic-5-Clause
#

module = NRF_CLOUD_MQTT
module-prompt = "nRF Cloud MQTT library"
orsource "../Kconfig.cloud_$(CLOUD_SERVICE_SELECTOR)"

menuconfig $(module)
	bool
	prompt "nRF Cloud MQTT Library" if !CLOUD_SERVICE_MUTUAL_EXCLUSIVE
	select MQTT_LIB
	select MQTT_LIB_TLS
	select SETTINGS if !MQTT_CLEAN_SESSION
	select CJSON_LIB

if NRF_CLOUD_MQTT

config NRF_CLOUD_STATIC_IPV4
	bool "Enable use of static IPv4"
	default n

config NRF_CLOUD_STATIC_IPV4_ADDR
	string "Static IPv4 address"
	depends on NRF_CLOUD_STATIC_IPV4
	default "192.168.2.2"

config NRF_CLOUD_PORT
	int "nRF Cloud server port"
	default 8883

config NRF_CLOUD_IPV6
	bool "Configure nRF Cloud library to use IPv6 addressing. Otherwise IPv4 is used"

choice NRF_CLOUD_SEND_SOCKET
	prompt "Socket behavior when sending"
	default NRF_CLOUD_SEND_BLOCKING

config NRF_CLOUD_SEND_BLOCKING
	bool "Send data using blocking socket"
	help
	  Send data using a blocking socket. Selecting this option will make call to
	  send data block until the data is processed by the network stack.

config NRF_CLOUD_SEND_NONBLOCKING
	bool "Send data using non-blocking socket"
	help
	  When using a blocking socket, the application can in certain situations
	  fail and hang indefinitely if a watchdog timer is not used.
	  Using a non-blocking socket for data transfers can help avoid getting
	  into such a situation, at the cost of failing in situations where
	  a short period of blocking would have sent the data.

config NRF_CLOUD_SEND_TIMEOUT
	bool "Send data with socket timeout"
	help
	  Configures a timeout on the nRF Cloud socket to ensure that a call to
	  te send function will not block indefinitely.
	  To configure the length of the timeout, use NRF_CLOUD_SEND_TIMEOUT_SEC.

endchoice

config NRF_CLOUD_SEND_TIMEOUT_SEC
	int "Send timeout"
	default 60
	help
	  Timeout in seconds to use when the nRF Cloud socket is configured to
	  send with a timeout by enabling NRF_CLOUD_SEND_TIMEOUT.

config NRF_CLOUD_MQTT_MESSAGE_BUFFER_LEN
	int "Size of the buffer for MQTT library"
	default 256
	help
	  Specifies maximum message size can be transmitted/received through
	  MQTT (exluding MQTT PUBLISH payload).

config NRF_CLOUD_MQTT_PAYLOAD_BUFFER_LEN
	int "Size of the buffer for MQTT PUBLISH payload"
	default 2144 if NRF_CLOUD_AGNSS
	default 2048

config NRF_CLOUD_CONNECTION_POLL_THREAD
	bool "Poll cloud connection in a separate thread"
	default y


if NRF_CLOUD_CONNECTION_POLL_THREAD

config NRF_CLOUD_CONNECTION_POLL_THREAD_STACK_SIZE
	int "Stack size for nRF Cloud connection poll thread."
	default 4096 if BOARD_QEMU_X86
	default 3072

endif

config NRF_CLOUD_MQTT_KEEPALIVE
	int "Maximum number of keep alive time for MQTT (in seconds)"
	default 1200
	help
	  Keep alive time for MQTT connection to nRF Cloud, in seconds. This option overwrites
	  the CONFIG_MQTT_KEEPALIVE value. Default is set to the maximum specified MQTT keepalive
	  for nRF Cloud.

endif # NRF_CLOUD_MQTT
```
