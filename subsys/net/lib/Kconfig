## subsys/net/lib/lwm2m_client_utils/Kconfig
```kconfig
#
# Copyright (c) 2021 Nordic Semiconductor
#
# SPDX-License-Identifier: LicenseRef-Nordic-5-Clause
#

menuconfig LWM2M_CLIENT_UTILS
	bool "LWM2M client utilities library"
	select LWM2M if !ZTEST

if LWM2M_CLIENT_UTILS

config LWM2M_CLIENT_UTILS_DEVICE_OBJ_SUPPORT
	bool "Device object support"
	default y

config LWM2M_CLIENT_UTILS_SECURITY_OBJ_SUPPORT
	bool "Security object support"
	default y

if LWM2M_CLIENT_UTILS_SECURITY_OBJ_SUPPORT

config LWM2M_CLIENT_UTILS_SERVER
	string "LwM2M server address"
	help
	  Choose the LwM2M server you wish to connect to. Address must be full URI containing
	  protocol and port numbers, unless it is same as CONFIG_LWM2M_PEER_PORT.
	  For example "coaps://server.example.com:5684".
	  Protocol must be "coap" when no security is used, or "coaps" when DTLS is used.

config LWM2M_CLIENT_UTILS_SERVER_TLS_TAG
	int "LwM2M server TLS tag"
	default 35724861
	help
	  This security tag is used when connecting to LwM2M server.
	  Client utilities will overwrite credentials of this security tag if bootstrap
	  server writes new keys for device.

config LWM2M_CLIENT_UTILS_BOOTSTRAP_TLS_TAG
	int "LwM2M bootstrap server TLS tag"
	default 35724862
	help
	  This security tag is used when connecting to LwM2M Bootstrap server.
	  Credentials could be provisioned to the modem for this security tag or application
	  may write credentials into first LwM2M security instance "0/0/5".
	  Client utilities only write to this security tag if it is empty.

endif # LWM2M_CLIENT_UTILS_SECURITY_OBJ_SUPPORT

config LWM2M_CLIENT_UTILS_CONN_MON_OBJ_SUPPORT
	bool "Connection Monitor object support"
	default y
	select LWM2M_CONN_MON_OBJ_SUPPORT if !ZTEST

if LWM2M_CLIENT_UTILS_CONN_MON_OBJ_SUPPORT

config LWM2M_CONN_MON_BEARER_MAX
	int "Max number of bearers"
	default 2

config LWM2M_CONN_HOLD_TIME_RSRP
	int "Minimum time [s] between RSRP notification messages"
	default 60
	help
	  The minimum time in seconds that notifications can be sent to observers of the
	  Connectivity Monitoring data.

endif # LWM2M_CLIENT_UTILS_CONN_MON_OBJ_SUPPORT

config LWM2M_CLIENT_UTILS_LOCATION_OBJ_SUPPORT
	bool "Location object support"
	default y
	select LWM2M_LOCATION_OBJ_SUPPORT

config LWM2M_CLIENT_UTILS_FIRMWARE_UPDATE_OBJ_SUPPORT
	bool "Firmware Update object support"
	default y
	select LWM2M_FIRMWARE_UPDATE_OBJ_SUPPORT if (!LWM2M_CLIENT_UTILS_ADV_FIRMWARE_UPDATE_OBJ_SUPPORT && !ZTEST)
	select DFU_TARGET
	select BOOTLOADER_MCUBOOT if !ZTEST
	select IMG_MANAGER if !ZTEST
	select IMG_ERASE_PROGRESSIVELY if !ZTEST
	select FLASH if !ZTEST
	select MPU_ALLOW_FLASH_WRITE if !ZTEST
	select FOTA_DOWNLOAD_PROGRESS_EVT if FOTA_DOWNLOAD

if LWM2M_CLIENT_UTILS_FIRMWARE_UPDATE_OBJ_SUPPORT

config LWM2M_CLIENT_UTILS_DOWNLOADER_SEC_TAG
	int "Security tag for FOTA download library"
	default 16842753
	help
	  This security tag is used when firmware image is fetch from
	  https:// or coaps:// URI. It has no effect on usage of http:// or coap://
	  -1 disables the usage of security tag.

config LWM2M_CLIENT_UTILS_FIRMWARE_UPDATE_THREAD_STACK_SIZE
	int "FOTA thread stack size"
	default 2048

endif # LWM2M_CLIENT_UTILS_FIRMWARE_UPDATE_OBJ_SUPPORT

config LWM2M_CLIENT_UTILS_ADV_FIRMWARE_UPDATE_OBJ_SUPPORT
	bool "Advanced Firmware Update object support (EXPERIMENTAL)"
	default n
	select EXPERIMENTAL
	help
	  This is a non standard Advanced Firmware Update object which is still
	  under development. Server support might be lacking and the implementation
	  might not match latest specification from OMA working group.

if LWM2M_CLIENT_UTILS_ADV_FIRMWARE_UPDATE_OBJ_SUPPORT

config LWM2M_CLIENT_UTILS_ADV_FOTA_INSTANCE_COUNT
	int "Firmware object instance count"
	default 3 if DFU_TARGET_SMP
	default 2
	help
	  Number of supported instances for Advanced Firmware object.

endif # LWM2M_CLIENT_UTILS_ADV_FIRMWARE_UPDATE_OBJ_SUPPORT

config LWM2M_CLIENT_UTILS_GROUND_FIX_OBJ_SUPPORT
	bool "Support ground fix object"
	select EXPERIMENTAL
	select LWM2M_CLIENT_UTILS_LOCATION_ASSISTANCE

config LWM2M_CLIENT_UTILS_GNSS_ASSIST_OBJ_SUPPORT
	bool "Support GNSS assistance obj"
	select EXPERIMENTAL
	select LWM2M_CLIENT_UTILS_LOCATION_ASSISTANCE

config LWM2M_CLIENT_UTILS_LOCATION_ASSISTANCE
	bool

if LWM2M_CLIENT_UTILS_LOCATION_ASSISTANCE

config LWM2M_CLIENT_UTILS_LOCATION_ASSIST_CELL
	bool "Use location based on current cell and possibly neighboring cells"
	imply LWM2M_CLIENT_UTILS_SIGNAL_MEAS_INFO_OBJ_SUPPORT
	help
	  Information of current cell and neighboring cells are sent to lwm2m server to
	  obtain coarse location.

config LWM2M_CLIENT_UTILS_LOCATION_ASSIST_AGPS
	bool "Use location based on A-GPS"
	help
	  A-GPS assistance data is requested from lwm2m server and fed to the GNSS module
	  after the data has been received.

config LWM2M_CLIENT_UTILS_LOCATION_ASSIST_PGPS
	bool "Use location based on P-GPS"
	help
	  P-GPS assistance data is requested from lwm2m server and fed to the GNSS module
	  after the data has been received.

config LWM2M_CLIENT_UTILS_LOCATION_ASSIST_PGPS_PREDICTION_COUNT
	int "Number of predictions to be requested"
	default 42
	range 1 168
	depends on LWM2M_CLIENT_UTILS_LOCATION_ASSIST_PGPS
	help
	  Default values give 6 predictions per day for a week. Depends on the starting day
	  and the prediction interval.

config LWM2M_CLIENT_UTILS_LOCATION_ASSIST_PGPS_PREDICTION_INTERVAL
	int "Interval between predictions in minutes"
	default 240
	range 120 480
	depends on LWM2M_CLIENT_UTILS_LOCATION_ASSIST_PGPS
	help
	  By default, 240 (4 hours) is used. Valid values are: 120, 240, 360, 480

config LWM2M_CLIENT_UTILS_LOCATION_ASSIST_PGPS_STARTING_DAY
	int "Starting day of the predictions as GPS day"
	default 0
	depends on LWM2M_CLIENT_UTILS_LOCATION_ASSIST_PGPS
	help
	  Do not override if you are not sure about the date. By default, the value
	  is not provided to the server and the current GPS day is used.

config LWM2M_CLIENT_UTILS_LOCATION_ASSIST_PGPS_STARTING_TIME
	int "Starting time of the day of predictions"
	default 0
	range 0 86399
	depends on LWM2M_CLIENT_UTILS_LOCATION_ASSIST_PGPS
	help
	  The starting time of the predictions.

config LWM2M_CLIENT_UTILS_LOCATION_ASSIST_AGPS_BUF_SIZE
	int "Size of the buffer for storing the assistance data coming from server"
	depends on LWM2M_CLIENT_UTILS_LOCATION_ASSIST_AGPS
	default 4096

config LWM2M_CLIENT_UTILS_LOCATION_ASSIST_AGPS_ELEVATION_MASK
	int "Minimum elevation angle for visible satellites."
	depends on LWM2M_CLIENT_UTILS_LOCATION_ASSIST_AGPS
	default -1
	help
	  Minimum elevation angle for visible satellites. The range is 0...90.
	  Set -1 to disabled. Disabled by default.

config LWM2M_CLIENT_UTILS_SIGNAL_MEAS_INFO_OBJ_SUPPORT
	bool "Signal measurement information object support (ID 10256)"
	help
	  This object is used in combination with Connectivity Monitor object (ID 4)
	  and provides information about neighbouring cells. It is used to assist
	  with the device location services.

config LWM2M_CLIENT_UTILS_VISIBLE_WIFI_AP_OBJ_SUPPORT
	bool "Visible Wi-Fi AP object support (ID 33627)"
	help
	  This object is used in combination with Ground Fix object (ID 33626)
	  and provides information about nearby Wi-Fi access points. It is used to
	  assist with the device location services.

config LWM2M_CLIENT_UTILS_SIGNAL_MEAS_INFO_INSTANCE_COUNT
	int "Maximum # of signal measurement objects"
	default 3
	depends on LWM2M_CLIENT_UTILS_SIGNAL_MEAS_INFO_OBJ_SUPPORT

config LWM2M_CLIENT_UTILS_NEIGHBOUR_CELL_LISTENER
	bool "Use a listener to populate signal measurement objects"
	depends on LWM2M_CLIENT_UTILS_SIGNAL_MEAS_INFO_OBJ_SUPPORT

config LWM2M_CLIENT_UTILS_VISIBLE_WIFI_AP_INSTANCE_COUNT
	int "Maximum # of visible Wi-Fi access point objects"
	default 5
	depends on LWM2M_CLIENT_UTILS_VISIBLE_WIFI_AP_OBJ_SUPPORT

config LWM2M_CLIENT_UTILS_WIFI_AP_SCANNER
	bool "Use a scanner to populate visible Wi-Fi AP objects"
	depends on LWM2M_CLIENT_UTILS_VISIBLE_WIFI_AP_OBJ_SUPPORT

endif # LWM2M_CLIENT_UTILS_LOCATION_ASSISTANCE

config LWM2M_CLIENT_UTILS_CELL_CONN_OBJ_SUPPORT
	bool "Support for cellular connectivity object (ID 10)"

if LWM2M_CLIENT_UTILS_CELL_CONN_OBJ_SUPPORT

config LWM2M_CELL_CONN_OBJ_VERSION_1_1
	bool "Use cellular connectivity object version 1.1"
	default y

config LWM2M_CELL_CONN_APN_PROFILE_COUNT
	int "Maximum number of APN connection profiles"
	default 3

endif #LWM2M_CLIENT_UTILS_CELL_CONN_OBJ_SUPPORT

config LWM2M_CLIENT_UTILS_RAI
	bool "Enable release assistance indication (RAI)"
	help
	  This option enables RAI for access stratum (AS) which was introduced in REL14.
	  When AS RAI is configured, device may indicate that no further data is
	  expected in the near future and the connection may be released.

config LWM2M_CLIENT_UTILS_LTE_CONNEVAL
	bool "Enable connection pre-evaluation [EXPERIMENTAL]"
	select EXPERIMENTAL
	help
	  Connection pre-evaluation allows the application to get an estimation of the
	  energy efficiency in a cell that the modem would use for data transmission.
	  The information is used to determine when the actual data transmission is
	  started.

config LWM2M_CLIENT_UTILS_DTLS_CID
	bool "Enable DTLS Connection Identifier"
	help
	  Enable DTLS connection Identifier negitiation.
	  Requires either LWM2M_RD_CLIENT_STOP_POLLING_AT_IDLE or LWM2M_RD_CLIENT_LISTEN_AT_IDLE to be useful.
	  This requires modem firmware v1.3.5 or newer.

if LWM2M_CLIENT_UTILS_DTLS_CID

config LWM2M_CLIENT_UTILS_DTLS_CON_MANAGEMENT
	bool "Enable DTLS connection save and load"
	depends on LWM2M_RD_CLIENT_STOP_POLLING_AT_IDLE
	help
	  Enable DTLS connection identifier save at idle and load exit from idle.
	  This requires modem firmware v1.3.5 or newer.

endif #LWM2M_CLIENT_UTILS_DTLS_CID

module = LWM2M_CLIENT_UTILS
module-dep = LOG
module-str = LwM2M client utilities library
source "${ZEPHYR_BASE}/subsys/logging/Kconfig.template.log_config"

endif # LWM2M_CLIENT_UTILS
```

## subsys/net/lib/mcumgr_smp_client/Kconfig
```kconfig
#
# Copyright (c) 2023 Nordic Semiconductor
#
# SPDX-License-Identifier: LicenseRef-Nordic-5-Clause
#

menuconfig NRF_MCUMGR_SMP_CLIENT
	bool "MCUMGR SMP client library"
	select BASE64
	select DFU_TARGET
	select DFU_TARGET_SMP
	select DOWNLOAD_CLIENT
	select FOTA_DOWNLOAD
	select NET_BUF
	select ZCBOR
	select CRC
	select MCUMGR
	select SMP_CLIENT
	select MCUMGR_GRP_IMG_CLIENT
	select MCUMGR_GRP_OS_CLIENT
	select MCUMGR_GRP_OS_CLIENT_ECHO
	select MCUMGR_GRP_OS_CLIENT_RESET

if NRF_MCUMGR_SMP_CLIENT

config NRF_MCUMGR_SMP_CLIENT_SHELL
	bool "MCUmg SMP client shell"
	depends on SHELL

module = NRF_MCUMGR_SMP_CLIENT
module-dep = LOG
module-str = NRF_MCUmgr_smp_client
source "${ZEPHYR_BASE}/subsys/logging/Kconfig.template.log_config"

endif # NRF_MCUMGR_SMP_CLIENT
```

## subsys/net/lib/mqtt_helper/Kconfig
```kconfig
# Copyright (c) 2023 Nordic Semiconductor
#
# SPDX-License-Identifier: LicenseRef-Nordic-5-Clause
#

menuconfig MQTT_HELPER
	bool "MQTT helper library"
	select NET_SOCKETS_POSIX_NAMES if !POSIX_API
	select MQTT_LIB
	help
	  Convenience library that simplifies Zephyr MQTT API and socket handling.

if MQTT_HELPER

config MQTT_HELPER_NATIVE_TLS
	bool "Native TLS socket"
	help
	  Enabling this option will configure the socket to be native for TLS
	  instead of offloading TLS operations to the device's networking stack.

config MQTT_HELPER_PORT
	int "MQTT broker port"
	default 8883 if MQTT_LIB_TLS
	default 1883
	help
	  Port number to connect to the MQTT broker.

config MQTT_HELPER_SEC_TAG
	int "TLS sec tag"
	depends on MQTT_LIB_TLS
	default -1
	help
	  Security tag where TLS credentials are stored.

config MQTT_HELPER_SEND_TIMEOUT
	bool "Send data with socket timeout"
	default y
	help
	  Configures a timeout on the MQTT socket to ensure that a call to the send
	  function will not block indefinitely. To configure the length of the timeout,
	  use MQTT_HELPER_SEND_TIMEOUT_SEC.

config MQTT_HELPER_SEND_TIMEOUT_SEC
	int "Send timeout"
	depends on MQTT_HELPER_SEND_TIMEOUT
	default 60
	help
	  Timeout in seconds to use when the MQTT socket is configured to
	  send with a timeout by enabling MQTT_HELPER_SEND_TIMEOUT.

config MQTT_HELPER_STATIC_IP_ADDRESS
	string "Static IP address"
	help
	  Set a static IP address to use when connecting to the MQTT broker.
	  Leave the string empty to use DNS to resolve the IoT Hub hostname instead.

config MQTT_HELPER_SECONDARY_SEC_TAG
	int "Secondary TLS sec tag"
	default -1
	help
	  Security tag where TLS credentials are stored.
	  The secondary tag can be used to store for instance an additional server certificate.
	  -1 indicates that the secondary sec tag is not used.

config MQTT_HELPER_STACK_SIZE
	int "Connection thread stack size"
	default 2560
	help
	  The stack size of the internal thread in the library.
	  The thread polls the MQTT socket while it's open.
	  All MQTT-related callbacks happen in context of this thread, so the stack size may have
	  to be adjusted for your needs.

config MQTT_HELPER_RX_TX_BUFFER_SIZE
	int "Buffer sizes for the MQTT library"
	default 256
	help
	  Specifies maximum message size can be transmitted/received through
	  MQTT (exluding MQTT PUBLISH payload).

config MQTT_HELPER_PAYLOAD_BUFFER_LEN
	int "Size of the MQTT PUBLISH payload buffer (receiving MQTT messages)"
	default 2048 if NRF_MODEM_LIB
	default 4096

config MQTT_HELPER_PROVISION_CERTIFICATES
	bool "Run-time provisioning of certificates"
	depends on (BOARD_QEMU_X86 || BOARD_NATIVE_POSIX || BOARD_NRF7002DK_NRF5340_CPUAPP || BOARD_NRF7002DK_NRF5340_CPUAPP_NS) && MQTT_LIB_TLS
	default y
	imply MBEDTLS_PEM_CERTIFICATE_FORMAT if MBEDTLS
	help
	  Enable run-time provisioning of certificates located in the folder path
	  set by CONFIG_MQTT_HELPER_CERTIFICATES_FOLDER.
	  This option is only intended for testing and should not be used in a production scenario.
	  Enabling this option means that the credentials used in the TLS communication towards the
	  server will be exposed in flash memory.

config MQTT_HELPER_CERTIFICATES_FOLDER
	string "TLS certificates folder"
	depends on MQTT_HELPER_PROVISION_CERTIFICATES
	default "certs"
	help
	  The default path for the folder that contains credentials, relative to the application source directory.
	  By default, the library expects the credentials to be in
	  Privacy Enhanced Mail (PEM) format.

config MQTT_HELPER_LAST_WILL
	bool "Last will"
	help
	  If this option is set a configurable last will topic and message is
	  provided by the device in the MQTT CONNECT message. Upon a disconnect
	  from the MQTT broker the broker will publish the last will message
	  to the last will topic.

if MQTT_HELPER_LAST_WILL

config MQTT_HELPER_LAST_WILL_MESSAGE
	string "Last will message"
	default "{\"lastwill\": \"offline\"}"

config MQTT_HELPER_LAST_WILL_TOPIC
	string "Last will topic"
	default "lastwilltopic"

endif

module = MQTT_HELPER
module-str = MQTT helper library
source "${ZEPHYR_BASE}/subsys/logging/Kconfig.template.log_config"

endif # MQTT_HELPER
```
