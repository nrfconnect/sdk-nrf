## subsys/net/lib/download_client/Kconfig
```kconfig
#
# Copyright (c) 2018 Nordic Semiconductor
#
# SPDX-License-Identifier: LicenseRef-Nordic-5-Clause
#

menuconfig  DOWNLOAD_CLIENT
	bool "Download client"

if DOWNLOAD_CLIENT

comment "Thread and stack buffers"

config DOWNLOAD_CLIENT_STACK_SIZE
	int "Thread stack size"
	range 768 4096
	default 1280

config DOWNLOAD_CLIENT_MAX_HOSTNAME_SIZE
	int "Maximum hostname length (stack)"
	range 8 256
	default 255

config DOWNLOAD_CLIENT_MAX_FILENAME_SIZE
	int "Maximum filename length (stack)"
	range 8 2048
	default 255

config DOWNLOAD_CLIENT_SHELL
	bool "Enable shell"
	depends on SHELL

config DOWNLOAD_CLIENT_TRANSPORT_PARAMS_SIZE
	int "Maximum transport parameter size"
	default 128 if DOWNLOAD_CLIENT_TRANSPORT_COAP
	default 64 if DOWNLOAD_CLIENT_TRANSPORT_HTTP

config DOWNLOAD_CLIENT_TRANSPORT_HTTP
	bool "HTTP transport"
	depends on NET_IPV4 || NET_IPV6
	default y

if DOWNLOAD_CLIENT_TRANSPORT_HTTP

config DOWNLOAD_CLIENT_HTTP_TIMEO_MS
	int "Receive timeout on TCP sockets, in milliseconds"
	default 30000
	range -1 600000
	help
	  Socket timeout for recv() calls, in milliseconds.
	  When using HTTP or HTTPS, set a timeout to be able to detect
	  when the server is not responding and client should give up.
	  Set to -1 disable.

endif #DOWNLOAD_CLIENT_TRANSPORT_HTTP

config DOWNLOAD_CLIENT_TRANSPORT_COAP
	bool "CoAP transport"
	depends on COAP
	depends on NET_IPV4 ||NET_IPV6

if DOWNLOAD_CLIENT_TRANSPORT_COAP

config DOWNLOAD_CLIENT_COAP_MAX_RETRANSMIT_REQUEST_COUNT
	int "Number of CoAP request retransmissions"
	default 4
	range 1 10
	help
	  As part of CoAP exponential backoff mechanism this is the number
	  of retransmissions of a request. If the retransmissions exceeds,
	  the download will be stopped.

config DOWNLOAD_CLIENT_CID
	bool "Use DTLS Connection-ID"
	help
	  Use DTLS Connection-ID option when downloading from CoAPS resources.
	  This requires modem firmware 1.3.5 or newer.


config DOWNLOAD_CLIENT_COAP_BLOCK_SIZE
	int
	default 3 if DOWNLOAD_CLIENT_COAP_BLOCK_SIZE_128
	default 4 if DOWNLOAD_CLIENT_COAP_BLOCK_SIZE_256
	default 5 if DOWNLOAD_CLIENT_COAP_BLOCK_SIZE_512

choice DOWNLOAD_CLIENT_COAP_BLOCK_SIZE_CHOICE
	prompt "CoAP block size"
	depends on COAP
	default DOWNLOAD_CLIENT_COAP_BLOCK_SIZE_512
	help
	   CoAP blockwise transfer block size.

config DOWNLOAD_CLIENT_COAP_BLOCK_SIZE_512
	bool "512"
	depends on DOWNLOAD_CLIENT_BUF_SIZE >= 532

config DOWNLOAD_CLIENT_COAP_BLOCK_SIZE_256
	bool "256"
	depends on DOWNLOAD_CLIENT_BUF_SIZE >= 276

config DOWNLOAD_CLIENT_COAP_BLOCK_SIZE_128
	bool "128"
	depends on DOWNLOAD_CLIENT_BUF_SIZE >= 148

endchoice

endif #DOWNLOAD_CLIENT_TRANSPORT_COAP

module=DOWNLOAD_CLIENT
module-dep=LOG
module-str=Download client
source "${ZEPHYR_BASE}/subsys/logging/Kconfig.template.log_config"

if DOWNLOAD_CLIENT_LOG_LEVEL_DBG

config DOWNLOAD_CLIENT_LOG_HEADERS
	bool "Log protocol headers to console [Debug]"

endif

endif
```

## subsys/net/lib/downloader/Kconfig
```kconfig
#
# Copyright (c) 2024 Nordic Semiconductor
#
# SPDX-License-Identifier: LicenseRef-Nordic-5-Clause
#

menuconfig DOWNLOADER
	bool "Download client"

if DOWNLOADER

comment "Thread and stack buffers"

config DOWNLOADER_STACK_SIZE
	int "Thread stack size"
	range 768 8192
	default 1408 if NRF_CLOUD_PGPS
	default 1280

config DOWNLOADER_MAX_HOSTNAME_SIZE
	int "Maximum hostname length (stack)"
	range 8 256
	default 256

config DOWNLOADER_MAX_FILENAME_SIZE
	int "Maximum filename length (stack)"
	range 8 2048
	default 255

config DOWNLOADER_MAX_REDIRECTS
	int "Number of redirects before download is aborted"
	range 0 255
	default 10
	help
	   The maximum number of redirects can be overwritten in the host config.

config DOWNLOADER_SHELL
	bool "Download client shell"
	depends on SHELL

config DOWNLOADER_TRANSPORT_PARAMS_SIZE
	int "Maximum transport parameter size"
	default 256

config DOWNLOADER_TRANSPORT_HTTP
	bool "HTTP transport"
	depends on NET_IPV4 || NET_IPV6
	default y

config DOWNLOADER_TRANSPORT_COAP
	bool "CoAP transport"
	depends on COAP
	depends on NET_IPV4 ||NET_IPV6

if DOWNLOADER_SHELL

config DOWNLOADER_SHELL_BUF_SIZE
	int "Shell buffer size"
	default 2048

endif # DOWNLOADER_SHELL

module=DOWNLOADER
module-dep=LOG
module-str=Download client
source "$(ZEPHYR_BASE)/subsys/logging/Kconfig.template.log_config"

if DOWNLOADER_LOG_LEVEL_DBG

config DOWNLOADER_LOG_HEADERS
	bool "Log protocol headers to console [Debug]"

endif # DOWNLOADER_LOG_LEVEL_DBG

endif # DOWNLOADER
```

## subsys/net/lib/fota_download/Kconfig
```kconfig
#
# Copyright (c) 2019 Nordic Semiconductor ASA
#
# SPDX-License-Identifier: LicenseRef-Nordic-5-Clause
#

menuconfig FOTA_DOWNLOAD
	bool "FOTA Download"
	depends on DOWNLOAD_CLIENT
	depends on DFU_TARGET
	select SYS_HASH_FUNC32
	imply FW_INFO

if (FOTA_DOWNLOAD)

config FOTA_SOCKET_RETRIES
	int "Number of retries for socket-related download issues"
	default 2

config FOTA_DOWNLOAD_PROGRESS_EVT
	bool "Emit progress event upon receiving a download fragment"

config FOTA_CLIENT_AUTOSCHEDULE_UPDATE
	bool "Mark target images to be updated when downloaded"
	default y

config FOTA_DOWNLOAD_MCUBOOT_FLASH_BUF_SZ
	int "Size of buffer used for flash write operations during MCUboot updates"
	depends on DFU_TARGET_MCUBOOT
	default 512
	help
	  Buffer size must be aligned to the minimal flash write block size

config FOTA_DOWNLOAD_FULL_MODEM_BUF_SZ
	int "Size of buffer used for flash write operations during full modem updates"
	depends on DFU_TARGET_FULL_MODEM
	default 4096
	help
	  Buffer size must be aligned to the minimal flash write block size

config FOTA_DOWNLOAD_NATIVE_TLS
	bool "Enable native TLS socket"
	help
	  Enabling this option will configure the socket to be native for TLS
	  instead of offloading TLS operations to the modem.

config FOTA_DOWNLOAD_FILE_NAME_LENGTH
	int "Size of buffer used for file name"
	default 128

config FOTA_DOWNLOAD_HOST_NAME_LENGTH
	int "Size of buffer used for host name"
	default 128

config FOTA_DOWNLOAD_RESOURCE_LOCATOR_LENGTH
	int "Size of buffer used for Resource locator"
	default 512

config FOTA_DOWNLOAD_SEC_TAG_LIST_SIZE_MAX
	int "Size of security tag list"
	default 5
	help
	  Maximum size of the list of security tags used to store TLS credentials.

module=FOTA_DOWNLOAD
module-dep=LOG
module-str=Firmware Over the Air Download
source "${ZEPHYR_BASE}/subsys/logging/Kconfig.template.log_config"

endif # FOTA_DOWNLOAD
```

## subsys/net/lib/ftp_client/Kconfig
```kconfig
#
# Copyright (c) 2020 Nordic Semiconductor
#
# SPDX-License-Identifier: LicenseRef-Nordic-5-Clause
#

menuconfig FTP_CLIENT
	bool "FTP client"

if FTP_CLIENT
config FTP_CLIENT_KEEPALIVE_TIME
	int "Keep-alive time in seconds after connection"
	default 60
	help
	  Define the heart-beat time.

config FTP_CLIENT_LISTEN_TIME
	int "Poll time in seconds in receiving FTP message"
	default 10
	help
	  Define the wait time for receiving.

config FTP_CLIENT_TLS
	bool "Connection over TLS"

module=FTP_CLIENT
module-dep=LOG
module-str=FTP client
source "${ZEPHYR_BASE}/subsys/logging/Kconfig.template.log_config"

if FTP_CLIENT_LOG_LEVEL_DBG

config FTP_CLIENT_LOG_HEADERS
	bool "Log FTP headers to Console [Debug]"

endif

endif
```

## subsys/net/lib/hostap_crypto/Kconfig
```kconfig
#
# Copyright (c) 2024 Nordic Semiconductor
#
# SPDX-License-Identifier: LicenseRef-Nordic-5-Clause
#

if WIFI_NM_WPA_SUPPLICANT && SOC_FAMILY_NORDIC_NRF

choice WIFI_NM_WPA_SUPPLICANT_CRYPTO_BACKEND
	default WIFI_NM_WPA_SUPPLICANT_CRYPTO_EXT
endchoice

config HOSTAP_CRYPTO_ALT_PSA
	bool "PSA crypto support for Wi-Fi using nRF Security"
	default y
	select PSA_CRYPTO
	# HostAP mbedtls alt still uses legacy MPI/cipher symbols from TF-PSA-Crypto.
	select MBEDTLS_DECLARE_PRIVATE_IDENTIFIERS
	select MBEDTLS_BIGNUM_C
	select MBEDTLS_PK_C
	select MBEDTLS_PK_PARSE_C
	select MBEDTLS_PK_WRITE_C
	select MBEDTLS_MD_C
	select MBEDTLS_ENABLE_HEAP
	select PSA_WANT_GENERATE_RANDOM
	select PSA_WANT_ALG_HMAC
	select PSA_WANT_KEY_TYPE_HMAC
	select PSA_WANT_ALG_CMAC
	select PSA_WANT_ALG_ECB_NO_PADDING
	select PSA_WANT_ALG_SHA_1
	select PSA_WANT_ALG_SHA_256
	# Zephyr hostap always defines CONFIG_SHA384; wpa_gmk_to_gtk() uses
	# sha384_prf() -> PSA_ALG_HMAC(PSA_ALG_SHA_384) for GMK/GTK derivation
	# and WPS/P2P GO needs it too.
	select PSA_WANT_ALG_SHA_384
	# Zephyr hostap always defines CONFIG_SHA512; sha512_prf() needs
	# PSA_ALG_HMAC(PSA_ALG_SHA_512) for SAE/FT and similar paths.
	select PSA_WANT_ALG_SHA_512
	select PSA_WANT_ALG_PBKDF2_HMAC
	select PSA_WANT_KEY_TYPE_PASSWORD
	select PSA_WANT_KEY_TYPE_AES
	# Personal/WPS/P2P pull in the fuller PSA cipher/hash set. Enterprise
	# keeps the lean set (it builds the mbedtls TLS stack on top) to stay
	# within RAM/flash budgets, matching the old legacy backend.
	select PSA_WANT_ALG_CBC_PKCS7 if !HOSTAP_CRYPTO_ENTERPRISE
	select PSA_ACCEL_CBC_MAC_AES_128 if !HOSTAP_CRYPTO_ENTERPRISE
	select PSA_ACCEL_CBC_MAC_AES_192 if !HOSTAP_CRYPTO_ENTERPRISE
	select PSA_ACCEL_CBC_MAC_AES_256 if !HOSTAP_CRYPTO_ENTERPRISE
	select PSA_WANT_ALG_CCM if !HOSTAP_CRYPTO_ENTERPRISE
	select PSA_WANT_ALG_GCM if !HOSTAP_CRYPTO_ENTERPRISE
	select PSA_WANT_ALG_CTR if !HOSTAP_CRYPTO_ENTERPRISE
	select PSA_WANT_ALG_MD5 if !HOSTAP_CRYPTO_ENTERPRISE
	select PSA_ACCEL_MD5 if !HOSTAP_CRYPTO_ENTERPRISE
	select PSA_WANT_ALG_SHA_224 if !HOSTAP_CRYPTO_ENTERPRISE
	select PSA_WANT_ALG_PBKDF2_AES_CMAC_PRF_128 if !HOSTAP_CRYPTO_ENTERPRISE
	select PSA_WANT_KEY_TYPE_ECC_PUBLIC_KEY if !HOSTAP_CRYPTO_ENTERPRISE
	help
	  Crypto backend for the WPA supplicant built on PSA Crypto with the
	  HostAP mbedtls alt glue. This is the single backend for all Wi-Fi
	  modes: WPA2/WPA3 personal, and with the enterprise and WPS/P2P
	  options it also covers EAP and WPS/P2P.

# Internal bignum WPA3 is incompatible with the PSA alt backend; defaults use
# EXT when HOSTAP_CRYPTO_WPA3_PSA is enabled (see Kconfig.defconfig).
config WIFI_NM_WPA_SUPPLICANT_WPA3_IMPLEMENTATION_INT
	depends on !HOSTAP_CRYPTO_ALT_PSA

if WIFI_NM_WPA_SUPPLICANT_CRYPTO_ENTERPRISE

config HOSTAP_CRYPTO_ENTERPRISE
	bool "Enterprise Crypto support for Wi-Fi using nRF Security"
	depends on HOSTAP_CRYPTO_ALT_PSA
	default y
	select MBEDTLS
	select PSA_WANT_ALG_HMAC
	select PSA_WANT_ALG_TLS12_PRF
	select PSA_WANT_ALG_TLS12_PSK_TO_MS
	select PSA_WANT_ALG_ECDH
	select PSA_WANT_ECC_SECP_R1_256
	# Enterprise EAP-TLS pulls in the mbedtls software TLS/X.509 stack on
	# top of the PSA backend, which needs its own entropy/DRBG and ciphers.
	select MBEDTLS_ECP_C
	select MBEDTLS_ECDSA_C
	select MBEDTLS_MD_C
	select MBEDTLS_AES_C
	select MBEDTLS_SHA256_C
	select MBEDTLS_ENTROPY_C
	select MBEDTLS_CTR_DRBG_C
	select MBEDTLS_HMAC_DRBG_C
	select MBEDTLS_PKCS5_C
	select MBEDTLS_SSL_TLS_C
	select MBEDTLS_SSL_SRV_C
	select MBEDTLS_SSL_CLI_C
	select MBEDTLS_X509_LIBRARY
	select MBEDTLS_TLS_LIBRARY
	select MBEDTLS_X509_CRL_PARSE_C
	select MBEDTLS_TLS_VERSION_1_2
	select MBEDTLS_RSA_C
	select MBEDTLS_SSL_SERVER_NAME_INDICATION
	# Default test_certs/rsa3k (CMake) use RSA-3072 and sha384WithRSAEncryption.
	select PSA_WANT_RSA_KEY_SIZE_3072
	select PSA_WANT_ALG_SHA_384

endif

# WPA3 over PSA is personal security only for now
if HOSTAP_CRYPTO_ALT_PSA

config HOSTAP_CRYPTO_WPA3_PSA
	bool "WPA3 PSA support"
	depends on !SOC_SERIES_NRF54H && !WIFI_NM_WPA_SUPPLICANT_AP
	# Off by default for enterprise: WPA3 SAE is personal-only and the PSA
	# PAKE driver does not fit the already tight enterprise EAP-TLS budget.
	# It can still be enabled explicitly on boards with spare RAM/flash.
	default y if !SOC_SERIES_NRF54H && !HOSTAP_CRYPTO_ENTERPRISE
	select PSA_WANT_ALG_WPA3_SAE_FIXED
	select PSA_WANT_ALG_WPA3_SAE_H2E
	select PSA_WANT_KEY_TYPE_WPA3_SAE
	select PSA_WANT_ECC_SECP_R1_256

endif

endif
```

## subsys/net/lib/hostap_crypto/Kconfig.defconfig
```kconfig
#
# Copyright (c) 2026 Nordic Semiconductor
#
# SPDX-License-Identifier: LicenseRef-Nordic-5-Clause
#

# PSA backend defaults: WPA3 via external PSA implementation.
if WIFI_NM_WPA_SUPPLICANT && SOC_FAMILY_NORDIC_NRF && HOSTAP_CRYPTO_ALT_PSA

choice WIFI_NM_WPA_SUPPLICANT_WPA3_IMPLEMENTATION
	default WIFI_NM_WPA_SUPPLICANT_WPA3_IMPLEMENTATION_EXT if HOSTAP_CRYPTO_WPA3_PSA
	default WIFI_NM_WPA_SUPPLICANT_WPA3_IMPLEMENTATION_INT if WIFI_NM_WPA_SUPPLICANT_AP
	default WIFI_NM_WPA_SUPPLICANT_WPA3_IMPLEMENTATION_NONE
endchoice

# HOSTAP_CRYPTO_ALT_PSA selects MBEDTLS_ENABLE_HEAP, so DH/MPI allocations
# from the vendored dhm.c path use the TF-PSA static mbedtls heap rather than
# libc calloc. WPS DH group 5 (1536-bit) needs well above the 512-byte Kconfig
# default; 32 KiB covers DH and follow-on WPS crypto on nRF54LM20.
config MBEDTLS_HEAP_SIZE
	default 32768 if WIFI_NM_WPA_SUPPLICANT_WPS

endif # WIFI_NM_WPA_SUPPLICANT && SOC_FAMILY_NORDIC_NRF && HOSTAP_CRYPTO_ALT_PSA
```

## subsys/net/lib/http_client/Kconfig
```kconfig
#
# Copyright (c) 2019 Nordic Semiconductor
#
# SPDX-License-Identifier: LicenseRef-BSD-5-Clause-Nordic
#

config  NRF_HTTP_CLIENT
	bool "HTTP client"
```

## subsys/net/lib/http_download/Kconfig
```kconfig
#
# Copyright (c) 2018 Nordic Semiconductor
#
# SPDX-License-Identifier: LicenseRef-BSD-5-Clause-Nordic
#

menuconfig  HTTP_DOWNLOAD
	bool "HTTP downloader"

if HTTP_DOWNLOAD

config HTTP_DOWNLOAD_MAX_FRAGMENT_SIZE
	int "Fragment size"
	range 512 2048 if BSD_LIBRARY && HTTP_DOWNLOAD_TLS
	default 2048 if BSD_LIBRARY && HTTP_DOWNLOAD_TLS
	range 512 4096
	default 4096
	help
	  Size of the data fragments reported to the application in each event.
	  When using BSD library and TLS, the fragment can not exceed 2.3kB.
	  When not using TLS, prefer a larger fragment size to reduce the
	  bandwidth overhead due to the HTTP headers.

config HTTP_DOWNLOAD_MAX_RESPONSE_SIZE
	int "Response size"
	default HTTP_DOWNLOAD_MAX_FRAGMENT_SIZE
	help
	  Buffer to accommodate for the HTTP response.
	  Must be large enough to accomodate for a full fragment.

config HTTP_DOWNLOAD_STACK_SIZE
	int "Thread stack size"
	default 2048

config HTTP_DOWNLOAD_SOCK_TIMEOUT_MS
	int "Receive timeout, in milliseconds"
	default -1
	range -1 30000
	help
	  Socket timeout for recv() calls, in milliseconds.
	  Set to -1 disable.

config HTTP_DOWNLOAD_IPV6
	bool "Prefer IPv6 connections"
	help
	  Prefer IPv6 protocol but fallback to
	  IPv4 when the hostname can't be resolved.

config HTTP_DOWNLOAD_TLS
	bool "Download over HTTPS"

module=HTTP_DOWNLOAD
module-dep=LOG
module-str=HTTP downloader
source "${ZEPHYR_BASE}/subsys/logging/Kconfig.template.log_config"

if HTTP_DOWNLOAD_LOG_LEVEL_DBG

config HTTP_DOWNLOAD_LOG_HEADERS
	bool "Log HTTP headers to Console [Debug]"

endif

endif
```

## subsys/net/lib/icalendar_parser/Kconfig
```kconfig
#
# Copyright (c) 2018 Nordic Semiconductor
#
# SPDX-License-Identifier: LicenseRef-Nordic-5-Clause
#

menuconfig  ICAL_PARSER
	bool "iCalendar parser"

if ICAL_PARSER

config ICAL_PARSER_BUFFER_SIZE
	int "Buffer size for unparsed data"
	default 2048
	help
	  Size for internal buffer to store unparsed data.

config ICAL_PARSER_MAX_PROPERTY_SIZE
	int "Maximum size of an iCalendar property"
	default 1024

config ICAL_PARSER_DESCRIPTION_SIZE
	int "Maximum size of a DESCRIPTION property"
	range 32 ICAL_PARSER_MAX_PROPERTY_SIZE
	default 128

config ICAL_PARSER_DTEND_SIZE
	int "Maximum size of a DTEND property"
	range 16 ICAL_PARSER_MAX_PROPERTY_SIZE
	default 16

config ICAL_PARSER_DTSTART_SIZE
	int "Maximum size of a DTSTART property"
	range 16 ICAL_PARSER_MAX_PROPERTY_SIZE
	default 16

config ICAL_PARSER_LOCATION_SIZE
	int "Maximum size of a LOCATION property"
	range 32 ICAL_PARSER_MAX_PROPERTY_SIZE
	default 64

config ICAL_PARSER_SUMMARY_SIZE
	int "Maximum size of a SUMMARY property"
	range 32 ICAL_PARSER_MAX_PROPERTY_SIZE
	default 64

module=ICAL_PARSER
module-dep=LOG
module-str=iCalendar parser
source "${ZEPHYR_BASE}/subsys/logging/Kconfig.template.log_config"

endif
```
