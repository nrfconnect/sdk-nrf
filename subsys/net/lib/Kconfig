## subsys/net/lib/mqtt_socket/Kconfig
```kconfig
# Kconfig - Socket MQTT Library for Zephyr
#
# Copyright (c) 2018 Nordic Semiconductor ASA
#
# SPDX-License-Identifier: Apache-2.0
#

config MQTT_SOCKET_LIB
	bool "Socket MQTT Library Support"
	select NET_SOCKETS
	select NET_SOCKETS_POSIX_NAMES
	help
	  Enable the Zephyr MQTT Library

if MQTT_SOCKET_LIB

module=MQTT
module-dep=NET_LOG
module-str=Log level for MQTT
module-help=Enables mqtt debug messages.
source "subsys/net/Kconfig.template.log_config.net"

config MQTT_MAX_CLIENTS
	int "Maximum number of clients"
	default 1
	help
	  Maximum number of clients that can be managed by the module.

config MQTT_KEEPALIVE
	int "Maximum number of clients Keep alive time for MQTT (in seconds)"
	default 60
	help
	  Keep alive time for MQTT (in seconds). Sending of Ping Requests to
	  keep the connection alive are governed by this value.

config MQTT_MAX_PACKET_LENGTH
	int "Maximum MQTT packet size"
	default 128
	help
	  Maximum MQTT packet size that can be sent (including the fixed and
	  variable header).

config MQTT_LIB_TLS
	bool "TLS support for socket MQTT Library"
	help
	  Enable TLS support for socket MQTT Library

endif # MQTT_SOCKET_LIB
```

## subsys/net/lib/nrf70_fw_ext/Kconfig
```kconfig
#
# Copyright (c) 2024 Nordic Semiconductor
#
# SPDX-License-Identifier: LicenseRef-Nordic-5-Clause
#

if WIFI_NRF70

# NCS always uses the external handling of the nRF70 FW patches
choice NRF_WIFI_FW_BLOB_HANDLING
	default NRF_WIFI_PATCHES_EXTERNAL
endchoice

choice NRF_WIFI_PATCHES_EXT_FLASH_SUPPORT
	prompt "Store nRF700x FW patches in external flash"
	default NRF_WIFI_PATCHES_EXT_FLASH_DISABLED
	help
	  Select this option to store nRF700x FW patches in external flash.
	  This option helps to reduce the code memory size of the application, but
	  requires external memory to be available for storing the FW patches.

config NRF_WIFI_PATCHES_EXT_FLASH_DISABLED
	bool "Store nRF700x FW patches in RAM"

config NRF_WIFI_PATCHES_EXT_FLASH_XIP
	bool "Relocate nRF700x FW patches to external memory and execute from there"
	# For accessing external flash
	select FLASH
	# For relocation code to external flash
	select XIP
	select NORDIC_QSPI_NOR
	select BUILD_NO_GAP_FILL
	select CODE_DATA_RELOCATION
	select HAVE_CUSTOM_LINKER_SCRIPT

config NRF_WIFI_PATCHES_EXT_FLASH_STORE
	bool "Store nRF700x FW patches in external memory but execute from RAM"
	select FLASH
	select FLASH_MAP
endchoice

if NRF_WIFI_PATCHES_EXT_FLASH_STORE
config NRF_WIFI_FW_FLASH_CHUNK_SIZE
	int "Chunk size for nRF70 FW patches to be read from external flash"
	default NRF70_PATCH_DL_CHUNK_SIZE
	help
	  Chunk size for nRF70 FW patches to be read from external flash.
	  This option impacts the loading time of the nRF70 FW patches and
	  RAM usage (heap) of the application.

	  Each chunk read from flash is written to the RPU in a single SPI/QSPI
	  transfer, so it must stay within the host EasyDMA MAXCNT and any DMA
	  bounce region of the bus driver. It therefore defaults to
	  NRF70_PATCH_DL_CHUNK_SIZE, which is sized for the most constrained
	  supported SoC. Do not raise it above that limit.

config NRF_WIFI_FW_PATCH_INTEGRITY_CHECK
	bool "Integrity check of nRF70 FW patches"
	select FLASH_AREA_CHECK_INTEGRITY
	default y
	help
	  Select this option to enable integrity check of nRF70 FW patches using
	  SHA-256 verification algorithm.This option impacts the loading time of the
	  nRF70 FW patches but protects against corrupted FW patches.

config HEAP_MEM_POOL_ADD_SIZE_NRF70_FW_EXT
	def_int 10000

endif

config CUSTOM_LINKER_SCRIPT
	string "Custom linker script for nRF70 FW patches in external flash"
	default "$(ZEPHYR_BASE)/../nrf/subsys/net/lib/nrf70_fw_ext/rpu_fw_patches.ld"
endif
```
