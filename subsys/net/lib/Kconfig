## subsys/net/lib/Kconfig
```kconfig
# Copyright (c) 2018 Nordic Semiconductor
#
# SPDX-License-Identifier: LicenseRef-Nordic-5-Clause
#

menu "Application protocols"

config CLOUD_SERVICE_MUTUAL_EXCLUSIVE
	bool
	default y if "$(CLOUD_SERVICE_SELECTOR)" = "choice"
	help
	  Internal setting which indicates that the Cloud Service is mutually
	  exclusive.
	  An application defconfig can indicate that the Cloud Service is
	  mutually exclusive by requesting that selection of cloud services should
	  be selectable using a choice menu.
	  The choice selection can be enabled in the application Kconfig by
	  setting the `CLOUD_SERVICE_SELECTOR` variable to `choice`, that is
	  adding a line as:
	  CLOUD_SERVICE_SELECTOR := choice

choice CLOUD_SERVICE
	bool
	prompt "Cloud Service"
	depends on CLOUD_SERVICE_MUTUAL_EXCLUSIVE
	optional
endchoice

rsource "nrf_cloud/Kconfig"
rsource "rest_client/Kconfig"
rsource "download_client/Kconfig"
rsource "fota_download/Kconfig"
rsource "aws_iot/Kconfig"
rsource "aws_jobs/Kconfig"
rsource "aws_fota/Kconfig"
rsource "azure_fota/Kconfig"
rsource "azure_iot_hub/Kconfig"
rsource "zzhc/Kconfig"
rsource "icalendar_parser/Kconfig"
rsource "ftp_client/Kconfig"
rsource "coap_utils/Kconfig"
rsource "lwm2m_client_utils/Kconfig"
rsource "wifi_credentials/Kconfig"
rsource "wifi_provision/Kconfig"
rsource "wifi_mgmt_ext/Kconfig"
rsource "mqtt_helper/Kconfig"
rsource "nrf_provisioning/Kconfig"
rsource "mcumgr_smp_client/Kconfig"

endmenu
```

## subsys/net/lib/Kconfig.cloud_choice
```kconfig
choice CLOUD_SERVICE

config $(module)
	bool
	prompt "$(module-prompt)"
	select $(module)_CHOICE

endchoice

module := $(module)_CHOICE
```

## subsys/net/lib/aws_jobs/Kconfig
```kconfig
# Copyright (c) 2018 Nordic Semiconductor
#
# SPDX-License-Identifier: LicenseRef-Nordic-5-Clause
#

menuconfig AWS_JOBS
	bool "AWS Jobs library"

if AWS_JOBS

config CLIENT_ID_MAX_LEN
	int "MQTT Client ID length"
	default 64

config UPDATE_JOB_PAYLOAD_LEN
	int "Update job document buffer size"
	default 1350

module=AWS_JOBS
module-dep=LOG
module-str=Log level for AWS Jobs
module-help=Enables AWS Jobs log messages.
source "${ZEPHYR_BASE}/subsys/logging/Kconfig.template.log_config"

endif # AWS_JOBS
```

## subsys/net/lib/azure_fota/Kconfig
```kconfig
#
# Copyright (c) 2020 Nordic Semiconductor
#
# SPDX-License-Identifier: LicenseRef-Nordic-5-Clause
#

menuconfig AZURE_FOTA
	bool "Azure FOTA library [EXPERIMENTAL]"
	depends on FOTA_DOWNLOAD
	depends on CJSON_LIB
	depends on !BOARD_QEMU_X86
	select EXPERIMENTAL
	default y if AZURE_IOT_HUB

if AZURE_FOTA

config AZURE_FOTA_VERSION_MAX_LEN
	int "Version string buffer size"
	default 64

config AZURE_FOTA_JOB_ID_MAX_LEN
	int "Job ID string buffer size"
	default 40

config AZURE_FOTA_APP_VERSION_AUTO
	bool "Automatically create application version"
	help
	  Automatically create app version string using the output from the
	  git command 'git describe'

config AZURE_FOTA_APP_VERSION
	string "Application version"
	default "0.0.0-dev"
	help
	  The application version is reported to the device twin and
	  indicates the current firmware version on the device.

config AZURE_FOTA_TLS
	bool "Use HTTPS for downloads"
	default y
	help
	  Currently, the transport protocol must be configured at compile time.
	  Disable this option to use HTTP without security.

config AZURE_FOTA_SEC_TAG
	int "TLS sec tag"
	default -1
	help
	  A security tag is a positive integer that serves as pointer to the
	  location of the relevant certificates in the certificate storage of
	  the device. A value of -1 indicates that no certificates are
	  provisioned, which in most cases mean that a TLS connection will
	  not be successfully established.

config AZURE_FOTA_DOWNLOAD_PORT
	int "Port number"
	default 443 if AZURE_FOTA_TLS
	default 80

module=AZURE_FOTA
module-dep=LOG
module-str=Log level for Azure FOTA
module-help=Enables Azure FOTA log messages.
source "${ZEPHYR_BASE}/subsys/logging/Kconfig.template.log_config"

endif # AZURE_FOTA
```

## subsys/net/lib/azure_iot_hub/Kconfig
```kconfig
#
# Copyright (c) 2020 Nordic Semiconductor
#
# SPDX-License-Identifier: LicenseRef-Nordic-5-Clause
#

module = AZURE_IOT_HUB
module-prompt = "Azure IoT Hub"
orsource "../Kconfig.cloud_$(CLOUD_SERVICE_SELECTOR)"

menuconfig $(module)
	bool
	prompt "Azure IoT Hub" if !CLOUD_SERVICE_MUTUAL_EXCLUSIVE
	select AZURE_SDK
	select MQTT_HELPER
	select MQTT_LIB_TLS
	select EXPERIMENTAL

if AZURE_IOT_HUB

config AZURE_IOT_HUB_DEVICE_ID
	string "Device ID"
	help
	  Device ID to be used when connecting to IoT hub and optionally DPS.
	  Providing a device ID can also be done at run-time using the appropriate APIs.

config AZURE_IOT_HUB_HOSTNAME
	string "Azure IoT Hub hostname"
	help
	  Hostname to Azure IoT Hub instance.

config AZURE_IOT_HUB_AUTO_DEVICE_TWIN_REQUEST
	bool "Request device twin automatically when connected"
	default y
	help
	  When enabled, the library will automatically request the device twin upon connection to
	  the IoT Hub.

config AZURE_IOT_HUB_DPS
	bool "Device Provisioning Service"
	select CJSON_LIB
	depends on SETTINGS
	help
	  Enabling DPS will make the device connect to the specified DPS
	  host name, provision the device and retrieve the IoT hub host name to
	  use.

config AZURE_IOT_HUB_USER_NAME_BUF_SIZE
	int "User name max length"
	default 160
	help
	  Maximum length of the user name.

config AZURE_IOT_HUB_TOPIC_MAX_LEN
	int "Max length of topic"
	default 100
	help
	  Sets the maximum length of a topic. If you plan to use message properties,
	  it should be considered to increase this value to fit the topic into the allocated
	  buffers.

config AZURE_IOT_HUB_MSG_PROPERTY_RECV_MAX_COUNT
	int "Maximum number of property bag elements"
	default 3
	help
	  The maximum number of message properties that can be parsed from a topic in an incoming
	  MQTT message.
	  Increasing this value will increase stack usage when parsing topics,
	  and vice versa if decreasing it.

config AZURE_IOT_HUB_MSG_PROPERTY_BUFFER_SIZE
	int "Message property buffer size"
	default 128
	help
	  Message properties are converted to a string before sending to Azure. This option
	  can be used to configure the buffer size for the property string. The buffer is
	  allocated on the stack, so it's beneficial to reduce it if message properties will not
	  be used for device-originated messages.


if AZURE_IOT_HUB_DPS

config AZURE_IOT_HUB_DPS_ID_SCOPE
	string "DPS ID scope"
	help
	  ID scope to be used in the provisioning request to DPS. The ID scope can also be provided
	  at runtime.

config AZURE_IOT_HUB_DPS_REG_ID
	string "Registration ID"
	help
	  The registration ID to be used in the provisioning request to DPS.
	  The registation ID can also be provided at runtime.

config AZURE_IOT_HUB_DPS_HOSTNAME
	string "DPS host name"
	default "global.azure-devices-provisioning.net"
	help
	  Hostname for the DPS instance to use.

config AZURE_IOT_HUB_DPS_TIMEOUT_SEC
	int "DPS timeout"
	default 90
	help
	  Timeout in seconds for device provisioning. If the device has not been assigned within
	  the timeout, the provisioning attempt is terminated.
	  This timeout is useful if the device can't reach the server and vice versa in the middle
	  of the registration process.
	  The timer is reset on every incoming MQTT message from the server.
	  Note the difference between this timeout and MQTT_HELPER_SEND_TIMEOUT, which only
	  affects send() calls.

config AZURE_IOT_HUB_DPS_HOSTNAME_MAX_LEN
	int "Azure IoT Hub name max length"
	default 64
	help
	  Maximum length for IoT Hub hostname.

config AZURE_IOT_HUB_DPS_DEVICE_ID_MAX_LEN
	int "Maximum length of device ID"
	default 128

config AZURE_IOT_HUB_DPS_TOPIC_BUFFER_SIZE
	int "Topic buffer size"
	default 224
	help
	  Topic buffer size for the topic used when sending registration request and status request to DPS.
	  The buffer can be adjusted depending on the registration ID length and expected operation ID length.
	  The operation ID is received from DPS after registration request is sent.

config AZURE_IOT_HUB_DPS_USER_NAME_BUFFER_SIZE
	int "User name buffer size"
	default 256
	help
	  Size of the buffer where the user name is stored.

config AZURE_IOT_HUB_DPS_OPERATION_ID_BUFFER_SIZE
	int "Operation ID buffer size"
	default 68
	help
	  Size of the buffer where the received operation ID is stored.

endif # AZURE_IOT_HUB_DPS

module=AZURE_IOT_HUB
module-dep=LOG
module-str=Azure IoT Hub
source "${ZEPHYR_BASE}/subsys/logging/Kconfig.template.log_config"

endif # AZURE_IOT_HUB
```

## subsys/net/lib/cloud/Kconfig
```kconfig
# Copyright (c) 2019 Nordic Semiconductor
#
# SPDX-License-Identifier: LicenseRef-Nordic-5-Clause
#

config CLOUD_API
	bool "Cloud API"
```

## subsys/net/lib/coap/Kconfig
```kconfig
#
# Copyright (c) 2018 Nordic Semiconductor
#
# SPDX-License-Identifier: LicenseRef-BSD-5-Clause-Nordic
#

menuconfig NRF_COAP_LIB
	bool "Nordic CoAP library support"
	help
	  "Enable CoAP library"

if NRF_COAP_LIB

config NRF_COAP_LOG_LEVEL
	int "Log level for CoAP"
	default 0
	range 0 4
	help
	  "Enables CoAP debug messages."

config NRF_COAP_ACK_RANDOM_FACTOR
	int "Random factor to calculate the initial time-out value for a confirmable message."
	default 1
	range 0 65535
	help
	  "COAP_MAX_TRANSMISSION_SPAN / COAP_MAX_RETRANSMIT_COUNT / COAP_ACK_TIMEOUT"

config NRF_COAP_ACK_TIMEOUT
	int "Minimum spacing before another retransmission."
	default 2
	range 0 65535
	help
	  "Max value should not exceed COAP_MAX_TRANSMISSION_SPAN / COAP_MAX_RETRANSMIT_COUNT."

config NRF_COAP_ENABLE_OBSERVE_CLIENT
	bool "Enable CoAP observe client role."
	help
	  "If enabled, the coap_observe module has to be included. It will enable
	   the module with a table to store observable resources, and provide access
	   to functions to register and unregister observable resources. The
	   observable resources list is used to match incoming notifications to
	   an application callback function."

config NRF_COAP_OBSERVE_MAX_NUM_OBSERVABLES
	int "Maximum number of CoAP observable resources that a client can have active."
	depends on NRF_COAP_ENABLE_OBSERVE_CLIENT
	default 0
	range 0 255
	help
	  "Maximum number of observable resources to be registered by a client.
	   For each observable resource added, it will increase the memory
	   consumption of one coap_observable_t struct."

config NRF_COAP_ENABLE_OBSERVE_SERVER
	bool "Enable CoAP observe server role."
	help
	  "If enabled the coap_observe module has to be included. It will enable the
	   module with a table to store observers, and provide access to functions
	   to register and unregister observers. The list can be traversed order
	   to send notifications to the observers."

config NRF_COAP_OBSERVE_MAX_NUM_OBSERVERS
	int "Maximum number of CoAP observers that a server can have active."
	depends on NRF_COAP_ENABLE_OBSERVE_SERVER
	default 0
	range 0 255
	help
	  "Maximum number of observers to be registered by a server. For each
	   observer added, it will increase the memory consumption of one
	   coap_observer_t struct."

config NRF_COAP_MAX_NUMBER_OF_OPTIONS
	int "Maximum size of a CoAP message excluding the mandatory CoAP header."
	default 8
	range 1 65535

config NRF_COAP_MAX_RETRANSMIT_COUNT
	int "Maximum number of transmit attempts for a confirmable messages."
	default 1
	range 0 255

config NRF_COAP_MAX_TRANSMISSION_SPAN
	int "Maximum transmission span."
	default 10
	range 0 65535
	help
	  "Maximum time from the first transmission of a confirmable message to its
	   last retransmission."

config NRF_COAP_MESSAGE_DATA_MAX_SIZE
	int "Maximum size of a CoAP message excluding the mandatory CoAP header."
	default 256
	range 1 65535

config NRF_COAP_MESSAGE_QUEUE_SIZE
	int "Maximum number of CoAP messages that can be in transmission at a time."
	default 4
	range 1 65535
	help
	  "CoAP uses the memory allocator function registered with it on coap_init.
	   Ensure the allocator function registered can allocate this size."

config NRF_COAP_PORT_COUNT
	int "Number of local ports used by CoAP."
	default 1
	range 0 255
	help
	  "Max number of client/server ports used by the application. One socket
	   will be created for each port."

config NRF_COAP_SESSION_COUNT
	int "Number of sessions used by CoAP."
	default 0
	range 0 255
	help
	  "Max number of secure sessions used by the application. One socket
	   will be created for each session."

config NRF_COAP_RESOURCE_MAX_DEPTH
	int "Maximum number of CoAP resource levels."
	default 5
	range 1 255
	help
	  "Maximum number of resource depth levels CoAP will use. The number will
	   be used when adding resource to the resource structure, or when
	   traversing the resources for a matching resource name given in a request.
	   Each level added will increase the stack usage runtime with 4 bytes."

config NRF_COAP_RESOURCE_MAX_NAME_LEN
	int "Maximum length of CoAP resource verbose name."
	default 19
	range 1 65535
	help
	  "Maximum length of resource name that can be supplied from the
	   application."

config NRF_COAP_VERSION
	int "CoAP version number."
	default 1
	range 0 3
	help
	  "The version of CoAP which all CoAP messages will be populated with."

endif # NRF_COAP_LIB
```

## subsys/net/lib/coap_utils/Kconfig
```kconfig
#
# Copyright (c) 2020 Nordic Semiconductor ASA
#
# SPDX-License-Identifier: LicenseRef-Nordic-5-Clause
#
config COAP_UTILS
	bool "Support for communication with CoAP"
	depends on COAP
	help
	  Send and receive CoAP non-confirmable requests.
	  Utilize CoAP and Modem libraries.

if COAP_UTILS

module = COAP_UTILS
module-str = CoAP utils
source "${ZEPHYR_BASE}/subsys/logging/Kconfig.template.log_config"

endif
```

## subsys/net/lib/dect/l2_shell/Kconfig
```kconfig
# Copyright (c) 2025 Nordic Semiconductor ASA
#
# SPDX-License-Identifier: LicenseRef-Nordic-5-Clause

config DECT_L2_SHELL_LIB
	bool "DECT L2 shell library"
	depends on NET_MGMT
	depends on NET_MGMT_EVENT
	depends on NET_MGMT_EVENT_INFO
	depends on NET_L2_DECT_MGMT
	depends on GETOPT_LONG
	depends on DECT_UTILS_LIB
	help
	  DECT L2 shell library providing shell commands for DECT NR+ network
	  management interface.
```

## subsys/net/lib/dect/utils/Kconfig
```kconfig
# Copyright (c) 2025 Nordic Semiconductor ASA
#
# SPDX-License-Identifier: LicenseRef-Nordic-5-Clause

config DECT_UTILS_LIB
	bool "DECT NR+ utilities library"
	depends on DECT
	help
	  Utility functions for DECT NR+ operations, including long RD ID
	  extraction and IPv6 address handling.
```

## subsys/net/lib/dfu_client/Kconfig
```kconfig
#
# Copyright (c) 2018 Nordic Semiconductor
#
# SPDX-License-Identifier: LicenseRef-BSD-5-Clause-Nordic
#

menuconfig  NRF_HTTP_DFU_CLIENT
	bool "HTTP DFU client"

if NRF_HTTP_DFU_CLIENT
config  NRF_HTTP_CLIENT
	bool "HTTP client"

config NRF_DFU_HTTP_MAX_REQUEST_SIZE
	int "HTTP request size"
	default 256

config NRF_DFU_HTTP_MAX_FRAGMENT_SIZE
	int "HTTP fragment size"
	default 1024

config NRF_DFU_HTTP_MAX_RESPONSE_SIZE
	int "HTTP response size"
	default 2048

endif
```
