## subsys/net_core_monitor/Kconfig
```kconfig
#
# Copyright (c) 2023 Nordic Semiconductor
#
# SPDX-License-Identifier: LicenseRef-Nordic-5-Clause
#

config NET_CORE_MONITOR
	bool "NCM (Network Core Monitor) module [EXPERIMENTAL]"
	select EXPERIMENTAL
	depends on (SOC_NRF5340_CPUAPP || SOC_NRF5340_CPUNET)
	help
	  Enable the Network Core Monitor module.
	  To define the user action for event, you need to override the
	  weak function definition of the ncm_net_core_event_handler.

if NET_CORE_MONITOR

menu "Net Core Monitor"

config NCM_FEEDING_INTERVAL_MSEC
	default 500 if SOC_NRF5340_CPUNET
	default 1000 if SOC_NRF5340_CPUAPP
	int "Feeding interval in milliseconds"
	help
	  The value of this parameter on the application core must be greater
	  than the value on the network core. Otherwise the network core monitor
	  will report false positive network code malfunctions.

config NCM_RESET_INIT_PRIORITY
	int "Reset init priority"
	default KERNEL_INIT_PRIORITY_DEFAULT

endmenu

module = NET_CORE_MONITOR
module-str = NET_CORE_MONITOR
source "${ZEPHYR_BASE}/subsys/logging/Kconfig.template.log_config"

endif #NET_CORE_MONITOR
```

## subsys/nfc/Kconfig
```kconfig
#
# Copyright (c) 2018 Nordic Semiconductor
#
# SPDX-License-Identifier: LicenseRef-Nordic-5-Clause
#

menu "NFC"

rsource "ndef/Kconfig"
rsource "t2t/Kconfig"
rsource "t4t/Kconfig"
rsource "lib/Kconfig"
rsource "tnep/Kconfig"

endmenu
```

## subsys/nfc/lib/Kconfig
```kconfig
#
# Copyright (c) 2019 Nordic Semiconductor ASA
#
# SPDX-License-Identifier: LicenseRef-Nordic-5-Clause
#
config NFC_PLATFORM
	bool "Common NFC configuration"
	default y if NFC_T2T_NRFXLIB || NFC_T4T_NRFXLIB
	select NRFX_NFCT
	help
	  Enable common configuration for the NFC

if NFC_PLATFORM

config NFCT_IRQ_PRIORITY
	int "Interrupt priority"
	range 0 5 if ZERO_LATENCY_IRQS
	range 0 6
	default 1
	help
	  Sets NFC interrupt priority.
	  Levels are from 0 (highest priority) to 6 (lowest priority)

config NFC_THREAD_CALLBACK
	bool "Thread context for NFC callbacks"
	select RING_BUFFER
	default y
	help
	  Use this option to decouple the user NFC callback
	  from the NFC interrupt context. When enabled, the user
	  callback is called from a thread (System Workqueue
	  or a dedicated thread depending on the CONFIG_NFC_OWN_THREAD
	  setting) instead of being called from the interrupt context.
	  Using this option ensures robust NFC communication
	  (deterministic time of the interrupt handling) and allows
	  deferred callback execution, while it results in higher memory
	  footprint and CPU load.

if NFC_THREAD_CALLBACK

config HEAP_MEM_POOL_SIZE
	default 512

config NFC_RING_SIZE
	int "Size of ring buffer in bytes"
	default 2048
	help
	  Size of the ring buffer.
	  The specified size is expressed as n bytes.

config NFC_LIB_CTX_MAX_SIZE
	int "Maximum size of NFC library context in bytes"
	default 16
	range 16 255
	help
	  Maximum size of the NFC library context in bytes.
	  The specified size should be divisible by 4.

config NFC_OWN_THREAD
	bool "Call NFC callback from its own thread"
	default n
	help
	  Use dedicated a thread to call NFC callback.
	  Otherwise use the system workqueue thread.

if NFC_OWN_THREAD

config NFC_THREAD_STACK_SIZE
	int "Size of NFC thread stack"
	default 256
	help
	  Size of the NFC dedicated thread stack in bytes.

config NFC_THREAD_PRIORITY
	int "Priority of NFC callback thread"
	default -1
	help
	  Priority of the dedicated NFC callback thread.
	  Cooperative thread priority is preferred,
	  because it might decrease latency and fifo usage

endif# NFC_OWN_THREAD

config NFC_LOW_LATENCY_IRQ
	bool "Use low latency IRQ for NFC"
	default y
	# NFC low latency interrupt requires software interrupt being supported.
	default y if $(dt_has_compat,$(DT_COMPAT_NORDIC_NRF_EGU)) || \
		     $(dt_has_compat,$(DT_COMPAT_NORDIC_NRF_SWI))
	select ZERO_LATENCY_IRQS
	help
	  Using this option ensures fast NFC interrupt
	  execution on the cost of using additional interrupt (SWI).

if NFC_LOW_LATENCY_IRQ

config NFC_SWI_NUMBER
	int
	default 0 if NFC_SWI0
	default 1 if NFC_SWI1
	default 2 if NFC_SWI2
	default 3 if NFC_SWI3
	default 4 if NFC_SWI4
	default 5 if NFC_SWI5

choice NFC_SWI
	default NFC_SWI1
	prompt "Software interrupt to use for NFC callback request"
	help
	  Software interrupt instantion to use for NFC callback request.

config NFC_SWI0
	bool "SWI0"
	depends on HAS_HW_NRF_EGU0 || HAS_HW_NRF_SWI0
	help
	  Use SWI0 for NFC.

config NFC_SWI1
	bool "SWI1"
	depends on HAS_HW_NRF_EGU1 || HAS_HW_NRF_SWI1
	help
	  Use SWI1 for NFC.

config NFC_SWI2
	bool "SWI2"
	depends on HAS_HW_NRF_EGU2 || HAS_HW_NRF_SWI2
	help
	  Use SWI2 for NFC.

config NFC_SWI3
	bool "SWI3"
	depends on HAS_HW_NRF_EGU3 || HAS_HW_NRF_SWI3
	help
	  Use SWI3 for NFC.

config NFC_SWI4
	bool "SWI4"
	depends on HAS_HW_NRF_EGU4 || HAS_HW_NRF_SWI4
	help
	  Use SWI4 for NFC.

config NFC_SWI5
	bool "SWI5"
	depends on HAS_HW_NRF_EGU5 || HAS_HW_NRF_SWI5
	help
	  Use SWI5 for NFC.

endchoice

endif

endif # NFC_THREAD_CALLBACK

module = NFC_PLATFORM
module-str = nfc_platform
source "${ZEPHYR_BASE}/subsys/logging/Kconfig.template.log_config"

endif # NFC_PLATFORM
```

## subsys/nfc/ndef/Kconfig
```kconfig
#
# Copyright (c) 2017 Nordic Semiconductor ASA
#
# SPDX-License-Identifier: LicenseRef-Nordic-5-Clause
#

config NFC_NDEF
	bool "NDEF libraries"
	help
	  Enable NFC Data Exchange Format libraries

config NFC_NDEF_PARSER
	bool "NDEF parser libraries"
	help
	  Enable NFC Data Exchange Format parser libraries

config NFC_NDEF_PAYLOAD_TYPE_COMMON
	bool "Standard NDEF Record Type definitions"
	help
	  Enable NFC Data Exchange Format Record Type definitions

if NFC_NDEF

config NFC_NDEF_MSG
	bool "NDEF Message generator library"

config NFC_NDEF_RECORD
	bool "NDEF Record generator library"

config NFC_NDEF_LE_OOB_REC
	bool "NDEF LE OOB record generator library"
	select NFC_NDEF_PAYLOAD_TYPE_COMMON
	depends on BT_HCI_HOST

config NFC_NDEF_TEXT_RECORD
	bool "Encoding data for a text record for NFC Tag"

config NFC_NDEF_TNEP_RECORD
	bool "Encoding data for a tnep record for NFC Tag"

config NFC_NDEF_URI_MSG
	bool "NDEF URI messages generator library"

config NFC_NDEF_URI_REC
	bool "NDEF URI record generator library"

config NFC_NDEF_CH_MSG
	bool "NDEF pairing Connection Handover message generator library"
	select NFC_NDEF_CH_REC
	help
	  Enable NDEF Connection Handover message generator library

config NFC_NDEF_CH_REC
	bool "NDEF Connection Handover records generator library"
	help
	  Enable NDEF Connection Handover records generator library

config NFC_NDEF_LAUNCHAPP_MSG
	bool "NDEF Launch App message library"
	select NFC_NDEF_LAUNCHAPP_REC
	help
	  Enable NDEF Launch App message generator library

config NFC_NDEF_LAUNCHAPP_REC
	bool "NDEF Launch App records"
	help
	  Enable NDEF Launch App records library


config NDEF_FILE_SIZE
	int "NDEF file maximal size"
	default 1024
	help
	  Set maximal NDEF file size

endif # NFC_NDEF

if NFC_NDEF_CH_MSG

config NFC_NDEF_CH_MAJOR_VERSION
	int "Connection Handover major version"
	default 1
	help
	  The major version of the Connection Handover specification.

config NFC_NDEF_CH_MINOR_VERSION
	int "Connection Handover minor version"
	default 5
	help
	  The minor version of the Connection Handover specification.

endif # NFC_NDEF_PAIR_MSG

if NFC_NDEF_PARSER

module = NFC_NDEF_PARSER
module-str = nfc_ndef_parser
source "$(ZEPHYR_BASE)/subsys/logging/Kconfig.template.log_config"

config NFC_NDEF_LE_OOB_REC_PARSER
	bool "NDEF LE OOB record parser library"
	select NFC_NDEF_PAYLOAD_TYPE_COMMON
	select NET_BUF

config NFC_NDEF_CH_PARSER
	bool "NDEF Connection Handover parser library"
	select NFC_NDEF_PAYLOAD_TYPE_COMMON
	select NET_BUF

if NFC_NDEF_LE_OOB_REC_PARSER

module = NFC_NDEF_LE_OOB_REC_PARSER
module-str = nfc_ndef_le_oob_rec_parser
source "$(ZEPHYR_BASE)/subsys/logging/Kconfig.template.log_config"

endif # NFC_NDEF_LE_OOB_REC_PARSER

if NFC_NDEF_CH_PARSER

module = NFC_NDEF_CH_REC_PARSER
module-str = nfc_ndef_ch_rec_parser
source "$(ZEPHYR_BASE)/subsys/logging/Kconfig.template.log_config"

endif # NFC_NDEF_CH_PARSER

endif # NFC_NDEF_PARSER
```

## subsys/nfc/rpc/Kconfig
```kconfig
#
#
# Copyright (c) 2024 Nordic Semiconductor
#
# SPDX-License-Identifier: LicenseRef-Nordic-5-Clause
#

menuconfig NFC_RPC
	bool "NFC over RPC [EXPERIMENTAL]"
	select NRF_RPC
	select NRF_RPC_CBOR
	select EXPERIMENTAL
	help
	  Enables NFC serialization over RPC

if NFC_RPC

choice NFC_RPC_ROLE_CHOICE
	prompt "NFC over RPC role selection"
	default NFC_RPC_CLIENT
	help
	  Selects the device role for NFC over RPC. The default role is
	  a client role.

config NFC_RPC_CLIENT
	bool "NFC over RPC client"
	help
	  Enables NFC over RPC client role that uses nRF RPC library to
	  invoke NFC functions on the remote core.

config NFC_RPC_SERVER
	bool "NFC over RPC server"
	help
	  Enables NFC over RPC server role that runs the full NFC
	  stack and exposes NFC functions using nRF RPC library to a client
	  running on the remote core.

endchoice

config NFC_RPC_T2T
	bool "NFC T2T over RPC"
	default y
	help
	  Enables serialization NFC T2T API over RPC.

config NFC_RPC_T4T
	bool "NFC T4T over RPC"
	select NFC_NDEF
	select NFC_NDEF_MSG
	default y
	help
	  Enables serialization NFC T4T API over RPC.

config NFC_RPC_INITIALIZE_NRF_RPC
	bool "Automatically initialize nRF RPC library"
	help
	  Initialize nRF RPC library during the system startup. Disabling this
	  option allow user to initialize it in a different way.

if NFC_RPC_T4T
rsource "../ndef/Kconfig"
endif

endif # NFC_RPC
```

## subsys/nfc/t2t/Kconfig
```kconfig
#
# Copyright (c) 2019 Nordic Semiconductor ASA
#
# SPDX-License-Identifier: LicenseRef-Nordic-5-Clause
#

config NFC_T2T_PARSER
	bool "NFC Type 2 Tag parser libraries"
	help
	  Enable NFC Type 2 Tag parser libraries

if NFC_T2T_PARSER

module = NFC_T2T_PARSER
module-str = nfc_t2t_parser
source "${ZEPHYR_BASE}/subsys/logging/Kconfig.template.log_config"

endif # NFC_NDEF_PARSER
```

## subsys/nfc/t4t/Kconfig
```kconfig
#
# Copyright (c) 2019 Nordic Semiconductor ASA
#
# SPDX-License-Identifier: LicenseRef-Nordic-5-Clause
#

config NFC_T4T_NDEF_FILE
	bool "NFC Type 4 Tag NDEF File"
	default y if (NFC_T4T_NRFXLIB && NFC_NDEF_MSG) || NFC_T4T_HL_PROCEDURE
	help
	  Enable NFC Type 4 Tag NDEF File generator library.

config NFC_T4T_ISODEP
	bool "NFC Type 4 Tag isodep"
	help
	  Enable NFC Type 4 Tag ISO-DEP.


if NFC_T4T_ISODEP

config NFC_T4T_ISODEP_RATS_RETRY
	int "NFC-A Type 4 Tag RATS retry"
	default 0
	range 0 1
	help
	  NFC-A Type 4 Tag RATS retry count. According to NFC Forum
	  Digital Specification 2.0 14.7.1.1.

config NFC_T4T_ISODEP_ACK_RETRY
	int "NFC-A Type 4 Tag ISO-DEP ACK retry"
	default 2
	range 2 5
	help
	  NFC-A Type 4 Tag ISO-DEP ACK retry count. According to NFC Forum
	  Digital Specification 2.0 16.2.6.

config NFC_T4T_ISODEP_NAK_RETRY
	int "NFC-A Type 4 Tag NAK retry"
	default 2
	range 2 5
	help
	  NFC-A Type 4 Tag ISO-DEP NAK retry count. According to NFC Forum
	  Digital Specification 2.0 16.2.6.

config NFC_T4T_ISODEP_WTX_RETRY
	int "NFC-A Type 4 Tag S(WTX) retry"
	default 2
	range 2 5
	help
	  NFC-A Type 4 Tag ISO-DEP S(WTX) retry count. According to NFC Forum
	  Digital Specification 2.0 16.2.6.5.

config NFC_T4T_ISODEP_DESELECT_RETRY
	int "NFC-A Type 4 Tag S(DESELECT) retry"
	default 0
	range 0 5
	help
	  NFC-A Type 4 Tag ISO-DEP S(WTX) retry count. According to NFC Forum
	  Digital Specification 2.0 16.2.7.

module = NFC_T4T_ISODEP
module-str = ISODEP
source "${ZEPHYR_BASE}/subsys/logging/Kconfig.template.log_config"

endif # NFC_T4T_ISODEP

config NFC_T4T_APDU
	bool "NFC Type 4 Tag APDU"
	help
	  Enable NFC Type 4 TAG APDU codec

if NFC_T4T_APDU

module = NFC_T4T_APDU
module-str = APDU
source "${ZEPHYR_BASE}/subsys/logging/Kconfig.template.log_config"

endif # NFC_T4T_APDU

config NFC_T4T_CC_FILE
	bool "NFC Type 4 Tag CC file"
	help
	  Enable NFC Type 4 TAG CC file

if NFC_T4T_CC_FILE

module = NFC_T4T_CC_FILE
module-str = CC_FILE
source "${ZEPHYR_BASE}/subsys/logging/Kconfig.template.log_config"

endif # NFC_T4T_CC_FILE

config NFC_T4T_HL_PROCEDURE
	bool "NFC Type 4 Tag High Level Procedure"
	select NFC_T4T_CC_FILE
	select NFC_T4T_APDU
	select NFC_T4T_ISODEP
	help
	  Enable NFC Type 4 Tag High Level Procedure

if NFC_T4T_HL_PROCEDURE

config NFC_T4T_HL_PROCEDURE_CC_BUFFER_SIZE
	int "NFC Type 4 Tag Capability Container buffer size"
	default 64
	help
	  NFC Type 4 Tag Capability Container buffer size in bytes

config NFC_T4T_HL_PROCEDURE_APDU_BUF_SIZE
	int "NFC Type 4 Tag APDU buffer size"
	range 0 255
	default 255
	help
	  NFC Type 4 Tag APDU command buffer size in bytes

module = NFC_T4T_HL_PROCEDURE
module-str = HL_PROCEDURE
source "${ZEPHYR_BASE}/subsys/logging/Kconfig.template.log_config"

endif # NFC_T4T_HL_PROCEDURE
```

## subsys/nfc/tnep/Kconfig
```kconfig
#
# Copyright (c) 2019 Nordic Semiconductor ASA
#
# SPDX-License-Identifier: LicenseRef-BSD-5-Clause-Nordic
#

config NFC_TNEP_TAG
	bool "Tag NDEF Exchange Protocol."
	select NFC_NDEF
	select NFC_NDEF_MSG
	select NFC_NDEF_TNEP_RECORD
	select NFC_NDEF_PARSER
	help
	  Enable TAG NDEF Exchange Protocol

if NFC_TNEP_TAG

config NFC_TNEP_RX_MAX_RECORD_CNT
	int "Maximum count of NDEF Records in the received NDEF Message"
	default 16
	help
	  Set the maximum count of NDEF Records in the received NDEF Message

config NFC_TNEP_RX_MAX_RECORD_SIZE
	int "Maximum size of received NDEF Record"
	default 64
	help
	  Set the maximum size of received NDEF Record

module = NFC_TNEP_TAG
module-str = TNEP_TAG
source "${ZEPHYR_BASE}/subsys/logging/Kconfig.template.log_config"

endif # NFC_TNEP_TAG
```

## subsys/nfc/tnep/ch/Kconfig
```kconfig
#
# Copyright (c) 2020 Nordic Semiconductor ASA
#
# SPDX-License-Identifier: LicenseRef-Nordic-5-Clause
#

config NFC_TNEP_CH
	bool "NFC TNEP Connection Handover"
	select NFC_NDEF_CH_MSG
	select NFC_NDEF_CH_PARSER
	help
	  Enable NFC TNEP Connection Handover service

if NFC_TNEP_CH

if NFC_TNEP_TAG

config NFC_TNEP_CH_MAX_NDEF_SIZE
	int "Maximum TNEP NDEF Message size"
	default 1024
	help
	  The maximum NDEF Message size for the Connection Handover Service.
	  The NFC Tag Device can limit the maximum NDEF message size for each
	  of its offered Services. The maximum NDEF message size is equal to
	  or smaller than the maximum NDEF message size that fits in the data
	  area announced during the NDEF Detection Procedure.

config NFC_TNEP_CH_MIN_WAIT_TIME
	int "Minimum waiting time"
	default 44
	range 0 63
	help
	  The minimum waiting time measured. The minimum waiting time is the
	  time measured between the end of the last write command of an NDEF
	  Write Procedure and the start of the first command of the first
	  NDEF Read.

config NFC_TNEP_CH_MAX_TIME_EXTENSION
	int "Maximum number of Waiting Time Extension"
	default 2
	range 0 15
	help
	  The maximum number of requested waiting time extensions. The TNEP
	  Tag Device can request more time for NDEF data processing when
	  Tag Device is not responding with the NDEF Message.

endif # NFC_TNEP_TAG

if NFC_TNEP_POLLER

config NFC_TNEP_CH_POLLER_RX_BUF_SIZE
	int "Connection Handover Poller receive buffer size"
	default 256
	help
	  Size of the Poller receive buffer.

endif # NFC_TNEP_POLLER

config NFC_TNEP_CH_MAX_RECORD_COUNT
	int "Maximum Record count in received NDEF Message"
	default 3 if NFC_TNEP_POLLER
	default 2
	help
	  The maximum expected NDEF Records count in received main NDEF
	  Message.

config NFC_TNEP_CH_MAX_LOCAL_RECORD_COUNT
	int "Maximum local Records count in the nested Connection Handover Message"
	default 2
	help
	  The maximum expected local NDEF Record count in the nested Connection
	  Handover Message.

config NFC_TNEP_CH_PARSER_BUFFER_SIZE
	int "Connection Handover parser buffer size"
	default 512
	help
	  Size of the Connection Handover parser buffer.

module = NFC_TNEP_CH
module-str = TNEP_CH
source "${ZEPHYR_BASE}/subsys/logging/Kconfig.template.log_config"

endif # NFC_TNEP_CH
```
