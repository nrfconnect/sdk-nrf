## subsys/net/lib/srest_client_lib/Kconfig
```kconfig
# Copyright (c) 2021 Nordic Semiconductor
#
# SPDX-License-Identifier: LicenseRef-Nordic-5-Clause
#

menuconfig SREST_CLIENT_LIB
	bool "Simple/Stupid REST client lib"

if SREST_CLIENT_LIB

config SREST_CLIENT_LIB_SEND_TIMEOUT
	int "Socket send timeout, in seconds"
	default 60
	help
	  Sets the timeout duration in seconds to use when sending data.
	  To disable, set the timeout duration to -1.

config SREST_CLIENT_LIB_RECV_TIMEOUT
	int "Socket receive timeout, in seconds"
	default 60
	help
	  Sets the timeout duration in seconds to use when receiving data.
	  To disable, set the timeout duration to -1.

module=SREST_CLIENT_LIB
module-dep=LOG
module-str=Log level for sREST client lib
module-help=Enables sREST client lib log messages.
source "${ZEPHYR_BASE}/subsys/logging/Kconfig.template.log_config"

endif # SREST_CLIENT_LIB
```

## subsys/net/lib/tls_credentials/Kconfig
```kconfig
# Copyright (c) 2025 Nordic Semiconductor
#
# SPDX-License-Identifier: LicenseRef-Nordic-5-Clause
#

if TLS_CREDENTIALS

config TLS_MAX_CREDENTIALS_NUMBER
	# Increase default maximum number of TLS credentials that can be registered.
	default 20 if TLS_CREDENTIALS_BACKEND_NRF_MODEM

choice TLS_CREDENTIALS_BACKEND
	depends on TLS_CREDENTIALS
	default TLS_CREDENTIALS_BACKEND_NRF_MODEM if NRF_MODEM_LIB
	help
	  TLS credentials management backend implementation.

config TLS_CREDENTIALS_BACKEND_NRF_MODEM
	bool "Use modem credentials storage as backend"
	depends on MODEM_KEY_MGMT
	help
	  TLS credentials management backend using the nrf modem key management API to store
	  credentials and keep entries across system reboot.
	  Entries are loaded from the modem at boot, and can then be used in socket connections.

endchoice

endif # TLS_CREDENTIALS
```

## subsys/net/lib/wifi_credentials/Kconfig
```kconfig
#
# Copyright (c) 2022 Nordic Semiconductor
#
# SPDX-License-Identifier: LicenseRef-Nordic-5-Clause
#

menuconfig WIFI_CREDENTIALS
	bool "WIFI credentials management"
	help
	  Enable WiFi credentials management subsystem.

if WIFI_CREDENTIALS

module = WIFI_CREDENTIALS
module-str = wifi_credentials
source "subsys/logging/Kconfig.template.log_config"

choice WIFI_CREDENTIALS_BACKEND
	prompt "WiFi credentials backend"
	default WIFI_CREDENTIALS_BACKEND_SETTINGS
	help
	  Selects whether to use PSA Protected Storage or the Zephyr settings subsystem
	  for credentials storage.

config WIFI_CREDENTIALS_BACKEND_SETTINGS
	bool "Zephyr Settings"
	depends on SETTINGS
	depends on !SETTINGS_NONE

config WIFI_CREDENTIALS_BACKEND_PSA
	bool "PSA Protected Storage"
	depends on BUILD_WITH_TFM && !TFM_PROFILE_TYPE_MINIMAL

endchoice

config WIFI_CREDENTIALS_MAX_ENTRIES
	int "Number of supported WiFi credentials"
	default 2
	help
	  This detemines how many different WiFi networks can be configured at a time.

config WIFI_CREDENTIALS_SAE_PASSWORD_LENGTH
	int "Max. length of SAE password"
	default 128
	help
	  There is no official limit on SAE password length,
	  but for example Linux 6.0 has a hardcoded limit of 128 bytes.

config WIFI_CREDENTIALS_SHELL
	bool "Shell commands to manage Wi-Fi credentials"
	default y
	depends on SHELL

endif # WIFI_CREDENTIALS

if WIFI_CREDENTIALS_BACKEND_PSA

config WIFI_CREDENTIALS_BACKEND_PSA_UID_OFFSET
	int "Protected Storage UID offset"
	default 3586949806
	help
	  This library will use WIFI_CREDENTIALS_MAX_ENTRIES entries starting with the
	  WIFI_CREDENTIALS_BACKEND_PSA_UID_OFFSET uid.

endif # WIFI_CREDENTIALS_BACKEND_PSA

config WIFI_CREDENTIALS_STATIC
	bool "Static Wi-Fi network configuration"

if WIFI_CREDENTIALS_STATIC

config WIFI_CREDENTIALS_STATIC_SSID
	string "SSID of statically configured WiFi network"

config WIFI_CREDENTIALS_STATIC_PASSWORD
	string "Password of statically configured Wi-Fi network"
	default ""

choice WIFI_CREDENTIALS_STATIC_TYPE
	prompt "Static Wi-Fi network security type"
	default WIFI_CREDENTIALS_STATIC_TYPE_PSK

config WIFI_CREDENTIALS_STATIC_TYPE_OPEN
	bool "OPEN"

config WIFI_CREDENTIALS_STATIC_TYPE_PSK
	bool "WPA2-PSK"

config WIFI_CREDENTIALS_STATIC_TYPE_PSK_SHA256
	bool "WPA2-PSK-SHA256"

config WIFI_CREDENTIALS_STATIC_TYPE_SAE
	bool "SAE"

endchoice

endif
```

## subsys/net/lib/wifi_keys/Kconfig
```kconfig
#
# Copyright (c) 2026 Nordic Semiconductor
#
# SPDX-License-Identifier: LicenseRef-Nordic-5-Clause
#

config WIFI_KEYS_DRIVER
	bool "Wi-Fi Keys driver"
    default y
	imply NRF_WIFI_KMU
	help
	  Driver for Wi-Fi security key management.
	  This driver handles cryptographic keys for Wi-Fi security
	  using KMU (Key Management Unit) slots on nRF71 series devices.
```

## subsys/net/lib/wifi_mgmt_ext/Kconfig
```kconfig
#
# Copyright (c) 2023 Nordic Semiconductor
#
# SPDX-License-Identifier: LicenseRef-Nordic-5-Clause
#

config WIFI_MGMT_EXT
	bool "Extended commands for Wi-Fi management"
	depends on WIFI_NM_WPA_SUPPLICANT
	depends on WIFI_CREDENTIALS
	default y
	help
	  Extends Wi-Fi L2 stack by commands to handle
	  automatic connection management.

config WIFI_CREDENTIALS_SHELL_AUTOCONNECT
	bool "Shell commands to manage Wi-Fi credentials"
	default y
	depends on WIFI_CREDENTIALS_SHELL
	depends on WIFI_MGMT_EXT

if WIFI_MGMT_EXT

config WIFI_MGMT_EXT_CONNECTION_TIMEOUT
	int "Connection timeout"
	default 30
	help
	   Wait period before falling back to the next entry in the list of stored SSIDs.

module = WIFI_MGMT_EXT
module-str = wifi_mgmt_ext
source "subsys/logging/Kconfig.template.log_config"

endif
```

## subsys/net/lib/wifi_prov_core/Kconfig
```kconfig
#
# Copyright (c) 2025 Nordic Semiconductor
#
# SPDX-License-Identifier: LicenseRef-Nordic-5-Clause
#

config WIFI_PROV_CORE
	bool "Wi-Fi provisioning core library"
	select EXPERIMENTAL
	depends on WIFI_NM_WPA_SUPPLICANT
	depends on NET_MGMT
	help
	  Enable the Wi-Fi provisioning core subsystem that provides
	  APIs and infrastructure for Wi-Fi provisioning, including
	  configuration management and event handling.

	  This library is required for Wi-Fi provisioning workflows
	  and should be enabled when using Wi-Fi provisioning features.

module = WIFI_PROV_CORE
module-dep = LOG
module-str = Log level for sample
source "$(ZEPHYR_BASE)/subsys/logging/Kconfig.template.log_config"
```

## subsys/net/lib/wifi_provision/Kconfig
```kconfig
#
# Copyright (c) 2024 Nordic Semiconductor ASA
#
# SPDX-License-Identifier: LicenseRef-Nordic-5-Clause
#

menuconfig WIFI_PROVISION
	bool "Wifi provision"
	select NANOPB
	select NRF700X_AP_MODE
	select WPA_SUPP_AP
	select SMF
	select NET_DHCPV4_SERVER
	select NET_CONFIG_SETTINGS
	select TLS_CREDENTIALS
	select WIFI_CREDENTIALS
	select HTTP_PARSER
	select HTTP_PARSER_URL
	select NET_SOCKETS_SOCKOPT_TLS

if WIFI_PROVISION

config WIFI_PROVISION_SSID
	string "SSID"
	default "mobileappsrules"

config WIFI_PROVISION_CERTIFICATE_SEC_TAG
	int "TLS credentials storage security tag"
	default 88

config WIFI_PROVISION_TCP_PORT
	int "TCP port number"
	default 443

module = WIFI_PROVISION
module-str = Wi-Fi provision
source "${ZEPHYR_BASE}/subsys/logging/Kconfig.template.log_config"

endif # WIFI_PROVISION
```

## subsys/net/lib/wifi_ready/Kconfig
```kconfig
#
# Copyright (c) 2024 Nordic Semiconductor
#
# SPDX-License-Identifier: LicenseRef-Nordic-5-Clause
#

menuconfig WIFI_READY_LIB
	bool "Wi-Fi ready event handling library"
	select EXPERIMENTAL
	depends on WIFI_NM_WPA_SUPPLICANT
	depends on NET_MGMT
	help
	  Enable WiFi ready management subsystem that allows the application to
	  register callbacks that are called when the WiFi is ready to be used and
	  when the WiFi is not ready to be used.

if WIFI_READY_LIB

module = WIFI_READY_LIB
module-str = wifi_ready_lib
source "subsys/logging/Kconfig.template.log_config"

config WIFI_READY_MAX_CALLBACKS
	int "Maximum number of Wi-Fi ready callbacks"
	default 2
	help
	  Set the maximum number of Wi-Fi ready callbacks that can be registered
	  by the application.

config WIFI_READY_INIT_PRIORITY
	int "Wi-Fi ready initialization priority"
	default 90
	help
	  Set the initialization priority of the Wi-Fi ready subsystem.
endif
```

## subsys/net/lib/zzhc/Kconfig
```kconfig
#
# Copyright (c) 2019 Nordic Semiconductor
#
# SPDX-License-Identifier: LicenseRef-Nordic-5-Clause
#

menu "Self-Registration (Zi ZHu Ce)"

config ZZHC
	bool "Self-Registration Daemon"
	depends on TRUSTED_EXECUTION_NONSECURE
	depends on NRF_MODEM_LIB
	depends on SETTINGS
	select AT_CMD_PARSER
	select AT_MONITOR
	select BASE64
	select JSON_LIBRARY

if ZZHC

config ZZHC_STACK_SIZE
	int "Background thread Stack size"
	default 2048

config ZZHC_THREAD_PRIO
	int "Background thread priority level"
	range 0 NUM_PREEMPT_PRIORITIES
	default 0 if !MULTITHREADING
	default 10

module = ZZHC
module-str = ZZHC Daemon
source "${ZEPHYR_BASE}/subsys/logging/Kconfig.template.log_config"

endif # ZZHC

endmenu
```

## subsys/net/openthread/Kconfig
```kconfig
# Copyright (c) 2020 Nordic Semiconductor
#
# SPDX-License-Identifier: LicenseRef-Nordic-5-Clause
#

# The purpose of this file is to override and extend settings related to
# building Thread from sources. It extends the zephyrs openthread Kconfig file.
# Separate Kconfig exists in nrfxlib repository responsible solely for managing
# OpenThread precompiled libraries.

if NET_L2_OPENTHREAD

menu "OpenThread"

config NORDIC_SECURITY_PROMPTLESS
	bool
	default y if !CUSTOM_OPENTHREAD_SECURITY

choice OPENTHREAD_SECURITY
	depends on !OPENTHREAD_SECURITY_INTERNAL

config OPENTHREAD_NRF_SECURITY_PSA_CHOICE
	bool "nRF Security with PSA crypto enabled"
	select OPENTHREAD_NRF_SECURITY_PSA

config OPENTHREAD_NRF_SECURITY_CHOICE
	bool "nRF Security"
	select OPENTHREAD_NRF_SECURITY

endchoice

config OPENTHREAD_NRF_SECURITY_PSA
	bool
	select EXPERIMENTAL
	select NRF_SECURITY
	select MBEDTLS_ENABLE_HEAP
	select MBEDTLS_TLS_LIBRARY if (OPENTHREAD_JOINER || OPENTHREAD_COMMISSIONER || OPENTHREAD_COAPS)
	select PSA_WANT_ALG_HKDF
	select PSA_WANT_ALG_CCM
	select PSA_WANT_ALG_CMAC
	select PSA_WANT_ALG_HMAC
	select PSA_WANT_ALG_ECB_NO_PADDING
	select PSA_WANT_ALG_SHA_224
	select PSA_WANT_ALG_SHA_256
	select PSA_WANT_ALG_GCM if OPENTHREAD_BLE_TCAT
	select PSA_WANT_ALG_JPAKE  if (OPENTHREAD_JOINER || OPENTHREAD_COMMISSIONER)
	select PSA_WANT_ALG_TLS12_ECJPAKE_TO_PMS  if (OPENTHREAD_JOINER || OPENTHREAD_COMMISSIONER)
	select PSA_WANT_ALG_DETERMINISTIC_ECDSA if OPENTHREAD_ECDSA
	select PSA_WANT_ALG_ECDSA if OPENTHREAD_ECDSA
	select PSA_WANT_ALG_ECDH if OPENTHREAD_ECDSA
	select PSA_WANT_ECC_SECP_R1_256
	select PSA_WANT_GENERATE_RANDOM
	select PSA_WANT_KEY_TYPE_AES
	select PSA_WANT_KEY_TYPE_ECC_KEY_PAIR
	imply OPENTHREAD_CRYPTO_PSA
	help
	  Enables nrf_security module for use by OpenThread with PSA Crypto enabled.
	  This allows OpenThread to make use of hardware accelerated cryptography
	  functions if available as well as fast oberon backend for software encryption.

config OPENTHREAD_NRF_SECURITY_PSA
	bool
	select MBEDTLS_PSA_CRYPTO_STORAGE_C
	select SECURE_STORAGE
# SECURE_STORAGE requires Settings
	select SETTINGS
	depends on !BUILD_WITH_TFM

choice SECURE_STORAGE_BACKEND_AEAD_KEY
# Temporarily use hash of UID as AEAD Key implementation
# until Hardware Unique Key provisioning (more secure) is implemented
	default SECURE_STORAGE_BACKEND_AEAD_KEY_HASH_UID if OPENTHREAD_NRF_SECURITY_PSA

endchoice # SECURE_STORAGE_BACKEND_AEAD_KEY

config OPENTHREAD_NRF_SECURITY
	bool
	select MBEDTLS_AES_C
	select MBEDTLS_ENABLE_HEAP
	select MBEDTLS_CCM_C
	select MBEDTLS_CMAC_C
	select MBEDTLS_CTR_DRBG_C
	select MBEDTLS_ECDH_C if OPENTHREAD_ECDSA
	select MBEDTLS_ECDSA_C if OPENTHREAD_ECDSA
	select MBEDTLS_PK_C if OPENTHREAD_ECDSA
	select MBEDTLS_PK_WRITE_C if OPENTHREAD_ECDSA
	select MBEDTLS_ECJPAKE_C if (OPENTHREAD_JOINER || OPENTHREAD_COMMISSIONER)
	select MBEDTLS_ECP_C
	select MBEDTLS_ECP_DP_SECP256R1_ENABLED
	select MBEDTLS_HMAC_DRBG_C
	select MBEDTLS_TLS_LIBRARY if (OPENTHREAD_JOINER || OPENTHREAD_COMMISSIONER || OPENTHREAD_COAPS)
	select NORDIC_SECURITY_BACKEND
	select NRF_SECURITY_ADVANCED
	select OBERON_BACKEND if !CC3XX_BACKEND
	help
	  Enables nrf_security module for use by OpenThread. This allows
	  OpenThread to make use of hardware accelerated cryptography functions
	  if available as well as fast oberon backend for software encryption.

config OPENTHREAD_MBEDTLS_LIB_NAME
	default "mbedtls_external" if OPENTHREAD_NRF_SECURITY || OPENTHREAD_NRF_SECURITY_PSA

config OPENTHREAD_MBEDTLS_DEBUG
	bool "MbedTLS logs for OpenThread"
	select MBEDTLS
	select MBEDTLS_DEBUG
	select MBEDTLS_DEBUG_C

config OPENTHREAD_THREAD_STACK_SIZE
	int "OpenThread thread stack size"
	default 6240 if OPENTHREAD_COMMISSIONER || OPENTHREAD_JOINER
	default 3168

config OPENTHREAD_RADIO_WORKQUEUE_STACK_SIZE
	int "OpenThread radio transmit workqueue stack size"
	default 1084 if SOC_NRF5340_CPUAPP
	default 1024

choice TFM_PROFILE_TYPE
	default TFM_PROFILE_TYPE_NOT_SET
endchoice

endmenu

endif
```
