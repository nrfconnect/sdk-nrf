## subsys/net/openthread/Kconfig.defconfig
```kconfig
# Copyright (c) 2021 Nordic Semiconductor
#
# SPDX-License-Identifier: LicenseRef-Nordic-5-Clause
#

# The purpose of this file is to define new default values of settings related
# to building Thread from sources.
# This file only changes defaults and thus all symbols here must be prompltless
# and safeguarded so that they only are applied when building Thread.

if OPENTHREAD

choice OPENTHREAD_STACK_VERSION
	default OPENTHREAD_THREAD_VERSION_1_4
endchoice

config OPENTHREAD_LIBRARY_AVAILABLE
	bool
	# Switch:
	# - To `y` when libraries for the current OpenThread revision are provided
	# - To `n` on the next OpenThread upmerge
	default y
	depends on OPENTHREAD_THREAD_VERSION_1_4
	depends on (OPENTHREAD_NORDIC_LIBRARY_MASTER && (SOC_NRF52840 || SOC_SERIES_NRF54L)) || \
		    OPENTHREAD_NORDIC_LIBRARY_FTD || OPENTHREAD_NORDIC_LIBRARY_MTD
	depends on !OPENTHREAD_COPROCESSOR
	depends on SOC_NRF52840 || SOC_NRF5340_CPUAPP || SOC_SERIES_NRF54L

choice OPENTHREAD_IMPLEMENTATION
	default OPENTHREAD_LIBRARY if OPENTHREAD_LIBRARY_AVAILABLE
endchoice

if (OPENTHREAD_COAPS || OPENTHREAD_BLE_TCAT)

config MBEDTLS_SSL_CLI_ALLOW_WEAK_CERTIFICATE_VERIFICATION_WITHOUT_HOSTNAME
	default y

endif

config OPENTHREAD_PLATFORM_PKT_TXTIME
	default y if NET_PKT_TXTIME
	default y if !NET_L2_OPENTHREAD

if !NET_L2_OPENTHREAD

if HAS_HW_NRF_RADIO_IEEE802154

config NRF_802154_RADIO_DRIVER
	default y

endif

if !HAS_HW_NRF_RADIO_IEEE802154

config NRF_802154_SER_HOST
	default y

endif

endif # !NET_L2_OPENTHREAD

# In nrf-sdk, the init priority should be set to 90 to ensure that the OpenThread stack is
# initialized after MPSL.
config OPENTHREAD_SYS_INIT_PRIORITY
	default 90

config OPENTHREAD_PLATFORM_CARRIER_FUNCTIONS
	default y if OPENTHREAD_DIAG && IEEE802154_CARRIER_FUNCTIONS
	default y if OPENTHREAD_DIAG && NRF5_CARRIER_FUNCTIONS

# CSL nRF configuration
config OPENTHREAD_DYNAMIC_STORE_FRAME_AHEAD_COUNTER
	default y

config OPENTHREAD_MIN_RECEIVE_ON_AHEAD
	default 104

config OPENTHREAD_MIN_RECEIVE_ON_AFTER
	default 0

config OPENTHREAD_PLATFORM_CSL_UNCERT
	default 12

config OPENTHREAD_CSL_RECEIVER_LOCAL_TIME_SYNC
	default y if NRF_802154_SER_HOST

config OPENTHREAD_CSL_TIMEOUT
	default 20

config OPENTHREAD_PING_SENDER
	default y

choice LIBC_IMPLEMENTATION
	default PICOLIBC
endchoice

config NEWLIB_LIBC_NANO
	default y if NEWLIB_LIBC

# Workaround for picolib. Currently, Zephyr does not support
# POSIX_SYSCONF_IMPL_FULL if PICOLIBC is enabled.
# Use POSIX_SYSCONF_IMPL_MACRO instead until it is fixed in Zephyr.
choice POSIX_SYSCONF_IMPL_CHOICE
	default POSIX_SYSCONF_IMPL_MACRO if PICOLIBC
endchoice

config NUM_METAIRQ_PRIORITIES
	default 1

config SYSTEM_WORKQUEUE_STACK_SIZE
	default 320 if OPENTHREAD_COPROCESSOR_RCP
	default 1120

config MAIN_STACK_SIZE
	default 1024 if OPENTHREAD_COPROCESSOR_RCP
	default 2560

config LOG_BUFFER_SIZE
	default 4048 if LOG

config INIT_STACKS
	default y

config OPENTHREAD_MANUAL_START
	default y

choice OPENTHREAD_SECURITY
	default OPENTHREAD_NRF_SECURITY_PSA_CHOICE if SOC_FAMILY_NORDIC_NRF
endchoice

config MBEDTLS_PROMPTLESS
	default n

config MBEDTLS_SSL_PROTO_DTLS
	default n if !(OPENTHREAD_JOINER || OPENTHREAD_COMMISSIONER || OPENTHREAD_COAPS || OPENTHREAD_BLE_TCAT)
	default y

config MBEDTLS_SSL_MAX_FRAGMENT_LENGTH
	default n if !(OPENTHREAD_JOINER || OPENTHREAD_COMMISSIONER || OPENTHREAD_COAPS || OPENTHREAD_BLE_TCAT)
	default y

config MBEDTLS_MPI_MAX_SIZE
	default 256

config MBEDTLS_ENTROPY_C
	default y

config MBEDTLS_CIPHER_MODE_CBC
	default n

config MBEDTLS_CIPHER_MODE_CTR
	default n

config MBEDTLS_CHACHA20_C
	default n

config MBEDTLS_POLY1305_C
	default n

config MBEDTLS_CHACHAPOLY_C
	default n

config MBEDTLS_DHM_C
	default n

config MBEDTLS_RSA_C
	default n

config MBEDTLS_SHA512_C
	default n

config MBEDTLS_GCM_C
	default n

config MBEDTLS_CIPHER_MODE_XTS
	default n

if !(OPENTHREAD_BORDER_AGENT || OPENTHREAD_COMMISSIONER || OPENTHREAD_COAPS || OPENTHREAD_BLE_TCAT)

config MBEDTLS_SSL_SRV_C
	default n

config MBEDTLS_SSL_COOKIE_C
	default n

endif # !(OPENTHREAD_BORDER_AGENT || OPENTHREAD_COMMISSIONER || OPENTHREAD_COAPS || OPENTHREAD_BLE_TCAT)

if !(OPENTHREAD_JOINER || OPENTHREAD_COMMISSIONER || OPENTHREAD_COAPS || OPENTHREAD_BLE_TCAT)

config MBEDTLS_SSL_CLI_C
	default n

config MBEDTLS_SSL_TLS_C
	default n

endif # !(OPENTHREAD_JOINER || OPENTHREAD_COMMISSIONER || OPENTHREAD_COAPS)

# Note: MBEDTLS_HEAP_SIZE value for OPENTHREAD_NRF_SECURITY_PSA is experimental.
# It might be changed in the future.
config MBEDTLS_HEAP_SIZE
	default 20360 if OPENTHREAD_BLE_TCAT
	default 15360 if OPENTHREAD_NRF_SECURITY_PSA
	default 12440 if !OPENTHREAD_NRF_SECURITY_PSA

if OPENTHREAD_COPROCESSOR_RCP

config MBEDTLS_PSA_KEY_SLOT_COUNT
	default 1

config ISR_STACK_SIZE
	default 640

config IDLE_STACK_SIZE
	default 128

config MPSL_WORK_STACK_SIZE
	default 512

endif # OPENTHREAD_COPROCESSOR_RCP

if OPENTHREAD_BLE_TCAT

config MBEDTLS_GCM_C
	default y

config MBEDTLS_SSL_OUT_CONTENT_LEN
	default 2048

config MBEDTLS_SSL_IN_CONTENT_LEN
	default 2048

config MBEDTLS_KEY_EXCHANGE_PSK_ENABLED
	default y

config OPENTHREAD_BLE_TCAT_THREAD_STACK_SIZE
	default 8196 if SOC_NRF54L15
	default 6144

endif # OPENTHREAD_BLE_TCAT

config OPENTHREAD_NUM_MESSAGE_BUFFERS
	range 96 65535 if OPENTHREAD_FTD
	range 64 65535
	default 96 if OPENTHREAD_FTD
	default 64

# File system configuration
if SOC_FLASH_NRF_RRAM || SOC_FLASH_NRF_MRAM

config ZMS
	default y

config ZMS_LOOKUP_CACHE
	default y

config ZMS_LOOKUP_CACHE_SIZE
	default 512

config ZMS_LOOKUP_CACHE_FOR_SETTINGS
	default y

endif

if !(SOC_FLASH_NRF_RRAM || SOC_FLASH_NRF_MRAM)

config NVS
	default y

config NVS_LOOKUP_CACHE
	default y

config NVS_LOOKUP_CACHE_SIZE
	default 512

config NVS_LOOKUP_CACHE_FOR_SETTINGS
	default y

endif

if !OPENTHREAD_THREAD_VERSION_1_1

# Thread 1.2 dependencies
config NRF_802154_ENCRYPTION
	default y

endif # !OPENTHREAD_THREAD_VERSION_1_1
endif # OPENTHREAD

rsource "Kconfig.defconfig.l2"
```

## subsys/net/openthread/Kconfig.defconfig.l2
```kconfig
# Copyright (c) 2025 Nordic Semiconductor
#
# SPDX-License-Identifier: LicenseRef-Nordic-5-Clause
#

# The purpose of this file is to define new default values of settings related
# to building Thread from sources.
# This file only changes defaults related to the Zephyr L2 layer.

if NET_L2_OPENTHREAD

config NET_IPV6_NBR_CACHE
	default n

config NET_IPV6_MLD
	default n

config NET_PKT_RX_COUNT
	default 4 if OPENTHREAD_COPROCESSOR_RCP
	default 10

config NET_PKT_TX_COUNT
	default 4 if OPENTHREAD_COPROCESSOR_RCP
	default 16

if !OPENTHREAD_THREAD_VERSION_1_1

config NET_PKT_TXTIME
	default y

config NET_PKT_TIMESTAMP
	default y

# CSL Transmitter configuration
config IEEE802154_NRF5_DELAY_TRX_ACC
	default 50 if BOARD_NRF52840DONGLE_NRF52840 || BOARD_NRF54L15DK
	default 20

config IEEE802154_CSL_ENDPOINT
	default y if OPENTHREAD_CSL_RECEIVER

endif # !OPENTHREAD_THREAD_VERSION_1_1

if OPENTHREAD_COPROCESSOR_RCP

config NET_RX_STACK_SIZE
	default 300

config NET_TX_STACK_SIZE
	default 300

endif # OPENTHREAD_COPROCESSOR_RCP

endif # NET_L2_OPENTHREAD
```

## subsys/net/openthread/dns_offload/Kconfig
```kconfig
# Copyright (c) 2026 Nordic Semiconductor ASA
#
# SPDX-License-Identifier: LicenseRef-Nordic-5-Clause

config OPENTHREAD_ZEPHYR_DNS_OFFLOAD
	bool "Zephyr DNS offload using OpenThread DNS client"
	depends on NET_SOCKETS_OFFLOAD
	depends on OPENTHREAD_DNS_CLIENT || OPENTHREAD_RPC_CLIENT
	help
	  Builds ot_dns_offload_register(), which registers a Zephyr DNS offload
	  path that uses the OpenThread DNS client (IPv4 A via NAT64 first, then
	  IPv6 AAAA) and returns IPv6-only results for getaddrinfo().

if OPENTHREAD_ZEPHYR_DNS_OFFLOAD

config OPENTHREAD_ZEPHYR_DNS_OFFLOAD_SYS_INIT
	bool "Auto-register OpenThread DNS offload via SYS_INIT"
	default y
	help
	  Automatically register the OpenThread DNS offload at system initialization
	  by calling ot_dns_offload_register() via SYS_INIT.

config OPENTHREAD_ZEPHYR_DNS_OFFLOAD_SYS_INIT_PRIORITY
	int "OpenThread DNS offload SYS_INIT priority"
	depends on OPENTHREAD_ZEPHYR_DNS_OFFLOAD_SYS_INIT
	default 91
	help
	  Priority level for the SYS_INIT call that registers the OpenThread DNS
	  offload.

endif # OPENTHREAD_ZEPHYR_DNS_OFFLOAD
```

## subsys/net/openthread/otperf/Kconfig
```kconfig
# Copyright (c) 2026 Nordic Semiconductor ASA
#
# SPDX-License-Identifier: LicenseRef-Nordic-5-Clause

menuconfig OTPERF
	bool "otperf tool"
	depends on OPENTHREAD
	help
	  This option enables otperf library, which allows to generate network traffic and evaluate
	  network bandwidth in conjunction with other devices running otperf, zperf or a desktop
	  running the iperf2 utility.

if OTPERF

module = OTPERF
module-str = otperf
source "subsys/logging/Kconfig.template.log_config"

config OTPERF_SHELL
	bool "otperf shell command"
	default y
	depends on SHELL
	help
	  Enables the otperf shell interface, allowing interactive use of various otperf commands.
	  With the commands, you can send and receive UDP packets, measure throughput and latency
	  as well as analyse network performance.
	  To see the complete list of available otperf UDP commands and usage details, enter
	  "otperf udp help" in the shell.


config OTPERF_MAX_PACKET_SIZE
	int "Maximum packet size"
	range 40 65535
	default 1064
	help
	  Upper size limit for packets sent by otperf. Default allows for a 1kB
	  payload with the 40 byte iperf UDP client header.

config OTPERF_SERVER
	bool "otperf server support"
	default y
	help
	  Support running a otperf server for testing downloads from the application

config OTPERF_MAX_SESSIONS
	int "Maximum number of otperf sessions"
	depends on OTPERF_SERVER
	default 4
	help
	  Upper size limit for connections handled by otperf.

config OTPERF_UDP_REPORT_RETRANSMISSION_COUNT
	int "Maximum number of UDP upload report retransmissions"
	range 0 16
	default 4
	help
	  Maximum number of retries otperf will take to retrieve the UDP upload
	  report from the server. `0` means the report will not be requested
	  at all, which is useful for testing purposes.

config OTPERF_DEFAULT_PORT
	int "Default port used by the tool"
	default 5001
	help
	  Default port will be used when no port is specified

config OTPERF_DEFAULT_DURATION_S
	int "Default duration in seconds of the session"
	default 1
	help
	  Default duration in seconds that is used when no other value is specified

config OTPERF_DEFAULT_PACKET_SIZE
	int "Default packet size"
	default 256
	help
	  Default size of packets sent by the tool during upload
	  used when no other value is specified

config OTPERF_DEFAULT_RATE_KBPS
	int "Default data rate in Kbps"
	default 50
	help
	  Default data rate in Kbits per second used when no other value is specified

endif
```

## subsys/net/openthread/report/Kconfig
```kconfig
# Copyright (c) 2024 Nordic Semiconductor
#
# SPDX-License-Identifier: LicenseRef-Nordic-5-Clause
#

menuconfig OPENTHREAD_REPORT
	bool "OpenThread report generation"
	default y
	depends on NET_L2_OPENTHREAD
	help
	  Enables report generation that contains the OpenThread version,
	  NCS revision, OpenThread library build information, List of enabled
	  Thread features, the diff of nrfxlib directory between the NCS release
	  version (TAG) and the version that is used by a customer.
	  The report will be stored as a build artefact (separate .txt file),
	  or printed to console.

config OPENTHREAD_REPORT_BUILD_ARTEFACT_NAME
	string "Name of the report .txt file build artefact"
	depends on OPENTHREAD_REPORT
	default "ot_report.txt"
	help
	  Set the name of the report .txt build artefact.
```

## subsys/net/openthread/rpc/Kconfig
```kconfig
#
#
# Copyright (c) 2024 Nordic Semiconductor
#
# SPDX-License-Identifier: LicenseRef-Nordic-5-Clause
#

menuconfig OPENTHREAD_RPC
	bool "OpenThread over RPC [EXPERIMENTAL]"
	select NRF_RPC
	select NRF_RPC_CBOR
	select EXPERIMENTAL
	help
	  Enables OpenThread serialization over RPC

if OPENTHREAD_RPC

config OPENTHREAD_RPC_DNS_MAX_TXT_DATA_SIZE
	int "Maximum size of TXT data that can be serialized by DNS API"
	default 255
	help
	  During serialization of a service information the server must allocate
	  a stack allocated buffer for storing TXT data. This value controls the
	  buffer size.

choice OPENTHREAD_RPC_ROLE_CHOICE
	prompt "OpenThread over RPC role selection"
	default OPENTHREAD_RPC_CLIENT
	help
	  Selects the device role for OpenThread over RPC. The default role is
	  a client role.

config OPENTHREAD_RPC_CLIENT
	bool "OpenThread over RPC client"
	help
	  Enables OpenThread over RPC client role that uses nRF RPC library to
	  invoke OpenThread functions on the remote core.

config OPENTHREAD_RPC_SERVER
	bool "OpenThread over RPC server"
	depends on OPENTHREAD || ZTEST
	depends on !NET_L2_OPENTHREAD
	help
	  Enables OpenThread over RPC server role that runs the full OpenThread
	  stack and exposes OpenThread functions using nRF RPC library to a client
	  running on the remote core.

endchoice

config OPENTHREAD_RPC_NET_IF
	bool "OpenThread over RPC network interface"
	default y
	help
	  Enables OpenThread RPC commands for sending and receiving IPv6 packets
	  to/from the OpenThread stack. For the RPC client role, it additionally
	  creates a Zephyr network interface that employs these commands.

menu "OpenThread over RPC client configuration"
	depends on OPENTHREAD_RPC_CLIENT

config OPENTHREAD_RPC_CLIENT_NUM_SENT_COAP_REQUESTS
	int "Maximum number of ongoing sent CoAP messages"
	default 8
	help
	  Defines the number of slots for storing a callback along with its context
	  for ongoing CoAP requests awaiting a response.

config OPENTHREAD_RPC_CLIENT_RADIO_TIME_REFRESH_PERIOD
	int "Radio time sync period [s]"
	default 30
	help
	  Defines how frequently the RPC client shall read the RPC server's
	  radio time instead of extrapolating it from the last reading and the
	  current local time. The purpose of this setting is to reduce the RPC
	  traffic given that otLinkRawGetRadioTime() may be used extensively by
	  the application.

endmenu # "OpenThread over RPC client configuration"

menu "OpenThread over RPC server configuration"
	depends on OPENTHREAD_RPC_SERVER

config OPENTHREAD_RPC_MESSAGE_POOL
	int "Maximum number of messages key identifiers that can be allocated on server"
	default 8
	help
	  Defines maximum number of messages key indentifiers that can be allocated on server at
	  the same time.

config OPENTHREAD_RPC_ERASE_SETTINGS
	bool "Erase settings partition on factory reset"
	depends on SETTINGS_NVS || SETTINGS_ZMS
	help
	  Erase the entire settings partition when otInstanceFactoryReset() is invoked
	  using a remote procedure call.

endmenu # "OpenThread over RPC server configuration"

config OPENTHREAD_RPC_INITIALIZE_NRF_RPC
	bool "Automatically initialize nRF RPC library"
	default n
	help
	  Initialize nRF RPC library during the system startup. Disabling this
	  option allow user to initialize it in a different way.

endif # OPENTHREAD_RPC
```
