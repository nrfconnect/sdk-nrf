## sysbuild/Kconfig.mcuboot
```kconfig
# Copyright (c) 2023 Nordic Semiconductor
#
# SPDX-License-Identifier: LicenseRef-Nordic-5-Clause

menu "MCUboot configuration"
	depends on BOOTLOADER_MCUBOOT

config MCUBOOT_SIGN_MERGED_BINARY
	bool "Sign single, merged update package [EXPERIMENTAL]"
	default y if (MCUBOOT_MODE_DIRECT_XIP || MCUBOOT_MODE_DIRECT_XIP_WITH_REVERT)
	default y if MCUBOOT_MODE_FIRMWARE_UPDATER
	depends on SOC_NRF54H20
	select EXPERIMENTAL

config MCUBOOT_IMAGES_ROM_END_OFFSET_AUTO
	string "Images that should have automatically calculated ROM end offset"
	default ""
	depends on SOC_NRF54H20
	help
	  Enable automatic calculation of the ROM end offset based on the
	  bootloader configuration as well as the image size.
	  This setting should be a semicolon-separated list of image names
	  (e.g. "smp_svr;ipc_radio", "mcuboot_secondary_app").
	  If empty the default set of updateable images will be affected.

config MCUBOOT_MANIFEST_UPDATES
	bool "Manifest-based updates"
	depends on SOC_NRF54H20
	depends on (MCUBOOT_UPDATEABLE_IMAGES > 1) && (MCUBOOT_MODE_DIRECT_XIP || MCUBOOT_MODE_DIRECT_XIP_WITH_REVERT)
	help
	  When enabled, supports transactional updates using manifests.
	  This allows multiple images to be updated atomically. The manifest
	  is a separate TLV which contains a list of images to update and
	  their expected hash values. The manifest TLV is a part of an image
	  that is signed to prevent tampering.
	  The manifest must be transferred as part of the image with index 0.
	  It can be a dedicated image, or part of an existing image.
	  If the second option is selected, all updates must contain an update
	  for image 0.

if MCUBOOT_MANIFEST_UPDATES

config MCUBOOT_MANIFEST_IMAGE_INDEX
	int "Index of the image that must include manifest"
	default 0
	range 0 MCUBOOT_UPDATEABLE_IMAGES
	help
	  Specifies the index of the image that must include the manifest.

endif # MCUBOOT_MANIFEST_UPDATES

config MCUBOOT_BUILD_DIRECT_XIP_VARIANT
	bool "Build DirectXIP variant image"
	depends on MCUBOOT_MODE_DIRECT_XIP || MCUBOOT_MODE_DIRECT_XIP_WITH_REVERT
	default y
	help
	  Will build the alternative slot (variant) image of the main application.

menuconfig MCUBOOT_HARDWARE_DOWNGRADE_PREVENTION
	bool "Downgrade prevention using hardware security counters"
	depends on (SOC_NRF5340_CPUAPP || SOC_SERIES_NRF91 || SOC_SERIES_NRF54L || SOC_SERIES_NRF54H)
	depends on !SECURE_BOOT_APPCORE
	depends on !QSPI_XIP_SPLIT_IMAGE
	help
	  This option can be enabled by the application and will ensure that the
	  MCUBOOT_HW_DOWNGRADE_PREVENTION Kconfig option is enabled in the MCUboot image.

	  Note that this can only be used on first image, it will not be applied to the second
	  image (network core updates) on nRF5340 which will use software downgrade protection
	  on the network core CPU instead.

if MCUBOOT_HARDWARE_DOWNGRADE_PREVENTION

config MCUBOOT_HW_DOWNGRADE_PREVENTION_COUNTER_SLOTS
	int "Number of available hardware counter slots"
	default 240
	range 2 288 if SOC_SERIES_NRF54L
	range 2 300
	depends on !SOC_SERIES_NRF54H
	help
	  When MCUBOOT_HW_DOWNGRADE_PREVENTION is enabled, MCUboot will use one hardware counter
	  for each updatable image (UPDATEABLE_IMAGE_NUMBER). This configuration specifies how many
	  counter slots will be allocated for each hardware counter. The hardware counters are
	  stored in OTP storage. The rationale for the default number (240): Assume one update a
	  month for 10 years, then double that value just in case. This default fits comfortably
	  within the OTP region of UICR.

config MCUBOOT_HW_DOWNGRADE_PREVENTION_COUNTER_VALUE
	int "Security counter value"
	default 1
	range 1 65535 if !SOC_SERIES_NRF54H
	range 1 4294967295 if SOC_SERIES_NRF54H
	help
	  The security counter value for this image.
	  This is the value that will be passed to the --security-counter parameter of imgtool.py

endif # MCUBOOT_HARDWARE_DOWNGRADE_PREVENTION

config MCUBOOT_COMPRESSED_IMAGE_SUPPORT
	bool "Compressed image support"
	depends on MCUBOOT_MODE_OVERWRITE_ONLY
	help
	  When enabled, supports loading compressed images using LZMA2 to the secondary slot which
	  will then be decompressed and loaded to the primary slot.

config MCUBOOT_EXTRA_IMAGES
	int "Extra images"
	default 0
	range 0 2
	depends on !MCUBOOT_MODE_SINGLE_APP

config MCUBOOT_MAX_UPDATEABLE_IMAGES
	int
	default 1 if MCUBOOT_MODE_SINGLE_APP
	default 6 if MCUBOOT_EXTRA_IMAGES > 1
	default 5 if MCUBOOT_EXTRA_IMAGES > 0
	default 4

config MCUBOOT_NETWORK_CORE_HAS_UPDATE_SLOT
	bool
	default y if NETCORE_APP_UPDATE && !MCUBOOT_MODE_SINGLE_APP
	default y if !NETCORE_NONE && (SOC_NRF54H20 && !MCUBOOT_SIGN_MERGED_BINARY)

config MCUBOOT_WIFI_PATCHES_HAS_UPDATE_SLOT
	bool
	default y if WIFI_PATCHES_EXT_FLASH_XIP || WIFI_PATCHES_EXT_FLASH_STORE

config MCUBOOT_MIN_UPDATEABLE_IMAGES
	int
	default 4 if MCUBOOT_NETWORK_CORE_HAS_UPDATE_SLOT && MCUBOOT_WIFI_PATCHES_HAS_UPDATE_SLOT && QSPI_XIP_SPLIT_IMAGE
	default 3 if (MCUBOOT_NETWORK_CORE_HAS_UPDATE_SLOT && MCUBOOT_WIFI_PATCHES_HAS_UPDATE_SLOT && !QSPI_XIP_SPLIT_IMAGE) || (MCUBOOT_NETWORK_CORE_HAS_UPDATE_SLOT && !MCUBOOT_WIFI_PATCHES_HAS_UPDATE_SLOT && QSPI_XIP_SPLIT_IMAGE) || (!MCUBOOT_NETWORK_CORE_HAS_UPDATE_SLOT && MCUBOOT_WIFI_PATCHES_HAS_UPDATE_SLOT && QSPI_XIP_SPLIT_IMAGE)
	default 2 if (MCUBOOT_NETWORK_CORE_HAS_UPDATE_SLOT && !MCUBOOT_WIFI_PATCHES_HAS_UPDATE_SLOT && !QSPI_XIP_SPLIT_IMAGE) || (!MCUBOOT_NETWORK_CORE_HAS_UPDATE_SLOT && MCUBOOT_WIFI_PATCHES_HAS_UPDATE_SLOT && !QSPI_XIP_SPLIT_IMAGE) || (!MCUBOOT_NETWORK_CORE_HAS_UPDATE_SLOT && !MCUBOOT_WIFI_PATCHES_HAS_UPDATE_SLOT && QSPI_XIP_SPLIT_IMAGE)
	default 1

config MCUBOOT_MIN_ADDITIONAL_UPDATEABLE_IMAGES
	int
	default 1 if SECURE_BOOT_APPCORE
	default 1 if NRF_RADIO_LOADER && !MCUBOOT_SIGN_MERGED_BINARY
	default 0

config MCUBOOT_UPDATEABLE_IMAGES
	int "Updateable images"
	range MCUBOOT_MIN_UPDATEABLE_IMAGES MCUBOOT_MAX_UPDATEABLE_IMAGES
	help
	  The number of images that MCUboot will be built with. Note that if
	  ``MCUBOOT_ADDITIONAL_UPDATEABLE_IMAGES`` is set to a non-zero value then that value will
	  be added to the MCUboot updateable image number but not the application, this is to allow
	  for features like NSIB updates of MCUboot itself.

config MCUBOOT_ADDITIONAL_UPDATEABLE_IMAGES
	int "Additional MCUboot-only updateable images"
	range MCUBOOT_MIN_ADDITIONAL_UPDATEABLE_IMAGES MCUBOOT_MIN_ADDITIONAL_UPDATEABLE_IMAGES
	default MCUBOOT_MIN_ADDITIONAL_UPDATEABLE_IMAGES
	help
	  The number of additional images that MCUboot will be built with.

config MCUBOOT_APP_SYNC_UPDATEABLE_IMAGES
	bool "Sync updateable image value to main application"
	default y
	help
	  If enabled then will synchronise the value of ``MCUBOOT_UPDATEABLE_IMAGES`` to MCUboot
	  and the main application, if disabled then will only set this value to MCUboot.

	  Note: ``MCUBOOT_MIN_ADDITIONAL_UPDATEABLE_IMAGES`` will be applied to MCUboot only
	  irrespective of this option.

config SECURE_BOOT_MCUBOOT_VERSION
	string "MCUboot S0/S1 image update version"
	default "0.0.0+0"
	depends on SECURE_BOOT
	depends on BOOTLOADER_MCUBOOT
	help
	  The version of the MCUboot S0/S1 upgrade package

if BOOTLOADER_MCUBOOT

choice BOOT_SIGNATURE_TYPE
	default BOOT_SIGNATURE_TYPE_RSA if THINGY91_STATIC_PARTITIONS_FACTORY
	default BOOT_SIGNATURE_TYPE_ED25519 if SOC_SERIES_NRF54L || SOC_SERIES_NRF54H
	default BOOT_SIGNATURE_TYPE_ECDSA_P256 if ((SOC_NRF52840 || SOC_SERIES_NRF91) && !BOARD_THINGY91_NRF9160 && !BOARD_THINGY91_NRF52840)
	default BOOT_SIGNATURE_TYPE_ECDSA_P256 if SECURE_BOOT_APPCORE

endchoice

choice MCUBOOT_MODE
	default MCUBOOT_MODE_SWAP_USING_MOVE

endchoice

config BOOT_SIGNATURE_TYPE_PURE
	bool "Verify signature directly over image"
	depends on SOC_SERIES_NRF54L || SOC_SERIES_NRF54H
	depends on BOOT_SIGNATURE_TYPE_ED25519
	help
	  The image signature will be verified over image rather than
	  hash of an image.
	  This option is currently only supported with ED25519 and configurations
	  where both image slots are within internal SoC device storage.

config BOOT_IMG_HASH_ALG_SHA512
	bool "Use SHA512 for image hash calculation"
	depends on BOOT_SIGNATURE_TYPE_ED25519
	default y if SOC_SERIES_NRF54L || SOC_SERIES_NRF54H
	help
	  The image hash will be calculated using SHA512 algorithm.

config MCUBOOT_SIGNATURE_USING_KMU
	bool "Use KMU stored keys for signature verification"
	depends on SOC_SERIES_NRF54L
	depends on BOOT_SIGNATURE_TYPE_ED25519
	help
	  The device needs to be provisioned with proper set of keys.

config MCUBOOT_SIGNATURE_KMU_UROT_MAPPING
	bool "Use original UROT KMU key mapping [DEPRECATED]"
	depends on MCUBOOT_SIGNATURE_USING_KMU
	depends on SOC_SERIES_NRF54L
	depends on !SECURE_BOOT_APPCORE
	select DEPRECATED
	help
	  When this option is enabled, it will use the previous UROT_PUBKEY key slot IDs for the
	  MCUboot image which are assigned for the non-immutable bootloader IDs, otherwise it
	  will use the key set for the mode that MCUboot is used in (non-immutable slots when b0
	  is enabled, or immutable slots when b0 is not enabled).

config MCUBOOT_SIGNATURE_USING_ITS
	bool "Use ITS stored keys for signature verification [EXPERIMENTAL]"
	depends on SOC_SERIES_NRF54H
	select EXPERIMENTAL
	help
	  The device needs to be provisioned with proper set of keys.

config BOOT_SHARED_CRYPTO_ECDSA_P256
	bool "Use external crypto from NSIB for ECDSA P256 signature"
	depends on SECURE_BOOT_APPCORE && SECURE_BOOT_SIGNATURE_TYPE_ECDSA
	depends on BOOT_SIGNATURE_TYPE_ECDSA_P256 && !SOC_SERIES_NRF54L
	default y

config MCUBOOT_GENERATE_DEFAULT_KMU_KEYFILE
	bool "Generate default keyfile for provisioning during build"
	depends on SOC_SERIES_NRF54L
	depends on MCUBOOT_SIGNATURE_USING_KMU
	help
	  If enabled, the build system will generate keyfile.json file in the build directory.

endif

config MCUBOOT_USE_ALL_AVAILABLE_RAM
	bool "Allow MCUboot to use all available RAM"
	depends on BOARD_IS_NON_SECURE
	help
	  By default MCUboot uses only the secure RAM partition.

config MCUBOOT_NRF53_MULTI_IMAGE_UPDATE
	bool "Network core multi-image update (in single operation)"
	depends on NETCORE_APP_UPDATE
	depends on !MCUBOOT_MODE_SINGLE_APP
	help
	  If selected, network core image updates can be applied in a single operation. This is
	  required if the secondary partition resides in off-chip memory.

	  Note: if not using overwrite only mode for MCUboot, this can result in a bricked device
	  upon firmware reverts.

endmenu
```

## sysbuild/Kconfig.netcore
```kconfig
# Copyright (c) 2023 Nordic Semiconductor
#
# SPDX-License-Identifier: LicenseRef-Nordic-5-Clause

config EXTERNAL_CONFIGURED_NETCORE
	bool
	default y
	select NETCORE_REMOTE_NRF5340_CPUNET if NET_CORE_BOARD = "nrf5340dk/nrf5340/cpunet"
	depends on NET_CORE_IMAGE_HCI_IPC # Zephyr Kconfig enabling HCI IPC on netcore

config SUPPORT_NETCORE
	bool
	default y if (SOC_NRF5340_CPUAPP || SOC_NRF54H20_CPUAPP)

config NETCORE_REMOTE_BOARD_TARGET_CPUCLUSTER
	string
	default "cpunet" if SOC_NRF5340_CPUAPP
	default "cpurad" if SOC_NRF54H20_CPUAPP

config NETCORE_REMOTE_DOMAIN
	string
	default "CPUNET" if NETCORE_REMOTE_BOARD_TARGET_CPUCLUSTER != ""

menu "Network core configuration"
	depends on SUPPORT_NETCORE

config SUPPORT_NETCORE_EMPTY
	bool
	default y

config SUPPORT_NETCORE_HCI_IPC
	bool
	default y

config SUPPORT_NETCORE_RPC_HOST
	bool
	default y

config SUPPORT_NETCORE_802154_RPMSG
	bool
	default y

config SUPPORT_NETCORE_MULTIPROTOCOL_RPMSG
	bool
	default y

config SUPPORT_NETCORE_IPC_RADIO
	bool
	default y

config NRF_DEFAULT_EMPTY
	bool

config NRF_DEFAULT_BLUETOOTH
	bool

config NRF_DEFAULT_RPC_HOST
	bool

config NRF_DEFAULT_802154
	bool

config NRF_DEFAULT_MULTIPROTOCOL
	bool

config NRF_DEFAULT_IPC_RADIO
	bool

choice NETCORE
	prompt "Netcore image"
	default NETCORE_HCI_IPC if NRF_DEFAULT_BLUETOOTH && NETCORE_REMOTE_BOARD_TARGET_CPUCLUSTER != ""
	default NETCORE_RPC_HOST if NRF_DEFAULT_RPC_HOST && NETCORE_REMOTE_BOARD_TARGET_CPUCLUSTER != ""
	default NETCORE_802154_RPMSG if NRF_DEFAULT_802154 && NETCORE_REMOTE_BOARD_TARGET_CPUCLUSTER != ""
	default NETCORE_MULTIPROTOCOL_RPMSG if NRF_DEFAULT_MULTIPROTOCOL && NETCORE_REMOTE_BOARD_TARGET_CPUCLUSTER != ""
	default NETCORE_IPC_RADIO if NRF_DEFAULT_IPC_RADIO && NETCORE_REMOTE_BOARD_TARGET_CPUCLUSTER != ""
	default NETCORE_EMPTY if NRF_DEFAULT_EMPTY && NETCORE_REMOTE_BOARD_TARGET_CPUCLUSTER != ""
	depends on SUPPORT_NETCORE && !EXTERNAL_CONFIGURED_NETCORE

config NETCORE_NONE
	bool "None"
	help
	  Do not include a netcore image in the build.

config NETCORE_EMPTY
	bool "Empty"
	depends on SUPPORT_NETCORE_EMPTY
	help
	  Include empty image as the netcore image to use.

config NETCORE_HCI_IPC
	bool "hci_ipc"
	depends on SUPPORT_NETCORE_HCI_IPC
	help
	  Include hci_ipc as the netcore image to use.

config NETCORE_RPC_HOST
	bool "rpc_host"
	depends on SUPPORT_NETCORE_RPC_HOST
	help
	  Include rpc_host as the netcore image to use.

config NETCORE_802154_RPMSG
	bool "802154_rpmsg"
	depends on SUPPORT_NETCORE_802154_RPMSG
	help
	  Include 802154_rpmsg as the netcore image to use.

config NETCORE_MULTIPROTOCOL_RPMSG
	bool "multiprotocol_rpmsg"
	depends on SUPPORT_NETCORE_MULTIPROTOCOL_RPMSG
	help
	  Include multiprotocol_rpmsg as the netcore image to use.

menuconfig NETCORE_IPC_RADIO
	bool "ipc_radio"
	depends on SUPPORT_NETCORE_IPC_RADIO
	help
	  Add ipc_radio as a netcore image to use.
	  The image can be configured as Bluetooth radio and/or IEEE 802.15.4 radio.

if NETCORE_IPC_RADIO

config NETCORE_IPC_RADIO_BT_HCI_IPC
	bool "HCI serialization for Bluetooth"
	help
	  Use HCI serialization for Bluetooth.

config NETCORE_IPC_RADIO_BT_RPC
	bool "nRF RPC serialization for Bluetooth"
	help
	  Use nRF RPC serialization for Bluetooth.

config NETCORE_IPC_RADIO_IEEE802154
	bool "Spinel serialization for IEEE 802.15.4"
	help
	  Use Spinel serialization for IEEE 802.15.4.

endif # NETCORE_IPC_RADIO

endchoice

if !NETCORE_NONE

config NETCORE_IMAGE_NAME
	string
	default "empty_net_core" if NETCORE_EMPTY
	default "hci_ipc" if NETCORE_HCI_IPC
	default "rpc_host" if NETCORE_RPC_HOST
	default "802154_rpmsg" if NETCORE_802154_RPMSG
	default "multiprotocol_rpmsg" if NETCORE_MULTIPROTOCOL_RPMSG
	default "ipc_radio" if NETCORE_IPC_RADIO
	help
	  Name of netcore image.

config NETCORE_IMAGE_PATH
	string
	default "${ZEPHYR_NRF_MODULE_DIR}/samples/nrf5340/empty_net_core" if NETCORE_EMPTY
	default "${ZEPHYR_BASE}/samples/bluetooth/hci_ipc" if NETCORE_HCI_IPC
	default "${ZEPHYR_NRF_MODULE_DIR}/samples/bluetooth/rpc_host" if NETCORE_RPC_HOST
	default "${ZEPHYR_BASE}/samples/boards/nordic/ieee802154/802154_rpmsg" if NETCORE_802154_RPMSG
	default "${ZEPHYR_NRF_MODULE_DIR}/samples/nrf5340/multiprotocol_rpmsg" if NETCORE_MULTIPROTOCOL_RPMSG
	default "${ZEPHYR_NRF_MODULE_DIR}/applications/ipc_radio" if NETCORE_IPC_RADIO
	help
	  Source directory of netcore image.

config NETCORE_IMAGE_DOMAIN
	string
	default NETCORE_REMOTE_DOMAIN

config NETCORE_APP_UPDATE
	bool "Network core updates"
	depends on BOOTLOADER_MCUBOOT
	depends on SECURE_BOOT_NETCORE
	help
	  Enabling this will add support for network core updates from the application core,
	  requires b0n for network core and MCUboot for application core.

endif # !NETCORE_NONE

endmenu
```

## sysbuild/Kconfig.nrf54l_kmu
```kconfig
# Copyright (c) 2025 Nordic Semiconductor
#
# SPDX-License-Identifier: LicenseRef-Nordic-5-Clause

config NRF54L_INVALIDATE_PROTECTED_RAM_SLOTS
	bool
	default y
	depends on SOC_SERIES_NRF54LX
```

## sysbuild/Kconfig.periphconf
```kconfig
# Copyright (c) 2025 Nordic Semiconductor
# SPDX-License-Identifier: LicenseRef-Nordic-5-Clause

config NRF_PERIPHCONF_MIGRATE
	bool "Generate periphconf_migrated.c"
	default y
	depends on SOC_SERIES_NRF54HX
	help
	  Enable autogenerating UICR.PERIPHCONF tables for multi-image builds,
	  to migrate an existing project for running with IronSide SE.
	  You can disable this if you have your own UICR.PERIPHCONF file.
```
