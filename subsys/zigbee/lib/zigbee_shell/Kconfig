## sysbuild/Kconfig.suit
```kconfig
#
# Copyright (c) 2024 Nordic Semiconductor
#
# SPDX-License-Identifier: LicenseRef-Nordic-5-Clause
#

menu "SUIT"

menuconfig SUIT_ENVELOPE
	bool "Create SUIT envelope"
	help
	  Enable DFU SUIT envelope creation

if SUIT_ENVELOPE

config SUIT_ENVELOPE_ROOT_TEMPLATE_FILENAME
	string "Name of the default root envelope template"
	default "root_with_binary_nordic_top.yaml.jinja2"
	help
	  Name of the default root envelope template. The build system searches for a file with this
	  name in the suit/<soc> directory inside the application directory. If the file is not found
	  the default template from the base template directory is used.

config SUIT_ENVELOPE_BASIC_KMS_SCRIPT_KEY_DIRECTORY
	string "The directory in which the keys are stored"
	default "${ZEPHYR_SUIT_GENERATOR_MODULE_DIR}/ncs"
	help
	  Location of the key files used if the default basic KMS script is used during signing
	  or encryption.

config SUIT_ENVELOPE_KMS_SCRIPT_CONTEXT
	string "Context for the SUIT KMS script"
	default SUIT_ENVELOPE_BASIC_KMS_SCRIPT_KEY_DIRECTORY
	help
	  Context to pass to the SUIT KMS script during signing and encryption.

config SUIT_ENVELOPE_ROOT_ARTIFACT_NAME
	string "Name of the root SUIT artifact."
	default "root"
	help
	  Name of the root SUIT artifact.

config SUIT_ENVELOPE_NORDIC_TOP_DIRECTORY
	string "Path to the folder with nordic_top envelope"
	default ""
	help
	  Path to the folder containing nordic_top.suit envelope.
	  nordic_top.suit won't be included in the root manifest if value is empty.

config SUIT_ENVELOPE_NORDIC_TOP_IN_ROOT
	bool
	default y if SUIT_ENVELOPE_NORDIC_TOP_DIRECTORY != ""

if SUIT_ENVELOPE_NORDIC_TOP_IN_ROOT

config SUIT_ENVELOPE_NORDIC_TOP_EXTRACT_PAYLOADS_TO_CACHE
	bool "Extract payloads from the nordic_top envelope to cache"
	help
	  When this option is enabled, the build system extracts payloads from
	  the nordic_top envelope and stores them into a cache partition file.
	  Note, if this option is enabled, the installation of the Nordic components
	  must be orchestrated by the APP_ROOT envelope.
	  The root envelope must make use of the In-Place Updateable Components (IPUC)
	  feature - one of the MEM components must be marked as IPUC by setting its
	  size to 0 in the suit-candidate-verification sequence - so that its
	  memory can be used as a mirror for the update of the Nordic elements.

config SUIT_ENVELOPE_NORDIC_TOP_EXTRACT_PAYLOADS_FOR_PULL
	bool "Extract payloads from the nordic_top envelope for the use of the pull model"
	depends on !SUIT_ENVELOPE_NORDIC_TOP_EXTRACT_PAYLOADS_TO_CACHE
	default y if SUIT_BUILD_AB_UPDATE
	help
	  When this option is enabled, the build system extracts payloads from
	  the nordic_top envelope into binaries. The binaries are stored in the
	  DFU directory, allowing them to be used for the pull model.
	  They are also added to the DFU zip file.

config SUIT_ENVELOPE_NORDIC_TOP_CACHE_PARTITION_NUM
	int "Cache partition number to store the payloads extracted from nordic_top envelope"
	default 1

endif # SUIT_ENVELOPE_NORDIC_TOP_IN_ROOT

config SUIT_ENVELOPE_ROOT_SIGN
	bool "Sign the root envelope"

if SUIT_ENVELOPE_ROOT_SIGN

choice SUIT_ENVELOPE_ROOT_SIGN_KEY_GEN
	prompt "SUIT root envelope signing key generation"
	default SUIT_ENVELOPE_ROOT_SIGN_KEY_GEN1

config SUIT_ENVELOPE_ROOT_SIGN_KEY_GEN1
	bool "Key generation 1"

config SUIT_ENVELOPE_ROOT_SIGN_KEY_GEN2
	bool "Key generation 2"

config SUIT_ENVELOPE_ROOT_SIGN_KEY_GEN3
	bool "Key generation 3"

endchoice

config SUIT_ENVELOPE_ROOT_SIGN_KEY_ID
	hex "The key ID used to identify the OEM root public key on the device"
	default 0x4000AA00 if SUIT_ENVELOPE_ROOT_SIGN_KEY_GEN1
	default 0x4000AA01 if SUIT_ENVELOPE_ROOT_SIGN_KEY_GEN2
	default 0x4000AA02 if SUIT_ENVELOPE_ROOT_SIGN_KEY_GEN3
	help
	  This string is translated to the numeric KEY ID by the encryption script

config SUIT_ENVELOPE_ROOT_SIGN_PRIVATE_KEY_NAME
	string "Name of the private key used for signing - to identify the key in the KMS"
	default "MANIFEST_OEM_ROOT_GEN1_priv" if SUIT_ENVELOPE_ROOT_SIGN_KEY_GEN1
	default "MANIFEST_OEM_ROOT_GEN2_priv" if SUIT_ENVELOPE_ROOT_SIGN_KEY_GEN2
	default "MANIFEST_OEM_ROOT_GEN3_priv" if SUIT_ENVELOPE_ROOT_SIGN_KEY_GEN3

choice SUIT_ENVELOPE_ROOT_SIGN_ALG
	prompt "Algorithm used to sign the root envelope"
	default SUIT_ENVELOPE_ROOT_SIGN_ALG_EDDSA

config SUIT_ENVELOPE_ROOT_SIGN_ALG_EDDSA
	bool "Use the EdDSA algorithm"

config SUIT_ENVELOPE_ROOT_SIGN_ALG_ECDSA_256
	bool "Use the ECDSA algorithm with key length of 256 bits"

config SUIT_ENVELOPE_ROOT_SIGN_ALG_ECDSA_384
	bool "Use the ECDSA algorithm with key length of 384 bits"

config SUIT_ENVELOPE_ROOT_SIGN_ALG_ECDSA_521
	bool "Use the ECDSA algorithm with key length of 521 bits"

config SUIT_ENVELOPE_ROOT_SIGN_ALG_HASH_EDDSA
	bool "Use the HashEdDSA algorithm (specifically: ed25519ph)"
	select EXPERIMENTAL

endchoice

config SUIT_ENVELOPE_ROOT_SIGN_ALG_NAME
	string "String name of the algorithm used to sign the root envelope"
	default "eddsa" if SUIT_ENVELOPE_ROOT_SIGN_ALG_EDDSA
	default "es-256" if SUIT_ENVELOPE_ROOT_SIGN_ALG_ECDSA_256
	default "es-384" if SUIT_ENVELOPE_ROOT_SIGN_ALG_ECDSA_384
	default "es-521" if SUIT_ENVELOPE_ROOT_SIGN_ALG_ECDSA_521
	default "hash-eddsa" if SUIT_ENVELOPE_ROOT_SIGN_ALG_HASH_EDDSA

endif # SUIT_ENVELOPE_ROOT_SIGN

config SUIT_BASE_MANIFEST_TEMPLATE_DIR
	string "Base manifest directory"
	default "${ZEPHYR_NRF_MODULE_DIR}/config/suit/templates"
	help
	  Path to the base template directory.

config SUIT_BASE_MANIFEST_VARIANT
	string "Base manifest variant"
	default "default/v1"
	help
	  Base manifest variant used during the build.

config SUIT_MULTI_IMAGE_PACKAGE_BUILD
	bool "Create multi-image DFU for SUIT envelope and cache images"
	help
	  Build DFU Multi Image package that contains a manifest file followed by SUIT envelope
	  and selected cache image files.

endif # SUIT_ENVELOPE

config SUIT_BUILD_RECOVERY
	bool "Build SUIT recovery firmware"
	help
	  Build the recovery firmware, which allows to recover the main application
	  if the image on the board was damaged.

if SUIT_BUILD_RECOVERY

choice SUIT_RECOVERY_APPLICATION
	prompt "Select SUIT recovery application"
	default SUIT_RECOVERY_APPLICATION_NONE if SUIT_BUILD_AB_UPDATE
	default SUIT_RECOVERY_APPLICATION_DEFAULT

config SUIT_RECOVERY_APPLICATION_DEFAULT
	bool "Use the default recovery application"
	help
	  Use the default recovery application using BluetoothLE and SMP.

config SUIT_RECOVERY_APPLICATION_NONE
	bool "Do not build the recovery application"
	help
	  Provide a recovery manifest, but do not build a recovery application.

endchoice

choice SUIT_RECOVERY_APPLICATION_IMAGE_MANIFEST
	prompt "Select which manifest controls the recovery application FW image"
	default SUIT_RECOVERY_APPLICATION_IMAGE_MANIFEST_APP_LOCAL_3

config SUIT_RECOVERY_APPLICATION_IMAGE_MANIFEST_APP_LOCAL_3
	bool "The recovery application FW image is controlled by APP_LOCAL_3 manifest"

config SUIT_RECOVERY_APPLICATION_IMAGE_MANIFEST_APP_RECOVERY
	bool "The recovery application FW image is controlled directly by APP_RECOVERY manifest"

endchoice

config SUIT_RECOVERY_APPLICATION_PATH
	string
	default "${ZEPHYR_NRF_MODULE_DIR}/samples/suit/recovery" if SUIT_RECOVERY_APPLICATION_DEFAULT
	help
	  Source directory of the SUIT recovery application.

config SUIT_ENVELOPE_APP_RECOVERY_TEMPLATE_FILENAME
	string "Name of the default root envelope template"
	default "app_recovery_envelope_app_local.yaml.jinja2" if SUIT_RECOVERY_APPLICATION_IMAGE_MANIFEST_APP_LOCAL_3
	default "app_recovery_envelope_direct.yaml.jinja2" if SUIT_RECOVERY_APPLICATION_IMAGE_MANIFEST_APP_RECOVERY
	help
	  Name of the default application recovery envelope template. This also has a role of the
	  recovery firmware root envelope template.
	  The build system first searches for a file with this name in the suit/<soc> directory inside
	  the application directory, then in the recovery application suit/<soc> directory.
	  If the file is not found the default template from the base template directory is used.

config SUIT_ENVELOPE_APP_RECOVERY_ARTIFACT_NAME
	string "Name of the root recovery manifest SUIT artifact."
	default "app_recovery"
	help
	  Name of the root SUIT artifact.

config SUIT_ENVELOPE_APP_RECOVERY_SIGN
	bool "Sign the app recovery envelope"

if SUIT_ENVELOPE_APP_RECOVERY_SIGN

choice SUIT_ENVELOPE_APP_RECOVERY_SIGN_KEY_GEN
	prompt "SUIT app recovery envelope signing key generation"
	default SUIT_ENVELOPE_APP_RECOVERY_SIGN_KEY_GEN1

config SUIT_ENVELOPE_APP_RECOVERY_SIGN_KEY_GEN1
	bool "Key generation 1"

config SUIT_ENVELOPE_APP_RECOVERY_SIGN_KEY_GEN2
	bool "Key generation 2"

config SUIT_ENVELOPE_APP_RECOVERY_SIGN_KEY_GEN3
	bool "Key generation 3"

endchoice

config SUIT_ENVELOPE_APP_RECOVERY_SIGN_KEY_ID
	hex "The key ID used to identify the app recovery public key on the device"
	default 0x40022100 if SUIT_ENVELOPE_APP_RECOVERY_SIGN_KEY_GEN1
	default 0x40022101 if SUIT_ENVELOPE_APP_RECOVERY_SIGN_KEY_GEN2
	default 0x40022102 if SUIT_ENVELOPE_APP_RECOVERY_SIGN_KEY_GEN3
	help
	  This string is translated to the numeric KEY ID by the encryption script

config SUIT_ENVELOPE_APP_RECOVERY_SIGN_PRIVATE_KEY_NAME
	string "Name of the private key used for signing - to identify the key in the KMS"
	default "MANIFEST_APPLICATION_GEN1_priv" if SUIT_ENVELOPE_APP_RECOVERY_SIGN_KEY_GEN1
	default "MANIFEST_APPLICATION_GEN2_priv" if SUIT_ENVELOPE_APP_RECOVERY_SIGN_KEY_GEN2
	default "MANIFEST_APPLICATION_GEN3_priv" if SUIT_ENVELOPE_APP_RECOVERY_SIGN_KEY_GEN3

choice SUIT_ENVELOPE_APP_RECOVERY_SIGN_ALG
	prompt "Algorithm used to sign the app recovery envelope"
	default SUIT_ENVELOPE_APP_RECOVERY_SIGN_ALG_EDDSA

config SUIT_ENVELOPE_APP_RECOVERY_SIGN_ALG_EDDSA
	bool "Use the EdDSA algorithm"

config SUIT_ENVELOPE_APP_RECOVERY_SIGN_ALG_ECDSA_256
	bool "Use the ECDSA algorithm with key length of 256 bits"

config SUIT_ENVELOPE_APP_RECOVERY_SIGN_ALG_ECDSA_384
	bool "Use the ECDSA algorithm with key length of 384 bits"

config SUIT_ENVELOPE_APP_RECOVERY_SIGN_ALG_ECDSA_521
	bool "Use the ECDSA algorithm with key length of 521 bits"

config SUIT_ENVELOPE_APP_RECOVERY_SIGN_ALG_HASH_EDDSA
	bool "Use the HashEdDSA algorithm (specifically: ed25519ph)"
	select EXPERIMENTAL

endchoice

config SUIT_ENVELOPE_APP_RECOVERY_SIGN_ALG_NAME
	string "String name of the algorithm used to sign the app recovery envelope"
	default "eddsa" if SUIT_ENVELOPE_APP_RECOVERY_SIGN_ALG_EDDSA
	default "es-256" if SUIT_ENVELOPE_APP_RECOVERY_SIGN_ALG_ECDSA_256
	default "es-384" if SUIT_ENVELOPE_APP_RECOVERY_SIGN_ALG_ECDSA_384
	default "es-521" if SUIT_ENVELOPE_APP_RECOVERY_SIGN_ALG_ECDSA_521
	default "hash-eddsa" if SUIT_ENVELOPE_APP_RECOVERY_SIGN_ALG_HASH_EDDSA

endif # SUIT_ENVELOPE_APP_RECOVERY_SIGN

endif # SUIT_BUILD_RECOVERY

config SUIT_BUILD_FLASH_COMPANION
	bool "Build SUIT flash companion firmware"
	help
	  Build the flash companion firmware, which acts as a proxy for the secure domain
	  firmware to read and write to the external memory.

if SUIT_BUILD_FLASH_COMPANION

config FLASH_COMPANION_TARGET_CPUCLUSTER
	string "Flash companion target cluster"
	default "cpuapp"  if SOC_SERIES_NRF54HX
	help
	  Set the target CPU cluster on which the companion firmware will run.

endif # SUIT_BUILD_FLASH_COMPANION

config SUIT_BUILD_AB_UPDATE
	bool "Build AB variant"
	imply SUIT_SOC_FLASH_NRF_RADIO_SYNC_RPC
	help
	  Build two applications for the A and B update.

config SUIT_SOC_FLASH_NRF_RADIO_SYNC_RPC
	bool "Enable flash driver synchronization with radio protocols through RPC"

endmenu
```
