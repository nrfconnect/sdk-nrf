## subsys/zigbee/lib/zigbee_shell/Kconfig
```kconfig
#
# Copyright (c) 2022 Nordic Semiconductor
#
# SPDX-License-Identifier: LicenseRef-Nordic-5-Clause
#

menuconfig ZIGBEE_SHELL
	bool "Enable Zigbee Shell"
	depends on ZIGBEE
	imply SHELL

if ZIGBEE_SHELL

config ZIGBEE_SHELL_ENDPOINT
	int "Number of endpoint to be used by the Zigbee Shell instance"
	range 1 240
	help
	  This option sets the endpoint which Zigbee shell uses for sending commands.
	  Zigbee shell library can utilize only already existing endpoint.

	  Note: If chosen endpoint is not registered, some functionalities will not work correctly.

config ZIGBEE_SHELL_CTX_MGR_ENTRIES_NBR
	int "Number of entries in context manager"
	default 24
	range 3 254
	help
	  Number of entries in context manager of Zigbee Shell.
	  Entries are shared by ZDO commands, ZCL commands and PING commands.

config ZIGBEE_SHELL_DEBUG_CMD
	bool "Enable debug shell commands"
	select ZIGBEE_DEBUG_FUNCTIONS
	imply ZIGBEE_LOGGER_EP
	help
	  This option enables:

	  - Logging incoming ZCL frames.
	  - Command to send custom ZCL frames.
	  - Command to suspend/resume Zigbee Stack execution.

	  Note: These commands may be useful when debugging but can cause instability of the device.

config ZIGBEE_SHELL_ZCL_CMD_TIMEOUT
	int "Amount of time in seconds after which the ZCL cmd commands time out if no response is received"
	default 10
	range 5 60

config ZIGBEE_SHELL_MONITOR_CACHE_SIZE
	int "Size of the Zigbee active neighbor monitor cache"
	default 10
	range 3 254
	help
	  The maximum number of neighbor table entries, logged by the Zigbee active neighbor monitor.

# Configure ZIGBEE_SHELL_LOG_LEVEL
module = ZIGBEE_SHELL
module-str = Zigbee Shell
source "${ZEPHYR_BASE}/subsys/logging/Kconfig.template.log_config"

endif #ZIGBEE_SHELL
```

## sysbuild/Kconfig.appcore
```kconfig
# Copyright (c) 2024 Nordic Semiconductor
#
# SPDX-License-Identifier: LicenseRef-Nordic-5-Clause

config SUPPORT_APPCORE
	bool
	default y if (SOC_NRF5340_CPUNET || SOC_NRF54H20_CPURAD)

config APPCORE_REMOTE_BOARD_TARGET_CPUCLUSTER
	string
	default "cpuapp"

config APPCORE_REMOTE_DOMAIN
	string
	default "CPUAPP" if APPCORE_REMOTE_BOARD_TARGET_CPUCLUSTER != ""

menu "Application core configuration"
	depends on SUPPORT_APPCORE

config SUPPORT_APPCORE_EMPTY
	bool
	default y

config SUPPORT_APPCORE_REMOTE_SHELL
	bool
	default y

config NRF_DEFAULT_EMPTY
	bool

config NRF_DEFAULT_REMOTE_SHELL
	bool

choice APPCORE
	prompt "Appcore image"
	default APPCORE_REMOTE_SHELL if NRF_DEFAULT_REMOTE_SHELL
	default APPCORE_EMPTY if NRF_DEFAULT_EMPTY
	depends on SUPPORT_APPCORE

config APPCORE_NONE
	bool "None"
	help
	  Do not include a appcore image in the build.

config APPCORE_EMPTY
	bool "Empty"
	depends on SUPPORT_APPCORE_EMPTY
	help
	  Include empty image as the appcore image to use.

config APPCORE_REMOTE_SHELL
	bool "remote_shell"
	depends on SUPPORT_APPCORE_REMOTE_SHELL
	help
	  Include remote_shell as the appcore image to use.

endchoice

if !APPCORE_NONE

config APPCORE_IMAGE_NAME
	string
	default "empty_app_core" if APPCORE_EMPTY
	default "remote_shell" if APPCORE_REMOTE_SHELL
	help
	  Name of appcore image.

config APPCORE_IMAGE_PATH
	string
	default "$(ZEPHYR_NRF_MODULE_DIR)/samples/nrf5340/empty_app_core" if APPCORE_EMPTY && SOC_SERIES_NRF53
	default "$(ZEPHYR_NRF_MODULE_DIR)/samples/nrf5340/remote_shell" if APPCORE_REMOTE_SHELL && SOC_SERIES_NRF53
	default "$(ZEPHYR_NRF_MODULE_DIR)/samples/nrf54h20/empty_app_core" if APPCORE_EMPTY && SOC_NRF54H20
	help
	  Source directory of appcore image.

config APPCORE_IMAGE_DOMAIN
	string
	default APPCORE_REMOTE_DOMAIN

endif # !APPCORE_NONE

endmenu
```

## sysbuild/Kconfig.approtect
```kconfig
# Copyright (c) 2024 Nordic Semiconductor
#
# SPDX-License-Identifier: LicenseRef-Nordic-5-Clause

choice APPROTECT_HANDLING
	prompt "APPROTECT handling"
	depends on SOC_SERIES_NRF52 || SOC_SERIES_NRF53 || SOC_SERIES_NRF54L || SOC_SERIES_NRF91
	default APPROTECT_NO_SYSBUILD
	help
	  Specifies how the SystemInit() function of all the images should
	  handle the APPROTECT mechanism.

config APPROTECT_DISABLE
	bool "Disable"
	depends on SOC_SERIES_NRF54L
	help
	  Enable CONFIG_NRF_APPROTECT_DISABLE in all images.

config APPROTECT_USE_UICR
	bool "Use UICR"
	depends on SOC_SERIES_NRF52 || SOC_SERIES_NRF53 || SOC_SERIES_NRF91
	help
	  Enable CONFIG_NRF_APPROTECT_USE_UICR in all images.

config APPROTECT_LOCK
	bool "Lock"
	help
	  Enable CONFIG_NRF_APPROTECT_LOCK in all images.

config APPROTECT_USER_HANDLING
	bool "Allow user handling"
	depends on !SOC_SERIES_NRF52
	help
	  Enable CONFIG_NRF_APPROTECT_USER_HANDLING in all images.

config APPROTECT_NO_SYSBUILD
	bool "No sysbuild level configuration"
	help
	  Approtect handling is not configured at sysbuild level.

endchoice

choice SECURE_APPROTECT_HANDLING
	prompt "Secure APPROTECT handling"
	depends on SOC_NRF5340_CPUAPP || SOC_SERIES_NRF54L || SOC_SERIES_NRF91
	default SECURE_APPROTECT_NO_SYSBUILD
	help
	  Specifies how the SystemInit() function of all the images should
	  handle the secure APPROTECT mechanism.

config SECURE_APPROTECT_DISABLE
	bool "Disable"
	depends on SOC_SERIES_NRF54L
	help
	  Enable CONFIG_NRF_SECURE_APPROTECT_DISABLE in all images.

config SECURE_APPROTECT_USE_UICR
	bool "Use UICR"
	depends on SOC_NRF5340_CPUAPP || SOC_SERIES_NRF91
	help
	  Enable CONFIG_NRF_SECURE_APPROTECT_USE_UICR in all images.

config SECURE_APPROTECT_LOCK
	bool "Lock"
	help
	  Enable CONFIG_NRF_SECURE_APPROTECT_LOCK in all images.

config SECURE_APPROTECT_USER_HANDLING
	bool "Allow user handling"
	help
	  Enable CONFIG_NRF_SECURE_APPROTECT_USER_HANDLING in all images.

config SECURE_APPROTECT_NO_SYSBUILD
	bool "No sysbuild level configuration"
	help
	  Secure approtect handling is not configured at sysbuild level.

endchoice
```

## sysbuild/Kconfig.bt
```kconfig
#
# Copyright (c) 2024 Nordic Semiconductor
#
# SPDX-License-Identifier: LicenseRef-Nordic-5-Clause
#

menuconfig BT
	bool "Bluetooth"
	imply NRF_DEFAULT_IPC_RADIO
	help
	  This option enables Bluetooth support.

if BT

menuconfig BT_RPC
	bool "Bluetooth over RPC [EXPERIMENTAL]"
	depends on (SOC_SERIES_NRF53X || SOC_SERIES_NRF54HX)
	depends on !IEEE802154
	select EXPERIMENTAL
	help
	  Enables Bluetooth serialization over RPC

if BT_RPC

config BT_RPC_USE_NORDIC_BT_RPC_SNIPPET
	bool "Use nordic-bt-rpc snippet"
	depends on NETCORE_IPC_RADIO || NETCORE_RPC_HOST
	default y
	help
	  Use nordic-bt-rpc snippet automatically.

endif # BT_RPC

config BT_FAST_PAIR
	bool "Bluetooth Fast Pair support"
	help
	  Enable this option to generate a Fast Pair provisioning data hex file and enable
	  Bluetooth Fast Pair support in the main image. Note that ``FP_MODEL_ID`` and
	  ``FP_ANTI_SPOOFING_KEY`` variables must be supplied when configuring the application for
	  this functionality to be available.

endif # BT
```

## sysbuild/Kconfig.bt_fast_pair
```kconfig
#
# Copyright (c) 2023-2025 Nordic Semiconductor
#
# SPDX-License-Identifier: LicenseRef-Nordic-5-Clause
#

menu "Bluetooth Fair Pair"

config BT_FAST_PAIR_MODEL_ID
	hex "Set the Model ID used for Fast Pair provisioning"
	range 0x000000 0x1000000
	default 0x1000000
	help
	  Set the Model ID that is used to generate the Fast Pair provisioning data hex file.
	  The Model ID is obtained during device model registration in the Google Nearby Console.
	  Note that the corresponding SB_CONFIG_BT_FAST_PAIR_ANTI_SPOOFING_PRIVATE_KEY Kconfig
	  option must be supplied to trigger the generation of the Fast Pair provisioning data hex
	  file. The generation is indicated by the SB_CONFIG_BT_FAST_PAIR_PROV_DATA Kconfig.

	  The Model ID should be a value from the 0x000000 - 0xFFFFFF range. The additional
	  default value (0x1000000) that is outside of the actual range is only used to mark
	  this option as unset by the user.

config BT_FAST_PAIR_ANTI_SPOOFING_PRIVATE_KEY
	string "Set the Anti-Spoofing Private Key used for Fast Pair provisioning"
	help
	  Set the Anti-Spoofing Private Key that is used to generate the Fast Pair provisioning
	  data hex file. The Anti-Spoofing Private Key is obtained during device model registration
	  in the Google Nearby Console. Note that the corresponding SB_CONFIG_BT_FAST_PAIR_MODEL_ID
	  Kconfig option must be supplied to trigger the generation of the Fast Pair provisioning
	  data hex file The generation is indicated by the SB_CONFIG_BT_FAST_PAIR_PROV_DATA
	  Kconfig.

	  The Anti-Spoofing Private Key is confidential and must be handled securely. It is
	  recommended to store this key securely outside the code repository and pass it to
	  the project as an additional argument for the build command
	  (``-DSB_CONFIG_BT_FAST_PAIR_ANTI_SPOOFING_PRIVATE_KEY=<value>``).

config BT_FAST_PAIR_PROV_DATA
	bool
	depends on BT_FAST_PAIR_MODEL_ID != 0x1000000
	depends on BT_FAST_PAIR_ANTI_SPOOFING_PRIVATE_KEY != ""
	default y
	help
	  This option is automatically enabled when the Model ID (SB_CONFIG_BT_FAST_PAIR_MODEL_ID)
	  and the Anti-Spoofing Private Key (SB_CONFIG_BT_FAST_PAIR_ANTI_SPOOFING_PRIVATE_KEY) are
	  set. Both parameters are mandatory for the Fast Pair provisioning.

	  When this option is enabled, sysbuild generates the Fast Pair provisioning data hex file
	  and merges it with the final output hex file that is uploaded on the chosen board target.

	  For the generation step to work correctly, the user must manually define the Fast Pair
	  partition. In the case of platforms that use the DTS for memory map description (for
	  example, nRF54H), the Fast Pair partition must be defined as a DTS node. In the case of
	  platforms that use the Partition Manager (PM) for memory map description (for example,
	  nRF54L), the Fast Pair partition must be a statically defined PM partition. The PM
	  solution also supports the dynamic generation of the partition definition if the
	  CONFIG_BT_FAST_PAIR Kconfig is enabled in the main (default) image. This is the only case
	  when the partition does not have to be manually defined by the user. Detailed
	  documentation regarding the Fast Pair partition definition can be found in the Fast Pair
	  integration guide.

endmenu
```

## sysbuild/Kconfig.dfu
```kconfig
# Copyright (c) 2023 Nordic Semiconductor
#
# SPDX-License-Identifier: LicenseRef-Nordic-5-Clause

menuconfig DFU_MULTI_IMAGE_PACKAGE_BUILD
	bool "Create multi-image DFU"
	depends on BOOTLOADER_MCUBOOT
	depends on !QSPI_XIP_SPLIT_IMAGE
	help
	  Build DFU Multi Image package that contains a manifest file followed by selected update
	  images.

if DFU_MULTI_IMAGE_PACKAGE_BUILD

config DFU_MULTI_IMAGE_PACKAGE_APP
	bool "Application update"

if SECURE_BOOT

config DFU_MULTI_IMAGE_PACKAGE_NET
	bool "Network core update"
	depends on SUPPORT_NETCORE
	depends on !NETCORE_NONE
	depends on SECURE_BOOT_NETCORE

config DFU_MULTI_IMAGE_PACKAGE_MCUBOOT
	bool "MCUboot update"
	depends on SECURE_BOOT_BUILD_S1_VARIANT_IMAGE

endif # SECURE_BOOT

config DFU_MULTI_IMAGE_PACKAGE_WIFI_FW_PATCH
	bool "nRF70 firmware patch"
	depends on PARTITION_MANAGER
	depends on BOOTLOADER_MCUBOOT
	depends on WIFI_NRF70
	depends on (WIFI_PATCHES_EXT_FLASH_XIP || WIFI_PATCHES_EXT_FLASH_STORE)
	help
	  Enabling this option adds support for Device Firmware Update (DFU) for the nRF70 Series
	  Firmware Patch.

	  This feature requires the addition of an MCUBoot partition pair: a primary and a
	  secondary partition. These partitions are used to store the new firmware patch. The
	  specific partition numbers to be used depend on the number of partitions already in use.

	  The "nrf70_wifi_fw" partition must be added to the newly created MCUBoot primary
	  partition. Once this Kconfig option is enabled, the nRF70.hex file will be signed by
	  MCUBoot. The signed image will then be merged with the application image and flashed onto
	  the target board.

	  Ensure that the required MCUBoot partitions are properly configured before enabling this
	  option. Refer to the documentation for detailed instructions on partition configuration
	  and the DFU process.

endif # DFU_MULTI_IMAGE_PACKAGE_BUILD
```

## sysbuild/Kconfig.firmware_loader
```kconfig
#
# Copyright (c) 2025 Nordic Semiconductor
#
# SPDX-License-Identifier: LicenseRef-Nordic-5-Clause
#

config SUPPORT_FIRMWARE_LOADER_BLE_MCUMGR
	bool
	default y

config SUPPORT_FIRMWARE_LOADER_USB_MCUMGR
	bool
	depends on SOC_NRF54LM20A_CPUAPP || SOC_NRF54LM20B_CPUAPP
	default y

choice FIRMWARE_LOADER

config FIRMWARE_LOADER_IMAGE_BLE_MCUMGR
	bool "ble_mcumgr"
	depends on SUPPORT_FIRMWARE_LOADER_BLE_MCUMGR
	help
	  Include the minified firmware loader ``ble_mcumgr`` sample as the firmware loader image
	  to use.

config FIRMWARE_LOADER_IMAGE_USB_MCUMGR
	bool "usb_mcumgr"
	depends on SUPPORT_FIRMWARE_LOADER_USB_MCUMGR
	help
	  Include the minified firmware loader ``usb_mcumgr`` sample as the firmware loader image
	  to use.

endchoice

config FIRMWARE_LOADER_IMAGE_NAME
	default "ble_mcumgr" if FIRMWARE_LOADER_IMAGE_BLE_MCUMGR
	default "usb_mcumgr" if FIRMWARE_LOADER_IMAGE_USB_MCUMGR

config FIRMWARE_LOADER_IMAGE_PATH
	default "$(ZEPHYR_NRF_MODULE_DIR)/samples/dfu/fw_loader/ble_mcumgr" if FIRMWARE_LOADER_IMAGE_BLE_MCUMGR
	default "$(ZEPHYR_NRF_MODULE_DIR)/samples/dfu/fw_loader/usb_mcumgr" if FIRMWARE_LOADER_IMAGE_USB_MCUMGR

config FIRMWARE_LOADER_UPDATE
	bool "Firmware loader update"
	depends on MCUBOOT_MODE_FIRMWARE_UPDATER && !FIRMWARE_LOADER_IMAGE_NONE
	help
	  Firmware loader update.
	  This will allow to update the firmware loader image with the help of the installer image.

if FIRMWARE_LOADER_UPDATE

choice FIRMWARE_LOADER_INSTALLER_APPLICATION
	prompt "Firmware loader installer application image"
	default FIRMWARE_LOADER_INSTALLER

config FIRMWARE_LOADER_INSTALLER
	bool "Basic fw loader installer"

endchoice

config FIRMWARE_LOADER_INSTALLER_APPLICATION_IMAGE_NAME
	string
	default "installer" if FIRMWARE_LOADER_INSTALLER

config FIRMWARE_LOADER_INSTALLER_APPLICATION_IMAGE_PATH
	string
	default "$(ZEPHYR_NRF_MODULE_DIR)/applications/installer" if FIRMWARE_LOADER_INSTALLER

endif
```

## sysbuild/Kconfig.firmware_loader_radio
```kconfig
#
# Copyright (c) 2025 Nordic Semiconductor
#
# SPDX-License-Identifier: LicenseRef-Nordic-5-Clause
#

menu "Network core configuration"
	depends on SUPPORT_NETCORE

config SUPPORT_FIRMWARE_LOADER_IPC_RADIO
	bool
	default y

choice FIRMWARE_LOADER_RADIO
	prompt "Firmware loader radio image"
	default FIRMWARE_LOADER_RADIO_IMAGE_IPC_RADIO if FIRMWARE_LOADER_IMAGE_BLE_MCUMGR
	default FIRMWARE_LOADER_RADIO_IMAGE_IPC_RADIO if NRF_DEFAULT_IPC_RADIO && NETCORE_REMOTE_BOARD_TARGET_CPUCLUSTER != ""
	default FIRMWARE_LOADER_RADIO_IMAGE_NONE if NRF_DEFAULT_EMPTY && NETCORE_REMOTE_BOARD_TARGET_CPUCLUSTER != ""
	depends on MCUBOOT_MODE_FIRMWARE_UPDATER
	help
	  Select the firmware loader radio image to include in the build.

config FIRMWARE_LOADER_RADIO_IMAGE_NONE
	bool "None"
	help
	  Do not include a firmware loader radio image in the build.

menuconfig FIRMWARE_LOADER_RADIO_IMAGE_IPC_RADIO
	bool "ipc_radio"
	depends on SUPPORT_FIRMWARE_LOADER_IPC_RADIO
	help
	  Include the IPC Radio firmware loader image as the firmware loader radio image to use.

if FIRMWARE_LOADER_RADIO_IMAGE_IPC_RADIO

config FIRMWARE_LOADER_RADIO_IMAGE_IPC_RADIO_BT_HCI_IPC
	bool "HCI serialization for Bluetooth"
	default y
	help
	  Use HCI serialization for Bluetooth.

endif # FIRMWARE_LOADER_RADIO_IMAGE_IPC_RADIO

endchoice

config FIRMWARE_LOADER_RADIO_IMAGE_NAME
	string
	default "fw_loader_ipc_radio" if FIRMWARE_LOADER_RADIO_IMAGE_IPC_RADIO_BT_HCI_IPC
	help
	  Name of firmware loader radio image.

config FIRMWARE_LOADER_RADIO_IMAGE_PATH
	string
	default "$(ZEPHYR_NRF_MODULE_DIR)/applications/ipc_radio" if FIRMWARE_LOADER_RADIO_IMAGE_IPC_RADIO
	help
	  Source directory of firmware loader image.

config FIRMWARE_LOADER_RADIO_BOARD
	string
	default "$(BOARD)/nrf54h20/cpurad" if SOC_NRF54H20
	default "$(BOARD)/nrf54l15/cpurad" if SOC_NRF54L15
	help
	  Board for firmware loader radio image.

endmenu
```
