## sysbuild/Kconfig.flprcore
```kconfig
# Copyright (c) 2025 Nordic Semiconductor
#
# SPDX-License-Identifier: LicenseRef-Nordic-5-Clause

config SUPPORT_FLPRCORE
	bool
	default y if (SOC_NRF54L15_CPUAPP || SOC_NRF54H20_CPUAPP || SOC_NRF54LM20A_ENGA_CPUAPP || SOC_NRF7120_ENGA_CPUAPP)

if SUPPORT_FLPRCORE

config FLPRCORE_REMOTE_BOARD_TARGET_CPUCLUSTER
	string
	default "cpuflpr"

menu "Fast lightweight peripheral processor core (FLPR) configuration"
	depends on SUPPORT_FLPRCORE

config SUPPORT_FLPRCORE_EMPTY
	bool
	default y

config DEFAULT_FLPRCORE_EMPTY
	bool

choice FLPRCORE
	prompt "FLPR core image" if !HPF
	default FLPRCORE_EMPTY if DEFAULT_FLPRCORE_EMPTY && FLPRCORE_REMOTE_BOARD_TARGET_CPUCLUSTER != ""
	depends on SUPPORT_FLPRCORE

config FLPRCORE_NONE
	bool "None"
	help
	  Do not include a FLPR core image in the build.

config FLPRCORE_EMPTY
	bool "Empty"
	depends on SUPPORT_FLPRCORE_EMPTY
	help
	  Include empty image as the FLPR core image to use.

endchoice

if !FLPRCORE_NONE || HPF

config FLPRCORE_IMAGE_NAME
	string
	default "empty_flpr_core" if FLPRCORE_EMPTY
	default "hpf_gpio" if HPF_GPIO
	default "hpf_mspi" if HPF_MSPI
	help
	  Name of FLPR core image.

config FLPRCORE_IMAGE_PATH
	string
	default "$(ZEPHYR_NRF_MODULE_DIR)/samples/basic/empty" if FLPRCORE_EMPTY
	default "$(ZEPHYR_NRF_MODULE_DIR)/applications/hpf/gpio" if HPF_GPIO
	default "$(ZEPHYR_NRF_MODULE_DIR)/applications/hpf/mspi" if HPF_MSPI
	help
	  Source directory of FLPR core image.

endif # !FLPRCORE_NONE

# Include high performance framework which provides it's own FLPR configuration
rsource "Kconfig.hpf"

endmenu

endif # SUPPORT_FLPRCORE
```

## sysbuild/Kconfig.hpf
```kconfig
# Copyright (c) 2024 Nordic Semiconductor
#
# SPDX-License-Identifier: LicenseRef-Nordic-5-Clause

menuconfig HPF
	bool "High-Performance Framework"

if HPF

choice HPF_APPLICATION
	prompt "HPF application selection"
	help
	  Select which HPF application should be flashed on FLPR.

config HPF_GPIO
	bool "HPF GPIO application"

config HPF_MSPI
	bool "HPF MSPI application"

endchoice

config HPF_DEVELOPER_MODE
	bool "HPF developer mode"

config HPF_APPLY_SNIPPET
	bool "Apply HPF overlay snippet"
	default y
	help
	  Apply HPF overlay snippet to the build.

if HPF_GPIO

choice HPF_GPIO_BACKEND
	prompt "HPF GPIO backend type"
	default HPF_GPIO_BACKEND_ICMSG
	help
	  Select the backend type for HPF.

config HPF_GPIO_BACKEND_MBOX
	bool "MBOX backend"
	help
	  The MBOX version is more resource-efficient than the ICMSG backend,
	  but needs to have a shared structure defined as a communication channel.

config HPF_GPIO_BACKEND_ICMSG
	bool "ICMSG backend"

config HPF_GPIO_BACKEND_ICBMSG
	bool "ICBMSG backend"

endchoice

endif # HPF_GPIO

if HPF_MSPI

config HPF_FLPR_APP_FAULT_TIMER
	bool "HPF FLPR application fault timer"
	default y
	help
	  Enable HPF FLPR application fault timer.

if HPF_FLPR_APP_FAULT_TIMER

config HPF_FLPR_APP_FAULT_TIMEOUT
	int "HPF FLPR application fault timeout"
	default 1000000
	help
	  Fault timeout in microseconds.

endif # HPF_FLPR_APP_FAULT_TIMER

endif # HPF_MSPI

endif # HPF
```

## sysbuild/Kconfig.ieee802154
```kconfig
#
# Copyright (c) 2024 Nordic Semiconductor
#
# SPDX-License-Identifier: LicenseRef-Nordic-5-Clause
#

config IEEE802154
	bool "IEEE 802.15.4"
	imply NRF_DEFAULT_IPC_RADIO
	help
	  This option enables IEEE 802.15.4 support.
```

## sysbuild/Kconfig.kmu_prot_ram_inv
```kconfig
# Copyright (c) 2026 Nordic Semiconductor
#
# SPDX-License-Identifier: LicenseRef-Nordic-5-Clause

config KMU_INVALIDATE_PROTECTED_RAM_SLOTS
	bool "Populates the KMU slots for invalidation of the protected RAM using nrfutil"
	depends on SOC_SERIES_NRF54L && !(SOC_NRF54LS05A || SOC_NRF54LS05B)
	help
	  This option populates the KMU slots for invalidation of the Cracen protected RAM
	  using the nrfutil ncs-provision command.
```

## sysbuild/Kconfig.lwm2m_carrier
```kconfig
# Copyright (c) 2024 Nordic Semiconductor
#
# SPDX-License-Identifier: LicenseRef-Nordic-5-Clause

menuconfig LWM2M_CARRIER_DIVIDED_DFU
	bool "Proprietary LwM2M Carrier divided DFU file generation"
	depends on SOC_SERIES_NRF91
	depends on BOOTLOADER_MCUBOOT
	depends on MCUBOOT_MODE_SWAP_WITHOUT_SCRATCH || MCUBOOT_MODE_SWAP_USING_MOVE || MCUBOOT_MODE_SWAP_SCRATCH
	depends on MCUBOOT_UPDATEABLE_IMAGES = "1"
	help
	  Generate proprietary application update files required for the LwM2M carrier divided
	  FOTA procedure.

if LWM2M_CARRIER_DIVIDED_DFU

config LWM2M_CARRIER_DIVIDED_DFU_MAX_FILE_SIZE
	int "Divided DFU maximum file size"
	range 1 256
	default 100
	help
	  Maximum size of the divided DFU files (in kilobytes) that will be generated.

config LWM2M_CARRIER_DIVIDED_DFU_VERSION
	string "Divided DFU version string"
	default "version"
	help
	  Version to be included in the header of the divided DFU files.
	  The string must not be longer than 32 bytes (including the null termination).

endif # LWM2M_CARRIER_DIVIDED_DFU
```

## sysbuild/Kconfig.manufacturing_app
```kconfig
#
# Copyright (c) 2026 Nordic Semiconductor
#
# SPDX-License-Identifier: LicenseRef-Nordic-5-Clause
#

config SUPPORT_MANUFACTURING_APP
	bool
	default y if SOC_NRF54LV10A_CPUAPP

config NRF_MANUFACTURING_APP
	bool "Manufacturing Application [EXPERIMENTAL]"
	depends on SUPPORT_MANUFACTURING_APP
	select EXPERIMENTAL
	help
	  Enable the manufacturing application that:
	   - Generates IKG seed
	   - Provisions PRoT keys
	   - Transitions LCS up to SECURED state

if NRF_MANUFACTURING_APP

config NRF_MANUFACTURING_APP_BOARD
	string
	default "$(BOARD)/nrf54lv10a/cpuapp" if SOC_NRF54LV10A_CPUAPP
	help
	  Target board for the manufacturing application.

config SUPPORT_MANUFACTURING_APP_DEFAULT
	bool
	default y

choice NRF_MANUFACTURING_APP
	prompt "Manufacturing application image"
	default NRF_MANUFACTURING_APP_DEFAULT if SUPPORT_MANUFACTURING_APP_DEFAULT
	default NRF_MANUFACTURING_APP_NONE

config NRF_MANUFACTURING_APP_NONE
	bool "None"
	help
	  Do not include a manufacturing application image in the build.

config NRF_MANUFACTURING_APP_DEFAULT
	bool "Default"
	depends on SUPPORT_MANUFACTURING_APP_DEFAULT
	help
	  Include a default image as the manufacturing application image to use.

endchoice # NRF_MANUFACTURING_APP

config NRF_MANUFACTURING_APP_IMAGE_PATH
	string
	default "$(ZEPHYR_NRF_MODULE_DIR)/samples/manufacturing_app" if NRF_MANUFACTURING_APP_DEFAULT
	default "" if NRF_MANUFACTURING_APP_NONE
	help
	  Path to manufacturing application image.

endif # NRF_MANUFACTURING_APP
```

## sysbuild/Kconfig.matter
```kconfig
# Copyright (c) 2024 Nordic Semiconductor
#
# SPDX-License-Identifier: LicenseRef-Nordic-5-Clause

menuconfig MATTER
	bool "Matter"
	depends on ZEPHYR_CONNECTEDHOMEIP_MODULE

if MATTER

config MATTER_FACTORY_DATA_GENERATE
    bool "Create Matter factory data"
    help
      Enable Matter factory data generation at sysbuild time.
      This generates factory data hex files without building a separate Zephyr image,
      using device tree information from the main application.

config MATTER_FACTORY_DATA_MERGE_WITH_FIRMWARE
	bool "Merge generated factory data with merged.hex output"
	depends on MATTER_FACTORY_DATA_GENERATE
	default y
	help
	  Enables merging the generated factory data with the merged.hex output build file. As a
	  result, the merged.hex build output file, which is used when flashing the firmware using
	  the west tool, includes the factory data as well.

config MATTER_OTA
	bool "Matter OTA Software Update"
	default y
	help
	  Enables over-the-air (OTA) Requestor role that allows the node to perform Device Firmware
	  Update by querying and downloading a new firmware image from a peer OTA Provider node.

config MATTER_OTA_IMAGE_FILE_NAME
	string "OTA image file name"
	default "matter.ota"
	depends on MATTER_OTA
	help
	  Provides the file name of the generated Matter OTA image in the build directory.

endif # MATTER
```
