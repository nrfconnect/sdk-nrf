## sysbuild/Kconfig.pprcore
```kconfig
# Copyright (c) 2024 Nordic Semiconductor
#
# SPDX-License-Identifier: LicenseRef-Nordic-5-Clause

config SUPPORT_PPRCORE
	bool
	default y if SOC_NRF54H20_CPUAPP

if SUPPORT_PPRCORE

config PPRCORE_REMOTE_BOARD_TARGET_CPUCLUSTER
	string
	default "cpuppr" if SOC_NRF54H20_CPUAPP

menu "Peripheral processor core (PPR) configuration"
	depends on SUPPORT_PPRCORE

config SUPPORT_PPRCORE_EMPTY
	bool
	default y

config DEFAULT_PPRCORE_EMPTY
	bool

choice PPRCORE
	prompt "PPR core image"
	default PPRCORE_EMPTY if DEFAULT_PPRCORE_EMPTY && PPRCORE_REMOTE_BOARD_TARGET_CPUCLUSTER != ""
	depends on SUPPORT_PPRCORE

config PPRCORE_NONE
	bool "None"
	help
	  Do not include a PPR core image in the build.

config PPRCORE_EMPTY
	bool "Empty"
	depends on SUPPORT_PPRCORE_EMPTY
	help
	  Include empty image as the PPR core image to use.

endchoice

if !PPRCORE_NONE

config PPRCORE_IMAGE_NAME
	string
	default "empty_ppr_core" if PPRCORE_EMPTY
	help
	  Name of PPR core image.

config PPRCORE_IMAGE_PATH
	string
	default "$(ZEPHYR_NRF_MODULE_DIR)/samples/basic/empty" if PPRCORE_EMPTY
	help
	  Source directory of PPR core image.

endif # !PPRCORE_NONE

endmenu

endif # SUPPORT_PPRCORE
```

## sysbuild/Kconfig.radio_loader
```kconfig
#
# Copyright (c) 2025 Nordic Semiconductor
#
# SPDX-License-Identifier: LicenseRef-Nordic-5-Clause
#

config NRF_RADIO_LOADER
	bool "Radio Core Firmware Loader [EXPERIMENTAL]"
	depends on SOC_NRF54H20
	select EXPERIMENTAL
	help
	  Enable the radio loader that copies firmware from MRAM to TCM
	  (Tightly Coupled Memory) at boot time.

	  The loader runs from MRAM and:
	  - Copies firmware from MRAM partition to TCM
	  - Jumps to the loaded firmware in TCM for optimal performance

	  Requires devicetree memory map configuration with partitions
	  and chosen nodes defined in the project's overlay files.

if NRF_RADIO_LOADER

config NRF_RADIO_LOADER_BOARD
	string
	default "$(BOARD)/nrf54h20/cpurad"
	help
	  Target board for the radio loader application.

endif # NRF_RADIO_LOADER
```

## sysbuild/Kconfig.sdp
```kconfig
# Copyright (c) 2024 Nordic Semiconductor
#
# SPDX-License-Identifier: LicenseRef-Nordic-5-Clause

menu "SDP"

menuconfig SDP
	bool "SDP"

if SDP

choice SDP_APPLICATION
	prompt "SDP application selection"
	help
	  Select which SDP application should be flashed on FLPR.

config SDP_GPIO
	bool "SDP GPIO application"

config SDP_MSPI
	bool "SDP MSPI application"

endchoice

config SDP_DEVELOPER_MODE
	bool "SDP developer mode"

config SDP_IMAGE_PATH
	string
	default "${ZEPHYR_NRF_MODULE_DIR}/applications/sdp/gpio" if SDP_GPIO
	default "${ZEPHYR_NRF_MODULE_DIR}/applications/sdp/mspi" if SDP_MSPI
	help
	  Source directory of SDP image.

if SDP_GPIO

choice SDP_GPIO_BACKEND
	prompt "SDP GPIO backend type"
	default SDP_GPIO_BACKEND_ICMSG
	help
	  Select the backend type for SDP.

config SDP_GPIO_BACKEND_MBOX
	bool "MBOX backend"
	help
	  The MBOX version is more resource-efficient than the ICMSG backend,
	  but needs to have a shared structure defined as a communication channel.

config SDP_GPIO_BACKEND_ICMSG
	bool "ICMSG backend"

config SDP_GPIO_BACKEND_ICBMSG
	bool "ICBMSG backend"

endchoice

endif # SDP_GPIO

if SDP_MSPI

config SDP_FLPR_APP_FAULT_TIMER
	bool "SDP FLPR application fault timer"
	default y
	help
	  Enable SDP FLPR application fault timer.

if SDP_FLPR_APP_FAULT_TIMER

config SDP_FLPR_APP_FAULT_TIMEOUT
	int "SDP FLPR application fault timeout"
	default 1000000
	help
	  Fault timeout in microseconds.

endif # SDP_FLPR_APP_FAULT_TIMER

endif # SDP_MSPI

endif # SDP

endmenu
```

## sysbuild/Kconfig.secondary
```kconfig
# Copyright (c) 2025 Nordic Semiconductor
#
# SPDX-License-Identifier: LicenseRef-Nordic-5-Clause

config SUPPORT_SECONDARY
	bool
	default y if SOC_NRF54H20_CPUAPP

config SECONDARY_REMOTE_BOARD_TARGET_CPUCLUSTER
	string
	default "cpuapp" if SOC_NRF54H20_CPUAPP

menu "Secondary core configuration"
	depends on SUPPORT_SECONDARY

config SUPPORT_SECONDARY_BOOT_GEN_UICR
	bool
	default y

config NRF_DEFAULT_SECONDARY_BOOT
	bool

choice SECONDARY
	prompt "Secondary image"
	default SECONDARY_BOOT_GEN_UICR if NRF_DEFAULT_SECONDARY_BOOT && SECONDARY_REMOTE_BOARD_TARGET_CPUCLUSTER != ""
	depends on SUPPORT_SECONDARY

config SECONDARY_NONE
	bool "None"
	help
	  Do not include a secondary image in the build.

config SECONDARY_BOOT_GEN_UICR
	bool "Secondary Boot with UICR generation"
	depends on SUPPORT_SECONDARY_BOOT_GEN_UICR
	help
	  Include secondary boot sample with UICR generation as the secondary image to use.
	  This demonstrates secondary application boot with PERIPHCONF migration.

endchoice

if !SECONDARY_NONE

config SECONDARY_IMAGE_NAME
	string
	default "secondary" if SECONDARY_BOOT_GEN_UICR
	help
	  Name of secondary image.

config SECONDARY_IMAGE_PATH
	string
	default "${ZEPHYR_NRF_MODULE_DIR}/samples/ironside_se/secondary_boot_gen_uicr/secondary" if SECONDARY_BOOT_GEN_UICR
	help
	  Source directory of secondary image.

endif # !SECONDARY_NONE

endmenu
```
