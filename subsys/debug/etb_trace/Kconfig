## subsys/fw_metadata/Kconfig
```kconfig
#
# Copyright (c) 2018 Nordic Semiconductor ASA
#
# SPDX-License-Identifier: LicenseRef-BSD-5-Clause-Nordic
#

menuconfig FW_METADATA
	bool
	prompt "Firmware Metadata"

if (FW_METADATA)
config FW_VALIDATION_METADATA_OFFSET
	int "Offset to store validation metadata at."
	default 0
	help
	  Must be either 0 or larger than size of application. If 0 is set,
	  the metadata will be appended directly after the application image,
	  aligned to closest word.

config FW_FIRMWARE_INFO_OFFSET
	hex "The location of firmware info inside this firmware."
	default 0x200
	help
	  The location of firmware info inside the current firmware image. Valid
	  values are 0x200, 0x400 and 0x800. Compatible readers of FW info
	  should search all the possible offsets. Note that all space between
	  the vector table and this address is unused.

config FW_FIRMWARE_VERSION
	int "Version number of the firmware."
	default 1

config FW_MAGIC_COMMON
	hex "Magic word used for all structs (32 bits)."
	default 0x281ee6de
	help
	  There are 3 different metadata structs (see fw_metadata.h). They each
	  have their own magic word composed of 3 u32_t values. One of the
	  u32_ts is a compatibility id constructed from FW_HARDWARE_ID,
	  FW_INFO_VERSION, FW_CRYPTO_ID, and FW_CUSTOM_COMPATIBILITY_ID.
	  The other two u32_ts are defined in FW_MAGIC_COMMON (common to
	  all structs), and in one of FW_MAGIC_FIRMWARE_INFO,
	  SB_VALIDATION_INFO_MAGIC, and SB_VALIDATION_POINTER_MAGIC.
	  The bootloader expects a certain value for each struct, and if it
	  attempts to read a struct without a matching magic word, the struct
	  will be rejected. The config values here apply both to this build of
	  the bootloader, and to the metadata constructed for the app.
	  Refer to fw_metadata.cmake to see how the magic words are composed.

config FW_MAGIC_FIRMWARE_INFO
	hex "Magic word for firmware info structs (32 bits)."
	default 0x8fcebb4c
	help
	  Magic word value specific to firmware info structs (inside firmware).
	  For more info, see FW_MAGIC_COMMON.

config FW_MAGIC_ABI_GETTER_INFO
	hex "Magic word used for ABI getter structs (32 bits)."
	default 0x2ed9a4c5
	help
	  Magic word value specific to ABI getter structs.
	  For more info, see FW_MAGIC_COMMON.

config FW_MAGIC_ABI_INFO
	hex "Magic word used for ABI structs (32 bits)."
	default 0xb845acea
	help
	  Magic word value specific to ABI structs.
	  For more info, see FW_MAGIC_COMMON.

config FW_HARDWARE_ID
	int "The SOC a firmware is built to run on (8 bits)."
	range 0 255
	default 51 if SOC_SERIES_NRF51X
	default 52 if SOC_SERIES_NRF52X
	default 91 if SOC_SERIES_NRF91X
	help
	  Used to ensure binary compatibility.
	  For more info, see FW_MAGIC_COMMON.

config FW_INFO_VERSION
	int "Version number of the fw_*_info structs (8 bits)."
	range 0 255
	default 1
	help
	  Used to ensure binary compatibility.
	  For more info, see FW_MAGIC_COMMON.

config FW_INFO_CRYPTO_ID
	int
	default 0

config FW_CUSTOM_COMPATIBILITY_ID
	int "Compatibility ID for user-defined purposes (8 bits)."
	range 0 255
	default 0
	help
	  User defined value.
	  Used to ensure compatibility between bootloader and metadata.
	  For more info, see FW_MAGIC_COMMON.

config FW_MAGIC_LEN
	int
	default 12
	help
	  Total length of magic words (in bytes).
	  For more info, see FW_MAGIC_COMMON.

endif # FW_METADATA
```

## subsys/gazell/Kconfig
```kconfig
#
# Copyright (c) 2021 Nordic Semiconductor ASA
#
# SPDX-License-Identifier: LicenseRef-Nordic-5-Clause
#

menuconfig GAZELL
	bool "Gazell"
	depends on GZLL && CLOCK_CONTROL_NRF
	select NRFX_PPI if HAS_HW_NRF_PPI
	help
	  Enable Gazell functionality.

if GAZELL

module = GAZELL
module-str = Gazell
source "subsys/logging/Kconfig.template.log_config"

config GAZELL_PAIRING
	bool "Gazell Pairing"
	help
	  Enable Gazell Pairing.

if GAZELL_PAIRING

choice GAZELL_PAIRING_ROLE
	prompt "Gazell Pairing role"

config GAZELL_PAIRING_DEVICE
	bool "Device"

config GAZELL_PAIRING_HOST
	bool "Host"
	depends on ENTROPY_GENERATOR

endchoice # GAZELL_PAIRING_ROLE

config GAZELL_PAIRING_USER_CONFIG_ENABLE
	bool "Use application-specific Gazell Pairing configuration file"

if GAZELL_PAIRING_USER_CONFIG_ENABLE
config GAZELL_PAIRING_USER_CONFIG_FILE
	string "Gazell Pairing configuration file name"
	default "gzp_user_config.h"
	help
	  Modify the file name to use an application-specific Gazell Pairing configuration file.

endif # GAZELL_PAIRING_USER_CONFIG_ENABLE

if GAZELL_PAIRING_DEVICE

config GAZELL_PAIRING_DEVICE_MSGQ_LEN
	int "Gazell Pairing Device message queue length"
	range 1 20
	help
	  Specify the length of message queue in the device pairing module.
	  The module stores various events in the message queue. e.g. The
	  Gazell Link Layer callbacks are stored as events. The default of 1
	  works well for pairing and encypting data. Some applications
	  such as a computer mouse may send multiple packets at a time and
	  they will need a longer message queue.

endif # GAZELL_PAIRING_DEVICE

config GAZELL_PAIRING_CRYPT
	bool "Gazell Pairing encryption"
	depends on ENTROPY_GENERATOR && CRYPTO_NRF_ECB
	help
	  Enable Gazell Pairing encryption.

config GAZELL_PAIRING_SETTINGS
	bool "Gazell Pairing settings persistent storage"
	depends on SETTINGS
	help
	  Enable Gazell Pairing settings persistent storage.

endif # GAZELL_PAIRING

config GAZELL_ZERO_LATENCY_IRQS
	bool "Gazell zero-latency interrupts [EXPERIMENTAL]"
	depends on ZERO_LATENCY_IRQS
	select EXPERIMENTAL
	help
	  Enable zero-latency interrupt for Gazell's radio and timer IRQ so
	  that they will not be blocked by interrupt locking.

config GAZELL_HIGH_IRQ_PRIO
	int "Gazell high IRQ priority"
	range 0 0 if GAZELL_ZERO_LATENCY_IRQS
	range 0 5 if ZERO_LATENCY_IRQS
	range 0 6
	default 0
	help
	  The interrupt priority for Gazell's radio and timer IRQ. This value
	  shall be less than the Gazell's low IRQ priority value.

config GAZELL_LOW_IRQ_PRIO_MIN
	int
	default 0 if (GAZELL_ZERO_LATENCY_IRQS)
	default 1 if (GAZELL_HIGH_IRQ_PRIO = 0)
	default 2 if (GAZELL_HIGH_IRQ_PRIO = 1)
	default 3 if (GAZELL_HIGH_IRQ_PRIO = 2)
	default 4 if (GAZELL_HIGH_IRQ_PRIO = 3)
	default 5 if (GAZELL_HIGH_IRQ_PRIO = 4)
	default 6 if (GAZELL_HIGH_IRQ_PRIO = 5)
	default 7 if (GAZELL_HIGH_IRQ_PRIO = 6)

config GAZELL_LOW_IRQ_PRIO
	int "Gazell low IRQ priority"
	range GAZELL_LOW_IRQ_PRIO_MIN 6 if ZERO_LATENCY_IRQS
	range GAZELL_LOW_IRQ_PRIO_MIN 7
	default GAZELL_LOW_IRQ_PRIO_MIN
	help
	  The interrupt priority for Gazell's SWI IRQ. This value shall
	  be greater than the Gazell's high IRQ priority value.

choice GAZELL_TIMER
	default GAZELL_TIMER2
	prompt "Timer to use for the Gazell timer"

config GAZELL_TIMER0
	bool "TIMER0"
	depends on $(dt_nodelabel_has_compat,timer0,$(DT_COMPAT_NORDIC_NRF_TIMER))

config GAZELL_TIMER1
	bool "TIMER1"
	depends on $(dt_nodelabel_has_compat,timer1,$(DT_COMPAT_NORDIC_NRF_TIMER))

config GAZELL_TIMER2
	bool "TIMER2"
	depends on $(dt_nodelabel_has_compat,timer2,$(DT_COMPAT_NORDIC_NRF_TIMER))

config GAZELL_TIMER3
	bool "TIMER3"
	depends on $(dt_nodelabel_has_compat,timer3,$(DT_COMPAT_NORDIC_NRF_TIMER))

config GAZELL_TIMER4
	bool "TIMER4"
	depends on $(dt_nodelabel_has_compat,timer4,$(DT_COMPAT_NORDIC_NRF_TIMER))

endchoice

choice GAZELL_SWI
	default GAZELL_SWI0
	prompt "Software interrupt to use for Gazell event report"

config GAZELL_SWI0
	bool "SWI0"
	depends on HAS_HW_NRF_SWI0

config GAZELL_SWI1
	bool "SWI1"
	depends on HAS_HW_NRF_SWI1

config GAZELL_SWI2
	bool "SWI2"
	depends on HAS_HW_NRF_SWI2

config GAZELL_SWI3
	bool "SWI3"
	depends on HAS_HW_NRF_SWI3

config GAZELL_SWI4
	bool "SWI4"
	depends on HAS_HW_NRF_SWI4

config GAZELL_SWI5
	bool "SWI5"
	depends on HAS_HW_NRF_SWI5

endchoice

endif # GAZELL
```

## subsys/ieee802154/Kconfig
```kconfig
#
# Copyright (c) 2021 Nordic Semiconductor ASA
#
# SPDX-License-Identifier: LicenseRef-Nordic-5-Clause
#

menu "Nordic IEEE 802.15.4"

config NRF_802154_RADIO_CONFIG
	bool "nRF52 IEEE 802.15.4 configurator"
	default NRF_802154_SER_RADIO || IEEE802154_NRF5
	depends on NRF_802154_RADIO_DRIVER
	help
	  Enable the nRF IEEE 802.15.4 configurator module.

config NRF_802154_RADIO_CONFIG_PRIO
	int "nRF52 IEEE 802.15.4 configuration priority"
	default 91
	depends on NRF_802154_RADIO_CONFIG
	help
	  Set the nRF IEEE 802.15.4 configuration priority number. Must be
	  greater than nRF IEEE 802.15.4 Radio initialization priority.

config NRF_802154_ACK_TIMEOUT_CUSTOM_US
	int "nRF IEEE 802.15.4 ACK timeout"
	default 0
	range 0 2000
	depends on NRF_802154_RADIO_CONFIG
	help
	  Set the custom value of ACK timeout in the nRF IEEE 802.15.4 radio driver module.
	  It is not recommended to change this setting for anything but testing purposes.
	  Setting this value too low will cause the radio driver to never receive ACK frames
	  and setting it too high will increase current consumption. Set this value to 0 to
	  use the default and recommended value of the ACK timeout.

endmenu
```

## subsys/immutable_bootloader/Kconfig
```kconfig
#
# Copyright (c) 2018 Nordic Semiconductor ASA
#
# SPDX-License-Identifier: LicenseRef-BSD-5-Clause-Nordic
#

config MCUBOOT_BUILD_S1_VARIANT
	# This can not depend on BOOTLOADER_MCUBOOT, or IMMUTABLE_BOOTLOADER as this
	# option has to be set when building MCUBoot itself. Instead an error
	# is raised by CMake if an incorrect configuration is found.
	bool "Build S1 variant of MCUBoot"
	help
	  Build upgrade candidate of MCUBoot for alternative slot S1.

config IB_CRYPTO_CLIENT
	bool "Include Secure Bootloader crypto client API"
	help
	  Set this option to enable the crypto client API
	  which gives access to the cryptographic functions
	  from the secure bootloader. This will only work
	  when the secure bootloader is enabled.

config IMMUTABLE_BOOTLOADER
	bool "Use Secure Bootloader"
	depends on !IS_IMMUTABLE_BOOTLOADER
	select FW_METADATA
	select IB_CRYPTO
	help
	  Set this option to enable the first stage bootloader which
	  verifies the signature of the app.

if IMMUTABLE_BOOTLOADER

module=B0
source "${ZEPHYR_BASE}/../nrf/subsys/partition_manager/Kconfig.template.build_strategy"

config IB_PRIVATE_KEY_PROVIDED
	bool
	help
	  Hidden config specifying whether the build system has access to the
	  private key used for signing, and will use it to perform signing and
	  create the public key for the provision page.


choice IB_SIGNING
	prompt "Firmware signing method"
	default IB_SIGNING_PYTHON
	config IB_SIGNING_PYTHON
		bool "Sign with Python ecdsa library."
		select IB_PRIVATE_KEY_PROVIDED

	config IB_SIGNING_OPENSSL
		bool "Sign with openssl command line tool."
		select IB_PRIVATE_KEY_PROVIDED

	config IB_SIGNING_CUSTOM
		bool "Sign with custom command."
endchoice

config IB_SIGNING_KEY_FILE
	string
	prompt "Private key PEM file" if IB_PRIVATE_KEY_PROVIDED
	default ""
	help
	  Absolute path to the private key PEM file.
	  Specifies the private key used for signing the firmware image.
	  The hash of the corresponding public key is stored as the first
	  entry in the list of public key hashes in the provision hex file.
	  This value can also be set by exporting an environment variable
	  named 'SB_SIGNING_KEY_FILE' or passing
	  '-DSB_SIGNING_KEY_FILE=/path/to/my/pem' when running cmake.
	  See also IB_PUBLIC_KEY_FILES.

config IB_SIGNING_COMMAND
	string
	prompt "Custom signing command" if !SB_PRIVATE_KEY_PROVIDED
	default ""
	help
	  This command will be called to produce a signature of the firmware.
	  It will be called as "${CONFIG_IB_SIGNING_COMMAND} <file>"
	  The command must take calculate the signature over the the contents
	  of the <file> and write the signature to stdout.
	  The signature must be on DER format.

config IB_SIGNING_PUBLIC_KEY
	string
	prompt "Public key PEM file" if !SB_PRIVATE_KEY_PROVIDED
	default ""
	help
	  Path to a PEM file.
	  When using a custom signing command, specify the corresponding public
	  key here. This public key is checked during building, and added to
	  the provision page as the first entry. See IB_PUBLIC_KEY_FILES.

config IB_PUBLIC_KEY_FILES
	string "Public Key PEM files"
	default ""
	help
	  Comma-separated list of absolute paths to public key pem files.
	  The provision hex file will contain a list of hashes of public keys.
	  The first public key hash is the one corresponding to the private
	  signing key used to sign the image. See IB_SIGNING_KEY_FILE.
	  The hashes of the public keys specified in this configuration will be
	  placed after the aforementioned public key hash, in the order
	  they appear in this config.
	  If config is an empty string, 2 generated debug files
	  will be used.
	  Example value: ~/keys/pk1.pem,~/keys/pk2.pem,~/keys/pk3.pem


endif # IMMUTABLE_BOOTLOADER

menuconfig IS_IMMUTABLE_BOOTLOADER
	bool "Current app is bootloader"
	select IB_CRYPTO
	select SW_VECTOR_RELAY if SOC_SERIES_NRF51X
	select FW_METADATA
	help
	  This option is set by the first stage bootloader app to include all
	  files and set all the options required.

if IS_IMMUTABLE_BOOTLOADER

partition=B0
partition-size=0x8000
source "${ZEPHYR_BASE}/../nrf/subsys/partition_manager/Kconfig.template.partition_size"

menuconfig IB_DEBUG
	bool "Printing"
	select BOOT_BANNER
	select PRINTK
	select CONSOLE
	select SERIAL

if IB_DEBUG
choice IB_DEBUG_BACKEND
	prompt "Where to print to"
	default IB_DEBUG_UART

config IB_DEBUG_UART
	bool "Print to UART."
	select UART_NRFX
	select UART_CONSOLE

config IB_DEBUG_RTT
	bool "Print to RTT"
	select RTT_CONSOLE
	select USE_SEGGER_RTT
endchoice

config IB_BPROT_IN_DEBUG
	bool "Enable block protect in debug"
	default y
	depends on (HAS_HW_NRF_BPROT || HAS_HW_NRF_MPU)

endif # IB_DEBUG
endif # IS_IMMUTABLE_BOOTLOADER

if IS_IMMUTABLE_BOOTLOADER || IMMUTABLE_BOOTLOADER
config IB_FIRMWARE_INFO_OFFSET
	hex
	default FW_FIRMWARE_INFO_OFFSET

rsource "bl_crypto/Kconfig"
endif # IS_IMMUTABLE_BOOTLOADER || IMMUTABLE_BOOTLOADER
```
