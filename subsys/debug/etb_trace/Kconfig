## subsys/dm/rpc/Kconfig
```kconfig
#
# Copyright (c) 2022 Nordic Semiconductor ASA
#
# SPDX-License-Identifier: LicenseRef-Nordic-5-Clause
#

config DM_MODULE_RPC
	bool "Distance Measurement over RPC [EXPERIMENTAL]"
	select NRF_RPC
	select NRF_RPC_CBOR
	select EXPERIMENTAL
	depends on DM_MODULE
	help
	  Enables Distance Measurement serialization over RPC.

if DM_MODULE_RPC

choice DM_MODULE_RPC_ROLE_CHOICE
	prompt "Distance Measurement over RPC role selection"
	default DM_MODULE_RPC_CLIENT
	help
	  Select the device role for Distance Measurement over RPC.

config DM_MODULE_RPC_HOST
	bool "Distance Measurement over RPC Host"
	help
	  The Distance Measurement API uses the nRF RPC library to provide API for the client.
	  It is supposed to run on the same core as the Nordic Distance Measurement library.

config DM_MODULE_RPC_CLIENT
	bool "Distance Measurement over RPC Client"
	help
	  The Distance Measurement API uses the nRF RPC library to access host on a remote core.
	  It is supposed to run on the application core.

endchoice

config DM_MODULE_RPC_INITIALIZE_NRF_RPC
	bool "Automatically initialize nRF RPC library"
	default y
	help
	  Initialize nRF RPC library during the system startup. Disabling this
	  option allow user to initialize it in a different way.

config DM_MODULE_RPC_IPC_SERVICE_INIT_PRIORITY
	int "Initialization priority of IPC Service"
	default 90
	help
	  Initialization priority for the IPC Service and endpoint register.

endif #DM_MODULE_RPC
```

## subsys/dult/Kconfig
```kconfig
#
# Copyright (c) 2024 Nordic Semiconductor ASA
#
# SPDX-License-Identifier: LicenseRef-Nordic-5-Clause
#

menuconfig DULT
	bool "Detecting Unwanted Location Trackers (DULT) [EXPERIMENTAL]"
	select EXPERIMENTAL
	depends on BT
	help
	  Enable support for Detecting Unwanted Location Trackers (DULT) specification.

if DULT

config DULT_BATTERY
	bool "DULT battery information"
	help
	  Enable support for battery information such as battery type and battery level.
	  The battery information is an optional feature in the DULT specification and the
	  support for it is not required. The battery information can be read by the
	  connected peer over accessory non-owner service (ANOS).

if DULT_BATTERY

config DULT_BATTERY_LEVEL_CRITICAL_THR
	int "Battery level upper threshold [%] for entering critical battery state"
	range 0 100
	default 10
	help
	  This option changes the upper range for the critically low battery state.
	  The device stays in this battery state when the battery level is within
	  the following range:
	  [0; DULT_BATTERY_LEVEL_CRITICAL_THR].
	  The battery level thresholds are used to encode the correct battery level in the
	  Battery Level characteristic that is part of accessory non-owner service (ANOS).

config DULT_BATTERY_LEVEL_LOW_THR
	int "Battery level upper threshold [%] for entering low battery state"
	range 0 100
	default 40
	help
	  This option changes the upper range for the low battery state. The device
	  stays in this battery state when the battery level is within the following
	  range:
	  (DULT_BATTERY_LEVEL_CRITICAL_THR;
	   DULT_BATTERY_LEVEL_LOW_THR].
	  The battery level thresholds are used to encode the correct battery level in the
	  Battery Level characteristic that is part of accessory non-owner service (ANOS).

config DULT_BATTERY_LEVEL_MEDIUM_THR
	int "Battery level upper threshold [%] for entering medium battery state"
	range 0 100
	default 80
	help
	  This option changes the upper range for the medium battery state. The device
	  stays in this battery state when the battery level is within the following
	  range:
	  (DULT_BATTERY_LEVEL_LOW_THR;
	   DULT_BATTERY_LEVEL_MEDIUM_THR].
	  The device enters the full battery state once the battery level is greater
	  than the DULT_BATTERY_LEVEL_MEDIUM_THR threshold.
	  The battery level thresholds are used to encode the correct battery level in the
	  Battery Level characteristic that is part of accessory non-owner service (ANOS).

choice DULT_BATTERY_TYPE
	prompt "DULT battery type"
	default DULT_BATTERY_TYPE_POWERED

config DULT_BATTERY_TYPE_POWERED
	bool "Powered"

config DULT_BATTERY_TYPE_NON_RECHARGEABLE
	bool "Non-rechargeable battery"

config DULT_BATTERY_TYPE_RECHARGEABLE
	bool "Rechargeable battery"

endchoice

endif # DULT_BATTERY

config DULT_BT_ANOS
	bool
	default y
	help
	  Add DULT accessory non-owner service source file.

if DULT_BT_ANOS

config DULT_BT_ANOS_ID_PAYLOAD_LEN_MAX
	int "Maximum length of DULT identifier payload"
	default 18
	help
	  Set this to be higher or equal to the maximum accessory network identifier payload length.

config DULT_BT_ANOS_INDICATION_COUNT
	int "Number of simultaneously processed GATT indications in ANOS"
	range 1 32
	default 2
	help
	  Each GATT indication allocates one indicate params instance until the indication
	  completes. To handle a new GATT indication, there has to be an unallocated indicate params
	  instance present. Otherwise, an indication is not sent. Setting this Kconfig to n allows
	  handling up to n simultaneous GATT indications. The default value is set to 2 to
	  account for one information indication and one asynchronous sound indication at a time.

endif # DULT_BT_ANOS

config DULT_ID
	bool
	default y
	help
	  Add DULT identifier source files.

if DULT_ID

config DULT_ID_READ_STATE_TIMEOUT
	int
	default 5
	help
	  Identifier read state timeout in minutes. As stated in the DULT specification:
	  "The identifier read state MUST be enabled for 5 minutes once the user action on
	  the accessory is successfully performed.". Changing this value will break the
	  specification.

endif # DULT_ID

config DULT_NEAR_OWNER_STATE
	bool
	default y
	help
	  Add DULT near owner state source files.

config DULT_PROTOCOL_IMPLEMENTATION_VERSION
	hex
	default 0x00010000

config DULT_SOUND
	bool
	default y
	help
	  Add DULT sound source files.

config DULT_USER
	bool
	default y
	help
	  Add DULT user source files.

config DULT_MOTION_DETECTOR
	bool "Enable DULT Motion detector feature"
	help
	  The DULT Motion detector requests the device to ring if the accessory separated
	  from owner is moving. For more details see
	  https://www.ietf.org/archive/id/draft-detecting-unwanted-location-trackers-01.html#name-motion-detector.

if DULT_MOTION_DETECTOR

config DULT_MOTION_DETECTOR_TEST_MODE
	bool "Enable DULT Motion detector test mode"
	help
	  The DULT Motion detector test mode allows to configure motion detector parameters
	  for testing purposes. Those values are defined in the DULT specification and should
	  not be changed in the production code.

config DULT_MOTION_DETECTOR_SEPARATED_UT_SAMPLING_RATE1
	int
	default 10000
	help
	  Sampling rate in milliseconds when motion detector is enabled in separated state.

config DULT_MOTION_DETECTOR_SEPARATED_UT_SAMPLING_RATE2
	int
	default 500
	help
	  Motion detector sampling rate in milliseconds when movement is detected in separated
	  state.

config DULT_MOTION_DETECTOR_SEPARATED_UT_BACKOFF_PERIOD
	int "Period in minutes to disable motion detector if accessory is in separated state" if DULT_MOTION_DETECTOR_TEST_MODE
	default 2 if DULT_MOTION_DETECTOR_TEST_MODE
	default 360

config DULT_MOTION_DETECTOR_SEPARATED_UT_TIMEOUT_PERIOD_MIN
	int "Minimum time span in minutes in separated state before enabling motion detector" if DULT_MOTION_DETECTOR_TEST_MODE
	default 3 if DULT_MOTION_DETECTOR_TEST_MODE
	default 480

config DULT_MOTION_DETECTOR_SEPARATED_UT_TIMEOUT_PERIOD_MAX
	int "Maximum time span in minutes in separated state before enabling motion detector" if DULT_MOTION_DETECTOR_TEST_MODE
	default DULT_MOTION_DETECTOR_SEPARATED_UT_TIMEOUT_PERIOD_MIN if DULT_MOTION_DETECTOR_TEST_MODE
	default 1440

config DULT_MOTION_DETECTOR_SEPARATED_UT_ACTIVE_POLL_DURATION
	int
	default 20
	help
	  Time span in seconds of motion detector active polling with
	  CONFIG_DULT_MOTION_DETECTOR_SEPARATED_UT_SAMPLING_RATE2 rate. After the timeout, the
	  motion detector is disabled for CONFIG_DULT_MOTION_DETECTOR_SEPARATED_UT_BACKOFF_PERIOD
	  period.

config DULT_MOTION_DETECTOR_SEPARATED_UT_MAX_SOUND_COUNT
	int
	default 10
	help
	  Maximum number of sound indications to be sent by motion detector before disabling it.
	  After sending maximum number of sound indications, the motion detector is disabled for
	  CONFIG_DULT_MOTION_DETECTOR_SEPARATED_UT_BACKOFF_PERIOD period."

endif # DULT_MOTION_DETECTOR

module = DULT
module-str = DULT
source "${ZEPHYR_BASE}/subsys/logging/Kconfig.template.log_config"

endif # DULT
```

## subsys/emds/Kconfig
```kconfig
#
# Copyright (c) 2022 Nordic Semiconductor
#
# SPDX-License-Identifier: LicenseRef-Nordic-5-Clause
#

menuconfig EMDS
	bool "Emergency Data Storage"
	select CRC
	select CRC32_K_4_2_TABLE_256
	depends on PARTITION_MANAGER_ENABLED
	depends on FLASH_MAP
	help
	  Enable Emergency Data Storage subsystem.

if EMDS

config EMDS_SCANNING_FAILURES
	int "Maximum number of scanning failures"
	default 2
	help
	  Maximum number of allowed metadata scanning failures on partition
	  before giving up. The option should be tradeoff between
	  performance and reliability. If the value is too low, the system
	  may not take into account all the candidates, and may not select
	  the best one for recovery. If the value is too high, the system
	  may take too long to scan the partition, and may not be able to
	  recover in time. The value should be set to the number of
	  expected failures during the scanning process.

config EMDS_MAX_CANDIDATES
	int "Maximum number of snapshot candidates"
	default 3
	help
	  Maximum number of snapshot candidates to keep track within
	  the partition to select the best one for recovery.

config EMDS_FLASH_TIME_WRITE_ONE_WORD_US
	int
	default 41 if SOC_NRF52840
	default 43 if SOC_NRF52833
	default 43 if SOC_SERIES_NRF53
	default 28 if SOC_SERIES_NRF54L
	help
	  Max time to write one word into non-volatile storage (in microseconds).
	  The word size is 4 bytes. The value is dependent on the
	  chip used, and should be checked against the chip's datasheet.
	  For RRAM-based flash driver the average time to write a 32-bit word
	  in a stream of sequentially address ordered writes was taken.

	  Note that despite the typical time for streamed writing of a 32-bit word
	  for RRAM is 22 microseconds the actual time may vary. It is used a bit bigger
	  value here to compensate dispersion around the typical time.

config EMDS_CHUNK_PREPARATION_TIME_US
	int
	default 31 if SOC_NRF52840
	default 31 if SOC_NRF52833
	default 31 if SOC_SERIES_NRF53
	default 8 if SOC_SERIES_NRF54L
	help
	  Time that is required to prepare a chunk for storing.
	  It includes creation chunk from entries, crc calculation and
	  prologue/epilogue time of participated functions.
	  Time is approximate and depends on entry sizes and number of entries.

module = EMDS
module-str = emergency data storage
source "$(ZEPHYR_BASE)/subsys/logging/Kconfig.template.log_config"

endif # EMDS
```

## subsys/encrypted_storage/Kconfig
```kconfig
#
# Copyright (c) 2018 - 2023 Nordic Semiconductor
#
# SPDX-License-Identifier: LicenseRef-Nordic-5-Clause
#

# Secure storage subsystem configuration options

menuconfig ENCRYPTED_STORAGE
	bool "Secure Storage"
	depends on !BUILD_WITH_TFM
	help
	  The encrypted storage subsystem allows its users to store in a secure
	  way data ensuring data integrity and confidentially by using AEAD
	  algorithms. It supports several implementation back-ends to
	  provide various levels of trust depending on the device security
	  features.

if ENCRYPTED_STORAGE
module = ENCRYPTED_STORAGE
module-str = encrypted_storage
source "subsys/logging/Kconfig.template.log_config"


menuconfig PSA_PROTECTED_STORAGE
	bool "Protected Storage"
	help
	  The Protected Storage is designed to store critical assets.
	  It supports several storage back-ends and several secure
	  implementation back-ends to provide various levels of trust.

if PSA_PROTECTED_STORAGE

config PSA_PROTECTED_STORAGE_PREFIX
	string "Protected Storage object prefix"
	default "ps"
	help
	  This defines the prefix for Protected Storage object names.

endif # PSA_PROTECTED_STORAGE

menuconfig PSA_INTERNAL_TRUSTED_STORAGE
	bool "Internal Trusted Storage"
	default y
	help
	  The Internal Trusted Storage is designed to store critcal assets that
	  must be placed inside internal flash. Some examples of assets that
	  require this are replay protection values for external storage and
	  keys for use by components of the PSA Root of Trust.

if PSA_INTERNAL_TRUSTED_STORAGE

config PSA_INTERNAL_TRUSTED_STORAGE_PREFIX
	string "Internal Trusted Storage object prefix"
	depends on PSA_INTERNAL_TRUSTED_STORAGE
	default "its"
	help
	  This defines the prefix for Internal Trusted Storage object names.

endif # PSA_INTERNAL_TRUSTED_STORAGE

choice ENCRYPTED_STORAGE_BACKEND
	prompt "Secure storage backend"
	default ENCRYPTED_STORAGE_BACKEND_AEAD
	help
	  The backend that handles encryption, authentication or other means of
	  validation of the stored assets.

menuconfig ENCRYPTED_STORAGE_BACKEND_AEAD
	bool "Use AEAD scheme"
	help
	  Use an AEAD scheme to encrypt the asset data and authenticate its
	  data including the meta data.

if ENCRYPTED_STORAGE_BACKEND_AEAD

config ENCRYPTED_STORAGE_BACKEND_AEAD_MAX_DATA_SIZE
	int "AEAD backend maximum storage size"
	default 256
	help
	  This defines the maximum data size that can be stored.

choice ENCRYPTED_STORAGE_BACKEND_AEAD_CRYPTO
	prompt "AEAD algorithm crypto backend"
	default ENCRYPTED_STORAGE_BACKEND_AEAD_CRYPTO_PSA_CHACHAPOLY
	help
	  Decides which implementation to be used to perform the AEAD crypto
	  operations.

config ENCRYPTED_STORAGE_BACKEND_AEAD_CRYPTO_PSA_CHACHAPOLY
	bool "PSA ChaChaPoly"
	select PSA_WANT_ALG_CHACHA20_POLY1305
	help
	  Use PSA Crypto API's with the ChaChaPoly-1305 AEAD algorithm.

endchoice # ENCRYPTED_STORAGE_BACKEND_AEAD_CRYPTO

choice ENCRYPTED_STORAGE_BACKEND_AEAD_NONCE
	prompt "AEAD nonce implementation"
	default ENCRYPTED_STORAGE_BACKEND_AEAD_NONCE_PSA_SEED_COUNTER
	help
	  Implementation to provide a AEAD nonce.

config ENCRYPTED_STORAGE_BACKEND_AEAD_NONCE_PSA_SEED_COUNTER
	bool "PSA Nonce Seed + Counter"
	select PSA_WANT_GENERATE_RANDOM
	help
	  Use PSA Crypto for Nonce initial random seed, then incrementing
	  nonce for each AEAD encryption.

config ENCRYPTED_STORAGE_BACKEND_AEAD_NONCE_CUSTOM
	bool "Custom"
	help
	  Use custom implementation for AEAD Nonce provider.

endchoice # ENCRYPTED_STORAGE_BACKEND_AEAD_NONCE

choice ENCRYPTED_STORAGE_BACKEND_AEAD_KEY
	prompt "AEAD Key implementation"
	default ENCRYPTED_STORAGE_BACKEND_AEAD_KEY_DERIVE_FROM_HUK
	help
	  Implementation to provide the AEAD keys.

config ENCRYPTED_STORAGE_BACKEND_AEAD_KEY_HASH_UID
	bool "Hash of UID"
	select PSA_WANT_ALG_SHA_256
	help
	  Use SHA-256 hash of UID as key, this option does not provide a very high
	  level of security and therefor is not recommended and should only be used
	  if it is impossible to use the HUK.

config ENCRYPTED_STORAGE_BACKEND_AEAD_KEY_DERIVE_FROM_HUK
	bool "HUK + UID"
	select HW_UNIQUE_KEY
	select HW_UNIQUE_KEY_RANDOM
	select PM_SINGLE_IMAGE
	help
	  Use the Hardware Unique Key (HUK) with the UID as label to derive a
	  new key.

config ENCRYPTED_STORAGE_BACKEND_AEAD_KEY_CUSTOM
	bool "Custom"
	help
	  Use custom implementation for AEAD key provider.

endchoice # ENCRYPTED_STORAGE_BACKEND_AEAD_KEY

endif # ENCRYPTED_STORAGE_BACKEND_AEAD

endchoice # ENCRYPTED_STORAGE_BACKEND

choice ENCRYPTED_STORAGE_STORAGE_BACKEND
	prompt "Storage backend"
	default ENCRYPTED_STORAGE_STORAGE_BACKEND_SETTINGS
	help
	  Implementation used to store the assets

config ENCRYPTED_STORAGE_STORAGE_BACKEND_SETTINGS
	bool "Settings storage backend"
	depends on SETTINGS
	help
	  Use the Settings subsystem to store the assets

endchoice # CONFIG_ENCRYPTED_STORAGE_STORAGE_BACKEND

endif # ENCRYPTED_STORAGE
```
