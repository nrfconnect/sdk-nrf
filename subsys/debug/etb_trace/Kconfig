## subsys/debug/etb_trace/Kconfig
```kconfig
#
# Copyright (c) 2023 Nordic Semiconductor
#
# SPDX-License-Identifier: LicenseRef-Nordic-5-Clause
#

config ETB_TRACE
	bool "Enable ETB trace [EXPERIMENTAL]"
	depends on SOC_SERIES_NRF91X
	select EXPERIMENTAL
	help
	  Enable tracing using Coresight modules such as ETM, ITM and storing of traces to ETB.

if ETB_TRACE

config ETB_TRACE_SYS_INIT
	bool "Initialize automatically"
	default y

config ETB_TRACE_LOW_POWER
	bool "Low power ETB trace"
	select ARM_ON_ENTER_CPU_IDLE_HOOK
	select ARM_ON_EXIT_CPU_IDLE
	help
	  Tracing requires the debug system in the SoC to be enabled, which increases overall
	  power consumption by several mA.
	  Enabling this option will reduce the power consumption by disabling tracing when the
	  CPU is about to go to idle for a period longer than
	  CONFIG_ETB_TRACE_LOW_POWER_MIN_IDLE_TIME_MS.
	  Enabling this option will introduce latency to the system, as it will run code both
	  when entering and exiting idle, including when entering ISRs.
	  It may also have other unknown side effects to the system behavior.

config ETB_TRACE_LOW_POWER_MIN_IDLE_TIME_MS
	int "Minimum idle time"
	default 1000
	depends on ETB_TRACE_LOW_POWER

endif # ETB_TRACE
```

## subsys/debug/gpio_frontend/Kconfig
```kconfig
#
# Copyright (c) 2019 Nordic Semiconductor
#
# SPDX-License-Identifier: LicenseRef-BSD-5-Clause-Nordic
#

if LOG_FRONTEND
config LOG_FRONTEND_GPIO
	bool "Enable GPIO frontend"
	help
	  When enabled frontend is using GPIO pins to output logs.

if LOG_FRONTEND_GPIO
config LOG_FRONTEND_PORT_NUMBER
	int "GPIO port"
	default 0
	range 0 1 if HAS_HW_NRF_GPIO1
	range 0 0

config LOG_FRONTEND_LSB_PIN_NUMBER
	int "Pin number for least significant bit for GPIO frontend"
	default 1
	range 0 23 if LOG_FRONTEND_PORT_NUMBER = 0
	range 0 7

config LOG_FRONTEND_HEXDUMP_MAX_LENGTH
	int "Maximal allowed length in bytes for hexdump logs with GPIO frontend"
	default 16
endif # LOG_FRONTEND_GPIO

endif # LOG_FRONTEND
```

## subsys/debug/ppi_trace/Kconfig
```kconfig
#
# Copyright (c) 2019 Nordic Semiconductor
#
# SPDX-License-Identifier: LicenseRef-Nordic-5-Clause
#

config PPI_TRACE
	bool "Enable PPI trace"
	select NRFX_GPIOTE
	select NRFX_GPPI
	help
	  Enable PPI trace module which enables forwarding hardware events to
	  GPIOs.

config PPI_TRACE_PIN_CNT
	int "Maximum number of trace pins"
	default 8

if PPI_TRACE
module = PPI_TRACE
module-str = PPI trace
source "$(ZEPHYR_BASE)/subsys/logging/Kconfig.template.log_config"

endif # PPI_TRACE
```

## subsys/debug/stack_size_analyzer/Kconfig
```kconfig
#
# Copyright (c) 2019 Nordic Semiconductor
#
# SPDX-License-Identifier: LicenseRef-BSD-5-Clause-Nordic
#

menuconfig STACK_SIZE_ANALYZER
	bool "Enable Stack size analyzer functionality"
	select INIT_STACKS
	select THREAD_MONITOR
	select THREAD_STACK_INFO
	help
	  Enable stack size analyzer functionality and all the required modules.
	  This module may be used to debug stack overflow or to find stacks
	  which size may be optimized down.
	  The module uses less resources than shell implementation and does not
	  require a valid input to type the commands.

if STACK_SIZE_ANALYZER
module = STACK_SIZE_ANALYZER
module-str = stack size analyzer
source "${ZEPHYR_BASE}/subsys/logging/Kconfig.template.log_config"

choice
	prompt "Print mode"
	default STACK_SIZE_ANALYZER_USE_LOG

config STACK_SIZE_ANALYZER_USE_PRINTK
	bool "Use printk function"
	help
	  Use kernel printk function to print stack size information.

config STACK_SIZE_ANALYZER_USE_LOG
	bool "Use logger output"
	select LOG
	help
	  Use logger output to print stack size information.

endchoice

config STACK_SIZE_ANALYZER_RUN_UNLOCKED
	bool "Run analysis with interrupts unlocked"
	default y
	help
	  The stack analisys takes quite a long time.
	  Every stack it founds is analyzed word by word to find any that
	  does not match the magic number.
	  Normally while stacks are analyzed the k_thread_foreach function
	  is used.
	  It makes safe run from the thread list perspective but may lock
	  the interrupts for a long time - long enough to disconnect when
	  bluetooth communication is used.
	  Setting this flag would force stack analyzer to use
	  the k_thread_foreach_unlocked function.
	  This would allow the interrupts to be processed while the stack size
	  is analyzed.
	  For the limitation of such configuration see the k_thread_foreach
	  documentation.

config STACK_SIZE_ANALYZER_AUTO
	bool "Enable automatic printing"
	default y
	help
	  Run the stack size analyzer automatically, without the need to add
	  any code to the application.
	  Stack size analysis would be called periodically.

if STACK_SIZE_ANALYZER_AUTO

config STACK_SIZE_ANALYZER_AUTO_PERIOD
	int "Automatic printing period"
	default 5000
	help
	  The time in milliseconds to call stack analyzer periodic printing function.

config STACK_SIZE_ANALYZER_AUTO_STACK_SIZE
	int "The stack size for the thread to periodically run stack analisys"
	default 512

endif # STACK_SIZE_ANALYZER_AUTO

endif # STACK_SIZE_ANALYZER
```

## subsys/dfu/Kconfig
```kconfig
#
# Copyright (c) 2020 Nordic Semiconductor ASA
#
# SPDX-License-Identifier: LicenseRef-Nordic-5-Clause
#

menu "DFU"

rsource "dfu_multi_image/Kconfig"

rsource "dfu_target/Kconfig"

rsource "fmfu_fdev/Kconfig"

endmenu
```

## subsys/dfu/dfu_multi_image/Kconfig
```kconfig
#
# Copyright (c) 2022 Nordic Semiconductor ASA
#
# SPDX-License-Identifier: LicenseRef-Nordic-5-Clause
#

menuconfig DFU_MULTI_IMAGE
	bool "Device Firmware Upgrade Multi Image API"
	select ZCBOR

if DFU_MULTI_IMAGE

config DFU_MULTI_IMAGE_MAX_IMAGE_COUNT
	int "Maximum image count"
	default 2
	help
	  The maximum number of images that can be included in a DFU package
	  and correctly processed by the DFU Multi Image library.

config DFU_MULTI_IMAGE_SAVE_PROGRESS
	bool "Store dfu multi image write progress to flash stream"
	depends on DFU_TARGET_STREAM_SAVE_PROGRESS || ZTEST
	depends on SETTINGS
	help
	  Enable this option to cause dfu_multi_image to store the current
	  write progress to flash. In case of power failure or device reset,
	  the operation can then resume from the latest state.

if DFU_MULTI_IMAGE_SAVE_PROGRESS

config DFU_MULTI_IMAGE_ALIGN
	int "DFU Multi Image start of images alignment"
	default $(dt_node_int_prop_int,$(DT_CHOSEN_ZEPHYR_FLASH),write-block-size)
	help
	  Set the alignment of the start of every image inside the DFU Multi Image package.
	  Setting this to a value greater than 1 will add 0xFF padding at the end of the header
	  and between images as needed to ensure that each image starts at an offset with the given alignment.
	  This is needed when the DFU package is stored in a medium that requires specific alignment,
	  e.g., flash memory with minimum write size of 4.
	  Note - the additional 0xFF will be passed as part of the image to the underlying DFU target
	  and possibly will be written to the NVM.

endif # DFU_MULTI_IMAGE_SAVE_PROGRESS

module=DFU_MULTI_IMAGE
module-str=DFU Multi Image
source "${ZEPHYR_BASE}/subsys/logging/Kconfig.template.log_config"

endif # DFU_MULTI_IMAGE
```

## subsys/dfu/dfu_target/Kconfig
```kconfig
#
# Copyright (c) 2020 Nordic Semiconductor ASA
#
# SPDX-License-Identifier: LicenseRef-Nordic-5-Clause
#

menuconfig DFU_TARGET
	bool "Device Firmware Upgrade target API"

if (DFU_TARGET)

config DFU_TARGET_MCUBOOT
	bool "MCUBoot update support"
	default y
	depends on IMG_MANAGER
	depends on BOOTLOADER_MCUBOOT
	select DFU_TARGET_STREAM
	imply MPU_ALLOW_FLASH_WRITE
	help
	  Enable support for updates that are performed by MCUboot.

config DFU_TARGET_SMP
	bool "DFU SMP target for external update support"
	depends on SMP_CLIENT
	depends on MCUMGR_GRP_IMG_CLIENT
	depends on MCUMGR_GRP_OS_CLIENT
	select MCUMGR_GRP_OS_CLIENT_RESET
	select MCUMGR_GRP_OS_CLIENT_ECHO
	help
	  Enable support for Update external MCU by SMP client.

if DFU_TARGET_SMP

config DFU_TARGET_SMP_IMAGE_LIST_SIZE
	int "Supported Image list size"
	default 2
	help
	  Define size for Image cache list.

endif

config DFU_TARGET_STREAM
	bool "Generic DFU stream target"
	depends on STREAM_FLASH
	select STREAM_FLASH_ERASE if FLASH_HAS_EXPLICIT_ERASE

config DFU_TARGET_MCUBOOT_SAVE_PROGRESS
	bool "Store write progress to flash (MCUboot) [DEPRECATED]"
	select DFU_TARGET_STREAM_SAVE_PROGRESS
	help
	  DFU_TARGET_MCUBOOT_SAVE_PROGRESS is deprecated, please use
	  DFU_TARGET_STREAM_SAVE_PROGRESS instead.

if DFU_TARGET_MCUBOOT_SAVE_PROGRESS
	comment "DFU_TARGET_MCUBOOT_SAVE_PROGRESS is deprecated, please use DFU_TARGET_STREAM_SAVE_PROGRESS instead"
endif

config DFU_TARGET_STREAM_SAVE_PROGRESS
	bool "Store write progress to flash stream"
	depends on DFU_TARGET_STREAM || ZTEST # ZTEST for testing purposes
	depends on SETTINGS
	depends on !SETTINGS_NONE
	depends on !DFU_MULTI_IMAGE
	help
	  Enable this option to cause dfu_target_stream to store the current
	  write progress to flash. In case of power failure or device reset,
	  the operation can then resume from the latest state.

config DFU_TARGET_MODEM_DELTA
	bool "Modem delta update support"
	imply DOWNLOAD_CLIENT_RANGE_REQUESTS
	default y
	depends on SOC_SERIES_NRF91X
	help
	  Enable support for updates to the modem firmware.

if (DFU_TARGET_MODEM_DELTA)

config DFU_TARGET_MODEM_TIMEOUT
	int "Erase pending timeout"
	default 60
	depends on DFU_TARGET_MODEM_DELTA
	help
	  Set the time in seconds that the code will wait for the modem delta DFU erase
	  to complete before generating a DFU_TARGET_EVT_TIMEOUT event.
	  Every time this timeout is reached, a DFU_TARGET_EVT_TIMEOUT event is sent
	  and the counting timer is reset while the erasure continues.
	  If this timeout is reached, a disconnect of the LTE link is recommended
	  so that the modem has time to service the delta DFU erase request.
	  It's also possible to reboot the device to achieve the same behavior.

endif # DFU_TARGET_MODEM_DELTA

config DFU_TARGET_FULL_MODEM
	bool "Full Modem update support"
	depends on SOC_SERIES_NRF91X
	depends on DFU_TARGET_STREAM
	depends on STREAM_FLASH
	depends on FMFU_FDEV
	help
	  Enable support for full updates to the modem firmware.
	  Note that this requires an external flash.

# Flash size required for storing full modem image
config DFU_TARGET_FULL_MODEM_EXT_FLASH_SIZE
	hex
	depends on DFU_TARGET_FULL_MODEM
	default 0x400000 if SOC_SERIES_NRF91X

config DFU_TARGET_FULL_MODEM_USE_EXT_PARTITION
	default PM_EXTERNAL_FLASH_ENABLED
	depends on DFU_TARGET_FULL_MODEM
	select PM_PARTITION_REGION_FMFU_STORAGE_EXTERNAL
	bool "Use a dedicated FMFU partition on the external flash device"

config DFU_TARGET_SUIT
	bool "SUIT DFU target support"
	default y
	depends on SUIT
	imply MPU_ALLOW_FLASH_WRITE
	select SUIT_UTILS
	select ZCBOR
	select ZCBOR_CANONICAL
	select DFU_TARGET_STREAM
	help
	  Enable support for updates using DFU target based on SUIT

module=DFU_TARGET
module-dep=LOG
module-str=Device Firmware Upgrade
source "${ZEPHYR_BASE}/subsys/logging/Kconfig.template.log_config"

endif # DFU_TARGET
```

## subsys/dfu/fmfu_fdev/Kconfig
```kconfig
#
# Copyright (c) 2021 Nordic Semiconductor ASA
#
# SPDX-License-Identifier: LicenseRef-Nordic-5-Clause
#

menuconfig FMFU_FDEV
	bool "Full Modem Firmware Upgrade from flash device"
	depends on ZCBOR
	depends on NRF_MODEM_LIB
	depends on MBEDTLS_SHA256_C


if (FMFU_FDEV)

config FMFU_CDDL_DECODER_GENERATE
	bool "Regenerate FMFU CBOR code from cddl using zcbor, for internal use."
	help
	  Nordic internal, see cddl/CMakeLists.txt

config MBEDTLS_HEAP_SIZE
	int
	default 4096

config FMFU_FDEV_SKIP_PREVALIDATION
	bool "Skip prevalidation of modem firmware"
	help
	  Set this option to skip prevalidation of the modem firmware. Note
	  that the modem will still verify the validity of the modem firmmware
	  before booting it, but only after it has been written to the modem.
	  This option

if FMFU_FDEV_SKIP_PREVALIDATION
	comment "FMFU_FDEV_SKIP_PREVALIDATE should ONLY be used during development"
endif

module=FMFU_FDEV
module-dep=LOG
module-str=FMFU FDEV
source "${ZEPHYR_BASE}/subsys/logging/Kconfig.template.log_config"

endif # FMFU_FDEV
```

## subsys/dfu/fw_loader_settings/Kconfig
```kconfig
#
# Copyright (c) 2026 Nordic Semiconductor ASA
#
# SPDX-License-Identifier: LicenseRef-Nordic-5-Clause
#

config FW_LOADER_SETTINGS_ADV_NAME
	bool "Firmware loader Bluetooth advertising name in Settings [EXPERIMENTAL]"
	depends on SETTINGS_ZMS
	select EXPERIMENTAL
	help
	  Pass the firmware loader Bluetooth advertising name from the main
	  application to the firmware loader image. Enable a Settings handler for
	  the fw_loader/adv_name key and a load API. The main application can
	  write the name through the MCUmgr settings group; the firmware loader
	  can read it from the shared settings storage partition using
	  fw_loader_settings_adv_name_load().

	  Enable this option in the main application and firmware loader image
	  Kconfig fragments.

if FW_LOADER_SETTINGS_ADV_NAME

config FW_LOADER_SETTINGS_ADV_NAME_LEN
	int
	default 16
	help
	  Maximum length of the firmware loader Bluetooth advertising name stored
	  in Settings. This includes the terminating NUL character.

config FW_LOADER_SETTINGS_ADV_NAME_ACCESS_PROTECT
	bool "Protect firmware loader advertising name settings access"
	depends on MCUMGR_GRP_SETTINGS
	default y
	select MCUMGR_MGMT_NOTIFICATION_HOOKS
	select MCUMGR_GRP_SETTINGS_ACCESS_HOOK
	help
	  Restrict remote MCUmgr Settings access to the firmware loader
	  advertising name key. Read, write, delete, and save requests for other
	  Settings keys are rejected.

module=FW_LOADER_SETTINGS
module-str=Firmware loader settings
source "$(ZEPHYR_BASE)/subsys/logging/Kconfig.template.log_config"

endif # FW_LOADER_SETTINGS_ADV_NAME
```

## subsys/dm/Kconfig
```kconfig
#
# Copyright (c) 2021 Nordic Semiconductor
#
# SPDX-License-Identifier: LicenseRef-Nordic-5-Clause
#

config DM_MODULE
	bool "DM (Distance Measurement) module [EXPERIMENTAL]"
	select NRF_DM
	select EXPERIMENTAL
	help
	  Enable the DM (Distance Measurement) module.

if DM_MODULE

menu "nRF DM (Distance Measurement)"

config DM_HIGH_PRECISION_CALC
	# Due to memory limitations, functionality is not provided for nrf52832.
	depends on !SOC_NRF52832
	default n
	bool "Use high-precision distance estimation"
	help
	  Use a more compute-intensive algorithm for the distance estimation.
	  Works only with MCPD ranging mode.

config DM_TIMESLOT_RESCHEDULE
	bool "Timeslot reschedule"
	default n
	help
	  Enable allocation of the next timeslot after the previous timeslot has succeeded.

config DM_INITIATOR_DELAY_US
	int "Initiator start delay"
	default 1000
	help
	  Additional Initiator Start delay time.
	  Used to adjust synchronization.

config DM_MIN_TIME_BETWEEN_TIMESLOTS_US
	int "Minimum time between two timeslots"
	default 180000 if DM_HIGH_PRECISION_CALC
	default 8000
	help
	  Minimum time between two timeslots.
	  This should account for processing of the ranging data after the timeslot.

config DM_RANGING_OFFSET_US
	int "Ranging offset"
	default 1200000
	help
	  Time between the synchronisation and the ranging.
	  Increasing this allows for more rangings to different peers but also increases latency.

config DM_GPIO_DEBUG
	bool "Debugging with output pins"
	default n
	select PPI_TRACE
	help
	  Indication of distance measurement events by output pins.

config DM_TIMESLOT_QUEUE_LENGTH
	int "Timeslot queue length"
	default 40
	help
	  The maximum number of timeslots that can be scheduled.

config DM_TIMESLOT_QUEUE_COUNT_SAME_PEER
	int "The number of the same peer in the queue"
	default 10
	help
	  The maximum number of timeslots that can be scheduled for a single peer.

endmenu

module = DM_MODULE
module-str = DM_MODULE
source "${ZEPHYR_BASE}/subsys/logging/Kconfig.template.log_config"

endif #DM_MODULE

rsource "rpc/Kconfig"
```
