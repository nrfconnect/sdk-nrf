## subsys/esb/Kconfig
```kconfig
#
# Copyright (c) 2018 Nordic Semiconductor ASA
#
# SPDX-License-Identifier: LicenseRef-Nordic-5-Clause
#

menuconfig ESB
	bool "Enhanced ShockBurst"
	select NRFX_PPI if HAS_HW_NRF_PPI
	select NRFX_DPPI if HAS_HW_NRF_DPPIC
	select MPSL
	select MPSL_FEM_ONLY if !ESB_DYNAMIC_INTERRUPTS
	default n
	help
	  Enable ESB functionality.

if ESB

config ESB_MAX_PAYLOAD_LENGTH
	int "Maximum payload size"
	default 32
	range 1 252
	help
	  The maximum size of the payload.

config ESB_TX_FIFO_SIZE
	int "TX buffer length"
	default 8
	help
	  The length of the TX FIFO buffer, in number of elements.

config ESB_RX_FIFO_SIZE
	int "RX buffer length"
	default 8
	help
	  The length of the RX FIFO buffer, in number of elements.

config ESB_PIPE_COUNT
	int "Maximum number of pipes"
	default 8
	range 1 8
	help
	  The maximum number of pipes allowed in the API. Can be used if you
	  need to restrict the number of pipes used. The purpose is to prevent
	  accidental use of additional pipes, but it's not a problem leaving
	  this at 8 even if fewer pipes are used.

config ESB_RADIO_IRQ_PRIORITY
	int "Radio interrupt priority"
	range 0 5 if ZERO_LATENCY_IRQS
	range 0 6
	default 1

config ESB_EVENT_IRQ_PRIORITY
	int "Event interrupt priority"
	range 0 5 if ZERO_LATENCY_IRQS
	range 0 6
	default 2

menu "Hardware selection (alter with care)"

choice ESB_SYS_TIMER
	default ESB_SYS_TIMER021 if $(dt_nodelabel_has_compat,timer021,$(DT_COMPAT_NORDIC_NRF_TIMER))
	default ESB_SYS_TIMER10 if $(dt_nodelabel_has_compat,timer10,$(DT_COMPAT_NORDIC_NRF_TIMER))
	default ESB_SYS_TIMER2
	prompt "Timer to use for the ESB system timer"

config ESB_SYS_TIMER0
	bool "TIMER0"
	depends on $(dt_nodelabel_has_compat,timer0,$(DT_COMPAT_NORDIC_NRF_TIMER))
	select NRFX_TIMER0

config ESB_SYS_TIMER1
	bool "TIMER1"
	depends on $(dt_nodelabel_has_compat,timer1,$(DT_COMPAT_NORDIC_NRF_TIMER))
	select NRFX_TIMER1

config ESB_SYS_TIMER2
	bool "TIMER2"
	depends on $(dt_nodelabel_has_compat,timer2,$(DT_COMPAT_NORDIC_NRF_TIMER))
	select NRFX_TIMER2

config ESB_SYS_TIMER3
	bool "TIMER3"
	depends on $(dt_nodelabel_has_compat,timer3,$(DT_COMPAT_NORDIC_NRF_TIMER))
	select NRFX_TIMER3

config ESB_SYS_TIMER4
	bool "TIMER4"
	depends on $(dt_nodelabel_has_compat,timer4,$(DT_COMPAT_NORDIC_NRF_TIMER))
	select NRFX_TIMER4

config ESB_SYS_TIMER10
	bool "TIMER10"
	depends on $(dt_nodelabel_has_compat,timer10,$(DT_COMPAT_NORDIC_NRF_TIMER))
	select NRFX_TIMER10

config ESB_SYS_TIMER020
	bool "TIMER020"
	depends on $(dt_nodelabel_has_compat,timer020,$(DT_COMPAT_NORDIC_NRF_TIMER))
	select NRFX_TIMER020

config ESB_SYS_TIMER021
	bool "TIMER021"
	depends on $(dt_nodelabel_has_compat,timer021,$(DT_COMPAT_NORDIC_NRF_TIMER))
	select NRFX_TIMER021

config ESB_SYS_TIMER022
	bool "TIMER022"
	depends on $(dt_nodelabel_has_compat,timer022,$(DT_COMPAT_NORDIC_NRF_TIMER))
	select NRFX_TIMER022

endchoice

config ESB_SYS_TIMER_INSTANCE
	int
	default 0 if ESB_SYS_TIMER0
	default 1 if ESB_SYS_TIMER1
	default 2 if ESB_SYS_TIMER2
	default 3 if ESB_SYS_TIMER3
	default 4 if ESB_SYS_TIMER4
	default 10 if ESB_SYS_TIMER10
	default 20 if ESB_SYS_TIMER020
	default 21 if ESB_SYS_TIMER021
	default 22 if ESB_SYS_TIMER022

config ESB_SYS_TIMER_INSTANCE_LEADING_ZERO
	bool
	default y if ESB_SYS_TIMER020 || ESB_SYS_TIMER021 || ESB_SYS_TIMER022

endmenu

config ESB_DYNAMIC_INTERRUPTS
	bool "Use direct dynamic interrupts"
	depends on DYNAMIC_INTERRUPTS && DYNAMIC_DIRECT_INTERRUPTS
	help
	  This option configures ESB IRQ handlers using direct dynamic
	  interrupts. This allows reconfiguring ESB_SYS_TIMER_IRQn, ESB_EVT_IRQ,
	  and RADIO_IRQn handlers during runtime when ESB is uninitialized.

config ESB_NEVER_DISABLE_TX
	select EXPERIMENTAL
	bool "Never disable radio transmission stage"
	help
	  This option changes the radio behavior so that the
	  transmitter remains IDLE between transmissions instead of being disabled.
	  This is applicable only when the packet is not acknowledged. Otherwise,
	  the radio emitter needs to be turned off to enable the radio receiver.
	  This reduces delay between consecutive transmissions but consumes more energy.

config ESB_FAST_SWITCHING
	select EXPERIMENTAL
	depends on !ESB_NEVER_DISABLE_TX && SOC_NRF54H20_CPURAD
	bool "Fast radio TX/RX and RX/TX switching [EXPERIMENTAL]"
	help
	  This option enables fast switching between transmit (TX) and receive (RX) modes
	  and vice versa for ESB configurations.
	  For the PTX node, this switching occurs after transmitting a packet and before waiting
	  for acknowledgment (TX -> RX).
	  For the PRX node, this switching occurs after receiving a packet and before
	  transmitting an acknowledgment (RX -> TX).
	  Enabling this feature can improve the responsiveness and efficiency of the radio
	  communication system by reducing the latency.

config ESB_FAST_CHANNEL_SWITCHING
	select EXPERIMENTAL
	depends on SOC_NRF54H20_CPURAD
	bool "Fast radio channel switching [EXPERIMENTAL]"
	help
	  This option enables fast radio channel switching.
	  Allows the radio channel to be changed in RX radio state
	  without the need to switch the radio to DISABLE state.

module=ESB
module-str=ESB
source "${ZEPHYR_BASE}/subsys/logging/Kconfig.template.log_config"

endif # NRF_ENHANCED_SHOCKBURST
```

## subsys/event_manager/Kconfig
```kconfig
#
# Copyright (c) 2018 Nordic Semiconductor
#
# SPDX-License-Identifier: LicenseRef-Nordic-5-Clause
#

menuconfig EVENT_MANAGER
	bool
	prompt "Event Manager"
	help
	  Enable Event Manager.
	  Note that Event Manager uses orphan sections to handle its
	  data structures.

if EVENT_MANAGER

config EVENT_MANAGER_SHOW_EVENTS
	bool "Show events"
	depends on LOG
	default y
	help
	  This option controls if events are printed to console.

config EVENT_MANAGER_SHOW_EVENT_HANDLERS
	bool "Show event handlers"
	depends on EVENT_MANAGER_SHOW_EVENTS
	help
	  This option controls if event handlers are printed to console.

module = EVENT_MANAGER
module-str = Event Manager
source "${ZEPHYR_BASE}/subsys/logging/Kconfig.template.log_config"

config EVENT_MANAGER_EVENT_LOG_BUF_LEN
	int "Length of buffer for processing event message"
	default 128
	range 0 1024

config EVENT_MANAGER_LOG_EVENT_TYPE
	bool "Include event type in the event log output"
	default y

config EVENT_MANAGER_MAX_EVENT_CNT
	int "Maximum number of event types"
	default 32
	help
	  Maximum number of declared event types in Event Manager.

config EVENT_MANAGER_PROVIDE_EVENT_SIZE
	bool "Provide information about the event size"
	help
	  This option enables the information about event size.
	  This would require to store more information with event type
	  and should be enabled only if such an information is required.

endif # EVENT_MANAGER
```

## subsys/event_manager_profiler/Kconfig
```kconfig
#
# Copyright (c) 2021 Nordic Semiconductor
#
# SPDX-License-Identifier: LicenseRef-Nordic-5-Clause
#

config EVENT_MANAGER_PROFILER
	depends on EVENT_MANAGER
	bool "Log events to Profiler"
	select PROFILER
	help
	  Event Manager will use profiler event count equal to Event Manager profiled event count
	  + 2 events for processing event start/end.

if EVENT_MANAGER_PROFILER

config EVENT_MANAGER_PROFILER_TRACE_EVENT_EXECUTION
	bool "Trace events execution"
	default y

config EVENT_MANAGER_PROFILER_PROFILE_EVENT_DATA
	bool "Profile data connected with event"

endif # EVENT_MANAGER_PROFILER
```

## subsys/event_manager_profiler_tracer/Kconfig
```kconfig
#
# Copyright (c) 2021 Nordic Semiconductor
#
# SPDX-License-Identifier: LicenseRef-Nordic-5-Clause
#

config EVENT_MANAGER_PROFILER_TRACER
	depends on EVENT_MANAGER
	bool "Log events to Profiler"
	select PROFILER
	select EVENT_MANAGER_POSTINIT_HOOK
	select EVENT_MANAGER_SUBMIT_HOOKS
	select EVENT_MANAGER_PREPROCESS_HOOKS
	select EVENT_MANAGER_POSTPROCESS_HOOKS

if EVENT_MANAGER_PROFILER_TRACER

config EVENT_MANAGER_PROFILER_TRACER_TRACE_EVENT_EXECUTION
	bool "Trace events execution"
	default y

config EVENT_MANAGER_PROFILER_TRACER_PROFILE_EVENT_DATA
	bool "Profile data connected with event"

endif # EVENT_MANAGER_PROFILER_TRACER
```

## subsys/fw_info/Kconfig
```kconfig
#
# Copyright (c) 2018 Nordic Semiconductor ASA
#
# SPDX-License-Identifier: LicenseRef-Nordic-5-Clause
#

menuconfig FW_INFO
	bool
	prompt "Firmware Metadata"
	imply NRFX_NVMC

if (FW_INFO)

config FW_INFO_API
	bool "Only provide APIs to locate metadata"
	help
	  Only provide APIs to locate metadata.

config FW_INFO_OFFSET
	hex "The location of firmware info inside this firmware"
	default 0x200
	help
	  The location of firmware information inside the current firmware
	  image. Valid values are 0x0, 0x200, 0x400, 0x800, and 0x1000.
	  Compatible readers of firmware information should search all possible
	  offsets. Note that all space between the vector table and this address
	  is unused.

config FW_INFO_FIRMWARE_VERSION
	int "Version number of the firmware"
	range 0 32766 if SB_MONOTONIC_COUNTER
	default 1
	help
	  When SB_MONOTONIC_COUNTER is enabled, the firmware version is limited
	  to 15 bits since the monotonic counters are 16 bits and one bit is
	  used to denote the slot the firwmare is in.

config FW_INFO_MAGIC_COMMON
	hex
	default 0x281ee6de
	help
	  Magic word for all structs (32 bits).
	  This is used by different metadata structs (in fw_info.h and
	  elsewhere). They each have their own magic word composed of three
	  uint32_t values, where one is always this option (FW_INFO_MAGIC_COMMON).
	  One of the uint32_ts is a compatibility ID constructed from
	  FW_INFO_HARDWARE_ID, FW_INFO_VERSION, FW_CRYPTO_ID, and
	  FW_INFO_MAGIC_COMPATIBILITY_ID, while the final uint32_t is completely
	  different for each struct, e.g. FW_INFO_MAGIC_FIRMWARE_INFO.
	  The bootloader expects a certain value for each struct, and if it
	  attempts to read a struct without a matching magic word, the struct
	  will be rejected. The config values here apply both to this build of
	  the bootloader and to the metadata constructed for the app.
	  Refer to this module's CMakeLists.txt to see how the magic words are
	  composed.

config FW_INFO_MAGIC_FIRMWARE_INFO
	hex
	default 0x8fcebb4c
	help
	  Magic word for firmware information structs (32 bits).
	  Magic word value specific to firmware information structs (inside
	  the firmware). For more information, see FW_INFO_MAGIC_COMMON.

config FW_INFO_MAGIC_EXT_API
	hex
	default 0xb845acea
	help
	  Magic word value specific to EXT_API structs.
	  For more information, see FW_INFO_MAGIC_COMMON.

config FW_INFO_HARDWARE_ID
	int "The SoC a firmware is built to run on (8 bits)"
	range 0 255
	default 51 if SOC_SERIES_NRF51X
	default 52 if SOC_SERIES_NRF52X
	default 53 if SOC_SERIES_NRF53X
	default 91 if SOC_SERIES_NRF91X
	default 0 if BOARD_NATIVE_POSIX
	help
	  Used to ensure binary compatibility.
	  For more information, see FW_INFO_MAGIC_COMMON.

config FW_INFO_VERSION
	int
	range 0 255
	default 2
	help
	  Version number of the fw_*_info structs (8 bits).
	  Used to ensure binary compatibility.
	  For more information, see FW_INFO_MAGIC_COMMON.

config FW_INFO_CRYPTO_ID
	int
	default 0

config FW_INFO_MAGIC_COMPATIBILITY_ID
	int "Compatibility ID for user-defined purposes (8 bits)"
	range 0 255
	default 0
	help
	  User defined value.
	  Used to ensure compatibility between bootloader and metadata.
	  For more information, see FW_INFO_MAGIC_COMMON.

config FW_INFO_MAGIC_LEN
	int
	default 12
	help
	  Total length of magic words (in bytes).
	  For more information, see FW_INFO_MAGIC_COMMON.

config FW_INFO_VALID_VAL
	hex
	default 0x9102FFFF
	help
	  The value fw_info::valid will have when valid.

EXT_API = EXT_API_PROVIDE
id = 0x1200
flags = 0
ver = 1
source "${ZEPHYR_BASE}/../nrf/subsys/fw_info/Kconfig.template.fw_info_ext_api"

config EXT_API_PROVIDE_EXT_API_ATLEAST_OPTIONAL
	bool "Set the PROVIDE EXT_API as at least optional"
	help
	  When this is enabled MCUBOOT requires the presence of a FW_INFO struct in the firmware
	  image being booted.

endif # FW_INFO
```

## subsys/fw_info/Kconfig.template.fw_info_ext_api
```kconfig
#
# Copyright (c) 2019 Nordic Semiconductor ASA
#
# SPDX-License-Identifier: LicenseRef-BSD-5-Clause-Nordic
#

choice
	prompt "Request to use the $(EXT_API) EXT_API."
	default $(EXT_API)_EXT_API_UNUSED

config $(EXT_API)_EXT_API_UNUSED
	bool "Don't request the $(EXT_API) EXT_API."
	depends on !$(EXT_API)_EXT_API_ATLEAST_OPTIONAL && !$(EXT_API)_EXT_API_ATLEAST_REQUIRED

config $(EXT_API)_EXT_API_OPTIONAL
	bool "Request to use the $(EXT_API) EXT_API (optional)."
	depends on !$(EXT_API)_EXT_API_ATLEAST_REQUIRED
	help
	  Include client code for this EXT_API. This also puts a request for
	  this EXT_API into the firmware info, marked as optional. The user must
	  check that it is present before using it.

config $(EXT_API)_EXT_API_REQUIRED
	bool "Request to use the $(EXT_API) EXT_API (required)."
	help
	  Include client code for this EXT_API. This also puts a request for
	  this EXT_API into the firmware info, marked as required.
endchoice

config $(EXT_API)_EXT_API_ATLEAST_OPTIONAL
	bool
	default n
	help
	  Can be selected to force at least OPTIONAL

config $(EXT_API)_EXT_API_ATLEAST_REQUIRED
	bool
	default n
	help
	  Can be selected to force REQUIRED

config $(EXT_API)_EXT_API_ENABLED
	bool "Provide the $(EXT_API) EXT_API to other images."
	default n
	help
	  Provide this EXT_API to other images.

if ($(EXT_API)_EXT_API_ENABLED || !$(EXT_API)_EXT_API_UNUSED)
config $(EXT_API)_EXT_API_ID
	hex
	default $(id)
	help
	  Unique ID for the $(ABI) ABI.

config $(EXT_API)_EXT_API_FLAGS
	int
	default $(flags)
	help
	  Flags for the $(EXT_API) EXT_API.

config $(EXT_API)_EXT_API_VER
	int
	default $(ver)
	help
	  The current or requested version for the $(EXT_API) EXT_API.
	  This config is used by both the provider and client of the EXT_API.

config $(EXT_API)_EXT_API_MAX_VER
	int
	default 255
	help
	  The maximum requested version for the $(EXT_API) EXT_API.
endif

# Unset variables. Otherwise, if the file is included again without setting all
# variables, the variables will silently keep the old values.
EXT_API = NOT_SET
id = NOT_SET
flags = NOT_SET
ver = NOT_SET
```
