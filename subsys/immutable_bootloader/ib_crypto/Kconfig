## subsys/immutable_bootloader/ib_crypto/Kconfig
```kconfig
#
# Copyright (c) 2018 Nordic Semiconductor ASA
#
# SPDX-License-Identifier: LicenseRef-BSD-5-Clause-Nordic
#

menuconfig IB_CRYPTO
	bool
	prompt "Secure Boot Crypto"

if (SECURE_BOOT_CRYPTO)
config IB_ECDSA_SECP256R1
	bool
	select FW_ECDSA_SECP256R1
config IB_RSA_PSS2048
	bool
	select FW_RSA_PSS2048
config IB_SHA256
	bool
	select FW_SHA256

config IB_SIGNATURE_LEN
	int
	default 64 if IB_ECDSA_SECP256R1
	default 256 if IB_RSA_PSS2048

config IB_PUBLIC_KEY_LEN
	int
	default 64 if IB_ECDSA_SECP256R1
	default 256 if IB_RSA_PSS2048

config IB_HASH_LEN
	def_int 32

choice IB_CRYPTO_SIG
	prompt "Firmware verification Algorithm"
	default IB_CRYPTO_CC310_ECDSA_SECP256R1 if HAS_HW_NRF_CC310
	default IB_CRYPTO_OBERON_ECDSA_SECP256R1
	help
	  Crypto implementation to use for signature verification of firmware in Bootloader.

	config IB_CRYPTO_OBERON_ECDSA_SECP256R1
		bool "Software ECDSA secp256r1"
		select NRF_OBERON
		select IB_ECDSA_SECP256R1
		help
		  Software implementation of ECDSA with NIST curve secp256r1.

	config IB_CRYPTO_CC310_ECDSA_SECP256R1
		bool "Hardware ECDSA secp256r1" if HAS_HW_NRF_CC310
		select NRF_CC310_BL
		select IB_ECDSA_SECP256R1
		help
		  Hardware implementation of ECDSA with NIST curve secp256r1.

	#config IB_CRYPTO_OBERON_RSA_2048
	#	bool #"Software RSA-PSS 2048-bits"
	#	select NRF_OBERON
	#	select IB_RSA_PSS2048
	#	help
	#	  Software implementation of RSASSA-PSS, 2048-bits.
	#	  Not available yet.

	#config IB_CRYPTO_CC310_RSA_2048
	#	bool #"Hardware RSA-PSS 2048-bits" if HAS_HW_NRF_CC310
	#	select NRF_CC310_BL
	#	select IB_RSA_PSS2048
	#	help
	#	  Hardware implementation of RSASSA-PSS, 2048-bits.
	#	  Not available yet.

endchoice

choice IB_CRYPTO_HASH
	prompt "Hashing Implementation"
	default IB_CRYPTO_CC310_SHA256 if HAS_HW_NRF_CC310
	default IB_CRYPTO_OBERON_SHA256
	help
	  Crypto implementation to use for hash generation in Bootloader.

	config IB_CRYPTO_OBERON_SHA256
		bool "Software SHA256"
		select NRF_OBERON
		select IB_SHA256
		help
		  Software implementation of SHA256.

	config IB_CRYPTO_CC310_SHA256
		bool "Hardware SHA256" if HAS_HW_NRF_CC310
		select NRF_CC310_BL
		select NRF_OBERON
		select IB_SHA256
		help
		  Hardware implementation of SHA256.

endchoice

config IB_PUBLIC_KEY_HASH_LEN
	int "Public key hash size (bytes)"
	default 16
	help
	  The length to which public key hashes in the list of Root of Trust
	  Public Keys are truncated.

endif # IB_CRYPTO
```

## subsys/key_loader/Kconfig
```kconfig
# Copyright (c) 2024 Nordic Semiconductor ASA
# SPDX-License-Identifier: LicenseRef-Nordic-5-Clause

menuconfig NRF_KEY_LOADER
	bool "Key loader"
	depends on NRF_SECURITY
	depends on MBEDTLS_PSA_CRYPTO_C
	help
	  Enable support for loading keys built in at compile time.

if NRF_KEY_LOADER

config NRF_KEY_LOADER_BASE_PATH
	string "Path to directory that contains all key bin files"
	help
	  All required keys must be located in this directory with the correct name.
	  The required keys are:
	  - MANIFEST_PUBKEY_APPLICATION_GEN[1-3]
	  - MANIFEST_PUBKEY_RADIO_GEN[1-3]
	  - MANIFEST_PUBKEY_OEM_ROOT_GEN[1-3]
	  - FWENC_APPLICATION_GEN[1-2]
	  - FWENC_RADIO_GEN[1-2]

module=KEY_LOADER
module-dep=LOG
module-str=Key Loader
source "$(ZEPHYR_BASE)/subsys/logging/Kconfig.template.log_config"

endif # NRF_KEY_LOADER
```

## subsys/lcs/Kconfig
```kconfig
#
# Copyright (c) 2026 Nordic Semiconductor ASA
#
# SPDX-License-Identifier: LicenseRef-Nordic-5-Clause
#

menuconfig LCS
	bool "LCS handling"
	help
	  Enable device Life Cycle State subsystem.

if LCS

choice LCS_MEM
	prompt "LCS memory storage backend"
	default LCS_MEM_BL_STORAGE

config LCS_MEM_BL_STORAGE
	bool "BL Storage"
	help
	  Store Life Cycle State values in BL storage.

endchoice # LCS_MEM

module = LCS
module-str = Life Cycle State
source "${ZEPHYR_BASE}/subsys/logging/Kconfig.template.log_config"

endif # LCS
```

## subsys/logging/Kconfig
```kconfig
#
# Copyright (c) 2024 Nordic Semiconductor
#
# SPDX-License-Identifier: LicenseRef-Nordic-5-Clause
#

menu "Logging over RPC"

config LOG_RPC
	bool
	select NRF_RPC
	select NRF_RPC_CBOR

config LOG_FORWARDER_RPC
	bool "nRF RPC logging forwarder"
	depends on LOG
	select LOG_RPC
	help
	  Enables receiving log messages as nRF RPC events and forwarding them to
	  the Zephyr logging subsystem.

menuconfig LOG_BACKEND_RPC
	bool "nRF RPC logging backend"
	depends on LOG_MODE_DEFERRED
	depends on LOG_PROCESS_THREAD
	depends on !LOG_FORWARDER_RPC
	select LOG_OUTPUT
	select LOG_RPC
	help
	  Enables Zephyr logging backend that sends log messages as nRF RPC events.

if LOG_BACKEND_RPC

config LOG_BACKEND_RPC_OUTPUT_BUFFER_SIZE
	int "Output buffer size"
	default 128
	help
	  Defines the size of stack buffer that is used by the RPC logging backend
	  while formatting a log message.

config LOG_BACKEND_RPC_HISTORY
	bool "Log history support"
	help
	  Enables the feature to continuously store logs in a large ring buffer,
	  and adds nRF RPC commands for configuring and fetching the log history.

if LOG_BACKEND_RPC_HISTORY

choice LOG_BACKEND_RPC_HISTORY_STORAGE_CHOICE
	prompt "Log history storage type"
	default LOG_BACKEND_RPC_HISTORY_STORAGE_RAM

config LOG_BACKEND_RPC_HISTORY_STORAGE_RAM
	bool "RAM buffer"

config LOG_BACKEND_RPC_HISTORY_STORAGE_FCB
	bool "Flash Circular Buffer"
	depends on FCB
	help
	  Stores the log history in Flash Circular Buffer located in the "log_history"
	  flash partition. Note that enabling this option may significantly increase
	  the flash wear, so this option is not meant the production environments,
	  and extra caution should be taken when using this functionality.

endchoice # LOG_BACKEND_RPC_HISTORY_STORAGE_CHOICE

config LOG_BACKEND_RPC_HISTORY_UPLOAD_THREAD_STACK_SIZE
	int "Log history upload thread stack size"
	default 1024

config LOG_BACKEND_RPC_HISTORY_UPLOAD_CHUNK_SIZE
	int "Log history upload chunk size"
	default 1024

config LOG_BACKEND_RPC_HISTORY_SIZE
	hex "Log history size"
	default 0x4000 if LOG_BACKEND_RPC_HISTORY_STORAGE_RAM
	default 0x8000 if LOG_BACKEND_RPC_HISTORY_STORAGE_FCB
	help
	  Size of the ring buffer used to store the log history, in bytes.

config LOG_BACKEND_RPC_HISTORY_STORAGE_FCB_NUM_SECTORS
	int "Log history FCB maximum number of flash sectors"
	default 64
	depends on LOG_BACKEND_RPC_HISTORY_STORAGE_FCB

endif # LOG_BACKEND_RPC_HISTORY

config LOG_BACKEND_RPC_CRASH_LOG
	bool "Crash log support"
	depends on DEBUG_COREDUMP
	help
	  Enables saving the crash log in the "crash_log" retained RAM partition,
	  and adds an nRF RPC command that allows a remote user to read the crash
	  log after the device reboots.
	  The crash log contains any log messages passed to the nRF RPC logging
	  backend after the logging subsystem has been put in the panic mode.
	  Setting this option requires that the devicetree contains the "crash_log"
	  retained RAM partition.

config LOG_BACKEND_RPC_ECHO
	bool "Echo command support"
	help
	  Enables the support for "echo" nRF RPC command that allows the remote to
	  generate a log message on the local device. This can be used for testing
	  Logging over RPC functionality.

endif # LOG_BACKEND_RPC

config LOG_BACKED_RPC_CRASH_INFO_FILENAME_SIZE
	int "Maximum size of assert's filename in crash info structure"
	default 1 if !ASSERT || ASSERT_NO_FILE_INFO
	default 255

endmenu # "Logging over nRF RPC"
```

## subsys/matter/Kconfig
```kconfig
# Copyright (c) 2021 Nordic Semiconductor
#
# SPDX-License-Identifier: LicenseRef-Nordic-5-Clause
#

# Support for Matter (formerly Connected Home over IP) protocol in NCS is experimental for Wi-Fi technology
config CHIP_OVER_WIFI
	bool
	default y if CHIP && WIFI_NRF700X
	select EXPERIMENTAL
```

## subsys/mcuboot_ids/Kconfig
```kconfig
#
# Copyright (c) 2024 Nordic Semiconductor ASA
#
# SPDX-License-Identifier: LicenseRef-Nordic-5-Clause
#

menu "MCUboot IDs (informative only, do not change)"

config MCUBOOT_APPLICATION_IMAGE_NUMBER
	int "Application image number (informative only, do not change)"
	default -1

config MCUBOOT_NETWORK_CORE_IMAGE_NUMBER
	int "Netcore core image number (informative only, do not change)"
	default -1

config MCUBOOT_WIFI_PATCHES_IMAGE_NUMBER
	int "WiFi patches image number (informative only, do not change)"
	default -1

config MCUBOOT_QSPI_XIP_IMAGE_NUMBER
	int "QSPI XIP image number (informative only, do not change)"
	default -1

config MCUBOOT_MCUBOOT_IMAGE_NUMBER
	int "MCUboot (S0/S1) image number (informative only, do not change)"
	depends on MCUBOOT
	default -1

endmenu
```

## subsys/mgmt/fmfu/Kconfig
```kconfig
#
# Copyright (c) 2021 Nordic Semiconductor ASA
#
# SPDX-License-Identifier: LicenseRef-Nordic-5-Clause
#

menu "Full Modem Firmware Update Management(FMFU)"

config MGMT_FMFU
	bool "Serial Modem Firmware Update support"
	depends on MCUMGR_TRANSPORT_UART
	depends on MCUMGR
	depends on NRF_MODEM_LIB && !NRF_MODEM_LIB_SYS_INIT

module=MGMT_FMFU
module-dep=LOG
module-str=FMFU
source "${ZEPHYR_BASE}/subsys/logging/Kconfig.template.log_config"
endmenu
```

## subsys/mgmt/mcumgr/grp/Kconfig
```kconfig
#
# Copyright (c) 2024 Nordic Semiconductor
#
# SPDX-License-Identifier: LicenseRef-Nordic-5-Clause
#

menu "Additional MCUmgr group configuration"

rsource "os_mgmt/Kconfig"
rsource "img_mgmt/Kconfig"

endmenu
```

## subsys/mgmt/mcumgr/grp/os_mgmt/Kconfig
```kconfig
#
# Copyright (c) 2024-2025 Nordic Semiconductor ASA
#
# SPDX-License-Identifier: LicenseRef-Nordic-5-Clause
#

menu "Additional MCUmgr OS group management functionality"

config MCUMGR_GRP_OS_BOOTLOADER_INFO_B0_ACTIVE_SLOT
	bool "Bootloader info query for active b0 slot"
	depends on MCUMGR_GRP_OS_BOOTLOADER_INFO
	depends on BOOTLOADER_MCUBOOT
	depends on MCUBOOT_MCUBOOT_IMAGE_NUMBER != -1
	depends on FW_INFO
	depends on FW_INFO_API
	depends on MCUMGR_MGMT_NOTIFICATION_HOOKS
	depends on MCUMGR_GRP_OS_BOOTLOADER_INFO_HOOK
	help
	  Enables a bootloader info command for `active_b0_slot` which will return the active b0
	  image slot number, and can be used to determine which update image should be loaded.

config MCUMGR_GRP_OS_REBOOT_BT
	bool
	default y
	depends on MCUMGR_GRP_OS
	depends on (BT || MPSL)
	depends on SOC_SERIES_NRF54L
	select MCUMGR_MGMT_NOTIFICATION_HOOKS
	select MCUMGR_GRP_OS_RESET_HOOK

endmenu
```

## subsys/mgmt/settings/Kconfig
```kconfig
#
# Copyright (c) 2021 Nordic Semiconductor ASA
#
# SPDX-License-Identifier: LicenseRef-Nordic-5-Clause
#

menu "Settings Management"

if MCUBOOT
config MGMT_SETTINGS
	bool "Settings Management Module"
endif

if !MCUBOOT
config MGMT_SETTINGS
	bool "Settings Management Module"
	depends on MCUMGR
endif

module=MGMT_SETTINGS
module-dep=LOG
module-str=SETTINGS
source "${ZEPHYR_BASE}/subsys/logging/Kconfig.template.log_config"
endmenu
```

## subsys/mgmt/suitfu/Kconfig
```kconfig
#
# Copyright (c) 2023 Nordic Semiconductor ASA
#
# SPDX-License-Identifier: LicenseRef-Nordic-5-Clause
#

menuconfig MGMT_SUITFU
	bool "SUIT-based Firmware Update Management"
	depends on MCUMGR
	depends on SSF_SUIT_SERVICE_ENABLED
	depends on FLASH
	depends on MCUMGR_SMP_LEGACY_RC_BEHAVIOUR
	select MCUMGR_SMP_CBOR_MIN_DECODING_LEVEL_5
	select MCUMGR_SMP_CBOR_MIN_ENCODING_LEVEL_3

if MGMT_SUITFU

config MGMT_SUITFU_INITIALIZE_SUIT
	bool "Initialize the SUIT DFU library on startup"
	default y
	help
	  If enabled, SUIT modules will be enabled using the suit_dfu_initialize()
	  as part of the system startup.
	  Otherwise, this API must be called if a device uses SUIT DFU, before any
	  transport layer (such as SMP server, DFU target, USB) is initialized.

config MGMT_SUITFU_TRIGGER_UPDATE_RESET_DELAY_MS
	int "Delay between update trigger and the last firmware chunk, in ms"
	default 100
	help
	  The delay allows the application to send the SMP response before the update is triggered.

config MGMT_SUITFU_AUTO_REGISTER_HANDLERS
	bool "Automatically register SUIT Firmware Update handlers during boot"
	default y
	help
	  Use MCUMGR_HANDLER_DEFINE to automatically register SUIT Firmware
	  Update handlers during boot.

config MGMT_SUITFU_GRP_IMG
	bool "SUIT over Application, software image management group"
	default y
	# The IMG MGMT group is substituted, not extended by the SUIT variant
	depends on !MCUMGR_GRP_IMG

config MGMT_SUITFU_GRP_OS_BOOTLOADER_INFO_HOOK
	bool "Bootloader identification hook"
	default y
	depends on MCUMGR_GRP_OS_BOOTLOADER_INFO
	select MCUMGR_GRP_OS_BOOTLOADER_INFO_HOOK
	select MCUMGR_MGMT_NOTIFICATION_HOOKS

config MGMT_SUITFU_GRP_SUIT
	bool "Extended SUIT commands over USER group"
	default n

if MGMT_SUITFU_GRP_SUIT

config MGMT_GROUP_ID_SUIT
	int "SUIT Management Group ID"
	default 66

config MGMT_SUITFU_GRP_SUIT_MFSTS_STATE
	bool "Manifests state get"
	default y
	help
	  Gets information about UUIDs of manifests supported by the device
	  and selected attributes of installed manifests.

config MGMT_SUITFU_GRP_SUIT_MFSTS_STATE_MFSTS_COUNT
	int "Amount manifest entries for Manifests state get"
	default 15
	help
	  Shall not be lower than amount of manifests supported by the device

config MGMT_SUITFU_GRP_SUIT_CAND_ENV_UPLOAD
	bool "Candidate envelope upload"
	default y

config MGMT_SUITFU_GRP_SUIT_IMAGE_FETCH
	bool "Candidate image fetch"
	depends on SUIT_STREAM_FETCH_SOURCE_MGR
	default y

config MGMT_SUITFU_GRP_SUIT_IMAGE_FETCH_TIMEOUT_MS
	int "Inter-chunk timeout for image fetching, in ms"
	default 5000

config MGMT_SUITFU_GRP_SUIT_CACHE_RAW_UPLOAD
	bool "DFU cache raw image upload"
	default y
	depends on SUIT_CACHE_RW


endif # MGMT_SUITFU_GRP_SUIT


module=MGMT_SUITFU
module-dep=LOG
module-str=SUIT-based Firmware Update Management
source "${ZEPHYR_BASE}/subsys/logging/Kconfig.template.log_config"

endif # MGMT_SUITFU
```

## subsys/mpsl/Kconfig
```kconfig
#
# Copyright (c) 2019 - 2020 Nordic Semiconductor ASA
#
# SPDX-License-Identifier: LicenseRef-Nordic-5-Clause
#

menu "Multiprotocol service layer (MPSL)"

config MPSL_FEM_ONLY
	bool "Support only radio front-end module (FEM)"
	help
	  Support only radio front-end module (FEM) feature. The MPSL library is linked
	  into a build without the initialization. Using other MPSL features is not possible.

rsource "fem/Kconfig"

if !MPSL_FEM_ONLY

rsource "cx/Kconfig"
rsource "init/Kconfig"
rsource "pin_debug/Kconfig"
rsource "pm/Kconfig"

endif # !MPSL_FEM_ONLY

endmenu
```
