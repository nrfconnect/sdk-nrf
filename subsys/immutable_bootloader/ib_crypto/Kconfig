## subsys/mpsl/Kconfig.fem
```kconfig
#
# Copyright (c) 2019 - 2021 Nordic Semiconductor ASA
#
# SPDX-License-Identifier: LicenseRef-Nordic-5-Clause
#

DT_COMPAT_NORDIC_NRF21540_GPIO := nordic,nrf21540-fem
DT_COMPAT_GENERIC_FEM_2_CTRL_PIN := generic-fem-two-ctrl-pins

config MPSL_FEM_NRF21540_GPIO_SUPPORT
	bool
	default $(dt_nodelabel_has_compat,nrf_radio_fem,$(DT_COMPAT_NORDIC_NRF21540_GPIO))

config MPSL_FEM_GENERIC_TWO_CTRL_PINS_SUPPORT
	bool
	default $(dt_nodelabel_has_compat,nrf_radio_fem,$(DT_COMPAT_GENERIC_FEM_2_CTRL_PIN))

config MPSL_FEM
	bool "Radio front-end module (FEM) support"
# MPSL FEM is not supported on 53 yet
	depends on !(SOC_NRF5340_CPUAPP || SOC_NRF5340_CPUNET) && \
		   (MPSL_FEM_NRF21540_GPIO_SUPPORT || MPSL_FEM_GENERIC_TWO_CTRL_PINS_SUPPORT)
	default y
	help
	  Controls if front-end module (FEM) is to be configured and enabled
	  when MPSL is initialized. Default type of FEM to use depends on which
	  compatible nodes are in devicetree.

if MPSL_FEM

choice MPSL_FEM_CHOICE
	prompt "Radio front-end module (FEM) type"

config MPSL_FEM_NRF21540_GPIO
	depends on MPSL_FEM_NRF21540_GPIO_SUPPORT
	select NRFX_GPIOTE
	select NRFX_PPI
	bool "nRF21540 front-end module in GPIO mode"
	help
	  FEM device is nRF21540 and its control mode is GPIO.
	  Note: nRF21540 is unavailable when Bluetooth LE is enabled

config MPSL_FEM_SIMPLE_GPIO
	depends on MPSL_FEM_GENERIC_TWO_CTRL_PINS_SUPPORT
	select NRFX_GPIOTE
	select NRFX_PPI
	bool "Generic front-end module with two-pin control"
	help
	  FEM device has a generic two-pin control interface.
	  This option was originally designed to support the SKY66112-11,
	  but is potentially compatible with other devices with the same
	  control method.

endchoice	# MPSL_FEM_CHOICE

if MPSL_FEM_NRF21540_GPIO

config MPSL_FEM_NRF21540_TX_GAIN_DB
	int "TX gain of the nRF21540 PA amplifier in dB"
	default 20
	help
	  The default value of 20 dB is based on nRF21540 Product Specification
	  (v1.0) and it corresponds to the configuration in which the pin
	  MODE=0 and pin POUTA_SEL=0

config MPSL_FEM_NRF21540_RX_GAIN_DB
	int "RX gain of the nRF21540 LNA amplifier in dB"
	default 13
	help
	  The default value of 13 dB is based on nRF21540 Product Specification
	  (v1.0)

endif

endif	# MPSL_FEM

config MPSL_FEM_DEVICE_CONFIG_254
	bool "Apply device configuration 254"
	default MPSL_FEM
	help
	  Device configuration 254 may be required to conform to the requirements
	  in section TP/154/PHY24/TRANSMIT-05 of the ZigBee IEEE 802.15.4 Test
	  Specification, especially when an external PA is present.
	  Device configuration 254 may be required to improve RX blocking,
	  especially when an external LNA is present.
```

## subsys/mpsl/clock_ctrl/Kconfig
```kconfig
#
# Copyright (c) 2025 Nordic Semiconductor ASA
#
# SPDX-License-Identifier: LicenseRef-Nordic-5-Clause
#

config MPSL_USE_EXTERNAL_CLOCK_CONTROL
	bool "Use external clock control [EXPERIMENTAL]"
	depends on MPSL
	select CLOCK_CONTROL
	default y if SOC_SERIES_NRF54H
	select EXPERIMENTAL if SOC_SERIES_NRF52 || SOC_SERIES_NRF53
	help
	  This option configures MPSL to use an external clock driver, and
	  not the clock driver provided as part of the MPSL library.

if MPSL_USE_EXTERNAL_CLOCK_CONTROL

config MPSL_EXT_CLK_CTRL_CLOCK_REQUEST_WAIT_TIMEOUT_MS
	int "Timeout value that MPSL will wait for request to be completed by a clock driver, in milliseconds"
	default CLOCK_CONTROL_NRF_LFCLK_CLOCK_TIMEOUT_MS if CLOCK_CONTROL_NRF_LFCLK
	default 1000
	help
	  The option specifies a timeout value that MPSL clock control integration layer
	  will wait for completion of a request put to a clock driver. Note that the value
	  depends on the clock driver used, for example if nrf2 clock driver is used,
	  it must be greater or equalt than internal clock driver timeout value.

config MPSL_EXT_CLK_CTRL_NVM_CLOCK_REQUEST
	bool "Request for a non-volatile memory clock"
	depends on CLOCK_CONTROL_NRF_HSFLL_GLOBAL
	depends on SOC_SERIES_NRF54H
	default y
	help
	  This option enables MPSL to request a clock for non-volatile memory,
	  ensuring it operates at a frequency that prevents code execution being
	  too slow. This is crucial to meet meet radio protocols requirements.

config MPSL_EXT_CLK_CTRL_LFCLK_REQ_TIMEOUT_ALLOW
	bool "Workaround for LFCLK request timeout"
	depends on SOC_SERIES_NRF54H
	default y
	help
	  This option enables a workaround in MPSL external clock control
	  integration layer, to ignore the -NRF_ETIMEDOUT response for LFCLK
	  request. This workaround is safe to use for cases where there is no
	  other clock requests in the radio core FW or available requests are
	  for a clock with better accuracy than the one requested by the MPSL.
	  It is user responsibility to make sure these requirements are fulfilled.

endif # MPSL_USE_EXTERNAL_CLOCK_CONTROL
```

## subsys/mpsl/cx/Kconfig
```kconfig
#
# Copyright (c) 2021 Nordic Semiconductor ASA
#
# SPDX-License-Identifier: LicenseRef-Nordic-5-Clause
#

DT_COMPAT_CX_NRF700X := nordic,nrf700x-coex
DT_COMPAT_CX_SOFTWARE := nordic,software-coex

config MPSL_CX_ANY_SUPPORT
	bool
	default $(dt_nodelabel_enabled,nrf_radio_coex)
	help
	  Indicates that the device tree contains a nrf_radio_coex node.

config MPSL_CX_NRF70_SUPPORT
	bool
	default $(dt_nodelabel_has_compat,nrf_radio_coex,$(DT_COMPAT_CX_NRF700X))
	help
	  Indicates that the device tree contains a nrf_radio_coex node compatible with "nordic,nrf700x-coex".

config MPSL_CX_SOFTWARE_SUPPORT
	bool
	default $(dt_nodelabel_has_compat,nrf_radio_coex,$(DT_COMPAT_CX_SOFTWARE))
	help
	  Indicates that the device tree contains a nrf_radio_coex node compatible with "nordic,software-coex".

config MPSL_CX
	bool "Radio Coexistence interface support"
	depends on MPSL_CX_ANY_SUPPORT
	depends on !(BT_CTLR_PHY_CODED && MPSL_FEM && SOC_SERIES_NRF53X)
	help
	  Controls if Radio Coexistence interface is to be configured and enabled
	  when MPSL is initialized.

	  Radio Coexistence interface connects nRF5 radio protocols with external
	  Packet Traffic Arbiter (PTA) which denies or grants access to RF.

	  This is not supported with Coded Phy and FEM on the nRF5340 SoC.

config MPSL_CX_PIN_FORWARDER
	bool
	depends on SOC_NRF5340_CPUAPP
	depends on MPSL_CX
	default y

if MPSL_CX

config MPSL_CX_INIT_PRIORITY
	int "Initialization priority of the Radio Coexistence interface"
	default KERNEL_INIT_PRIORITY_DEFAULT
	help
	  Set the initialization priority number. Do not mess with it unless
	  you know what you are doing.

choice MPSL_CX_CHOICE
	prompt "Radio Coexistence interface implementation"

config MPSL_CX_NRF700X
	depends on MPSL_CX_NRF70_SUPPORT
	select NRFX_GPIOTE if !MPSL_CX_PIN_FORWARDER
	select GPIO if !MPSL_CX_PIN_FORWARDER
	imply NRF_RPC if SOC_SERIES_NRF53X
	imply NRF_RPC_CBOR if SOC_SERIES_NRF53X
	bool "nRF700x Radio Coexistence"
	help
	  Radio Coexistence supporting nRF700x interface.

config MPSL_CX_3WIRE
	select NRFX_GPIOTE if !MPSL_CX_PIN_FORWARDER
	select GPIO if !MPSL_CX_PIN_FORWARDER
	bool "Three-wire Radio Coexistence [EXPERIMENTAL]"
	select EXPERIMENTAL
	help
	  Radio Coexistence interface implementation according to Thread Radio
	  Coexistence Practical recommendations for using a three-wire PTA
	  implementation for co-located 2.4 GHz radios.

config MPSL_CX_BT_1WIRE
	select DEPRECATED
	select NRFX_GPIOTE if !MPSL_CX_PIN_FORWARDER
	select GPIO if !MPSL_CX_PIN_FORWARDER
	bool "Bluetooth Radio One-wire Coexistence [DEPRECATED]"
	help
	  Radio Coexistence interface implementation using a simple one-wire PTA
	  implementation for co-located radios. This option has been replaced
	  with MPSL_CX_1WIRE and will be removed in a future release.

config MPSL_CX_1WIRE
	select NRFX_GPIOTE if !MPSL_CX_PIN_FORWARDER
	select GPIO if !MPSL_CX_PIN_FORWARDER
	bool "One-wire Radio Coexistence"
	help
	  Radio Coexistence interface implementation using a simple one-wire PTA
	  implementation for co-located radios.

config MPSL_CX_SOFTWARE
	bool "Software Coexistence"
	depends on MPSL_CX_SOFTWARE_SUPPORT
	# If MPSL is not enabled in the current build, this option implies
	# the Software Coexistence RPC client role.
	select MPSL_CX_SOFTWARE_RPC if !MPSL
	help
	  Radio Coexistence interface implementation using software APIs to
	  configure currently granted radio operations.

endchoice # MPSL_CX_CHOICE

if MPSL_CX_SOFTWARE

config MPSL_CX_SOFTWARE_RPC_CLIENT
	bool

config MPSL_CX_SOFTWARE_RPC_SERVER
	bool

config MPSL_CX_SOFTWARE_RPC
	bool "Software Coexistence RPC"
	default y
	depends on MPSL_CX_SOFTWARE
	select MPSL_CX_SOFTWARE_RPC_SERVER if MPSL
	select MPSL_CX_SOFTWARE_RPC_CLIENT if !MPSL
	select NRF_RPC
	select NRF_RPC_CBOR
	help
	  Remote procedure call (RPC) layer for Software Coexistence implementation.
	  Enables the Software Coexistence RPC server role if MPSL is enabled, or
	  the Software Coexistence RPC client role otherwise.

endif # MPSL_CX_SOFTWARE

module=MPSL_CX
module-str=MPSL_CX
source "${ZEPHYR_BASE}/subsys/logging/Kconfig.template.log_config"

endif	# MPSL_CX
```
