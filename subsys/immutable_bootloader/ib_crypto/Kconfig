## subsys/mpsl/fem/hot_potato/models/power_map/Kconfig
```kconfig
menuconfig POWER_MAP_MODEL
	bool "Enable power map support"
        depends on MPSL_FEM_HOT_POTATO && OPENTHREAD
        select MPSL_FEM_POWER_MODEL
        select SOC_FLASH_NRF_EMULATE_ONE_BYTE_WRITE_ACCESS if SOC_FLASH_NRF
        help
          Enable power map support.

if POWER_MAP_MODEL

config POWER_LIMIT_TABLE_ID
  int "Power limit table ID"
  default 5
  help
    ID of the power limit table.

if PARTITION_MANAGER_ENABLED

config POWER_MAP_PARTITION_SIZE
	int "Power map partition size"
	default 4096
	help
	  Size of the power map partition in bytes.

config POWER_MAP_PARTITION_ALIGN
	int "Power map partition alignment"
	default 4096
	help
	  Alignment of the power map partition in bytes.

config POWER_LIMIT_IDS_PARTITION_SIZE
        int "Power limit IDs partition size"
        default 4096
        help
          Size of the power limit IDs partition in bytes.

config POWER_LIMIT_IDS_PARTITION_ALIGN
        int "Power limit IDs partition alignment"
        default 4096
        help
          Alignment of the power limit IDs partition in bytes.

endif # PARTITION_MANAGER_ENABLED
endif # POWER_MAP_MODEL
```

## subsys/mpsl/init/Kconfig
```kconfig
#
# Copyright (c) 2019 - 2021 Nordic Semiconductor ASA
#
# SPDX-License-Identifier: LicenseRef-Nordic-5-Clause
#

config MPSL_THREAD_COOP_PRIO
	int
	default 0 if OPENTHREAD
	default BT_CTLR_SDC_RX_PRIO if BT_LL_SOFTDEVICE
	default 8

config NRF52_ANOMALY_109_WORKAROUND_EGU_INSTANCE
	int
	depends on NRF52_ANOMALY_109_WORKAROUND
	default 4
	help
	  Update default EGU instance used by the nRF52 Anomaly 109 workaround
	  for PWM. The EGU instance 5 is used by the MPSL.

config MPSL_WORK_STACK_SIZE
	int "Size of the work handler thread stack"
	default 1024
	help
	  Size of the work handler thread stack, used to process work in MPSL
	  low priority context.

config MPSL_TIMESLOT_SESSION_COUNT
	int "Number of timeslot sessions"
	default 0
	help
	  Maximum number of timeslot sessions.

config MPSL_ASSERT_HANDLER
	bool "Application defined assertion handler"
	help
	  This option enables an application-defined sink for the
	  MPSL assertion mechanism. This must be defined in
	  application code and will be invoked whenever the
	  MPSL code encounters an unrecoverable error.

config MPSL_DYNAMIC_INTERRUPTS
	bool "Use direct dynamic interrupts for MPSL IRQ handlers"
	depends on DYNAMIC_DIRECT_INTERRUPTS
	help
	  This option configures MPSL IRQ handlers using direct dynamic
	  interrupts. This allows reconfiguring TIMER0_IRQn, RTC0_IRQn,
	  and RADIO_IRQn handlers during runtime when MPSL is uninitialized.

config MPSL_TRIGGER_IPC_TASK_ON_RTC_START
	bool "Trigger an IPC task when the RTC starts"
	depends on SOC_NRF5340_CPUNET
	depends on CLOCK_CONTROL_MPSL
	help
	  This option configures MPSL to trigger an IPC task at the time the
	  RTC starts. This can be used for synchronizing time betwen the
	  application and network core.

config MPSL_TRIGGER_IPC_TASK_ON_RTC_START_CHANNEL
	int "IPC channel to trigger on IPC start"
	depends on MPSL_TRIGGER_IPC_TASK_ON_RTC_START
	default 4
	help
	  The channel that will be triggered when the RTC starts.
	  The application core part of the code needs to be aware of
	  which channel is used.

config MPSL_LOW_PRIO_IRQN
	int
	default 25 if SOC_COMPATIBLE_NRF52X # SWI5
	default 26 if SOC_COMPATIBLE_NRF53X # SWI0
	default 88 if SOC_SERIES_NRF54H # SWI0
	default 28 if SOC_COMPATIBLE_NRF54LX # SWI00
	default 28 if SOC_SERIES_NRF71X # SWI00
	help
	  This option sets the low priority interrupt that MPSL will use.
	  Check the interrupt number in the MDK

config MPSL_HFCLK_LATENCY
	int "HFCLK ramp-up latency in microsecond, assumed by MPSL to wait for the clock availability"
	default $(dt_node_int_prop_int,/clocks/hfxo,startup-time-us) if $(dt_node_has_prop,/clocks/hfxo,startup-time-us)
	default $(dt_node_int_prop_int,/oscillators/hfxo,startup-time-us) if $(dt_node_has_prop,/oscillators/hfxo,startup-time-us)
	depends on !SOC_SERIES_NRF54H
	default 1400
	help
	  This option configures the amount of time MPSL will assume it takes
	  for the HFCLK to be available after it's requested.
	  Lowering this value will improve power consumption.
	  Making this value too small can degrade BLE performance.

	  To obtain an appropriate value for MPSL_HFCLK_LATENCY,
	  measure the startup time.
	  Set MPSL_HFCLK_LATENCY as twice this number to account for
	  temperature and supply variations.
	  On nRF52 and nRF53 Series devices, the startup time corresponds
	  to the time between TASKS_HFCLKSTART and EVENTS_HFCLKSTARTED.
	  On nRF54L Series devices, this corresponds to the time between
	  TASKS_XOSTART and EVENTS_XOTUNED.

	  Note that HFXO will need more time than usual on the first power-up
	  to set up the appropriate drive level for the crystal used.
	  The first power-up should not be used to set MPSL_HFCLK_LATENCY.

config MPSL_CALIBRATION_PERIOD
	int "Calibration callback period in milliseconds"
	depends on CLOCK_CONTROL_MPSL && (SOC_SERIES_NRF54L || CLOCK_CONTROL_NRF_K32SRC_RC_CALIBRATION)
	default CLOCK_CONTROL_NRF_CALIBRATION_PERIOD if CLOCK_CONTROL_NRF_K32SRC_RC_CALIBRATION
	default 60000
	help
	  This configuration means how often the calibration callback to mpsl is called.
	  On 54L, this still needs to be called even if LFRC is not used.

config MPSL_INIT_PRIORITY
	int
	default 52 if MPSL_USE_EXTERNAL_CLOCK_CONTROL
	default KERNEL_INIT_PRIORITY_DEFAULT
	help
	  This option configures MPSL system init priority level. For nRF54H SoC series the priority
	  must be lower than CONFIG_NRFS_BACKEND_IPC_SERVICE_INIT_PRIO. The nrf2 clock control depends
	  on the nRFS backend.

config MPSL_FORCE_RRAM_ON_ALL_THE_TIME
	bool "Force RRAM to stay on"
	depends on TRUSTED_EXECUTION_NONSECURE
	default y
	help
	  This option forces RRAM to stay on.
	  This is not needed when only basic bluetooth features are used.
	  Only needed when for example LLPM, Frame space update, ISO or Channel Sounding is used.

module=MPSL
module-str=MPSL
source "$(ZEPHYR_BASE)/subsys/logging/Kconfig.template.log_config"
```

## subsys/mpsl/pin_debug/Kconfig
```kconfig
#
# Copyright (c) 2024 Nordic Semiconductor ASA
#
# SPDX-License-Identifier: LicenseRef-Nordic-5-Clause
#

config MPSL_PIN_DEBUG
	bool "Toggle MPSL debug pins [EXPERIMENTAL]"
	select EXPERIMENTAL
	depends on (BOARD_NRF52DK_NRF52832 || \
		    BOARD_NRF52833DK_NRF52833 || \
		    BOARD_NRF52840DK_NRF52840 || \
		    BOARD_NRF5340DK_NRF5340_CPUNET || \
		    BOARD_NRF5340DK_NRF5340_CPUAPP || \
		    BOARD_NRF54L15DK || \
			BOARD_NRF54H20DK_NRF54H20_CPURAD)
	help
	  Set this option to enable toggling of GPIO pins upon radio
	  events. This can be useful for debugging purposes to figure
	  out when the radio is used.

config MPSL_PIN_DEBUG_APP_CORE
	bool
	depends on MPSL_PIN_DEBUG
	depends on SOC_COMPATIBLE_NRF5340_CPUAPP
	default y if SOC_COMPATIBLE_NRF5340_CPUAPP

config MPSL_PIN_DEBUG_RADIO_CORE
	bool
	depends on MPSL_PIN_DEBUG
	select NRFX_GPIOTE
	select NRFX_GPPI
	default y if (SOC_COMPATIBLE_NRF52X || SOC_COMPATIBLE_NRF5340_CPUNET)

config MPSL_PIN_DEBUG_54X_APP_OR_RADIO_CORE
	bool
	depends on MPSL_PIN_DEBUG
	select NRFX_GPIOTE
	select NRFX_GPPI
	default y if SOC_COMPATIBLE_NRF54LX
	default y if SOC_SERIES_NRF54HX

config MPSL_PIN_DEBUG_RADIO_READY_AND_DISABLED_PIN
	int "Pin toggled upon the events RADIO->EVENTS_READY and RADIO->EVENTS_DISABLED"
	depends on MPSL_PIN_DEBUG
	default 3 if SOC_COMPATIBLE_NRF52X
	default 4 if SOC_COMPATIBLE_NRF53X
	default 43 if SOC_COMPATIBLE_NRF54LX
	default 1 if SOC_SERIES_NRF54HX

	help
	  For nRF52 and nRF53 only PORT0 can be used.
	  For nRF54L only PORT1 can be used. Here the pin number
	  is 43 - 32 = 11.

config MPSL_PIN_DEBUG_RADIO_ADDRESS_AND_END_PIN
	int "Pin toggled upon the events RADIO->EVENTS_ADDRESS and RADIO->EVENTS_END"
	depends on MPSL_PIN_DEBUG
	default 4 if SOC_COMPATIBLE_NRF52X
	default 5 if SOC_COMPATIBLE_NRF53X
	default 44 if SOC_COMPATIBLE_NRF54LX
	default 2 if SOC_SERIES_NRF54HX
	help
	  For nRF52 and nRF53 only PORT0 can be used.
	  For nRF54L only PORT1 can be used. Here the pin number
	  is 44 - 32 = 12.
```

## subsys/mpsl/pm/Kconfig
```kconfig
#
# Copyright (c) 2024 Nordic Semiconductor ASA
#
# SPDX-License-Identifier: LicenseRef-Nordic-5-Clause
#

config MPSL_USE_ZEPHYR_PM
	bool "Use Zephyr's Power Management API"
	depends on SOC_SERIES_NRF54H
	depends on MPSL
	depends on PM
	default y
	help
	  This option configures MPSL to use Zephyr's Power Management.

if MPSL_USE_ZEPHYR_PM

config MPSL_PM_NO_RADIO_EVENT_PERIOD_LATENCY_US
	int "Latency value the MPSL PM allows in periods outside of radio events, in microseconds"
	default 499999
	help
	  The option specifies the latency in microseconds that is allowed by MPSL PM
	  outside of radio events.

config MPSL_PM_USE_MRAM_LATENCY_SERVICE
	bool "Use Zephyr's MRAM latency service"
	select MRAM_LATENCY
	default y
	help
	  This option enables MPSL PM integration with MRAM latency service.
	  Use of MRAM latency service ensures there is no latency due to code
	  fetching from disabled MRAM in REM events. It decreases power consumption
	  on nRF54H20 SoC.

endif # MPSL_USE_ZEPHYR_PM
```

## subsys/net/Kconfig
```kconfig
# Copyright (c) 2018 Nordic Semiconductor
#
# SPDX-License-Identifier: LicenseRef-Nordic-5-Clause
#

menu "Networking"

rsource "lib/Kconfig"
rsource "openthread/Kconfig"
rsource "l2_wifi_if_conn/Kconfig"

endmenu
```

## subsys/net/l2/Kconfig
```kconfig
# Copyright (c) 2016 Intel Corporation.
# SPDX-License-Identifier: Apache-2.0

menu "Link layer options"

config NET_L2_NRF_WIFI_MGMT
	bool "nRF Wi-Fi Management support"
	select NET_MGMT
	select NET_MGMT_EVENT
	select NET_MGMT_EVENT_INFO
	help
	  Add support for nRF Wi-Fi Management interface.
	  Conflicts with Zephyr's Wi-Fi Management interface.

config NET_L2_NRF_WIFI_SHELL
	bool "nRF Wi-Fi shell module"
	select NET_L2_NRF_WIFI_MGMT
	help
		This can be used for controlling Wi-Fi through the console via
		exposing a shell module named "wifi".

if NET_L2_NRF_WIFI_MGMT
module = NET_L2_NRF_WIFI_MGMT
module-dep = NET_LOG
module-str = Log level for nRF Wi-Fi management layer
module-help = Enables nRF Wi-Fi management interface to output debug messages.
source "subsys/net/Kconfig.template.log_config.net"
endif # NET_L2_NRF_WIFI_MGMT
endmenu
```

## subsys/net/l2_dect/Kconfig.conn_mgr
```kconfig
# Copyright (c) 2025 Nordic Semiconductor ASA
#
# SPDX-License-Identifier: LicenseRef-Nordic-5-Clause

menuconfig NET_L2_DECT_CONN_MGR
	bool "L2 DECT NR+ Connection Manager"
	depends on NET_CONNECTION_MANAGER && NET_L2_DECT && NET_L2_DECT_MGMT
	default y if NET_CONNECTION_MANAGER
	help
	  Enable support for DECT NR+ Connection Manager integration.

if NET_L2_DECT_CONN_MGR

config NET_L2_DECT_CONN_MGR_CONNECT_TIMEOUT_SECONDS
	int "Connect timeout in seconds"
	default 0
	help
	  Time period in seconds that the library will try to establish a DECT
	  connection, before timing out. The connect timeout can be updated by
	  calling conn_mgr_if_set_timeout().
	  Default value is 0 (timeout disabled). When the timeout is disabled,
	  the library relies solely on the modem's internal connection handling
	  to upkeep the connection.

config NET_L2_DECT_CONN_MGR_CONNECTION_PERSISTENCE
	bool "Connection persistency"
	help
	  Persistent connection. If the connection is lost the modem will try to
	  reconnect itself without the need for explicit calls to the network
	  interface.
	  Persistence can be updated run-time by calling conn_mgr_if_set_flag()
	  with CONN_MGR_IF_PERSISTENT as flag parameter.

config NET_L2_DECT_CONN_MGR_AUTO_DOWN
	bool "Auto down"
	help
	  If this option is set the Connection Manager will automatically take
	  the network interface down when it stops trying to connect. This option
	  sets the default value, the option can be changed at run time by calling
	  conn_mgr_if_set_flag() with or without the CONN_MGR_IF_NO_AUTO_DOWN flag.

config NET_L2_DECT_CONN_MGR_AUTO_CONNECT
	bool "Auto connect"
	help
	  If this option is set, the Connection Manager will automatically call
	  connect after the network interface has been brought up on when modem
	  is activated (PT or FT without BR) or when the BR for the sink is
	  connected (FT with BR support). This option sets the default value,
	  the option has a corresponding flag that can be set at run time by
	  calling conn_mgr_if_set_flag().

module = NET_L2_DECT_CONN_MGR
module-str = Log level for DECT NR+ connection manager
source "${ZEPHYR_BASE}/subsys/logging/Kconfig.template.log_config"

endif # NET_L2_DECT_CONN_MGR
```

## subsys/net/l2_wifi_if_conn/Kconfig
```kconfig
# Copyright (c) 2023 Nordic Semiconductor
#
# SPDX-License-Identifier: LicenseRef-Nordic-5-Clause
#

menuconfig L2_WIFI_CONNECTIVITY
	bool "L2 Wi-Fi Connectivity"
	depends on NET_CONNECTION_MANAGER

if L2_WIFI_CONNECTIVITY

config L2_WIFI_CONN_WQ_STACK_SIZE
	int "Wi-Fi connectivity work queue stack size"
	default 6144
	help
	  The workqueue stack size needs to be kept high to handle the
	  disconnect case which invokes supplicant calls.

config L2_WIFI_CONNECTIVITY_CONNECT_TIMEOUT_SECONDS
	int "Connect timeout in seconds"
	default 0
	help
	  Time period in seconds that the library will try to establish a Wi-Fi connection,
	  before timing out. The connect timeout can be updated by calling
	  conn_mgr_if_set_timeout(). Default value is 0 (timeout disabled).
	  When the timeout is disabled, the library relies solely on the internal
	  connection handling to upkeep the connection.

config L2_WIFI_CONNECTIVITY_CONNECTION_PERSISTENCE
	bool "Connection persistency"
	default y
	help
	  Persistent connection. If the connection is lost the device will try to reconnect
	  itself without the need for explicit calls to the network interface.
	  Persistence can be updated run-time by calling conn_mgr_if_set_flag() with
	  CONN_MGR_IF_PERSISTENT as flag parameter.

config L2_WIFI_CONNECTIVITY_AUTO_CONNECT
	bool "Auto connect"
	default y
	help
	 If this option is set the Connection Manager will automatically call connect after the
	 network interface has been brought up. This option sets the default value, the option has
	 a corresponding flag that can be set at run time by calling conn_mgr_if_set_flag().

config L2_WIFI_CONNECTIVITY_AUTO_DOWN
	bool "Auto down"
	default y
	help
	 If this option is set the Connection Manager will automatically take the network interface
	 down when it stops trying to connect. This option sets the default value, the option has
	 a corresponding flag that can be set at run time by calling conn_mgr_if_set_flag().

endif # L2_WIFI_CONNECTIVITY
```
