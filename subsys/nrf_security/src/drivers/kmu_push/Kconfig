## subsys/nrf_security/src/drivers/nrf_cc3xx_platform/Kconfig
```kconfig
#
# Copyright (c) 2023 Nordic Semiconductor
#
# SPDX-License-Identifier: LicenseRef-Nordic-5-Clause
#

config PSA_CRYPTO_DRIVER_ALG_PRNG_CC3XX_PLATFORM
	bool
	default y
	depends on CRYPTOCELL_USABLE
	depends on PSA_WANT_GENERATE_RANDOM

config PSA_CRYPTO_DRIVER_ALG_CTR_DRBG_CC3XX_PLATFORM
	bool
	default y
	depends on PSA_CRYPTO_DRIVER_ALG_PRNG_CC3XX_PLATFORM && \
		   PSA_WANT_ALG_CTR_DRBG

config PSA_CRYPTO_DRIVER_ALG_HMAC_DRBG_CC3XX_PLATFORM
	bool
	default y
	depends on PSA_CRYPTO_DRIVER_ALG_PRNG_CC3XX_PLATFORM && \
		   PSA_WANT_ALG_HMAC_DRBG
```

## subsys/nrf_security/src/drivers/nrf_oberon/cracen_trng/Kconfig
```kconfig
#
# Copyright (c) 2025 Nordic Semiconductor
#
# SPDX-License-Identifier: LicenseRef-Nordic-5-Clause
#

config PSA_NEED_CRACEN_TRNG_DRIVER
	bool
	depends on !PSA_CRYPTO_DRIVER_CRACEN
	default y if SOC_NRF54LS05B
	select PSA_ACCEL_GET_ENTROPY
	select NRFX_CRACEN
	help
	  PSA crypto driver for CRACEN True Random Number Generator.
	  This driver provides entropy functionality for nRF54LS05B devices
	  using direct access to the CRACEN TRNG hardware via nrfx.
```

## subsys/nrf_security/src/drivers/zephyr/Kconfig
```kconfig
#
# Copyright (c) 2023 Nordic Semiconductor
#
# SPDX-License-Identifier: LicenseRef-Nordic-5-Clause
#

config PSA_NEED_NRF_RNG_ENTROPY_DRIVER
	bool
	default y
	# Cannot select entropy-generator without creating a loop to ENTROPY_PSA_CRYPTO_RNG
	depends on ENTROPY_GENERATOR
	select PSA_ACCEL_GET_ENTROPY
	depends on HAS_HW_NRF_RNG
	depends on (!PSA_USE_CC3XX_CTR_DRBG_DRIVER && !PSA_USE_CC3XX_HMAC_DRBG_DRIVER) && \
				(PSA_USE_CTR_DRBG_DRIVER || PSA_USE_HMAC_DRBG_DRIVER)
```

## subsys/nrf_security/src/ironside_se/Kconfig
```kconfig
#
# Copyright (c) 2024 Nordic Semiconductor
#
# SPDX-License-Identifier: LicenseRef-Nordic-5-Clause
#

config NRF_IRONSIDE_SE_PSA_SERVICES
	bool
	prompt "PSA services provided by IronSide SE"
	default y
	depends on SOC_NRF54H20 || SOC_SERIES_NRF92X
	select NRF_IRONSIDE_CALL

if NRF_IRONSIDE_SE_PSA_SERVICES

config NRF_IRONSIDE_SE_PSA_SERVICES_OUT_BOUNCE_BUFFERS
	bool "Support PSA services with output buffers that are not cache-safe"
	default y
	depends on DCACHE
	help
	  When this option is enabled, the PSA service will
	  allocate bounce buffers for all PSA output vectors that are not
	  aligned to the DCache DataUnit size. When this option is
	  disabled, the PSA service will never use bounce buffers,
	  and the user of PSA APIs must ensure that the structures are
	  cache-safe. The structures are cache-safe if there are no writes
	  locally to any of the DataUnits that contain the structure
	  getting written from the remote.

if NRF_IRONSIDE_SE_PSA_SERVICES_OUT_BOUNCE_BUFFERS

config NRF_IRONSIDE_SE_PSA_SERVICES_OUT_HEAP_SIZE
	int "Size of the heap used to buffer output from PSA function calls"
	default 4096
	help
	  Size of the heap buffer used for out buffer.
	  Reducing the size may trigger PSA_ERROR_INSUFFICIENT_MEMORY in PSA calls.

endif # NRF_IRONSIDE_SE_PSA_SERVICES_OUT_BOUNCE_BUFFERS

endif # NRF_IRONSIDE_SE_PSA_SERVICES
```

## subsys/nrf_security/src/ssf_secdom/Kconfig
```kconfig
#
# Copyright (c) 2024 Nordic Semiconductor
#
# SPDX-License-Identifier: LicenseRef-Nordic-5-Clause
#

config PSA_SSF_CRYPTO_CLIENT
	bool
	prompt "PSA crypto provided through SSF"
	default y
	depends on SOC_NRF54H20 || SOC_SERIES_NRF92
	select IRONSIDE_SE_CALL

if PSA_SSF_CRYPTO_CLIENT

config PSA_SSF_CRYPTO_CLIENT_OUT_BOUNCE_BUFFERS
	bool "Support PSA crypto with output buffers that are not cache-safe"
	default y
	depends on DCACHE
	help
	  When this option is enabled, the PSA Crypto service will
	  allocate bounce buffers for all PSA output vectors that are not
	  aligned to the DCache DataUnit size. When this option is
	  disabled, the PSA Crypto service will never use bounce buffers,
	  and the user of PSA APIs must ensure that the structures are
	  cache-safe. The structures are cache-safe if there are no writes
	  locally to any of the DataUnits that contain the structure
	  getting written from the remote.

if PSA_SSF_CRYPTO_CLIENT_OUT_BOUNCE_BUFFERS

config PSA_SSF_CRYPTO_CLIENT_OUT_HEAP_SIZE
	int "Size of the heap used to buffer output from PSA function calls"
	default 4096
	help
	  Size of the heap buffer used for out buffer.
	  Reducing the size may trigger PSA_ERROR_INSUFFICIENT_MEMORY in PSA calls.

endif # PSA_SSF_CRYPTO_CLIENT_OUT_BOUNCE_BUFFERS

endif # PSA_SSF_CRYPTO_CLIENT
```

## subsys/partition_manager/Kconfig
```kconfig
#
# Copyright (c) 2020 Nordic Semiconductor ASA
#
# SPDX-License-Identifier: LicenseRef-Nordic-5-Clause
#

menu "Partition Manager"

config PARTITION_MANAGER_ENABLED
	bool "Partition manager is enabled (read-only option)"
	help
	  Option which can be checked to see whether or not the
	  partition manager is enabled in the current build. Note that this
	  should ideally be a hidden option, but it can't due to limitations
	  in how parent images impose options on child images. Don't
	  change the value of this option.

# Override this option to use custom flash map implementation when partition
# manager is enabled.
config FLASH_MAP_CUSTOM
	bool
	default y
	depends on PARTITION_MANAGER_ENABLED

# These values are now set by partition manager, so hide the option.
config SRAM_SIZE
	int
	depends on !PARTITION_MANAGER_ENABLED

# These values are now set by partition manager, so hide the option.
config SRAM_BASE_ADDRESS
	hex
	depends on !PARTITION_MANAGER_ENABLED

menu "Zephyr subsystem configurations"

DT_CHOSEN_Z_IPC_SHM := zephyr,ipc_shm

config RPMSG_NRF53_SRAM_SIZE
	hex "RPMsg shared memory size"
	default "$(dt_chosen_reg_size_hex,$(DT_CHOSEN_Z_IPC_SHM))"
	depends on SOC_NRF5340_CPUAPP
	depends on PARTITION_MANAGER_ENABLED
	help
	  This option specifies size of the memory region to be used
	  for the RPMsg shared memory

if FILE_SYSTEM_LITTLEFS
partition=LITTLEFS
partition-size=0x6000
rsource "Kconfig.template.partition_config"
rsource "Kconfig.template.partition_region"
endif


if SETTINGS_FCB || SETTINGS_NVS
partition=SETTINGS_STORAGE
partition-size=0x2000
rsource "Kconfig.template.partition_config"
rsource "Kconfig.template.partition_region"

config PM_PARTITION_ALIGN_SETTINGS_STORAGE
	hex "Settings storage partition alignment"
	default NRF_SPU_FLASH_REGION_SIZE if BUILD_WITH_TFM
	default FPROTECT_BLOCK_SIZE
	help
	  Alignment of the settings storage partition.

endif

if NVS && !SETTINGS_NVS
partition=NVS_STORAGE
partition-size=0x6000
rsource "Kconfig.template.partition_config"
rsource "Kconfig.template.partition_region"
endif

if ZIGBEE && !SOC_NRF52833
partition=ZBOSS_NVRAM
partition-size=0x8000
rsource "Kconfig.template.partition_config"
endif

if ZIGBEE && SOC_NRF52833
partition=ZBOSS_NVRAM
partition-size=0x4000
rsource "Kconfig.template.partition_config"
endif

if ZIGBEE
partition=ZBOSS_PRODUCT_CONFIG
partition-size=0x1000
rsource "Kconfig.template.partition_config"
endif

if EMDS
partition=EMDS_STORAGE
partition-size=0x1000
rsource "Kconfig.template.partition_config"
endif

if NRF_CLOUD_PGPS_STORAGE_PARTITION
partition=PGPS
partition-size=NRF_CLOUD_PGPS_PARTITION_SIZE
rsource "Kconfig.template.partition_config"
rsource "Kconfig.template.partition_region"

config PM_PGPS_ALIGN
	hex
	default NRF_SPU_FLASH_REGION_SIZE if BUILD_WITH_TFM
	default NRF_CLOUD_PGPS_PARTITION_ALIGN
	depends on PM_PARTITION_REGION_PGPS_EXTERNAL && BUILD_WITH_TFM

endif

if DFU_TARGET_FULL_MODEM_USE_EXT_PARTITION
partition=FMFU_STORAGE
partition-size=DFU_TARGET_FULL_MODEM_EXT_FLASH_SIZE
rsource "Kconfig.template.partition_config"
rsource "Kconfig.template.partition_region"
endif

if SOC_NRF54L15_ENGA_CPUFLPR
config PM_PARTITION_SIZE_VPR_LAUNCHER
	hex
	default $(dt_node_reg_addr_hex,/soc/rram-controller@5004b000/rram@165000)
	help
	  Memory set aside for the vpr_launcher partition.
	  Must match the size of the cpuapp_rram partition which is deleted.
	  This to place the flpr app's code at the address found in the devicetree.
endif

endmenu # Zephyr subsystem configurations
menu "NCS subsystem configurations"

endmenu # NCS subsystem configurations

config PM_SINGLE_IMAGE
	bool "Use the Partition Manager for single image builds" if !BUILD_WITH_TFM
	default y if BUILD_WITH_TFM
	select PARTITION_MANAGER_ENABLED
	help
	  Use the Partition Manager feature to partition the device even if
	  only a single image is included in the build. This is typically set
	  when a subsystem that defines its own Partition Manager configuration
	  is included in the build.

	  The option is always defined in builds where a TF-M image for the
	  Secure Execution environment is generated.

DT_CHOSEN_EXT_FLASH:= nordic,pm-ext-flash
DT_CHOSEN_EXT_FLASH_PATH := $(dt_chosen_path,$(DT_CHOSEN_EXT_FLASH))

config PM_EXTERNAL_FLASH_HAS_DRIVER
	bool
	default y if NORDIC_QSPI_NOR || SPI_NOR
	default y if PM_OVERRIDE_EXTERNAL_DRIVER_CHECK
	help
	  This option needs to be enabled by flash drivers that provide
	  support for external flash devices with partition manager
	  controlled partitions on them.
	  Partitions on devices without drivers will not have partition map
	  entries generated and will not be available from Flash Map API.

config PM_EXTERNAL_FLASH_BASE
	hex "External flash base address"
	default 0

config PM_EXTERNAL_FLASH_ENABLED
	bool
	default $(dt_chosen_enabled,$(DT_CHOSEN_EXT_FLASH))
	help
	  Internal PM_EXTERNAL_FLASH kconfig for exporting devicetree to sysbuild.

config PM_EXTERNAL_FLASH_PATH
	string
	default "$(DT_CHOSEN_EXT_FLASH_PATH)"
	help
	  Internal PM_EXTERNAL_FLASH kconfig for exporting devicetree to sysbuild.

config PM_EXTERNAL_FLASH_SIZE_BITS
	int
	default $(dt_node_int_prop_int,$(DT_CHOSEN_EXT_FLASH_PATH),size) if PM_EXTERNAL_FLASH_ENABLED
	default 0
	help
	  Internal PM_EXTERNAL_FLASH kconfig for exporting devicetree to sysbuild.

config PM_EXTERNAL_FLASH_MCUBOOT_SECONDARY
	bool "Place MCUboot secondary in external flash"
	depends on BOOTLOADER_MCUBOOT || MCUBOOT
	# Only depend on the chosen for the parent image. The value of this
	# option is propagated to the MCUboot child image automatically.
	depends on PM_EXTERNAL_FLASH_ENABLED || MCUBOOT
	default y if BOOTLOADER_MCUBOOT
	imply ADD_MCUBOOT_MEDIATE_SIM_FLASH_DTS
	help
	  Place the secondary partition of MCUboot in the external flash instead
	  of the internal flash. This option should only be enabled by the user
	  in the parent image.

config PM_IMAGE_NOT_BUILT_FROM_SOURCE
	bool
	help
	  Promptless helper config used to indicate that one or more
	  image is not built from source.

config PM_OVERRIDE_EXTERNAL_DRIVER_CHECK
	bool "Override external driver check"
	help
	  When enabled, will include all external flash stroage areas without
	  being gated on the NORDIC_QSPI_NOR Kconfig, can be enabled to use
	  non-QSPI external flash chips from partition manager.

# Helper configs needed since 'SRAM_SIZE/BASE' use the chosen node.
config PM_SRAM_BASE
	hex
	default $(dt_node_reg_addr_hex,/soc/memory@21000000) if SOC_NRF5340_CPUNET
	default 0x20000000 if SOC_NRF54L15_ENGA_CPUFLPR  # Because the cpuapp_sram DT node is deleted in nrf54l15_cpuflpr.dtsi
	default $(dt_node_reg_addr_hex,/soc/memory@20000000)

config PM_SRAM_SIZE
	hex
	default $(dt_node_reg_size_hex,/soc/memory@21000000) if SOC_NRF5340_CPUNET
	default 0x40000 if SOC_NRF54L15_ENGA_CPUFLPR  # Because the cpuapp_rram DT node is deleted in nrf54l15_cpuflpr.dtsi
	default $(dt_node_reg_size_hex,/soc/memory@20000000)

endmenu # Partition Manager
```

## subsys/partition_manager/Kconfig.template.build_strategy
```kconfig
if !HIDE_CHILD_PARENT_CONFIG

choice
	prompt "$(module) build strategy"
	default $(module)_BUILD_STRATEGY_FROM_SOURCE

config $(module)_BUILD_STRATEGY_USE_HEX_FILE
	# Mandatory option when being built through add_child_image'
	bool "Use hex file instead of building $(module)"
	select PM_IMAGE_NOT_BUILT_FROM_SOURCE
	select PARTITION_MANAGER_ENABLED

if $(module)_BUILD_STRATEGY_USE_HEX_FILE

config $(module)_HEX_FILE
	# Mandatory option when being built through add_child_image'
	string "$(module) hex file"

endif # $(module)_BUILD_STRATEGY_USE_HEX_FILE

config $(module)_BUILD_STRATEGY_SKIP_BUILD
	# Mandatory option when being built through add_child_image'
	bool "Skip building $(module)"
	select PM_IMAGE_NOT_BUILT_FROM_SOURCE
	select PARTITION_MANAGER_ENABLED

config $(module)_BUILD_STRATEGY_FROM_SOURCE
	# Mandatory option when being built through add_child_image'
	bool "Build from source"
	select PARTITION_MANAGER_ENABLED

endchoice

endif
```

## subsys/partition_manager/Kconfig.template.build_strategy_domain
```kconfig
#
# Copyright (c) 2020 Nordic Semiconductor ASA
#
# SPDX-License-Identifier: LicenseRef-Nordic-5-Clause
#

# We need a separate template for domain images since we can not merge
# the contents of the hex file to the parent domain hex file due to
# limitations in the programming procedure.
choice
	prompt "$(module) build strategy"
	default $(module)_BUILD_STRATEGY_FROM_SOURCE

config $(module)_BUILD_STRATEGY_SKIP_BUILD
	# Mandatory option when being built through add_child_image'
	bool "Skip building $(module)"
	select PM_IMAGE_NOT_BUILT_FROM_SOURCE
	select PARTITION_MANAGER_ENABLED

config $(module)_BUILD_STRATEGY_FROM_SOURCE
	# Mandatory option when being built through add_child_image'
	bool "Build from source"
	select PARTITION_MANAGER_ENABLED

endchoice
```

## subsys/partition_manager/Kconfig.template.partition_config
```kconfig
# Define used by partition_manager.py to deduce size of partition
config PM_PARTITION_SIZE_$(partition)
	hex "Memory reserved for $(partition)"
	default $(partition-size)
	help
	  Memory set aside for the $(partition) partition.
```

## subsys/partition_manager/Kconfig.template.partition_region
```kconfig
DT_CHOSEN_EXT_FLASH:= nordic,pm-ext-flash
config PM_PARTITION_REGION_$(partition)_EXTERNAL
	bool "Locate partition $(partition) in region 'external_flash'"
	depends on $(dt_chosen_enabled,$(DT_CHOSEN_EXT_FLASH))
```

## subsys/partition_manager/Kconfig.template.partition_size
```kconfig
# Define used by partition_manager.py to deduce size of partition
config PM_PARTITION_SIZE_$(partition)
	hex "Memory reserved for $(partition)"
	default $(partition-size)
	help
	  Memory set aside for the $(partition) partition.
if BUILD_WITH_TFM
config TFM_NONSECURE_STORAGE
	bool
	default y if PM_PARTITION_SIZE_$(partition) != 0
endif
```

## subsys/pcd/Kconfig
```kconfig
#
# Copyright (c) 2020 Nordic Semiconductor ASA
#
# SPDX-License-Identifier: LicenseRef-Nordic-5-Clause
#

menu "Peripheral CPU DFU (PCD)"

config PCD
	bool "Peripheral CPU DFU Support [DEPRECATED]"
	select PCD_APP
	select PCD_NET

if PCD
	comment "The PCD option is deprecated, please use PCD_APP or PCD_NET instead"
endif

config PCD_APP
	bool "Peripheral CPU DFU Support for Application Processor"
	default y if SOC_SERIES_NRF53X && MCUBOOT && BT_HCI_IPC

config PCD_VERSION_PAGE_BUF_SIZE
	int
	default 2046

config PCD_NET
	bool "Peripheral CPU DFU Support for Network Processor"
	default y if SOC_NRF5340_CPUNET && IS_SECURE_BOOTLOADER
	select FLASH_PAGE_LAYOUT
	select STREAM_FLASH
	select STREAM_FLASH_ERASE

if PCD_APP || PCD_NET

config PCD_READ_NETCORE_APP_VERSION
	bool "Include PCD command to read network core application version"
	depends on FW_INFO || FW_INFO_API

config PCD_USE_CONSTANTS
	bool "Use KConfig constants rather than pm_config.h"

config PCD_CMD_ADDRESS
	hex "PCD Command Address in RAM"
	depends on PCD_USE_CONSTANTS

config PCD_NET_CORE_APP_OFFSET
	hex "Network Core Application Offset in Flash"
	depends on PCD_USE_CONSTANTS

module=PCD
module-dep=LOG
module-str=Peripheral Core DFU
source "$(ZEPHYR_BASE)/subsys/logging/Kconfig.template.log_config"

endif # PCD_NET || PCD_APP

if PCD_NET

config PCD_BUF_SIZE
	int
	default 512
	help
	  Must be <= the page size of the flash device.

endif # PCD_NET

endmenu
```
