## subsys/nrf_security/src/drivers/kmu_push/Kconfig
```kconfig
#
# Copyright (c) 2026 Nordic Semiconductor
#
# SPDX-License-Identifier: LicenseRef-Nordic-5-Clause
#
config PSA_NEED_KMU_PUSH_DRIVER
	bool
	default y
	depends on PSA_CRYPTO_DRIVER_KMU_PUSH
```
