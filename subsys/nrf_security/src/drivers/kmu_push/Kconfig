## subsys/periphconf/Kconfig
```kconfig
# Copyright (c) 2025 Nordic Semiconductor
# SPDX-License-Identifier: LicenseRef-Nordic-5-Clause

# Periphconf integration

config NRF_PERIPHCONF_MIGRATE
	bool "Generate periphconf_migrated.c"
	default y
	depends on SOC_NRF54H20_CPURAD || SOC_NRF54H20_CPUAPP
	help
	  Enable autogenerating UICR.PERIPHCONF tables to migrate an
	  existing project for running with IronSide SE. Disable when
	  providing your own UICR.PERIPHCONF file.

	  Note that PPR and FLPR are in the global domain, and
	  generation of periphconf_migrated.c is only supported for local
	  domains.
```

## subsys/profiler/Kconfig
```kconfig
#
# Copyright (c) 2018 Nordic Semiconductor
#
# SPDX-License-Identifier: LicenseRef-Nordic-5-Clause

menuconfig PROFILER
	bool "System profiler"
	default n

if PROFILER

config MAX_NUMBER_OF_CUSTOM_EVENTS
	int "Maximum number of stored custom event types"
	default 32
	range 0 32

config PROFILER_CUSTOM_EVENT_BUF_LEN
	int "Length of data buffer for custom event data (in bytes)"
	default 64

config MAX_LENGTH_OF_CUSTOM_EVENTS_DESCRIPTIONS
	int "Maximum number of characters used to describe single event type"
	default 128

choice
	prompt "Profiler selection"
	default PROFILER_NORDIC
	depends on PROFILER

config PROFILER_SYSVIEW
	bool "SysView profiler"
	select USE_SEGGER_RTT
	depends on SEGGER_SYSTEMVIEW

config PROFILER_NORDIC
	bool "Nordic profiler"
	select USE_SEGGER_RTT

endchoice

menu "Nordic profiler advanced"
	depends on PROFILER_NORDIC

config PROFILER_NORDIC_START_LOGGING_ON_SYSTEM_START
	bool "Start logging on system start"
	depends on PROFILER_NORDIC
	default n

config PROFILER_NORDIC_COMMAND_BUFFER_SIZE
	int "Command buffer size"
	default 16

config PROFILER_NORDIC_DATA_BUFFER_SIZE
	int "Data buffer size"
	default 2048

config PROFILER_NORDIC_INFO_BUFFER_SIZE
	int "Info buffer size"
	default 256

config PROFILER_NORDIC_RTT_CHANNEL_DATA
	int "Data up channel index"
	default 1

config PROFILER_NORDIC_RTT_CHANNEL_INFO
	int "Info up channel index"
	default 2

config PROFILER_NORDIC_RTT_CHANNEL_COMMANDS
	int "Command down channel index"
	default 1

config PROFILER_NORDIC_STACK_SIZE
	int "Stack size for thread handling host input"
	default 512

config PROFILER_NORDIC_THREAD_PRIORITY
	int "Priority of thread handling host input"
	default 10

endmenu # Advanced

endif # PROFILER
```

## subsys/regulator/Kconfig
```kconfig
menuconfig REGULATOR
	bool "Regulator"
	help
	  This option enables regulator support

if REGULATOR

menuconfig REGULATOR_PI_REG
	bool "PI Regulator"
	help
	  Enable the PI regulator module

if REGULATOR_PI_REG

config REGULATOR_PI_REG_BT_MESH
	bool "Bluetooth Mesh PI Regulator"
	depends on FPU
	default y
	help
	  Enable Bluetooth Mesh specification-defined PI regulator implementation.

if REGULATOR_PI_REG_BT_MESH

config REGULATOR_PI_REG_BT_MESH_INTERVAL
	int "Update interval"
	default 100
	range 10 100
	help
	  Update interval of the mesh PI regulator (in milliseconds).

endif #REGULATOR_PI_REG_BT_MESH
endif #REGULATOR_PI_REG
endif #REGULATOR
```

## subsys/scm/sample.yaml
```yaml
sample:
  name: secure_context_manager
tests:
  test_build:
    build_only: true
    build_on_all: true
    platform_whitelist: nrf9160_pca10090
    tags: ci_build
```

## subsys/sdfw_services/Kconfig
```kconfig
#
# Copyright (c) 2024 Nordic Semiconductor ASA
#
# SPDX-License-Identifier: LicenseRef-Nordic-5-Clause
#

rsource "services/Kconfig"

config SSF_CLIENT
	def_bool $(dt_nodelabel_enabled_with_compat,cpusec_cpuapp_ipc,$(DT_COMPAT_ZEPHYR_IPC_ICMSG)) \
	      || $(dt_nodelabel_enabled_with_compat,cpusec_cpurad_ipc,$(DT_COMPAT_ZEPHYR_IPC_ICMSG))

config SDFW_SERVICES_ENABLED
	bool
	default y
	depends on SSF_CLIENT
	imply ZCBOR
	select ZCBOR_CANONICAL
	help
	  Enable SDFW Service Framework (SSF)

menu "SDFW Service Framework"
	depends on SDFW_SERVICES_ENABLED

config SSF_CLIENT_DOMAIN_ID
	int
	default 2 if SOC_NRF54H20_CPUAPP
	default 3 if SOC_NRF54H20_CPURAD
	default 0

config SSF_CLIENT_NRF_RPC_GROUP_NAME
	string
	default "app" if SOC_NRF54H20_CPUAPP
	default "rad" if SOC_NRF54H20_CPURAD
	default ""

config SSF_CLIENT_SYS_INIT
	bool "Start SDFW Service Framework client on boot"
	default y

config SSF_CLIENT_REGISTERED_LISTENERS_MAX
	int "Maximum number of simultaneous registered listeners"
	default 1

config SSF_CLIENT_ZCBOR_MAX_BACKUPS
	int "The maximum number of ZCBOR encoder/decoder backups"
	default 1
	help
	  Backups are needed for decoding if there are any lists, maps, or CBOR-encoded
	  strings in the data.
	  Backups are needed for encoding if there are any lists or maps and you are using
	  canonical encoding (ZCBOR_CANONICAL), or when using the CBOR-encoded strings in the data.

config SSF_ZCBOR_GENERATE
	bool "Re-generate CBOR parsers from CDDL using zcbor"
	help
	  If enabled, generate and use parsers from CDDL.
	  Install the generated parsers by running target 'ssf_parser_files_install'.
	  If disabled, use already installed parsers.
	  Generated parsers are found under the 'zcbor_generated' directories.

rsource "transport/Kconfig"

module = SSF_CLIENT
module-str = SSF Client
source "${ZEPHYR_BASE}/subsys/logging/Kconfig.template.log_config"

endmenu # "SDFW Service Framework"
```

## subsys/sdfw_services/services/Kconfig
```kconfig
#
# Copyright (c) 2024 Nordic Semiconductor ASA
#
# SPDX-License-Identifier: LicenseRef-Nordic-5-Clause
#

# Services
rsource "device_info/Kconfig"
rsource "enc_fw/Kconfig"
rsource "extmem/Kconfig"
```

## subsys/sdfw_services/services/Kconfig.template.service
```kconfig
#
# Copyright (c) 2024 Nordic Semiconductor ASA
#
# SPDX-License-Identifier: LicenseRef-Nordic-5-Clause
#

#
# Template for defining service options for SSF services.
#
# Set the following variables before sourcing this file:
#
# service_name            - Short uppercase name for use in the service's Kconfig options.
# service_default_enabled - 'y' to enable service by default,
#                           'n' if service should not be enabled by default.
# service_id              - Hexadecimal Service ID. To identify service when exchanging request
#                           and notification messages. All services should have unique IDs.
# service_version         - Service version number.
# service_buffer_size     - Size of buffer to allocate when sending request, response or
#                           notification messages in connection with the service.
# service_name_str        - Printable name for the service.
#
menuconfig SSF_$(service_name)_SERVICE_ENABLED
	bool "$(service_name_str) service"
	default y if $(service_default_enabled)
	depends on SDFW_SERVICES_ENABLED

if SSF_$(service_name)_SERVICE_ENABLED

config SSF_$(service_name)_SERVICE_ID
	hex
	default $(service_id)
	help
	  Service ID for $(service_name_str) service

config SSF_$(service_name)_SERVICE_VERSION
	int
	default $(service_version)
	help
	  Version of $(service_name_str) service

config SSF_$(service_name)_SERVICE_BUFFER_SIZE
	int "Buffer size for $(service_name_str) service handler"
	default $(service_buffer_size)

module = SSF_$(service_name)_SERVICE
module-str = $(service_name_str) service
source "${ZEPHYR_BASE}/subsys/logging/Kconfig.template.log_config"

endif
```

## subsys/sdfw_services/services/device_info/Kconfig
```kconfig
#
# Copyright (c) 2024 Nordic Semiconductor ASA
#
# SPDX-License-Identifier: LicenseRef-Nordic-5-Clause
#

service_name = DEVICE_INFO
service_default_enabled = y
service_id = 0x78
service_version = 1
service_buffer_size = 128
service_name_str = Device Info
rsource "../Kconfig.template.service"
```

## subsys/sdfw_services/services/dvfs/Kconfig
```kconfig
#
# Copyright (c) 2024 Nordic Semiconductor ASA
#
# SPDX-License-Identifier: LicenseRef-Nordic-5-Clause
#

service_name = DVFS
service_default_enabled = y
service_id = 0xDD
service_version = 1
service_buffer_size = 32
service_name_str = DVFS
rsource "../Kconfig.template.service"
```

## subsys/sdfw_services/services/echo/Kconfig
```kconfig
#
# Copyright (c) 2024 Nordic Semiconductor ASA
#
# SPDX-License-Identifier: LicenseRef-Nordic-5-Clause
#

service_name = ECHO
service_default_enabled = y
service_id = 0x64
service_version = 1
service_buffer_size = 128
service_name_str = Echo
rsource "../Kconfig.template.service"
```
