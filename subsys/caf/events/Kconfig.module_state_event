## subsys/caf/events/Kconfig.module_state_event
```kconfig
#
# Copyright (c) 2021 Nordic Semiconductor
#
# SPDX-License-Identifier: LicenseRef-Nordic-5-Clause
#

config CAF_MODULE_STATE_EVENTS
	bool "Enable module state events"
	help
	  Enable support for module state events.

config CAF_INIT_LOG_MODULE_STATE_EVENTS
	bool "Log module state events"
	depends on CAF_MODULE_STATE_EVENTS
	depends on LOG
	default y

config CAF_MODULES_FLAGS_COUNT
	int "Number of supported modules"
	depends on CAF_MODULE_STATE_EVENTS
	default 32
	help
	  Configure number of supported modules by modules flags variable.
	  The flags count should be big enough to have a bit for every module.
	  Bigger number allows more modules to be controllerd.
	  Smaller minimizes the footprint.
	  The memory is allocated in 32 bits chunks.
```

## subsys/caf/events/Kconfig.module_suspend_event
```kconfig
#
# Copyright (c) 2025 Nordic Semiconductor
#
# SPDX-License-Identifier: LicenseRef-Nordic-5-Clause
#

config CAF_MODULE_SUSPEND_EVENTS
	bool "Module suspend/resume request events"
	depends on CAF_MODULE_STATE_EVENTS
	help
	  Enable support for module suspend/resume request events.

config CAF_INIT_LOG_MODULE_SUSPEND_EVENTS
	bool "Log module suspend/resume request events"
	depends on CAF_MODULE_SUSPEND_EVENTS
	depends on LOG
	default y
```

## subsys/caf/events/Kconfig.power_manager_event
```kconfig
#
# Copyright (c) 2021 Nordic Semiconductor
#
# SPDX-License-Identifier: LicenseRef-Nordic-5-Clause
#

config CAF_POWER_MANAGER_EVENTS
	bool "Power manager event"
	help
	  Enable power manager event.

config CAF_INIT_LOG_POWER_MANAGER_EVENTS
	bool "Log power manager event"
	depends on LOG
	depends on CAF_POWER_MANAGER_EVENTS
	default y
	help
	  Log the power manager event.
```

## subsys/caf/events/Kconfig.sensor_event
```kconfig
#
# Copyright (c) 2023 Nordic Semiconductor
#
# SPDX-License-Identifier: LicenseRef-Nordic-5-Clause
#

config CAF_SENSOR_EVENTS
	bool "Enable sensor events"
	help
	  Enable support for sensor events.

config CAF_INIT_LOG_SENSOR_EVENTS
	bool "Log sensor events"
	depends on CAF_SENSOR_EVENTS
	depends on LOG
	default y
	help
	  Log sensor events, used to notify about sensor measured data.

config CAF_INIT_LOG_SENSOR_STATE_EVENTS
	bool "Log sensor state events"
	depends on CAF_SENSOR_EVENTS
	depends on LOG
	default y
	help
	  Log sensor state events, used to notify about sensor state change.
```

## subsys/caf/events/Kconfig.sensor_force_active_event
```kconfig
#
# Copyright (c) 2022 Nordic Semiconductor
#
# SPDX-License-Identifier: LicenseRef-Nordic-5-Clause
#

config CAF_SENSOR_FORCE_ACTIVE_EVENTS
	bool "Sensor force active event"
	help
	  Enable senor event to force the sensor stay active even if idle state is detected.

config CAF_INIT_LOG_SENSOR_FORCE_ACTIVE_EVENTS
	bool "Log sensor force active event"
	depends on LOG
	depends on CAF_POWER_MANAGER_EVENTS
	default y
	help
	  Log the sensor force active event.
```

## subsys/caf/modules/Kconfig
```kconfig
#
# Copyright (c) 2021 Nordic Semiconductor ASA
#
# SPDX-License-Identifier: LicenseRef-Nordic-5-Clause
#

rsource "Kconfig.ble_adv"
rsource "Kconfig.ble_bond"
rsource "Kconfig.ble_smp"
rsource "Kconfig.ble_state"
rsource "Kconfig.buttons"
rsource "Kconfig.click_detector"
rsource "Kconfig.factory_reset_request"
rsource "Kconfig.leds"
rsource "Kconfig.net_state"
rsource "Kconfig.power_manager"
rsource "Kconfig.sensor_data_aggregator"
rsource "Kconfig.sensor_manager"
rsource "Kconfig.settings_loader"
rsource "Kconfig.caf_shell"
```

## subsys/caf/modules/Kconfig.ble_adv
```kconfig
#
# Copyright (c) 2021 Nordic Semiconductor ASA
#
# SPDX-License-Identifier: LicenseRef-Nordic-5-Clause
#

menuconfig CAF_BLE_ADV
	bool "Enable Bluetooth LE advertising"
	depends on BT_PERIPHERAL
	depends on CAF_BLE_COMMON_EVENTS
	depends on CAF_BLE_STATE
	select BT_ADV_PROV

if CAF_BLE_ADV

config CAF_BLE_ADV_PM_EVENTS
	bool "Power management events support"
	depends on CAF_PM_EVENTS
	default y

config CAF_BLE_ADV_DIRECT_ADV
	bool "Advertise to bonded peer directly"
	depends on SETTINGS
	depends on CAF_BLE_BOND_SUPPORTED
	help
	  Device will use direct advertising if bonded. The device will not advertise directly
	  towards a central that uses Resolvable Private Address (RPA). The module does not read
	  the Central Address Resolution GATT characteristic of the central, so it does not know
	  if the remote device supports the address resolution of directed advertisements.

config CAF_BLE_ADV_FAST_ADV
	bool "Enable period of fast advertising"

config CAF_BLE_ADV_SLOW_INT_MIN
	hex "Minimum Advertising Interval during slow advertising (N * 0.625 milliseconds)"
	range 0x0020 0x4000
	default 0x00a0 # 100 ms
	help
	  Minimum Advertising Interval shall be less than or equal to the
	  Maximum Advertising Interval. The Minimum Advertising Interval and
	  Maximum Advertising Interval should not be the same value (as stated
	  in Bluetooth Core Spec 5.2, section 7.8.5)

config CAF_BLE_ADV_SLOW_INT_MAX
	hex "Maximum Advertising Interval during slow advertising (N * 0.625 milliseconds)"
	range 0x0020 0x4000
	default 0x00f0 # 150 ms
	help
	  Minimum Advertising Interval shall be less than or equal to the
	  Maximum Advertising Interval. The Minimum Advertising Interval and
	  Maximum Advertising Interval should not be the same value (as stated
	  in Bluetooth Core Spec 5.2, section 7.8.5)

if CAF_BLE_ADV_FAST_ADV

config CAF_BLE_ADV_FAST_INT_MIN
	hex "Minimum Advertising Interval during fast advertising (N * 0.625 milliseconds)"
	range 0x0020 0x4000
	default 0x0030 # 30 ms
	help
	  Minimum Advertising Interval shall be less than or equal to the
	  Maximum Advertising Interval. The Minimum Advertising Interval and
	  Maximum Advertising Interval should not be the same value (as stated
	  in Bluetooth Core Spec 5.2, section 7.8.5)

config CAF_BLE_ADV_FAST_INT_MAX
	hex "Maximum Advertising Interval during fast advertising (N * 0.625 milliseconds)"
	range 0x0020 0x4000
	default 0x0060 # 60 ms
	help
	  Minimum Advertising Interval shall be less than or equal to the
	  Maximum Advertising Interval. The Minimum Advertising Interval and
	  Maximum Advertising Interval should not be the same value (as stated
	  in Bluetooth Core Spec 5.2, section 7.8.5)

config CAF_BLE_ADV_FAST_ADV_TIMEOUT
	int "Time of initial fast advertising [s]"
	default 30
	help
	  Device will initially advertise with shorter interval to enable quicker discovery by
	  hosts. After this time it will shift to normal cadence advertising.

endif

if !CAF_BLE_ADV_FAST_ADV

config CAF_BLE_ADV_FAST_INT_MIN
	hex
	default 0x0

config CAF_BLE_ADV_FAST_INT_MAX
	hex
	default 0x0

config CAF_BLE_ADV_FAST_ADV_TIMEOUT
	int
	default 0

endif

config CAF_BLE_ADV_FILTER_ACCEPT_LIST
	bool "Enable filter accept list"
	select BT_FILTER_ACCEPT_LIST
	select BT_CTLR_FILTER_ACCEPT_LIST if BT_CTLR
	select BT_CTLR_PRIVACY if BT_CTLR
	help
	  If the used local identity already has bond, the device will filter
	  incoming scan response data requests and connection requests. In
	  that case, only the bonded peer can connect or request scan response
	  data.

config CAF_BLE_ADV_GRACE_PERIOD
	bool "Enable grace period feature"
	depends on CAF_BLE_ADV_PM_EVENTS
	default y if BT_ADV_PROV_SWIFT_PAIR
	help
	  The module advertises in grace period for predefined time before
	  advertising is turned off. During the grace period, the module
	  advertises modified payload.

	  The feature is used for example for devices that advertise Microsoft
	  Swift Pair data. To ensure users would not try to connect to a device
	  which is no longer available, Swift Pair vendor section is removed
	  and advertising is continued without Swift Pair data for additional
	  time before the advertising is stopped.

config CAF_BLE_ADV_ROTATE_RPA
	bool "Rotate RPA together with advertising data"
	depends on BT_PRIVACY
	default y if BT_ADV_PROV_FAST_PAIR
	help
	  During active advertising, the module periodically triggers RPA
	  rotation combined with advertising data update. This prevents
	  automatic RPA rotations triggered by Zephyr in the background.

	  Synchronizing RPA rotation with advertising data update is needed if
	  an advertising provider uses a random value when generating data. In
	  that case lack of synchronization could lead to compromising privacy.

if CAF_BLE_ADV_ROTATE_RPA

config CAF_BLE_ADV_ROTATE_RPA_TIMEOUT
	int "RPA rotation timeout [s]"
	range 60 900 if BT_ADV_PROV_FAST_PAIR
	range 60 3600
	default 720
	help
	  Period of time in seconds between subsequent RPA rotations
	  triggered by module.

config CAF_BLE_ADV_ROTATE_RPA_TIMEOUT_RAND
	int "RPA rotation timeout randomization [s]"
	range 10 50
	default 30
	help
	  Used RPA timeout value is randomized by subtracting a random value
	  that is between zero and randomization_timeout.

endif # CAF_BLE_ADV_ROTATE_RPA

if !CAF_BLE_ADV_ROTATE_RPA

config CAF_BLE_ADV_ROTATE_RPA_TIMEOUT
	int
	default 0

config CAF_BLE_ADV_ROTATE_RPA_TIMEOUT_RAND
	int
	default 0

endif # !CAF_BLE_ADV_ROTATE_RPA

config CAF_BLE_ADV_BLE_BOND_SUPPORTED
	bool
	default CAF_BLE_BOND_SUPPORTED
	help
	  Kconfig option used to inform that Bluetooth LE bond functionality is supported by the
	  application. If an application supports Bluetooth LE bond module, the Bluetooth LE
	  advertising module should not start advertising before the Bluetooth LE bond module is
	  initialized.

module = CAF_BLE_ADV
module-str = caf module BLE advertising
source "subsys/logging/Kconfig.template.log_config"

endif # CAF_BLE_ADV
```

## subsys/caf/modules/Kconfig.ble_bond
```kconfig
#
# Copyright (c) 2021 Nordic Semiconductor ASA
#
# SPDX-License-Identifier: LicenseRef-Nordic-5-Clause
#

menuconfig CAF_BLE_BOND
	bool "Enable CAF implementation of Bluetooth LE bond"
	depends on BT_BONDABLE
	depends on BT_SETTINGS
	depends on CAF_SETTINGS_LOADER
	depends on CAF_BLE_COMMON_EVENTS
	select CAF_BLE_BOND_SUPPORTED
	help
	  The simple CAF implementation that supports only bond erase for default Bluetooth local
	  identity when predefined button click is detected (if enabled with Kconfig).

if CAF_BLE_BOND

config CAF_BLE_BOND_PEER_ERASE_CLICK
	bool "Erase bonds using selected button click"
	depends on CAF_CLICK_EVENTS
	help
	  To remove bonds, predefined click type of a predefined button must be detected.

config CAF_BLE_BOND_PEER_ERASE_CLICK_KEY_ID
	hex "Key ID of a button click used to erase bonds"
	range 0x0000 0xffff
	depends on CAF_BLE_BOND_PEER_ERASE_CLICK

config CAF_BLE_BOND_PEER_ERASE_CLICK_TIMEOUT
	int "Click detection after system start timeout [ms]"
	default -1
	depends on CAF_BLE_BOND_PEER_ERASE_CLICK
	help
	  This Kconfig option limits time of waiting for the button click detection after boot.
	  Negative value disables the time limit. A non-negative value sets time limit to defined
	  value.

	  The timeout may need to be longer for some applications (for example if click event
	  submission or processing is delayed by operations in system workqueue context).

choice
	prompt "Select click type"
	depends on CAF_BLE_BOND_PEER_ERASE_CLICK
	default CAF_BLE_BOND_PEER_ERASE_CLICK_DOUBLE
	help
	  The click types are directly mapped from the click enum in click_event.

config CAF_BLE_BOND_PEER_ERASE_CLICK_SHORT
	bool "Short click"
	help
	  Button pressed and released after a short time.

config CAF_BLE_BOND_PEER_ERASE_CLICK_LONG
	bool "Long click"
	help
	  Button pressed and held for a long period of time.

config CAF_BLE_BOND_PEER_ERASE_CLICK_DOUBLE
	bool "Double click"
	help
	  Two sequences of the button press and release in a short time interval.

endchoice

module = CAF_BLE_BOND
module-str = caf module ble bond
source "subsys/logging/Kconfig.template.log_config"

endif

config CAF_BLE_BOND_SUPPORTED
	bool
	help
	  Kconfig option used to inform that Bluetooth LE bond functionality is supported by the
	  application. This option must be selected by Kconfig option that enables Bluetooth LE
	  bond support.
```

## subsys/caf/modules/Kconfig.ble_smp
```kconfig
#
# Copyright (c) 2020-2021 Nordic Semiconductor
#
# SPDX-License-Identifier: LicenseRef-Nordic-5-Clause
#

menuconfig CAF_BLE_SMP
	bool "SMP over Bluetooth LE module"
	select CAF_BLE_SMP_TRANSFER_EVENTS
	depends on CAF_BLE_STATE
	depends on MCUMGR_MGMT_NOTIFICATION_HOOKS
	depends on MCUMGR_GRP_IMG_UPLOAD_CHECK_HOOK
	depends on MCUMGR_GRP_IMG
	depends on MCUMGR_TRANSPORT_BT
	depends on BOOTLOADER_MCUBOOT
	help
	  This option enables SMP service allowing DFU over Bluetooth LE.

if CAF_BLE_SMP

module = CAF_BLE_SMP
module-str = caf module ble smp
source "subsys/logging/Kconfig.template.log_config"

endif # CAF_BLE_SMP
```

## subsys/caf/modules/Kconfig.ble_state
```kconfig
#
# Copyright (c) 2021 Nordic Semiconductor ASA
#
# SPDX-License-Identifier: LicenseRef-Nordic-5-Clause
#

menuconfig CAF_BLE_STATE
	bool "Bluetooth LE state module"
	depends on BT
	depends on BT_SMP
	select CAF_BLE_COMMON_EVENTS
	help
	  Module that enables Bluetooth, handles Zephyr's connection callbacks,
	  propagates information about the connection state and parameters by
	  using Application Event Manager events and exchanges GATT MTU on GATT
	  Client.

if CAF_BLE_STATE

config CAF_BLE_STATE_SECURITY_REQ
	bool "Request connection encryption (security level 2)"
	help
	  Automatically request connection encryption right after the connection is established.

config CAF_BLE_STATE_MAX_LOCAL_ID_BONDS
	int "Number of allowed bonds per Bluetooth local identity"
	depends on BT_PERIPHERAL
	range 1 BT_MAX_PAIRED
	default 1
	help
	  The available Bluetooth bonds are shared among Bluetooth local
	  identities. Limiting number of bonds allowed per local identity
	  prevents from situation where one local identity uses too many bonds.
	  In that case, other local identities may be unable to bond.

config CAF_BLE_STATE_MAX_LOCAL_ID_BONDS
	depends on !BT_PERIPHERAL
	default 0

config CAF_BLE_STATE_PM
	bool "Enable bluetooth LE power manager integration"
	depends on CAF_BLE_STATE
	depends on CAF_POWER_MANAGER
	select CAF_KEEP_ALIVE_EVENTS
	default y
	help
	  This enables small module that keeps track on active connections.
	  If there is any active connection the power down modes would be limited to SUSPENDED.
	  Full POWER OFF mode would be only allowed if we have no active connection.

config CAF_BLE_STATE_EXCHANGE_MTU
	bool "Exchange MTU"
	depends on BT_GATT_CLIENT
	default y
	help
	  Use the bt_gatt_exchange_mtu to set the MTU to the maximum possible size the buffers can
	  hold.

config CAF_BLE_USE_LLPM
	bool "Enable Low Latency Packet Mode (LLPM)"
	depends on (BT_CTLR_SDC_LLPM || !BT_CTLR)
	default y if BT_CTLR
	help
	  LLPM is a proprietary Bluetooth extension from Nordic Semiconductor. It is designed for
	  applications in which the interface response time is critical for the user. It introduces
	  the possibility to reduce the connection interval to 1 ms for one link. LLPM parameters
	  can be used for a given connection only if it's supported by both peripheral and central.

module = CAF_BLE_STATE
module-str = caf module BLE state
source "subsys/logging/Kconfig.template.log_config"

endif # CAF_BLE_STATE
```
