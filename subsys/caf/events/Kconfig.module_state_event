## subsys/caf/modules/Kconfig.buttons
```kconfig
#
# Copyright (c) 2019-2021 Nordic Semiconductor ASA
#
# SPDX-License-Identifier: LicenseRef-Nordic-5-Clause
#

menuconfig CAF_BUTTONS
	bool "Buttons module"
	select CAF_BUTTON_EVENTS
	help
	  Buttons scanned from key matrix or directly connected GPIO.

if CAF_BUTTONS

config CAF_BUTTONS_DEF_PATH
	string "Configuration file"
	default "buttons_def.h"
	help
	  Location of configuration file for buttons module.

config CAF_BUTTONS_PM_EVENTS
	bool "Power management events support"
	depends on CAF_PM_EVENTS
	default y

config CAF_BUTTONS_PM_KEEP_ALIVE
	bool "Generate keep alive power event on button press"
	depends on CAF_POWER_MANAGER
	select CAF_KEEP_ALIVE_EVENTS
	default y
	help
	  Every button press would generate keep alive event.

config CAF_BUTTONS_SCAN_INTERVAL
	int "Buttons scan interval in ms"
	default 2
	help
	  Interval at which key matrix is scanned.

config CAF_BUTTONS_DEBOUNCE_INTERVAL
	int "Interval before first button scan in ms"
	default 2
	help
	  Interval before first scan. Introduced for debouncing reasons.

config CAF_BUTTONS_POLARITY_INVERSED
	bool "Inverse buttons polarity"
	help
	  When this option is enabled, button is pressed when the GPIO state
	  is low.

config CAF_BUTTONS_EVENT_LIMIT
	int "Number of button events in a single scan loop"
	default 4
	range 0 255
	help
	  This option specifies the number of button events generated during
	  a single scanning loop. If more keys change state between scanning
	  intervals, subsequent changes will be ignored and picked up during
	  the next scanning.

module = CAF_BUTTONS
module-str = caf module buttons
source "subsys/logging/Kconfig.template.log_config"

endif # CAF_BUTTONS
```

## subsys/caf/modules/Kconfig.caf_shell
```kconfig
#
# Copyright (c) 2023 Nordic Semiconductor ASA
#
# SPDX-License-Identifier: LicenseRef-Nordic-5-Clause
#

menuconfig CAF_SHELL
	bool "Shell interface for triggering CAF events"
	depends on SHELL
	select CAF_BUTTON_EVENTS

if CAF_SHELL

module = CAF_SHELL
module-str = caf shell
source "subsys/logging/Kconfig.template.log_config"

endif # CAF_SHELL
```

## subsys/caf/modules/Kconfig.click_detector
```kconfig
#
# Copyright (c) 2019-2021 Nordic Semiconductor ASA
#
# SPDX-License-Identifier: LicenseRef-Nordic-5-Clause
#

menuconfig CAF_CLICK_DETECTOR
	bool "Click detector module"
	depends on CAF_BUTTON_EVENTS
	select CAF_CLICK_EVENTS

if CAF_CLICK_DETECTOR

config CAF_CLICK_DETECTOR_DEF_PATH
	string "Configuration file"
	default "click_detector_def.h"
	help
	  Location of configuration file for click detector module.

config CAF_CLICK_DETECTOR_LONG_CLICK_MSEC
	int "Minimum button hold time to decide that the click is long"
	default 5000

config CAF_CLICK_DETECTOR_SHORT_CLICK_MSEC
	int "Maximum button hold time to decide that the click is short"
	default 500

config CAF_CLICK_DETECTOR_PM_EVENTS
	bool "Power management events support"
	depends on CAF_PM_EVENTS
	default y
	help
	  React on power management events in click detector module.

module = CAF_CLICK_DETECTOR
module-str = caf module click detector
source "subsys/logging/Kconfig.template.log_config"

endif # CAF_CLICK_DETECTOR
```

## subsys/caf/modules/Kconfig.factory_reset_request
```kconfig
#
# Copyright (c) 2021 Nordic Semiconductor ASA
#
# SPDX-License-Identifier: LicenseRef-Nordic-5-Clause
#

menu "Factory reset request"

config CAF_FACTORY_RESET_REQUEST
	bool "Enable factory reset request module"
	select CAF_FACTORY_RESET_EVENTS
	help
	  Enable module that generates initialization event with
	  factory reset request.

config CAF_FACTORY_RESET_REQUEST_BUTTON
	hex "Key ID of button used to request factory reset"
	depends on CAF_FACTORY_RESET_REQUEST
	range 0x0000 0xffff
	default 0x0000
	help
	  Button that will trigger a factory reset when held during the board
	  boot-up. If the button is held, factory reset request event would be
	  propagated through the system.

config CAF_FACTORY_RESET_REQUEST_DELAY
	int "Time in miliseconds to wait for button event at initialization"
	depends on CAF_FACTORY_RESET_REQUEST
	default 50
	help
	  The time to wait for button event when the module is initialized.
	  The time should be long enough for the button module to react
	  for the button that is pressed during initialization.

endmenu
```

## subsys/caf/modules/Kconfig.leds
```kconfig
#
# Copyright (c) 2019-2021 Nordic Semiconductor ASA
#
# SPDX-License-Identifier: LicenseRef-Nordic-5-Clause
#

menuconfig CAF_LEDS
	bool "LEDs module"
	select CAF_LED_EVENTS
	depends on LED
	help
	  Enable LED hardware interface.

if CAF_LEDS

choice CAF_LEDS_OUTPUT
	prompt "Select LED driver"
	default CAF_LEDS_PWM

config CAF_LEDS_PWM
	bool "PWM"
	depends on LED_PWM

config CAF_LEDS_GPIO
	bool "GPIO"
	depends on LED_GPIO

endchoice

config CAF_LEDS_FRAMES_PER_SECOND
	int "Frames per second"
	default 100
	help
	  Number of LED updates per second.

config CAF_LEDS_PM_EVENTS
	bool "Power management events support"
	select PM_DEVICE
	depends on CAF_PM_EVENTS
	default y
	help
	  React on power management events in LEDs module.

module = CAF_LEDS
module-str = caf module leds
source "subsys/logging/Kconfig.template.log_config"

config CAF_LEDS_LOG_FREQUENT
	bool "Log verbose debug messages that may be printed out very frequently"
	default n
	depends on CAF_LEDS_LOG_LEVEL_DBG
	help
	  Log verbose debug messages that may be printed out very frequently (perhaps several per
	  frame)

endif # CAF_LEDS
```

## subsys/caf/modules/Kconfig.net_state
```kconfig
#
# Copyright (c) 2021 Nordic Semiconductor ASA
#
# SPDX-License-Identifier: LicenseRef-Nordic-5-Clause
#

menuconfig CAF_NET_STATE
	bool "Networking state processing"
	depends on LTE_LINK_CONTROL || NET_L2_OPENTHREAD
	select CAF_NET_STATE_EVENTS
	help
	  Enable a module that process and sends network state events.

if CAF_NET_STATE

config CAF_LOG_NET_STATE_WAITING
	bool "Log waiting on connection"
	depends on LOG
	default y
	help
	  If enabled periodic message informing about connection in progress
	  will be emitted.

config CAF_LOG_NET_STATE_WAITING_PERIOD
	int "Waiting on connection log period [s]"
	depends on CAF_LOG_NET_STATE_WAITING
	range 1 3600
	default 5
	help
	  Time in seconds at which waiting on connection log is emitted.

config CAF_NET_STATE_LTE
	bool
	default CAF_NET_STATE && LTE_LINK_CONTROL

config CAF_NET_STATE_OT
	bool
	default CAF_NET_STATE && NET_L2_OPENTHREAD

if CAF_NET_STATE_LTE
module = CAF_NET_STATE_LTE
module-str = Network state LTE
source "subsys/logging/Kconfig.template.log_config"
endif

if CAF_NET_STATE_OT
module = CAF_NET_STATE_OT
module-str = Network state OpenThread
source "subsys/logging/Kconfig.template.log_config"
endif

endif
```

## subsys/caf/modules/Kconfig.power_manager
```kconfig
#
# Copyright (c) 2021 Nordic Semiconductor
#
# SPDX-License-Identifier: LicenseRef-Nordic-5-Clause
#

menu "Power manager"

config CAF_POWER_MANAGER
	bool "Power management"
	select CAF_PM_EVENTS
	select CAF_POWER_MANAGER_EVENTS
	imply POWEROFF if !SOC_SERIES_NRF54H
	imply PM if SOC_SERIES_NRF54H
	imply PM_DEVICE
	imply PM_DEVICE_RUNTIME if SOC_SERIES_NRF54H
	help
	  Enable power management, which will put the device to low-power mode
	  if it is idle.

	  The sys_poweroff API is not yet fully supported on nRF54H SoC Series.
	  Because of that, it's not enabled by default for now.

if CAF_POWER_MANAGER

config CAF_POWER_MANAGER_STAY_ON
	bool "Block system off" if POWEROFF
	default y if !POWEROFF
	help
	  If disabled, the device will switch SoC to OFF mode (system off) after
	  power manager timeout is done in case no power state restrictions are
	  applied. If enabled, the device will stay in suspended state, but will
	  not enter system off state.

config CAF_POWER_MANAGER_TIMEOUT
	int "Power down timeout [s]"
	default 120
	help
	  Time in seconds after which the device will enter low-power mode.

config CAF_POWER_MANAGER_ERROR_TIMEOUT
	int "Power manager timeout on error [s]"
	default 30
	help
	 Time in seconds after which the device will be turned off after an error.

config CAF_POWER_MANAGER_CLEAR_RESET_REASON
	bool "Clear RESETREAS on system_off"
	default y
	depends on !SOC_SERIES_NRF54H
	help
	  Clear RESETREAS on system_off to avoid starting serial recovery if nobody
	  has cleared it already.

module = CAF_POWER_MANAGER
module-str = power manager
source "subsys/logging/Kconfig.template.log_config"

endif

endmenu
```

## subsys/caf/modules/Kconfig.sensor_data_aggregator
```kconfig
#
# Copyright (c) 2022 Nordic Semiconductor ASA
#
# SPDX-License-Identifier: LicenseRef-Nordic-5-Clause
#

DT_COMPAT_CAF_AGGREGATOR := caf,aggregator

menuconfig CAF_SENSOR_DATA_AGGREGATOR
	bool "Sensor data aggregator module"
	depends on CAF_SENSOR_EVENTS
	default $(dt_compat_enabled,$(DT_COMPAT_CAF_AGGREGATOR))
	select CAF_SENSOR_DATA_AGGREGATOR_EVENTS

if CAF_SENSOR_DATA_AGGREGATOR

module = CAF_SENSOR_DATA_AGGREGATOR
module-str = caf module sensor event aggregator
source "subsys/logging/Kconfig.template.log_config"

endif # CAF_SENSOR_DATA_AGGREGATOR

config CAF_SENSOR_DATA_AGGREGATOR_EVENTS
	bool "Sensor data aggregator module events"
```

## subsys/caf/modules/Kconfig.sensor_manager
```kconfig
#
# Copyright (c) 2021 Nordic Semiconductor ASA
#
# SPDX-License-Identifier: LicenseRef-Nordic-5-Clause
#

menuconfig CAF_SENSOR_MANAGER
	bool "Sensor manager module"
	depends on SENSOR
	select CAF_SENSOR_EVENTS

if CAF_SENSOR_MANAGER

config CAF_SENSOR_MANAGER_PM
	bool "Sensor manager passive power management"
	depends on CAF_POWER_MANAGER
	default y
	help
	  This option enables reaction to power events in the sensor manager module.

config CAF_SENSOR_MANAGER_ACTIVE_PM
	bool "Sensor manager active power management"
	depends on CAF_SENSOR_MANAGER_PM
	select CAF_POWER_MANAGER_EVENTS
	default y
	help
	  This option allows sensor manager to actively manage the power.
	  Sensor manager generates power events depending on the sensors data,
	  state and configuration.

config CAF_SENSOR_MANAGER_DEF_PATH
	string "Configuration file"
	default "sensor_manager_def.h"
	help
	  Location of configuration file for sensor manager module.

config CAF_SENSOR_MANAGER_THREAD_STACK_SIZE
	int "Size of sensor manager thread stack"
	default 2048
	help
	  The module samples sensors in a dedicated thread. The thread stack size must be big
	  enough for used sensors.

config CAF_SENSOR_MANAGER_THREAD_PRIORITY
	int "Priority of sensor manager thread"
	default 2
	help
	  It is recommended to use preemptive thread priority to make sure that the thread will
	  not block other operations in the system.

module = CAF_SENSOR_MANAGER
module-str = caf module sensor manager
source "subsys/logging/Kconfig.template.log_config"

endif # CAF_SENSOR_MANAGER
```

## subsys/caf/modules/Kconfig.sensor_sampler
```kconfig
#
# Copyright (c) 2021 Nordic Semiconductor ASA
#
# SPDX-License-Identifier: LicenseRef-Nordic-5-Clause
#

menuconfig CAF_SENSOR_SAMPLER
	bool "Sensor sampler module"
	depends on SENSOR
	select CAF_SENSOR_EVENTS

if CAF_SENSOR_SAMPLER

config CAF_SENSOR_SAMPLER_PM
	bool "Sensor sampler passive power management"
	depends on CAF_POWER_MANAGER
	default y
	help
	  This option enables reaction to power events in the sensor sampler module.

config CAF_SENSOR_SAMPLER_ACTIVE_PM
	bool "Sensor sampler active power management"
	depends on CAF_SENSOR_SAMPLER_PM
	select CAF_POWER_MANAGER_EVENTS
	default y
	help
	  This option allows sensor sampler to actively manage the power.
	  Sensor sampler generates power events depending on the sensors data,
	  state and configuration.

config CAF_SENSOR_SAMPLER_DEF_PATH
	string "Configuration file"
	default "sensor_sampler_def.h"
	help
	  Location of configuration file for sensor sampler module.

config CAF_SENSOR_SAMPLER_THREAD_STACK_SIZE
	int "Size of sensor sampler thread stack"
	default 2048
	help
	  The module samples sensors in a dedicated thread. The thread stack size must be big
	  enough for used sensors.

config CAF_SENSOR_SAMPLER_THREAD_PRIORITY
	int "Priority of sensor sampler thread"
	default 2
	help
	  It is recommended to use preemptive thread priority to make sure that the thread will
	  not block other operations in the system.

module = CAF_SENSOR_SAMPLER
module-str = caf module sensor sampler
source "subsys/logging/Kconfig.template.log_config"

endif # CAF_SENSOR_SAMPLER
```

## subsys/caf/modules/Kconfig.settings_loader
```kconfig
#
# Copyright (c) 2021 Nordic Semiconductor ASA
#
# SPDX-License-Identifier: LicenseRef-Nordic-5-Clause
#

menuconfig CAF_SETTINGS_LOADER
	bool "Settings loader module"
	depends on SETTINGS

if CAF_SETTINGS_LOADER

config CAF_SETTINGS_LOADER_DEF_PATH
	string "Configuration file"
	default "settings_loader_def.h"
	help
	  Location of configuration file for settings loader module.

config CAF_SETTINGS_LOADER_USE_THREAD
	bool "Enable loading of setting by separate thead"
	help
	  The option enables loading of settings by separate
	  thread in background instead of use of system
	  work queue for that purpose.

config CAF_SETTINGS_LOADER_THREAD_STACK_SIZE
	int "Settings module thread stack size"
	depends on CAF_SETTINGS_LOADER_USE_THREAD
	range 0 4096
	default 1200
	help
	  Stack size for thread responsible for loading
	  settings from flash memory.

if !CAF_SETTINGS_LOADER_USE_THREAD
config CAF_SETTINGS_LOADER_THREAD_STACK_SIZE
	int
	default 0
endif

module = CAF_SETTINGS_LOADER
module-str = caf module settings loader
source "subsys/logging/Kconfig.template.log_config"

endif # CAF_SETTINGS_LOADER
```

## subsys/common_application_framework/events/Kconfig
```kconfig
#
# Copyright (c) 2021 Nordic Semiconductor ASA
#
# SPDX-License-Identifier: LicenseRef-Nordic-5-Clause
#

menu "Event options"

config CAF_MODULE_STATE_EVENTS
	bool "Enable module state events"
	help
	  Enable support for module state events.

config CAF_INIT_LOG_MODULE_STATE_EVENTS
	bool "Log module state events"
	depends on CAF_MODULE_STATE_EVENTS
	depends on LOG
	default y

endmenu
```

## subsys/debug/Kconfig
```kconfig
#
# Copyright (c) 2019 Nordic Semiconductor
#
# SPDX-License-Identifier: LicenseRef-Nordic-5-Clause
#

menu "Debug"

rsource "cpu_load/Kconfig"
rsource "etb_trace/Kconfig"
rsource "ppi_trace/Kconfig"

endmenu
```
