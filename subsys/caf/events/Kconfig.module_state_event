## subsys/debug/coredump/Kconfig
```kconfig
#
# Copyright (c) 2025 Nordic Semiconductor
#
# SPDX-License-Identifier: LicenseRef-Nordic-5-Clause
#

if DEBUG_COREDUMP_BACKEND_OTHER

choice DEBUG_COREDUMP_BACKEND_NRF
	prompt "nRF core dump storage implementation"
	default DEBUG_COREDUMP_BACKEND_NRF_FLASH_PARTITION
	help
	  Select whether core dumps are written to on-chip non-volatile memory or to a
	  dedicated SRAM region (survives soft reset, not power loss).

config DEBUG_COREDUMP_BACKEND_NRF_FLASH_PARTITION
	bool "Internal flash or RRAM (partition coredump_partition) [EXPERIMENTAL]"
	depends on DT_HAS_NORDIC_NRF51_FLASH_CONTROLLER_ENABLED || \
		   DT_HAS_NORDIC_NRF52_FLASH_CONTROLLER_ENABLED || \
		   DT_HAS_NORDIC_NRF53_FLASH_CONTROLLER_ENABLED || \
		   DT_HAS_NORDIC_NRF91_FLASH_CONTROLLER_ENABLED || \
		   DT_HAS_NORDIC_RRAM_CONTROLLER_ENABLED
	depends on !BUILD_WITH_TFM
	select FLASH_MAP
	select EXPERIMENTAL
	help
	  Enables the Zephyr core dump backend that saves a core dump to the
	  flash or RRAM partition named "coredump_partition". This backend is
	  similar to the one enabled with DEBUG_COREDUMP_BACKEND_FLASH_PARTITION
	  option except that it bypasses the Zephyr flash device layer and uses
	  nrfx library directly.

config DEBUG_COREDUMP_BACKEND_NRF_RAM_REGION
	bool "Dedicated SRAM region (devicetree coredump_storage_region) [EXPERIMENTAL]"
	depends on $(dt_nodelabel_enabled,coredump_storage_region)
	select EXPERIMENTAL
	help
	  Stores raw core dump bytes in a reserved SRAM block defined in devicetree
	  (nodelabel coredump_storage_region), with the same header and CRC layout as
	  the flash/RRAM backend. Suitable when non-volatile coredump storage is
	  undesirable or unavailable.

endchoice

config DEBUG_COREDUMP_BACKEND_NRF_WRITE_BUF_SIZE
	int "Coredump backend streaming buffer size"
	depends on DEBUG_COREDUMP_BACKEND_NRF_FLASH_PARTITION || \
		   DEBUG_COREDUMP_BACKEND_NRF_RAM_REGION
	default 128

endif # DEBUG_COREDUMP_BACKEND_OTHER
```

## subsys/debug/cpu_load/Kconfig
```kconfig
#
# Copyright (c) 2019 Nordic Semiconductor
#
# SPDX-License-Identifier: LicenseRef-Nordic-5-Clause
#

menuconfig NRF_CPU_LOAD
	bool "CPU load measurement"
	select NRFX_GPPI
	depends on !SOC_SERIES_NRF51 # Lack of required HW events
	depends on !SOC_SERIES_NRF54H # Lack of required HW events
	depends on !RISCV # Lack of required HW events
	help
	  Enable the CPU load measurement instrumentation. This tool is using
	  POWER peripheral events with one TIMER peripheral and PPI to perform
	  accurate CPU load measurement.

if NRF_CPU_LOAD

module = NRF_CPU_LOAD
module-str = CPU load measurement
source "$(ZEPHYR_BASE)/subsys/logging/Kconfig.template.log_config"

config NRF_CPU_LOAD_CMDS
	bool "Shell commands"
	depends on SHELL
	default y

if LOG

config NRF_CPU_LOAD_LOG_PERIODIC
	bool "Periodically log current CPU load"
	help
	  INFO level must be enabled to get the log.

config NRF_CPU_LOAD_LOG_INTERVAL
	int "Logging interval for CPU load [ms]"
	depends on NRF_CPU_LOAD_LOG_PERIODIC
	default 2000

endif # LOG

config NRF_CPU_LOAD_ALIGNED_CLOCKS
	bool "Aligned clock sources"
	depends on !SOC_SERIES_NRF54L
	help
	  After enabling this option, the sleep period measurement
	  is done using the same clock source as the active period,
	  and one additional PPI channel is used.
	  If you use the internal RC oscillator for at least one
	  of the clock sources (high or low frequency), this option
	  will ensure more accurate results.
	  Enabling this option allows going to low power idle mode
	  because the high frequency clock is not used by this module.

config NRF_CPU_LOAD_USE_SHARED_DPPI_CHANNELS
	bool "Use shared DPPI channels"
	depends on HAS_HW_NRF_DPPIC
	depends on !SOC_SERIES_NRF54L
	help
	  DPPIC tasks and events can be assigned only to a single channel. When
	  enabled, module will use channels to which events are already
	  subscribed but will not enable it, relying on primary owner of the
	  channel. Without special care, it may lead to cpu_load misfunction.
	  On the other hand, it enables usage of cpu_load when events are used
	  by the system. If disabled, cpu_load initialization fails when cannot
	  allocate a DPPI channel.

choice
	prompt "Timer instance"
	default NRF_CPU_LOAD_TIMER_20 if SOC_SERIES_NRF54L
	default NRF_CPU_LOAD_TIMER_2

config NRF_CPU_LOAD_TIMER_0
	depends on $(dt_nodelabel_has_compat,timer0,$(DT_COMPAT_NORDIC_NRF_TIMER))
	bool "Timer 0"
	select NRFX_TIMER

config NRF_CPU_LOAD_TIMER_1
	depends on $(dt_nodelabel_has_compat,timer1,$(DT_COMPAT_NORDIC_NRF_TIMER))
	bool "Timer 1"
	select NRFX_TIMER

config NRF_CPU_LOAD_TIMER_2
	depends on $(dt_nodelabel_has_compat,timer2,$(DT_COMPAT_NORDIC_NRF_TIMER))
	bool "Timer 2"
	select NRFX_TIMER

config NRF_CPU_LOAD_TIMER_3
	depends on $(dt_nodelabel_has_compat,timer3,$(DT_COMPAT_NORDIC_NRF_TIMER))
	bool "Timer 3"
	select NRFX_TIMER

config NRF_CPU_LOAD_TIMER_4
	depends on $(dt_nodelabel_has_compat,timer4,$(DT_COMPAT_NORDIC_NRF_TIMER))
	bool "Timer 4"
	select NRFX_TIMER

config NRF_CPU_LOAD_TIMER_20
	depends on $(dt_nodelabel_has_compat,timer20,$(DT_COMPAT_NORDIC_NRF_TIMER))
	bool "Timer 20"
	select NRFX_TIMER

config NRF_CPU_LOAD_TIMER_21
	depends on $(dt_nodelabel_has_compat,timer21,$(DT_COMPAT_NORDIC_NRF_TIMER))
	bool "Timer 21"
	select NRFX_TIMER

config NRF_CPU_LOAD_TIMER_22
	depends on $(dt_nodelabel_has_compat,timer22,$(DT_COMPAT_NORDIC_NRF_TIMER))
	bool "Timer 22"
	select NRFX_TIMER

config NRF_CPU_LOAD_TIMER_23
	depends on $(dt_nodelabel_has_compat,timer23,$(DT_COMPAT_NORDIC_NRF_TIMER))
	bool "Timer 23"
	select NRFX_TIMER

config NRF_CPU_LOAD_TIMER_24
	depends on $(dt_nodelabel_has_compat,timer24,$(DT_COMPAT_NORDIC_NRF_TIMER))
	bool "Timer 24"
	select NRFX_TIMER

endchoice

config NRF_CPU_LOAD_TIMER_INSTANCE
	int
	default 0 if NRF_CPU_LOAD_TIMER_0
	default 1 if NRF_CPU_LOAD_TIMER_1
	default 2 if NRF_CPU_LOAD_TIMER_2
	default 3 if NRF_CPU_LOAD_TIMER_3
	default 4 if NRF_CPU_LOAD_TIMER_4
	default 20 if NRF_CPU_LOAD_TIMER_20
	default 21 if NRF_CPU_LOAD_TIMER_21
	default 22 if NRF_CPU_LOAD_TIMER_22
	default 23 if NRF_CPU_LOAD_TIMER_23
	default 24 if NRF_CPU_LOAD_TIMER_24

endif # NRF_CPU_LOAD
```
