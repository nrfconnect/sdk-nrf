## soc/nordic/nrf54l/Kconfig.defconfig.nrf54lm20a_enga_cpuapp
```kconfig
# Nordic Semiconductor nRF54LM20A MCU

# Copyright (c) 2024 Nordic Semiconductor ASA
# SPDX-License-Identifier: LicenseRef-Nordic-5-Clause

if SOC_NRF54LM20A_ENGA_CPUAPP

config NUM_IRQS
	default 290

endif # SOC_NRF54LM20A_ENGA_CPUAPP
```

## soc/nordic/nrf54l/Kconfig.defconfig.nrf54ls05_a_b_cpuapp
```kconfig
# Nordic Semiconductor nRF54LS05B MCU

# Copyright (c) 2025 Nordic Semiconductor ASA
# SPDX-License-Identifier: LicenseRef-Nordic-5-Clause

if SOC_NRF54LS05A_CPUAPP || SOC_NRF54LS05B_CPUAPP

config NUM_IRQS
	default 289

config NRF_COMPRESS_LZMA_MAX_DICT_SIZE
	default 4096

config NRF_COMPRESS_LZMA_LC
	default 0

config NRF_COMPRESS_LZMA_LP
	default 0

config NRF_COMPRESS_LZMA_MAX_LC_LP
	default 0

endif # SOC_NRF54LS05A_CPUAPP || SOC_NRF54LS05B_CPUAPP
```

## soc/nordic/nrf54l/Kconfig.defconfig.nrf54ls05b_cpuapp
```kconfig
# Nordic Semiconductor nRF54LS05B MCU

# Copyright (c) 2025 Nordic Semiconductor ASA
# SPDX-License-Identifier: LicenseRef-Nordic-5-Clause

if SOC_NRF54LS05B_CPUAPP

config NUM_IRQS
	default 289

endif # SOC_NRF54LS05B_CPUAPP
```

## soc/nordic/nrf54l/Kconfig.defconfig.nrf54lv10a
```kconfig
if SOC_NRF54LV10A_CPUAPP

config NRF_RRAM_WRITE_BUFFER_SIZE
	default 16
	range 0 16

endif # SOC_NRF54LV10A_CPUAPP
```

## soc/nordic/nrf54l/Kconfig.defconfig.nrf54lv10a_cpuflpr
```kconfig
# Nordic Semiconductor nRF54LV10A MCU

# Copyright (c) 2025 Nordic Semiconductor ASA
# SPDX-License-Identifier: LicenseRef-Nordic-5-Clause

if SOC_NRF54LV10A_CPUFLPR

config NUM_IRQS
	default 287

endif # SOC_NRF54LV10A_CPUFLPR
```

## soc/nordic/nrf54l/Kconfig.defconfig.nrf54lv10a_enga_cpuapp
```kconfig
# Nordic Semiconductor nRF54LV10A MCU

# Copyright (c) 2024 Nordic Semiconductor ASA
# SPDX-License-Identifier: LicenseRef-Nordic-5-Clause

if SOC_NRF54LV10A_ENGA_CPUAPP

config NUM_IRQS
	default 290

endif # SOC_NRF54LV10A_ENGA_CPUAPP
```

## soc/nordic/nrf54l/Kconfig.soc
```kconfig
# Nordic Semiconductor nRF54L MCU line

# Copyright (c) 2024 Nordic Semiconductor ASA
# SPDX-License-Identifier: LicenseRef-Nordic-5-Clause

config SOC_NRF54LS05B
	bool
	select SOC_SERIES_NRF54L
	help
	  NRF54LS05B

config SOC_NRF54LS05B_ENGA
	bool
	select SOC_NRF54LS05B
	help
	  NRF54LS05B ENGA

config SOC_NRF54LS05B_ENGA_CPUAPP
	bool
	select SOC_NRF54LS05B_ENGA
	help
	  NRF54LS05B ENGA CPUAPP

config SOC_NRF54LV10A
	bool
	select SOC_SERIES_NRF54L
	help
	  NRF54LV10A

config SOC_NRF54LV10A_ENGA
	bool
	select SOC_NRF54LV10A
	help
	  NRF54LV10A ENGA

config SOC_NRF54LV10A_ENGA_CPUAPP
	bool
	select SOC_NRF54LV10A_ENGA
	help
	  NRF54LV10A ENGA CPUAPP

config SOC_NRF54LV10A_ENGA_CPUFLPR
	bool
	select SOC_NRF54LV10A_ENGA
	help
	  NRF54LV10A ENGA CPUFLPR

config SOC
	default "nrf54ls05b" if SOC_NRF54LS05B
	default "nrf54lv10a" if SOC_NRF54LV10A
```

## soc/nordic/nrf71/Kconfig
```kconfig
# Nordic Semiconductor nRF71 MCU line

# Copyright (c) 2025 Nordic Semiconductor ASA
# SPDX-License-Identifier: LicenseRef-Nordic-5-Clause

config SOC_SERIES_NRF71X
	select HAS_NRFX
	select HAS_NORDIC_DRIVERS
	select HAS_SEGGER_RTT if ZEPHYR_SEGGER_MODULE
	select SOC_EARLY_INIT_HOOK
	select SOC_RESET_HOOK
	select NRF_PLATFORM_LUMOS

config SOC_NRF7120_ENGA_CPUAPP
	select ARM
	select ARMV8_M_DSP
	select CPU_CORTEX_M33
	select CPU_HAS_ARM_MPU
	select CPU_HAS_ICACHE
	select CPU_HAS_ARM_SAU
	select CPU_HAS_FPU
	select HAS_HW_NRF_RADIO_IEEE802154
	select HAS_POWEROFF
	select HAS_SWO

config SOC_NRF7120_ENGA_CPUFLPR
	select RISCV_CORE_NORDIC_VPR

if SOC_SERIES_NRF71X

DT_MPC_REGION_SIZE := $(dt_nodelabel_path,nrf_mpc_region)

config NRF_TRUSTZONE_FLASH_REGION_SIZE
	hex
	default $(dt_node_int_prop_hex,$(DT_MPC_REGION_SIZE),override-granularity)
	help
	  This defines the flash region size from the TRUSTZONE perspective.
	  It is used when configuring the TRUSTZONE and when setting alignments
	  requirements for the partitions.
	  This abstraction allows us to configure TRUSTZONE without depending
	  on peripheral specific symbols.

config NRF_TRUSTZONE_RAM_REGION_SIZE
	hex
	default $(dt_node_int_prop_hex,$(DT_MPC_REGION_SIZE),override-granularity)
	help
	  This defines the RAM region size from the TRUSTZONE perspective.
	  It is used when configuring the TRUSTZONE and when setting alignments
	  requirements for the partitions.
	  This abstraction allows us to configure TRUSTZONE without depending
	  on peripheral specific symbols.

# TODO: Remove this option once all pre-ENG variants support AMBIX03
config SOC_NRF7120_HAS_AMBIX03
	bool "AMBIX03 available"
	depends on SOC_NRF7120_PREENG

config NRF_WIFI_WICR_GENERATE_HEX
	bool "Generate WICR hex file from device tree"
	depends on DT_HAS_NORDIC_NRF_WICR_ENABLED
	default y
	help
	  Automatically validate and generate wicr.hex file from device tree
	  WICR configuration during build. The hex file will be created in
	  the build directory and can be loaded to the device to program
	  the WiFi Information Configuration Registers.

endif # SOC_SERIES_NRF71X
```

## soc/nordic/nrf92/Kconfig
```kconfig
# Copyright (c) 2026 Nordic Semiconductor ASA
# SPDX-License-Identifier: Apache-2.0

# nRF9220 / nRF9251
config SOC_NRF9220_CPUAPP
	select ARM
	select ARMV8_M_DSP
	select CPU_CORTEX_M33
	select CPU_HAS_ARM_MPU
	select CPU_HAS_ARM_SAU
	select CPU_HAS_DCACHE
	select CPU_HAS_ICACHE
	select CPU_HAS_FPU
	select CPU_HAS_CUSTOM_FIXED_SOC_MPU_REGIONS
	select HAS_NORDIC_DMM
	select HAS_SEGGER_RTT if ZEPHYR_SEGGER_MODULE
	select NRFS_LOCAL_DOMAIN if NRFS
	select NRFS_HAS_AUDIOPLL_SERVICE
	select NRFS_HAS_CLOCK_SERVICE
	select NRFS_HAS_GDPWR_SERVICE
	select NRFS_HAS_MRAM_SERVICE
	select NRFS_HAS_PMIC_SERVICE
	select NRFS_HAS_TEMP_SERVICE
	select NRFS_HAS_VBUS_DETECTOR_SERVICE
	select NRFS_TEMP_SERVICE_HAS_SUBSCRIPTION_SERVICE
	select HAS_IRONSIDE_SE_CALL

config SOC_NRF9220_CPUPPR
	select RISCV_CORE_NORDIC_VPR

config SOC_NRF9220_CPUFLPR
	select RISCV_CORE_NORDIC_VPR
```

## soc/nordic/nrf92/Kconfig.defconfig
```kconfig
# Copyright (c) 2026 Nordic Semiconductor ASA
# SPDX-License-Identifier: LicenseRef-Nordic-5-Clause

if SOC_SERIES_NRF92

rsource "Kconfig.defconfig.nrf92*"

endif #SOC_SERIES_NRF92
```

## soc/nordic/nrf92/Kconfig.defconfig.nrf9220_cpuapp
```kconfig
# Copyright (c) 2026 Nordic Semiconductor ASA
# SPDX-License-Identifier: Apache-2.0

if SOC_NRF9220_CPUAPP

config NUM_IRQS
	default 471

config NRF_REGTOOL_GENERATE_UICR
	default n

config NRF_PERIPHCONF_SECTION
	default y
	depends on $(dt_nodelabel_exists,periphconf_partition)

endif # SOC_NRF9220_CPUAPP
```

## soc/nordic/nrf92/Kconfig.defconfig.nrf9220_cpuflpr
```kconfig
# Copyright (c) 2026 Nordic Semiconductor ASA
# SPDX-License-Identifier: Apache-2.0

if SOC_NRF9220_CPUFLPR

config NUM_IRQS
	default 496

# As FLPR has limited memory most of tests does not fit with asserts enabled.
config ASSERT
	default n

endif # SOC_NRF9220_CPUFLPR
```

## soc/nordic/nrf92/Kconfig.defconfig.nrf9220_cpuppr
```kconfig
# Copyright (c) 2026 Nordic Semiconductor ASA
# SPDX-License-Identifier: Apache-2.0

if SOC_NRF9220_CPUPPR

config NUM_IRQS
	default 496

# As PPR has limited memory most of tests does not fit with asserts enabled.
config ASSERT
	default n

endif # SOC_NRF9220_CPUPPR
```

## soc/nordic/nrf92/Kconfig.defconfig.nrf9251_cpuapp
```kconfig
# Copyright (c) 2026 Nordic Semiconductor ASA
# SPDX-License-Identifier: LicenseRef-Nordic-5-Clause

if SOC_NRF9251_CPUAPP

config NUM_IRQS
	default 471

config ROM_START_OFFSET
	default 0x800 if BOOTLOADER_MCUBOOT

config NRF_REGTOOL_GENERATE_UICR
	default n

config NRF_PERIPHCONF_SECTION
	default y if $(dt_nodelabel_exists,periphconf_partition)

endif # SOC_NRF9251_CPUAPP
```

## soc/nordic/nrf92/Kconfig.defconfig.nrf9251_cpuflpr
```kconfig
# Copyright (c) 2026 Nordic Semiconductor ASA
# SPDX-License-Identifier: LicenseRef-Nordic-5-Clause

if SOC_NRF9251_CPUFLPR

config NUM_IRQS
	default 496

# As FLPR has limited memory most of tests does not fit with asserts enabled.
config ASSERT
	default n

endif # SOC_NRF9251_CPUFLPR
```

## soc/nordic/nrf92/Kconfig.defconfig.nrf9251_cpuppr
```kconfig
# Copyright (c) 2026 Nordic Semiconductor ASA
# SPDX-License-Identifier: LicenseRef-Nordic-5-Clause

if SOC_NRF9251_CPUPPR

config NUM_IRQS
	default 496

# As PPR has limited memory most of tests does not fit with asserts enabled.
config ASSERT
	default n

endif # SOC_NRF9251_CPUPPR
```

## soc/nordic/nrf92/Kconfig.soc
```kconfig
# Copyright (c) 2026 Nordic Semiconductor ASA
# SPDX-License-Identifier: LicenseRef-Nordic-5-Clause

config SOC_NRF9220
	bool
	select SOC_SERIES_NRF92

config SOC_NRF9220_CPUAPP
	bool
	select SOC_NRF9220

config SOC_NRF9220_CPUPPR
	bool
	select SOC_NRF9220

config SOC_NRF9220_CPUFLPR
	bool
	select SOC_NRF9220

# The SiP selects the actual SoC complete with engineer revision and appropriate CPU
config SOC_NRF9251
	bool
	select SOC_NRF9220_CPUAPP if SOC_NRF9251_CPUAPP
	select SOC_NRF9220_CPUPPR if SOC_NRF9251_CPUPPR
	select SOC_NRF9220_CPUFLPR if SOC_NRF9251_CPUFLPR
	help
	  nRF9251 SiP

# The CPU select the "SoC" (SiP)
config SOC_NRF9251_CPUAPP
	bool
	select SOC_NRF9251
	help
	  nRF9251 CPUAPP

config SOC_NRF9251_CPUPPR
	bool
	select SOC_NRF9251
	help
	  nRF9251 CPUPPR

config SOC_NRF9251_CPUFLPR
	bool
	select SOC_NRF9251
	help
	  nRF9251 CPUFLPR

config SOC
	default "nrf9251" if SOC_NRF9251

config SOC_SERIES
	default "nrf92" if SOC_SERIES_NRF92
```

## soc/sercomm/nrf91/Kconfig.defconfig
```kconfig
# Sercomm modules with Nordic Semiconductor nRF91 SoC

# Copyright (c) 2025 Nordic Semiconductor ASA
# SPDX-License-Identifier: LicenseRef-Nordic-5-Clause

if SOC_SERIES_NRF91

rsource "Kconfig.defconfig.tpm530m"

source "soc/nordic/nrf91/Kconfig.defconfig"

endif # SOC_SERIES_NRF91
```

## soc/sercomm/nrf91/Kconfig.defconfig.tpm530m
```kconfig
# Sercomm TPM530M module

# Copyright (c) 2025 Nordic Semiconductor ASA
# SPDX-License-Identifier: LicenseRef-Nordic-5-Clause

if SOC_TPM530M

config NUM_IRQS
	default 65

endif # SOC_TPM530M
```

## soc/sercomm/nrf91/Kconfig.soc
```kconfig
# Sercomm modules with Nordic Semiconductor nRF91 SoC

# Copyright (c) 2025 Nordic Semiconductor ASA
# SPDX-License-Identifier: LicenseRef-Nordic-5-Clause

config SOC_TPM530M
	bool
	select SOC_NRF9120

config SOC
	default "tpm530m" if SOC_TPM530M
```

## subsys/Kconfig
```kconfig
#
# Copyright (c) 2018 - 2020 Nordic Semiconductor
#
# SPDX-License-Identifier: LicenseRef-Nordic-5-Clause
#

menu "Subsystems"

rsource "bootloader/Kconfig"
rsource "bluetooth/Kconfig"
rsource "dfu/Kconfig"
rsource "esb/Kconfig"
rsource "emds/Kconfig"
rsource "gazell/Kconfig"
rsource "pcd/Kconfig"
rsource "net/Kconfig"
rsource "nfc/Kconfig"
rsource "app_event_manager/Kconfig"
rsource "app_event_manager_profiler_tracer/Kconfig"
rsource "event_manager_proxy/Kconfig"
rsource "nrf_profiler/Kconfig"
rsource "fw_info/Kconfig"
rsource "debug/Kconfig"
rsource "shell/Kconfig"
rsource "mpsl/Kconfig"
rsource "partition_manager/Kconfig"
rsource "nrf_rpc/Kconfig"
rsource "mgmt/fmfu/Kconfig"
rsource "mgmt/mcumgr/Kconfig"
rsource "caf/Kconfig"
rsource "dm/Kconfig"
rsource "nrf_security/Kconfig"
rsource "net_core_monitor/Kconfig"
rsource "audio_module/Kconfig"
rsource "audio/audio_module_template/Kconfig"
rsource "uart_async_adapter/Kconfig"
rsource "trusted_storage/Kconfig"
rsource "secure_storage/Kconfig"
rsource "logging/Kconfig"
rsource "dult/Kconfig"
rsource "nrf_compress/Kconfig"
rsource "mcuboot_ids/Kconfig"
rsource "settings/Kconfig"
rsource "nrf_ironside/Kconfig"
endmenu
```

## subsys/app_event_manager/Kconfig
```kconfig
#
# Copyright (c) 2018 Nordic Semiconductor
#
# SPDX-License-Identifier: LicenseRef-Nordic-5-Clause
#

menuconfig APP_EVENT_MANAGER
	bool
	prompt "Application Event Manager"
	help
	  Enable Application Event Manager.

if APP_EVENT_MANAGER

config APP_EVENT_MANAGER_REBOOT_ON_EVENT_ALLOC_FAIL
	bool "Reboot on event allocation failure"
	depends on REBOOT
	default y
	help
	  The default event allocator triggers assertion failure on event
	  allocation failure. Then, depending on the value of this Kconfig
	  option, the default allocator either triggers a system reboot or
	  kernel panic.

config APP_EVENT_MANAGER_SHOW_EVENTS
	bool "Show events"
	depends on LOG
	default y
	help
	  This option controls if events are logged.

config APP_EVENT_MANAGER_SHOW_EVENT_HANDLERS
	bool "Show event handlers"
	depends on APP_EVENT_MANAGER_SHOW_EVENTS
	help
	  This option controls if event handlers are printed to console.

config APP_EVENT_MANAGER_TRACE_EVENT_DATA
	bool "Enables tracing information"
	help
	  This option allows to gather information about events for tracing purposes.

config APP_EVENT_MANAGER_SHELL
	bool "Enable shell integration"
	depends on SHELL
	default y
	help
	  Enable Event Manager shell commands to display information about
	  listeners, subscribers and events. The commands also allow to
	  dynamically enable or disable logging for given event types.

module = APP_EVENT_MANAGER
module-str = Application Event Manager
source "${ZEPHYR_BASE}/subsys/logging/Kconfig.template.log_config"

config APP_EVENT_MANAGER_EVENT_LOG_BUF_LEN
	int "Length of buffer for processing event message"
	depends on APP_EVENT_MANAGER_USE_DEPRECATED_LOG_FUN
	default 128
	range 2 1024
	help
	  This option is only needed for deprecated event logging approach.

config APP_EVENT_MANAGER_USE_DEPRECATED_LOG_FUN
	bool "Allow using both logging functions current and deprecated one"
	help
	  This option is only needed for deprecated event logging approach.

config APP_EVENT_MANAGER_LOG_EVENT_TYPE
	bool "Include event type in the event log output"
	default y

config APP_EVENT_MANAGER_MAX_EVENT_CNT
	int "Maximum number of event types"
	default 32
	help
	  Maximum number of declared event types in Application Event Manager.

config APP_EVENT_MANAGER_PROVIDE_EVENT_SIZE
	bool "Provide information about the event size"
	help
	  This option enables the information about event size.
	  This would require to store more information with event type
	  and should be enabled only if such an information is required.

config APP_EVENT_MANAGER_POSTINIT_HOOK
	bool "Enable postinit hook"
	help
	  Enable postinit hooks support.
	  This option is here for optimisation purposes.
	  When postinit hook is not in use the related code may be removed.

config APP_EVENT_MANAGER_SUBMIT_HOOKS
	bool "Enable event submit hooks"
	help
	  Enable event submit hooks support.
	  This option is here for optimisation purposes.
	  When submit hook is not in use the related code may be removed.

config APP_EVENT_MANAGER_PREPROCESS_HOOKS
	bool "Enable event preprocess hooks"
	help
	  Enable event preprocess hooks support.
	  This option is here for optimisation purposes.
	  When preprocess hook is not in use the related code may be removed.

config APP_EVENT_MANAGER_POSTPROCESS_HOOKS
	bool "Enable event postprocess hooks"
	help
	  Enable event postprocess hooks support.
	  This option is here for optimisation purposes.
	  When postprocess hook is not in use the related code may be removed.

endif # APP_EVENT_MANAGER
```

## subsys/app_event_manager_profiler_tracer/Kconfig
```kconfig
#
# Copyright (c) 2021 Nordic Semiconductor
#
# SPDX-License-Identifier: LicenseRef-Nordic-5-Clause
#

config APP_EVENT_MANAGER_PROFILER_TRACER
	depends on APP_EVENT_MANAGER
	bool "Log events to Profiler"
	select NRF_PROFILER
	select APP_EVENT_MANAGER_POSTINIT_HOOK
	select APP_EVENT_MANAGER_SUBMIT_HOOKS
	select APP_EVENT_MANAGER_PREPROCESS_HOOKS
	select APP_EVENT_MANAGER_POSTPROCESS_HOOKS
	select APP_EVENT_MANAGER_TRACE_EVENT_DATA
	help
	  Application Event Manager will use nrf_profiler event count equal to Application Event Manager profiled event count
	  + 2 events for processing event start/end.

if APP_EVENT_MANAGER_PROFILER_TRACER

config APP_EVENT_MANAGER_PROFILER_TRACER_TRACE_EVENT_EXECUTION
	bool "Trace events execution"
	default y

config APP_EVENT_MANAGER_PROFILER_TRACER_PROFILE_EVENT_DATA
	bool "Profile data connected with event"

endif # APP_EVENT_MANAGER_PROFILER_TRACER
```
