## drivers/wifi/nrf700x/Kconfig.nrf700x
```kconfig
# Nordic Wi-Fi driver for nRF700x
#
# Copyright (c) 2022 Nordic Semiconductor
#
# SPDX-License-Identifier: LicenseRef-Nordic-5-Clause
#

config WIFI_NRF700X
	bool "nRF700x driver"
	depends on WIFI
	select NET_L2_WIFI_MGMT if NETWORKING
	select NET_L2_ETHERNET_MGMT if NETWORKING && NET_L2_ETHERNET
	select WIFI_USE_NATIVE_NETWORKING if NETWORKING
	select EXPERIMENTAL if !SOC_SERIES_NRF53X && !SOC_SERIES_NRF91X
	help
	  Nordic Wi-Fi Driver
if WIFI_NRF700X

module = WIFI_NRF700X_BUS
module-dep = LOG
module-str = Log level for Wi-Fi nRF700x bus layers
module-help = Sets log level for Wi-Fi nRF700x bus layers
source "subsys/net/Kconfig.template.log_config.net"

config NRF700X_STA_MODE
	bool
	default y if WPA_SUPP

config NRF_WIFI_IF_AUTO_START
	bool
	default y

config NRF_WIFI_PATCHES_EXT_FLASH
	bool "Store nRF700x FW patches in external flash"
	# nRF7002 supports SPI based external flash access with no XIP
	# Disable until Matter DFU changes are ready
	# default y if BOARD_NRF5340DK_NRF5340_CPUAPP || BOARD_NRF52840DK_NRF52840
	# For accessing external flash
	select FLASH
	# For relocation code to external flash
	select XIP
	select BUILD_NO_GAP_FILL
	select CODE_DATA_RELOCATION
	select HAVE_CUSTOM_LINKER_SCRIPT

config CUSTOM_LINKER_SCRIPT
	string "Custom linker script for nRF700x FW patches"
	default "${ZEPHYR_BASE}/../nrf/drivers/wifi/nrf700x/rpu_fw_patches.ld"

config NRF_WIFI_LOW_POWER
	bool "Enable low power mode in nRF Wi-Fi chipsets"
	default y

config NRF700X_TCP_IP_CHECKSUM_OFFLOAD
	bool "Enable TCP/IP checksum offload"
	default y

config NRF700X_REG_DOMAIN
	string "The ISO/IEC alpha2 country code for the country in which this device is currently operating. Default 00 (World regulatory)"
# 00 is used for World regulatory
	default "00"

# Making calls to RPU from net_mgmt callbacks.
#
# If WPA supplicant is enabled, then don't override as it has higher
# stack requirements.
config NET_MGMT_EVENT_STACK_SIZE
	default 2048 if !WPA_SUPP

# Wi-Fi interface will be operationally UP only after Wi-Fi connection.
config NET_CONFIG_INIT_TIMEOUT
	default 0 if NET_CONFIG_SETTINGS

config NRF700X_ON_QSPI
	def_bool NRF7000_ON_QSPI || NRF7001_ON_QSPI || NRF7002_ON_QSPI
	select NRFX_QSPI

config NRF700X_ON_SPI
	def_bool NRF7000_ON_SPI || NRF7001_ON_SPI || NRF7002_ON_SPI
	select SPI

# RF switch based coexistence
config NRF700X_RADIO_COEX
	def_bool $(dt_nodelabel_has_prop,nrf_radio_coex,btrf-switch-gpios)

config NRF700X_WORKQ_STACK_SIZE
	int "Stack size for workqueue"
	default 4096

config NRF700X_WORKQ_MAX_ITEMS
	int "Maximum work items for all workqueues"
	default 100

config NRF700X_MAX_TX_PENDING_QLEN
	int "Maximum number of pending TX packets"
	default 18

config NRF700X_RADIO_TEST
	bool "Radio test mode of the nRF700x driver"
	depends on !NRF700X_STA_MODE && !NRF700X_AP_MODE && !NRF700X_P2P_MODE && !NRF700X_DATA_TX

config NRF700X_AP_MODE
	bool "Enable Access point mode"
	select WPA_SUPP

config NRF700X_P2P_MODE
	bool "Enable P2P support in driver"
	select WPA_SUPP

config NRF700X_DATA_TX
	bool "Enable TX data path in the driver"
	default y if NRF700X_STA_MODE || NRF700X_AP_MODE || NRF700X_P2P_MODE

config NRF700X_UTIL
	depends on SHELL
	bool "Enable Utility shell in nRF700x driver"

config NRF700X_BT_COEX
	bool "Enable Wi-Fi Bluetooth coexistence support"
	depends on SOC_NRF5340_CPUAPP_QKAA
	default y if SOC_NRF5340_CPUAPP_QKAA

config NRF700X_QSPI_LOW_POWER
	bool "Enable low power mode in QSPI"
	default y if NRF_WIFI_LOW_POWER

config NRF700X_ANT_GAIN_2G
	int "Antenna gain for 2.4 GHz band"
	default 0
	range 0 6

config NRF700X_ANT_GAIN_5G_BAND1
	int "Antenna gain for 5 GHz band (5150 MHz - 5350 MHz)"
	default 0
	range 0 6

config NRF700X_ANT_GAIN_5G_BAND2
	int "Antenna gain for 5 GHz band (5470 MHz - 5730 MHz)"
	default 0
	range 0 6

config NRF700X_ANT_GAIN_5G_BAND3
	int "Antenna gain for 5 GHz band (5730 MHz - 5895 MHz)"
	default 0
	range 0 6

config NRF700X_BAND_2G_LOWER_EDGE_BACKOFF
	int "Transmit power backoff (in dB) for lower edge of 2.4 GHz frequency band"
	default 0
	range 0 10

config NRF700X_BAND_2G_UPPER_EDGE_BACKOFF
	int "Transmit power backoff (in dB) for upper edge of 2.4 GHz frequency band"
	default 0
	range 0 10

config NRF700X_BAND_UNII_1_LOWER_EDGE_BACKOFF
	int "Transmit power backoff (in dB) for lower edge of UNII-1 frequency band"
	default 0
	range 0 10

config NRF700X_BAND_UNII_1_UPPER_EDGE_BACKOFF
	int "Transmit power backoff (in dB) for upper edge of UNII-1 frequency band"
	default 0
	range 0 10

config NRF700X_BAND_UNII_2A_LOWER_EDGE_BACKOFF
	int "Transmit power backoff (in dB) for lower edge of UNII-2A frequency band"
	default 0
	range 0 10

config NRF700X_BAND_UNII_2A_UPPER_EDGE_BACKOFF
	int "Transmit power backoff (in dB) for upper edge of UNII-2A frequency band"
	default 0
	range 0 10

config NRF700X_BAND_UNII_2C_LOWER_EDGE_BACKOFF
	int "Transmit power backoff (in dB) for lower edge of UNII-2C frequency band"
	default 0
	range 0 10

config NRF700X_BAND_UNII_2C_UPPER_EDGE_BACKOFF
	int "Transmit power backoff (in dB) for upper edge of UNII-2C frequency band"
	default 0
	range 0 10

config NRF700X_BAND_UNII_3_LOWER_EDGE_BACKOFF
	int "Transmit power backoff (in dB) for lower edge of UNII-3 frequency band"
	default 0
	range 0 10

config NRF700X_BAND_UNII_3_UPPER_EDGE_BACKOFF
	int "Transmit power backoff (in dB) for upper edge of UNII-3 frequency band"
	default 0
	range 0 10

config NRF700X_BAND_UNII_4_LOWER_EDGE_BACKOFF
	int "Transmit power backoff (in dB) for lower edge of UNII-4 frequency band"
	default 0
	range 0 10

config NRF700X_BAND_UNII_4_UPPER_EDGE_BACKOFF
	int "Transmit power backoff (in dB) for upper edge of UNII-4 frequency band"
	default 0
	range 0 10

# Performance fine tuning options

config NRF700X_RX_NUM_BUFS
	int "Number of RX buffers"
	default 48

config NRF700X_MAX_TX_AGGREGATION
	int "Maximum number of TX packets to aggregate"
	default 12

config NRF700X_MAX_TX_TOKENS
	int "Maximum number of TX tokens"
	range 5 12 if !NRF700X_RADIO_TEST
	default 10

config NRF700X_TX_MAX_DATA_SIZE
	int "Maximum size of TX data"
	default 1600

config NRF700X_RX_MAX_DATA_SIZE
	int "Maximum size of RX data"
	default 1600

config NRF700X_SCAN_LIMIT
	int "Maximum number of scan results returned to application. Use negative values for unlimited scan results."
	default -1

config NRF700X_TX_DONE_WQ_ENABLED
	bool "Enable TX done workqueue (impacts performance negatively)"

config NRF700X_RX_WQ_ENABLED
	bool "Enable RX workqueue"

# Use for IRQ processing (TODO: using for BH processing causes issues)
config NUM_METAIRQ_PRIORITIES
	default 1

config NRF700X_IRQ_WQ_PRIORITY
	int "Priority of the workqueue for handling IRQs"
	default -15

config NRF700X_BH_WQ_PRIORITY
	int "Priority of the workqueue for handling bottom half"
	default 0

config NRF700X_IRQ_WQ_STACK_SIZE
	int "Stack size of the workqueue for handling IRQs"
	default 2048

config NRF700X_BH_WQ_STACK_SIZE
	int "Stack size of the workqueue for handling bottom half"
	default 2048

if NRF700X_TX_DONE_WQ_ENABLED
config NRF700X_TX_DONE_WQ_PRIORITY
	int "Priority of the workqueue for handling TX done"
	default 0

config NRF700X_TX_DONE_WQ_STACK_SIZE
	int "Stack size of the workqueue for handling TX done"
	default 2048
endif

if NRF700X_RX_WQ_ENABLED
config NRF700X_RX_WQ_PRIORITY
	int "Priority of the workqueue for handling RX"
	default 0

config NRF700X_RX_WQ_STACK_SIZE
	int "Stack size of the workqueue for handling RX"
	default 2048
endif

if NRF_WIFI_LOW_POWER

config NRF700X_RPU_PS_IDLE_TIMEOUT_MS
	int "RPU power save idle timeout in milliseconds"
	default 10

endif

config WIFI_FIXED_MAC_ADDRESS
	string "WiFi Fixed MAC address in format XX:XX:XX:XX:XX:XX"
	help
		This overrides the MAC address read from OTP. Strictly for testing purposes only.

config NRF700X_RSSI_STALE_TIMEOUT_MS
	int "RSSI stale timeout in milliseconds"
	default 1000
	help
	  RSSI stale timeout is the period after which driver querries
	  RPU to get the RSSI the value.
	  If data is active (e.g. ping), driver stores the RSSI value from
	  the received frames and provides this stored information
	  to wpa_supplicant. In this case a higher value will be suitable
	  as stored RSSI value at driver will be updated regularly.
	  If data is not active or after the stale timeout duration,
	  driver queries the RPU to get the RSSI value
	  and provides it to wpa_suuplicant. The value should be set to lower
	  value as driver does not store it and requires RPU to provide the
	  info.

endif
```

## drivers/wifi/nrf92/Kconfig
```kconfig
# Copyright (c) 2026 Nordic Semiconductor ASA
#
# SPDX-License-Identifier: LicenseRef-Nordic-5-Clause
#

config WIFI_NRF92
	bool "nRF92 Wi-Fi driver"
	depends on WIFI
	depends on NRF_MODEM_LIB
	select NET_L2_WIFI_MGMT
	help
	  nRF92 Wi-Fi driver supporting scanning of Wi-Fi APs.

if WIFI_NRF92

config WIFI_NRF92_IGNORE_PROBES
	bool "Ignore probes"
	help
	  Ignore probes and scan only beacons.

config WIFI_NRF92_IGNORE_LOCAL_ADDR
	bool "Ignore locally administered MAC addresses"
	default y
	help
	  Ignore locally administered MAC addresses in the scan results.

config WIFI_NRF92_INCREASE_MAX_GAIN
	bool "Increase maximum RF gain in the Wi-Fi receiver"
	help
	  Enhance the sensitivity of the Wi-Fi receiver by increasing the maximum RF gain,
	  allowing for detection of weaker signals. This action may increase the current
	  consumption and susceptibility to interference.

config WIFI_NRF92_OFFLINE_PROCESSING
	bool "Offline processing"
	default y
	help
	  Enable offline processing of beacon or probe response frames that cannot be processed
	  in real-time due to cycle budget constraints.

endif # WIFI_NRF92
```

## drivers/wifi_recal_monitor/Kconfig
```kconfig
#
# Copyright (c) 2026 Nordic Semiconductor ASA
#
# SPDX-License-Identifier: LicenseRef-Nordic-5-Clause
#

menuconfig WIFI_RECAL_MONITOR
	bool "Subsystem to monitor Wi-Fi recalibration triggers"
	help
	  Enable monitoring of operating conditions (battery voltage, die
	  temperature) that the Wi-Fi driver uses to trigger recalibration
	  or reconfiguration. Each enabled channel collects live data
	  through its own work item.

if WIFI_RECAL_MONITOR

menuconfig WIFI_RECAL_DIE_TEMP_MONITOR
	bool "Monitor die temperature"
	select SENSOR
	help
	  Reads via the Zephyr sensor API from the device pointed to by the
	  `nordic,wifi-recal-die-temp-sensor` devicetree chosen node. Falls back to
	  the SoC's own die temperature sensor (nodelabel `temp`) when no
	  chosen override is present, so this works out of the box on the
	  DK. Boards with their own ambient temperature sensor can override
	  the chosen node instead of touching this driver.

if WIFI_RECAL_DIE_TEMP_MONITOR

config WIFI_RECAL_DIE_TEMP_MONITOR_INTERVAL_MS
	int "Die temperature measurement interval (ms)"
	default 10000
	help
	  Interval between die temperature measurements in milliseconds.

endif # WIFI_RECAL_DIE_TEMP_MONITOR

config WIFI_RECAL_BATTERY_VOLTAGE_MONITOR
	bool "Monitor battery voltage"

config WIFI_RECAL_LOG_LEVEL
	int "Logging level in the Wi-Fi recalibration monitor"
	default LOG_DEFAULT_LEVEL
	depends on LOG
	help
	  Sets the logging level for the Wi-Fi recalibration monitor.

config WIFI_RECAL_DIE_TEMP_DEFAULT_VALUE
	int "Die temperature default value (centi-degC)"
	default 2500
	help
	  Default value when WIFI_RECAL_DIE_TEMP_MONITOR=n. 2500 = 25.00 C.

config WIFI_RECAL_BATTERY_VOLTAGE_DEFAULT_VALUE
	int "Battery voltage default value (mV)"
	default 3300
	help
	  Default value when WIFI_RECAL_BATTERY_VOLTAGE_MONITOR=n. 3300 = 3.3 V.

config WIFI_RECAL_SNAPSHOT_INTERVAL_MS
	int "Snapshot interval (ms)"
	default 10000
	help
	  How often a snapshot is captured from every
	  enabled channel.

endif # WIFI_RECAL_MONITOR
```

## dts/bindings/bluetooth/nordic,bt-cs-antenna-switch.yaml
```yaml
# Copyright (c) 2025 Nordic Semiconductor ASA
# SPDX-License-Identifier: LicenseRef-Nordic-5-Clause

description: |
  This is an abstract representation of a generic antenna switching circuit
  which is controlled by GPIO pins. Up to four antenna ports (ANT1-4) are defined.

compatible: "nordic,bt-cs-antenna-switch"

include: base.yaml

properties:
  multiplexing-mode:
    type: int
    description: |
      Multiplexing mode. This setting determines whether or not the switching circuit
      is controlled using a one-to-one mapping between pins and antennas.
      The possible values are:
      0: (default) One-to-one mapping. Each pin selects one antenna.
        Only one pin is active at a time.
      1: Multiplexed mapping. Antenna selection is derived from the state of all
        pins. Example: two pins select between four antennas.

  ant-gpios:
    type: phandle-array
    required: true
    description: |
      Array of pins corresponding to <ANT1, ANT2, ANT3, ANT4>.
      At least one pin is needed.
```

## dts/bindings/bluetooth/nordic,bt-hci-sdc.yaml
```yaml
description: Bluetooth HCI provided by the SoftDevice Controller

compatible: "nordic,bt-hci-sdc"

include: bt-hci.yaml

properties:
  bt-hci-name:
    default: "SDC"
  bt-hci-bus:
    default: "BT_HCI_BUS_VIRTUAL"
```

## dts/bindings/bootchain/mcuboot.yaml
```yaml
#
# Copyright (c) 2026 Nordic Semiconductor ASA
#
# SPDX-License-Identifier: LicenseRef-Nordic-5-Clause
#

description: MCUboot instance properties

compatible: nordic,mcuboot

properties:
  uuid-vid-required:
    type: boolean
    description: |
      Enable or disable checks for UUID Vendor IDs in images.
      If enabled, image candidates without UUID VID TLV will be rejected.

  uuid-cid-required:
    type: boolean
    description: |
      Enable or disable checks for UUID Class IDs in images.
      If enabled, image candidates without UUID CID TLV will be rejected.

  partitions:
    type: phandles
    description: |
      References to the partition nodes used by this MCUboot instance.
      Specifies a single partition if immutable MCUboot is used,
      or multiple partitions when MCUboot is updateable.

child-binding:
  child-binding:
    description: |
      Child nodes representing images managed by the MCUboot instance.
    properties:
      image-index:
        type: int
        required: true
        description: |
          Image index within the MCUboot images list.
```

## dts/bindings/bootchain/nordic,mcuboot-image.yaml
```yaml
#
# Copyright (c) 2026 Nordic Semiconductor ASA
#
# SPDX-License-Identifier: LicenseRef-Nordic-5-Clause
#

description: MCUboot instance properties

compatible: nordic,mcuboot-image

properties:
  image-index:
    type: int
    required: true
    description: |
      Image index within the MCUboot images list.

  uuid-vid:
    type: string-array
    description: |
      Image partition vendor unique identifiers.
      The following formats are supported:
       - Domain name (i.e. acme.corp)
       - Raw UUID (i.e. 12345678-1234-5678-1234-567812345678)
       - Raw HEX UUID (i.e. 12345678123456781234567812345678)

  uuid-cid:
    type: string-array
    description: |
      Image partition class unique identifiers.
      The following formats are supported:
       - Image class name (i.e. nRF5340_door_lock_btperipheral).
         This format requires uuid-vid property to be defined
         as the VID UUID is used as the namespace for image class UUID.
       - Raw UUID (i.e. 12345678-1234-5678-1234-567812345678)
       - Raw HEX UUID (i.e. 12345678123456781234567812345678)

  partitions:
    type: phandles
    required: true
    description: |
      References to the partition nodes for this image.
```
