## drivers/sensor/sensor_stub/Kconfig
```kconfig
# Sensor data simulator
#
# Copyright (c) 2022 Nordic Semiconductor
#
# SPDX-License-Identifier: LicenseRef-Nordic-5-Clause
#

DT_COMPAT_NORDIC_SENSOR_STUB := nordic,sensor-stub

config SENSOR_STUB
	bool "Simple sensor simulator"
	default y if $(dt_compat_enabled,$(DT_COMPAT_NORDIC_SENSOR_STUB))
	help
	  Enable the simple sensor simulator that just calls a callback to generate the value.
```

## drivers/serial/Kconfig
```kconfig
#
# Copyright (c) 2022 Nordic Semiconductor
#
# SPDX-License-Identifier: LicenseRef-Nordic-5-Clause
#

rsource "Kconfig.nrf_sw_lpuart"
rsource "Kconfig.ipc"
```

## drivers/serial/Kconfig.ipc
```kconfig
#
# Copyright (c) 2022 Nordic Semiconductor
#
# SPDX-License-Identifier: LicenseRef-Nordic-5-Clause
#

menuconfig IPC_UART
	bool "UART using the IPC transport"
	depends on IPC_SERVICE
	select SERIAL_HAS_DRIVER
	select RING_BUFFER
	select EVENTS
	help
	   This option enables access to IPC instance as a UART device.

if IPC_UART

config IPC_UART_BIND_TIMEOUT_MS
	int "Timeout while waiting for the endpoint to bind in ms"
	range 1 1000
	default 100
	help
	  Time in milliseconds to wait for endpoint binding.
	  This timeout depends on the time to initialize the remote device
	  the driver is going to communicate with.

config IPC_UART_TX_RING_BUFFER_SIZE
	int "Set TX ring buffer size"
	default 64
	help
	  TX buffer size. This buffer keeps UART data which is sent to the remote device
	  through IPC service.

config IPC_UART_RX_RING_BUFFER_SIZE
	int "Set RX ring buffer size"
	default 64
	help
	  RX ring buffer size. This buffer keeps data which comes from the remote device
	  through IPC service.

config IPC_UART_RESEND_DELAY
	int "Set IPC packet resend delay"
	range 1 1000
	default 1
	help
	  Time in millisecond to wait for next attemp to send UART data using the IPC transport
	  in case when previous tansaction failed due to lack of free place for a buffer allocation
	  on the shared memory by the IPC Service.

config IPC_UART_INIT_PRIORITY
	int "Initialization priority"
	default 60
	help
	  Initialization priority within POST_KERNEL level. It should be set to
	  a value that ensures that device is initialized later than IPC service backend used by
	  this device.

module = IPC_UART
module-str = IPC UART
source "subsys/logging/Kconfig.template.log_config"

endif # IPC UART
```

## drivers/serial/Kconfig.nrf_sw_dtr_uart
```kconfig
# UART configuration

# Copyright (c) 2025, Nordic Semiconductor ASA
# SPDX-License-Identifier: LicenseRef-Nordic-5-Clause

config NRF_SW_DTR_UART
	bool "Low Power UART using REQ/RDY lines"
	select GPIO
	select UART_ASYNC_API
	select RING_BUFFER
	select PM_DEVICE
	help
	  Low power UART implements UART API and extends standard UART
	  communication with 2 pins protocol for receiver wake up and flow control.

if NRF_SW_DTR_UART

config NRF_SW_DTR_UART_DTE_IDLE
	bool "Enable DTE idle detection"
	help
	  When DTE has not sent or received data for NRF_SW_DTR_UART_DTE_IDLE_TIMEOUT_MS period,
	  it will pull up DTR to force DCE to disable UART and then disables own UART.

config NRF_SW_DTR_UART_DTE_IDLE_TIMEOUT_MS
	int "DTE UART Idle Timeout (ms)"
	default 1000
	range 100 600000
	help
	  Idle detection timeout in milliseconds.

config NRF_SW_DTR_UART_INIT_PRIORITY
	int "Initialization priority"
	default 45
	help
	  Initialization priority within POST_KERNEL level.


module = NRF_SW_DTR_UART
module-str = dtr uart
source "subsys/logging/Kconfig.template.log_config"

endif
```

## drivers/serial/Kconfig.nrf_sw_lpuart
```kconfig
# UART configuration

# Copyright (c) 2020, Nordic Semiconductor ASA
# SPDX-License-Identifier: LicenseRef-Nordic-5-Clause

config NRF_SW_LPUART
	bool "Low Power UART using REQ/RDY lines"
	select GPIO
	select UART_ASYNC_API
	select RING_BUFFER
	help
	  Low power UART implements UART API and extends standard UART
	  communication with 2 pins protocol for receiver wake up and flow control.

if NRF_SW_LPUART

# Set number of event handlers used by the lpuart driver
config NRFX_GPIOTE_NUM_OF_EVT_HANDLERS
	default 2

config NRF_SW_LPUART_INIT_PRIORITY
	int "Initialization priority"
	default 45
	help
	  Initialization priority within POST_KERNEL level. It should be set to
	  a value that ensures that device is initialized later than gpio and
	  uart devices used by this device. Default is set to be between
	  default (KERNEL_INIT_PRIORITY_DEFAULT) and device
	  (KERNEL_INIT_PRIORITY_DEVICE).

config NRF_SW_LPUART_HFXO_ON_RX
	bool "Turn on HFXO for RX"
	default y
	help
	  According to the UART specification high frequency RC oscillator is
	  not accurate enough. However, in normal conditions and accurate clock
	  on the transmitter side it may be accepted to disable it. Turning on
	  HFXO prolongs receiver activation for up to 3 milliseconds.

config NRF_SW_LPUART_MAX_PACKET_SIZE
	int "Maximum RX packet size"
	default 128
	help
	  If interrupt driven API is enabled then internal RX buffer of that
	  size is created.

config NRF_SW_LPUART_DEFAULT_TX_TIMEOUT
	int "TX Timeout in microseconds"
	default 1000000
	help
	  Timeout is used in uart_poll_out and uart_fifo_fill (if interrupt
	  driven API is enabled).

config NRF_SW_LPUART_INT_DRIVEN
	bool "Enable interrupt driven API"
	select UART_INTERRUPT_DRIVEN
	help
	  If enabled, then asynchronous API cannot be used

config NRF_SW_LPUART_INT_DRV_TX_BUF_SIZE
	int "Tx buffer size"
	default 128
	depends on NRF_SW_LPUART_INT_DRIVEN
	help
	  Internal buffer of that size is created and used by uart_fifo_fill.
	  For optimal performance it should be able to fit the longest possible
	  packet.

module = NRF_SW_LPUART
module-str = low power uart
source "subsys/logging/Kconfig.template.log_config"

endif
```

## drivers/st25r3911b/Kconfig
```kconfig
#
# Copyright (c) 2019 Nordic Semiconductor ASA
#
# SPDX-License-Identifier: LicenseRef-BSD-5-Clause-Nordic
#

menuconfig ST25R3911B_LIB
	bool "NFC ST25R3911B library"
	help
	  Enable the NFC ST25R3911B library

if ST25R3911B_LIB

config ST25R3911B_SPI_FREQ
	int "ST25R3911B SPI frequency"
	default 4000000
	help
	  ST25R3911B SPI frequency

config ST25R3911B_SPI_PORT
	int "ST25R3911 SPI port"
	default 0
	help
	  Configure a SPI port for ST25R3911B

config ST25R3911B_IRQ_PORT
	int "ST25R3911B IRQ port"
	default 0
	help
	  Configure an IRQ port for ST25R3911B

config ST25R3911B_IRQ_PIN
	int "ST25R3911B IRQ pin"
	default 3
	help
	  Configure an IRQ pin for ST25R3911B

module = ST25R3911B_LIB
module-str = ST25R3911B
source "${ZEPHYR_BASE}/subsys/logging/Kconfig.template.log_config"

endif # ST25R3911B_LIB
```

## drivers/tmp_rng/Kconfig
```kconfig
#
# Copyright (c) 2024 Nordic Semiconductor
#
# SPDX-License-Identifier: LicenseRef-Nordic-5-Clause

config CRACEN_HW_PRESENT
	def_bool SOC_NRF54L15

config TMP_RNG
	bool
	default y
	depends on PSA_WANT_GENERATE_RANDOM
	depends on CRACEN_HW_PRESENT
	select EXPERIMENTAL
```

## drivers/vtf_monitoring/Kconfig
```kconfig
#
# Copyright (c) 2026 Nordic Semiconductor ASA
#
# SPDX-License-Identifier: LicenseRef-Nordic-5-Clause
#

menuconfig VTF_MONITORING
	bool "Subsystem to monitor VTF"
	help
	  Enable the VTF (Voltage-Temperature-Frequency) monitoring.
	  Each enabled channel collects live data through its own
	  work item.

if VTF_MONITORING

menuconfig VTF_DIE_TEMP_MONITOR
	bool "Monitor die temperature"
	select SENSOR
	help
	  Reads via the Zephyr sensor API from the device pointed to by the
	  `nordic,vtf-die-temp-sensor` devicetree chosen node. Falls back to
	  the SoC's own die temperature sensor (nodelabel `temp`) when no
	  chosen override is present, so this works out of the box on the
	  DK. Boards with their own ambient temperature sensor can override
	  the chosen node instead of touching this driver.

if VTF_DIE_TEMP_MONITOR

config VTF_DIE_TEMP_MONITOR_INTERVAL_MS
	int "Die temperature measurement interval (ms)"
	default 10000
	help
	  Interval between die temperature measurements in milliseconds.

endif # VTF_DIE_TEMP_MONITOR

config VTF_FREQ_OFFSET_MONITOR
	bool "Monitor frequency offset"

config VTF_BATTERY_VOLTAGE_MONITOR
	bool "Monitor battery voltage"

config VTF_LOG_LEVEL
	int "Logging level in VTF monitoring system"
	default LOG_DEFAULT_LEVEL
	depends on LOG
	help
	  Sets the logging level for VTF monitoring.

config VTF_DIE_TEMP_DEFAULT_VALUE
	int "Die temperature default value (centi-degC)"
	default 2500
	help
	  Default value when VTF_DIE_TEMP_MONITOR=n. 2500 = 25.00 C.

config VTF_BATTERY_VOLTAGE_DEFAULT_VALUE
	int "Battery voltage default value (mV)"
	default 3300
	help
	  Default value when VTF_BATTERY_VOLTAGE_MONITOR=n. 3300 = 3.3 V.

config VTF_FREQ_OFFSET_DEFAULT_VALUE
	int "Frequency offset default value (ppm)"
	default 100
	help
	  Default value when VTF_FREQ_OFFSET_MONITOR=n. 100 = 100 ppm.

config VTF_SNAPSHOT_INTERVAL_MS
	int "Snapshot interval (ms)"
	default 10000
	help
	  How often a snapshot is captured from every
	  enabled channel.

endif # VTF_MONITORING
```

## drivers/watchdog/Kconfig
```kconfig
#
# Copyright (c) 2026 Nordic Semiconductor
#
# SPDX-License-Identifier: LicenseRef-Nordic-5-Clause
#

menuconfig NRF_GSWDT
	bool "Nordic Global Software Watchdog Timer (GSWDT) driver"
	depends on SOC_SERIES_NRF54H || SOC_SERIES_NRF92
	select MBOX
	select WATCHDOG
	help
	  This option enables the Nordic Global Software Watchdog Timer
	  (GSWDT) driver.

if NRF_GSWDT

module = NRF_GSWDT
module-str = NRF_GSWDT
source "$(ZEPHYR_BASE)/subsys/logging/Kconfig.template.log_config"

endif
```

## drivers/wifi/Kconfig
```kconfig
#
# Copyright (c) 2022 Nordic Semiconductor ASA
#
# SPDX-License-Identifier: LicenseRef-Nordic-5-Clause
#

if WIFI

rsource "nrf700x/Kconfig"

endif # WIFI
```
