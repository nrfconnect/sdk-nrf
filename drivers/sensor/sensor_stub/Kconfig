## dts/bindings/caf/caf,aggregator.yaml
```yaml
# Copyright (c) 2022 Nordic Semiconductor ASA
# SPDX-License-Identifier: LicenseRef-Nordic-5-Clause

description: CAF sensor data aggregator

compatible: "caf,aggregator"

include: base.yaml

properties:
  sensor_descr:
    description: description of sensor which data is aggregated
    required: true
    type: string

  buf_data_length:
    description: buffer length in bytes, range 1-255.
    type: int
    default: 120

  sample_size:
    description: number of sensor_values in a single sample, range 1-31.
    type: int
    default: 1

  buf_count:
    description: Number of buffers in aggregator, range 1-255.
    type: int
    default: 2

  memory-region:
    description: phandle to the shared memory region
    required: false
    type: phandle
```

## dts/bindings/clock/nordic,nrf92-hfxo.yaml
```yaml
# Copyright (c) 2026 Nordic Semiconductor ASA
# SPDX-License-Identifier: LicenseRef-Nordic-5-Clause

description: Nordic nRF92 Series high-frequency crystal oscillator

compatible: "nordic,nrf92-hfxo"

include: fixed-clock.yaml

properties:
  clock-frequency:
    const: 32000000

  accuracy-ppm:
    type: int
    description: Clock accuracy in parts per million
    required: true
```

## dts/bindings/flash/nordic,rpc-flash-controller.yaml
```yaml
# Copyright (c) 2025 Nordic Semiconductor
# SPDX-License-Identifier: LicenseRef-Nordic-5-Clause

description: Flash RPC controller

compatible: "nordic,rpc-flash-controller"

include: flash-controller.yaml
```

## dts/bindings/gpio/nordic,gpio-pins.yaml
```yaml
# Copyright (c) 2023 Nordic Semiconductor ASA
# SPDX-License-Identifier: LicenseRef-Nordic-5-Clause

description: |
  This binding allows to assign a GPIO to the domain.
  It does not provide any specific driver.
  The binding enables the following functionalities:

  - Add an entry in UICR that marks the domain to own the selected pin.
  - Allow access to pins using the macros from the `zephyr/devicetree/gpio.h` file,
    which increases the hardware abstraction.

compatible: "nordic,gpio-pins"

properties:
  gpios:
    type: phandle-array
    required: true
```

## dts/bindings/gpio/nordic,hpf-gpio.yaml
```yaml
# Copyright (c) 2024 Nordic Semiconductor
# SPDX-License-Identifier: LicenseRef-Nordic-5-Clause
description: HPF GPIO node

compatible: "nordic,hpf-gpio"

include: [gpio-controller.yaml, base.yaml]

properties:

  "#gpio-cells":
    const: 2

  port:
    type: int
    required: true
    description: |
      The GPIO port number. GPIO port P0 has:

        port = <0>;

      And P1 has:

        port = <1>;

gpio-cells:
  - pin
  - flags
```

## dts/bindings/gpio/nordic,nrf-egpio.yaml
```yaml
# Copyright (c) 2024 Nordic Semiconductor
# SPDX-License-Identifier: LicenseRef-Nordic-5-Clause
description: Emulated GPIO node

compatible: "nordic,nrf-egpio"

include: [gpio-controller.yaml, base.yaml]

properties:

  "#gpio-cells":
    const: 2

  port:
    type: int
    required: true
    description: |
      The GPIO port number. GPIO port P0 has:

        port = <0>;

      And P1 has:

        port = <1>;

gpio-cells:
  - pin
  - flags
```

## dts/bindings/gpio/nordic,nrfe-gpio.yaml
```yaml
# Copyright (c) 2024 Nordic Semiconductor
# SPDX-License-Identifier: LicenseRef-Nordic-5-Clause
description: SDP GPIO node

compatible: "nordic,nrfe-gpio"

include: [gpio-controller.yaml, base.yaml]

properties:

  "#gpio-cells":
    const: 2

  port:
    type: int
    required: true
    description: |
      The GPIO port number. GPIO port P0 has:

        port = <0>;

      And P1 has:

        port = <1>;

gpio-cells:
  - pin
  - flags
```
