## drivers/wifi/nrf700x/Kconfig
```kconfig
# Nordic Wi-Fi driver for nRF700x
#
# Copyright (c) 2022 Nordic Semiconductor
#
# SPDX-License-Identifier: LicenseRef-Nordic-5-Clause
#

DT_COMPAT_NORDIC_NRF700X_QSPI := nordic,nrf700x-qspi
DT_COMPAT_NORDIC_NRF700X_SPI := nordic,nrf700x-spi

menuconfig WIFI_NRF700X
	bool "nRF700x driver"
	depends on WIFI
	select NET_L2_WIFI_MGMT if NETWORKING
	select NET_L2_ETHERNET_MGMT if NETWORKING && NET_L2_ETHERNET
	select WIFI_USE_NATIVE_NETWORKING if NETWORKING
	select EXPERIMENTAL if !SOC_SERIES_NRF53X && !SOC_SERIES_NRF91X
	help
	  Nordic Wi-Fi Driver
if WIFI_NRF700X

module = WIFI_NRF700X_BUS
module-dep = LOG
module-str = Log level for Wi-Fi nRF700x bus layers
module-help = Sets log level for Wi-Fi nRF700x bus layers
source "subsys/net/Kconfig.template.log_config.net"

config WIFI_NRF700X_BUS_LOG_LEVEL
	# Enable error by default
	default 1

choice NRF700X_OPER_MODES
	bool "nRF700x operating modes"
	default NRF700X_SYSTEM_MODE if WPA_SUPP
	default NRF700X_SCAN_ONLY if !WPA_SUPP
	help
	  Select the operating mode of the nRF700x driver

config NRF700X_SYSTEM_MODE
	bool "Enable nRF700X system mode"
	select NET_L2_WIFI_MGMT
	depends on WPA_SUPP
	help
	  Select this option to enable system mode of the nRF700x driver

config NRF700X_SCAN_ONLY
	bool "Enable nRF700X scan only mode"
	select NET_L2_WIFI_MGMT
	help
	  Select this option to enable scan only mode of the nRF700x driver

config NRF700X_RADIO_TEST
	bool "Radio test mode of the nRF700x driver"

endchoice

if NRF700X_SYSTEM_MODE

config NRF700X_STA_MODE
	bool "Enable nRF700X STA mode"
	default y
	help
		Select this option to enable STA mode of the nRF700x driver

config NRF700X_AP_MODE
	bool "Enable Access point mode"
	select EXPERIMENTAL
	depends on WPA_SUPP_AP

config NRF700X_P2P_MODE
	bool "Enable P2P support in driver"

endif # NRF700X_SYSTEM_MODE

config NRF700X_DATA_TX
	bool "Enable TX data path in the driver"
	default y if NRF700X_SYSTEM_MODE

config NRF700X_RAW_DATA_TX
	bool "Enable RAW TX data path in the driver"
	select EXPERIMENTAL
	depends on NRF700X_SYSTEM_MODE

config NRF700X_RAW_DATA_RX
	bool "Enable RAW RX sniffer operation in the driver"
	select EXPERIMENTAL
	depends on NRF700X_SYSTEM_MODE

config NRF700X_PROMISC_DATA_RX
	bool "Enable promiscuous RX sniffer operation in the driver"
	select EXPERIMENTAL
	depends on NRF700X_SYSTEM_MODE

config NRF_WIFI_IF_AUTO_START
	bool "Enable Wi-Fi interface auto start on boot"
	default y

config NRF_WIFI_PATCHES_BUILTIN
	bool "Store nRF700x FW patches as part of the driver"
	depends on !NRF_WIFI_PATCHES_EXT_FLASH_STORE
	default y if !NRF_WIFI_PATCHES_EXT_FLASH_STORE
	help
	  Select this option to store nRF700x FW patches as part of the driver.
	  This option impacts the code memory footprint of the driver.

choice NRF_WIFI_PATCHES_EXT_FLASH_SUPPORT
	bool "Store nRF700x FW patches in external flash"
	default NRF_WIFI_PATCHES_EXT_FLASH_DISABLED
	help
	  Select this option to store nRF700x FW patches in external flash.
	  This option helps to reduce the code memory size of the application, but
	  requires external memory to be available for storing the FW patches.

config NRF_WIFI_PATCHES_EXT_FLASH_DISABLED
	bool "Store nRF700x FW patches in RAM"
	select NRF_WIFI_PATCHES_BUILTIN

config NRF_WIFI_PATCHES_EXT_FLASH_XIP
	bool "Relocate nRF700x FW patches to external memory and execute from there"
	# nRF7002 supports SPI based external flash access with no XIP
	depends on !BOARD_NRF7002DK_NRF5340_CPUAPP && !BOARD_NRF7002DK_NRF5340_CPUAPP_NS
	# Disable until Matter DFU changes are ready
	# default y if BOARD_NRF5340DK_NRF5340_CPUAPP || BOARD_NRF52840DK_NRF52840
	select NRF_WIFI_PATCHES_BUILTIN
	# For accessing external flash
	select FLASH
	# For relocation code to external flash
	select XIP
	select NORDIC_QSPI_NOR
	select BUILD_NO_GAP_FILL
	select CODE_DATA_RELOCATION
	select HAVE_CUSTOM_LINKER_SCRIPT

config NRF_WIFI_PATCHES_EXT_FLASH_STORE
	bool "Store nRF700x FW patches in external memory but execute from RAM"
	# nRF7002 supports SPI based external memory access but missing tools support
	# TODO: Enable when tools support is available (NRFJPROG-157)
	depends on !BOARD_NRF7002DK_NRF5340_CPUAPP && !BOARD_NRF7002DK_NRF5340_CPUAPP_NS
	select FLASH
	select FLASH_MAP
endchoice

if NRF_WIFI_PATCHES_EXT_FLASH_STORE

config NRF_WIFI_FW_FLASH_CHUNK_SIZE
	int "Chunk size for nRF70 FW patches to be read from external flash"
	default 8192
	help
	  Chunk size for nRF70 FW patches to be read from external flash.
	  This option impacts the loading time of the nRF70 FW patches and
	  RAM usage (heap) of the application.

config NRF_WIFI_FW_PATCH_INTEGRITY_CHECK
	bool "Enable integrity check of nRF70 FW patches"
	select FLASH_AREA_CHECK_INTEGRITY
	default y
	help
	  Select this option to enable integrity check of nRF70 FW patches using
	  SHA-256 verification algorithm.This option impacts the loading time of the
	  nRF70 FW patches but protects against corrupted FW patches.

config NRF_WIFI_FW_PATCH_DFU
	bool "Direct Firmware Update of nRF70 FW patch"
	depends on PARTITION_MANAGER_ENABLED
	depends on BOOTLOADER_MCUBOOT
	depends on !XIP_SPLIT_IMAGE
	help
	  Enabling this option adds support for Device Firmware Update (DFU)
	  for the nRF70 Series Firmware Patch.

	  This feature requires the addition of an MCUBoot partition pair:
	  a primary and a secondary partition. These partitions are used to
	  store the new firmware patch. The specific partition numbers to be used
	  depend on the number of partitions already in use.

	  The "nrf70_wifi_fw" partition must be added to the newly created
	  MCUBoot primary partition. Once this Kconfig option is enabled,
	  the nRF70.hex file will be signed by MCUBoot. The signed image
	  will then be merged with the application image and flashed onto
	  the target board.

	  Ensure that the required MCUBoot partitions are properly configured
	  before enabling this option. Refer to the documentation for detailed
	  instructions on partition configuration and the DFU process.

# TC is the default but Wi-Fi uses MbedTLS, so, to avoid loading another library.
if NRF_WIFI_FW_PATCH_INTEGRITY_CHECK
choice FLASH_AREA_CHECK_INTEGRITY_BACKEND
	default FLASH_AREA_CHECK_INTEGRITY_MBEDTLS
endchoice
endif
endif

config CUSTOM_LINKER_SCRIPT
	string "Custom linker script for nRF700x FW patches"
	default "${ZEPHYR_BASE}/../nrf/drivers/wifi/nrf700x/rpu_fw_patches.ld"

config NRF_WIFI_LOW_POWER
	bool "Enable low power mode in nRF Wi-Fi chipsets"
	default y

config NRF700X_TCP_IP_CHECKSUM_OFFLOAD
	bool "Enable TCP/IP checksum offload"
	default y

config NRF700X_REG_DOMAIN
	string "The ISO/IEC alpha2 country code for the country in which this device is currently operating. Default 00 (World regulatory)"
# 00 is used for World regulatory
	default "00"

# Making calls to RPU from net_mgmt callbacks.
#
# If WPA supplicant is enabled, then don't override as it has higher
# stack requirements.
config NET_MGMT_EVENT_STACK_SIZE
	default 2048 if !WPA_SUPP

config NRF700X_LOG_VERBOSE
	bool "Maintains the verbosity of information in logs"
	default y

module = WIFI_NRF700X
module-dep = LOG
module-str = Log level for Wi-Fi nRF700x driver
module-help = Sets log level for Wi-Fi nRF700x driver
source "subsys/logging/Kconfig.template.log_config"

config WIFI_NRF700X_LOG_LEVEL
	# Enable error by default
	default 1

config NRF700X_ON_QSPI
	def_bool $(dt_compat_enabled,$(DT_COMPAT_NORDIC_NRF700X_QSPI))
	select NRFX_QSPI

config NRF700X_ON_SPI
	def_bool $(dt_compat_enabled,$(DT_COMPAT_NORDIC_NRF700X_SPI))
	select SPI

# RF switch based coexistence
config NRF700X_RADIO_COEX
	def_bool $(dt_nodelabel_has_prop,nrf_radio_coex,btrf-switch-gpios)

config NRF700X_WORKQ_STACK_SIZE
	int "Stack size for workqueue"
	default 4096

config NRF700X_WORKQ_MAX_ITEMS
	int "Maximum work items for all workqueues"
	default 100

config NRF700X_MAX_TX_PENDING_QLEN
	int "Maximum number of pending TX packets"
	default 18

config NRF700X_UTIL
	depends on SHELL
	bool "Enable Utility shell in nRF700x driver"

config NRF700X_SR_COEX
	bool "Enable Wi-Fi and SR coexistence support"
	default y if SOC_NRF5340_CPUAPP_QKAA

config NRF700X_QSPI_LOW_POWER
	bool "Enable low power mode in QSPI"
	default y if NRF_WIFI_LOW_POWER

config NRF700X_ANT_GAIN_2G
	int "Antenna gain for 2.4 GHz band"
	default 0
	range 0 6

config NRF700X_ANT_GAIN_5G_BAND1
	int "Antenna gain for 5 GHz band (5150 MHz - 5350 MHz)"
	default 0
	range 0 6

config NRF700X_ANT_GAIN_5G_BAND2
	int "Antenna gain for 5 GHz band (5470 MHz - 5730 MHz)"
	default 0
	range 0 6

config NRF700X_ANT_GAIN_5G_BAND3
	int "Antenna gain for 5 GHz band (5730 MHz - 5895 MHz)"
	default 0
	range 0 6

config NRF700X_BAND_2G_LOWER_EDGE_BACKOFF_DSSS
	int "DSSS Transmit power backoff (in dB) for lower edge of 2.4 GHz frequency band"
	default 0
	range 0 10

config NRF700X_BAND_2G_LOWER_EDGE_BACKOFF_HT
	int "HT/VHT Transmit power backoff (in dB) for lower edge of 2.4 GHz frequency band"
	default 0
	range 0 10

config NRF700X_BAND_2G_LOWER_EDGE_BACKOFF_HE
	int "HE Transmit power backoff (in dB) for lower edge of 2.4 GHz frequency band"
	default 0
	range 0 10

config NRF700X_BAND_2G_UPPER_EDGE_BACKOFF_DSSS
	int "DSSS Transmit power backoff (in dB) for lower edge of 2.4 GHz frequency band"
	default 0
	range 0 10

config NRF700X_BAND_2G_UPPER_EDGE_BACKOFF_HT
	int "HT/VHT Transmit power backoff (in dB) for lower edge of 2.4 GHz frequency band"
	default 0
	range 0 10

config NRF700X_BAND_2G_UPPER_EDGE_BACKOFF_HE
	int "HE Transmit power backoff (in dB) for lower edge of 2.4 GHz frequency band"
	default 0
	range 0 10

config NRF700X_BAND_UNII_1_LOWER_EDGE_BACKOFF_HT
	int "HT/VHT Transmit power backoff (in dB) for lower edge of UNII-1 frequency band"
	default 0
	range 0 10

config NRF700X_BAND_UNII_1_LOWER_EDGE_BACKOFF_HE
	int "HE Transmit power backoff (in dB) for lower edge of UNII-1 frequency band"
	default 0
	range 0 10

config NRF700X_BAND_UNII_1_UPPER_EDGE_BACKOFF_HT
	int "HT/VHT Transmit power backoff (in dB) for upper edge of UNII-1 frequency band"
	default 0
	range 0 10

config NRF700X_BAND_UNII_1_UPPER_EDGE_BACKOFF_HE
	int "HE Transmit power backoff (in dB) for upper edge of UNII-1 frequency band"
	default 0
	range 0 10

config NRF700X_BAND_UNII_2A_LOWER_EDGE_BACKOFF_HT
	int "HT/VHT Transmit power backoff (in dB) for lower edge of UNII-2A frequency band"
	default 0
	range 0 10

config NRF700X_BAND_UNII_2A_LOWER_EDGE_BACKOFF_HE
	int "HE Transmit power backoff (in dB) for lower edge of UNII-2A frequency band"
	default 0
	range 0 10

config NRF700X_BAND_UNII_2A_UPPER_EDGE_BACKOFF_HT
	int "HT/VHT Transmit power backoff (in dB) for upper edge of UNII-2A frequency band"
	default 0
	range 0 10

config NRF700X_BAND_UNII_2A_UPPER_EDGE_BACKOFF_HE
	int "HE Transmit power backoff (in dB) for upper edge of UNII-2A frequency band"
	default 0
	range 0 10

config NRF700X_BAND_UNII_2C_LOWER_EDGE_BACKOFF_HT
	int "HT/VHT Transmit power backoff (in dB) for lower edge of UNII-2C frequency band"
	default 0
	range 0 10

config NRF700X_BAND_UNII_2C_LOWER_EDGE_BACKOFF_HE
	int "HE Transmit power backoff (in dB) for lower edge of UNII-2C frequency band"
	default 0
	range 0 10

config NRF700X_BAND_UNII_2C_UPPER_EDGE_BACKOFF_HT
	int "HT/VHT Transmit power backoff (in dB) for upper edge of UNII-2C frequency band"
	default 0
	range 0 10

config NRF700X_BAND_UNII_2C_UPPER_EDGE_BACKOFF_HE
	int "HE Transmit power backoff (in dB) for upper edge of UNII-2C frequency band"
	default 0
	range 0 10

config NRF700X_BAND_UNII_3_LOWER_EDGE_BACKOFF_HT
	int "HT/VHT Transmit power backoff (in dB) for lower edge of UNII-3 frequency band"
	default 0
	range 0 10

config NRF700X_BAND_UNII_3_LOWER_EDGE_BACKOFF_HE
	int "HE Transmit power backoff (in dB) for lower edge of UNII-3 frequency band"
	default 0
	range 0 10

config NRF700X_BAND_UNII_3_UPPER_EDGE_BACKOFF_HT
	int "HT/VHT Transmit power backoff (in dB) for upper edge of UNII-3 frequency band"
	default 0
	range 0 10

config NRF700X_BAND_UNII_3_UPPER_EDGE_BACKOFF_HE
	int "HE Transmit power backoff (in dB) for upper edge of UNII-3 frequency band"
	default 0
	range 0 10

config NRF700X_BAND_UNII_4_LOWER_EDGE_BACKOFF_HT
	int "HT/VHT Transmit power backoff (in dB) for lower edge of UNII-4 frequency band"
	default 0
	range 0 10

config NRF700X_BAND_UNII_4_LOWER_EDGE_BACKOFF_HE
	int "HE Transmit power backoff (in dB) for lower edge of UNII-4 frequency band"
	default 0
	range 0 10

config NRF700X_BAND_UNII_4_UPPER_EDGE_BACKOFF_HT
	int "HT/VHT Transmit power backoff (in dB) for upper edge of UNII-4 frequency band"
	default 0
	range 0 10

config NRF700X_BAND_UNII_4_UPPER_EDGE_BACKOFF_HE
	int "HE Transmit power backoff (in dB) for upper edge of UNII-4 frequency band"
	default 0
	range 0 10

# Performance fine tuning options

config NRF700X_RX_NUM_BUFS
	int "Number of RX buffers"
	default 48

config NRF700X_MAX_TX_AGGREGATION
	int "Maximum number of TX packets to aggregate"
	default 12

config NRF700X_MAX_TX_TOKENS
	int "Maximum number of TX tokens"
	range 5 12 if !NRF700X_RADIO_TEST
	default 10

config NRF700X_TX_MAX_DATA_SIZE
	int "Maximum size of TX data"
	default 1600

config NRF700X_RX_MAX_DATA_SIZE
	int "Maximum size of RX data"
	default 1600

config NRF700X_TX_DONE_WQ_ENABLED
	bool "Enable TX done workqueue (impacts performance negatively)"

config NRF700X_RX_WQ_ENABLED
	bool "Enable RX workqueue"

# Use for IRQ processing (TODO: using for BH processing causes issues)
config NUM_METAIRQ_PRIORITIES
	default 1

config NRF700X_IRQ_WQ_PRIORITY
	int "Priority of the workqueue for handling IRQs"
	default -15

config NRF700X_BH_WQ_PRIORITY
	int "Priority of the workqueue for handling bottom half"
	default 0

config NRF700X_IRQ_WQ_STACK_SIZE
	int "Stack size of the workqueue for handling IRQs"
	default 2048

config NRF700X_BH_WQ_STACK_SIZE
	int "Stack size of the workqueue for handling bottom half"
	default 2048

if NRF700X_TX_DONE_WQ_ENABLED
config NRF700X_TX_DONE_WQ_PRIORITY
	int "Priority of the workqueue for handling TX done"
	default 0

config NRF700X_TX_DONE_WQ_STACK_SIZE
	int "Stack size of the workqueue for handling TX done"
	default 2048
endif

if NRF700X_RX_WQ_ENABLED
config NRF700X_RX_WQ_PRIORITY
	int "Priority of the workqueue for handling RX"
	default 0

config NRF700X_RX_WQ_STACK_SIZE
	int "Stack size of the workqueue for handling RX"
	default 2048
endif

if NRF_WIFI_LOW_POWER

config NRF700X_RPU_PS_IDLE_TIMEOUT_MS
	int "RPU power save idle timeout in milliseconds"
	default 10

config NRF700X_RPU_EXTEND_TWT_SP
	bool "Enable extending TWT service period"
	help
	  In case frames accepted before beginning of SP are not
	  transmitted before the SP completes then typically they are
	  dropped to conform to SP window as per specification i.e., no
	  transmission outside SP window.

	  This feature mitigates the frame loss by transmitting even after SP
	  completion by using standard contention mechanism which is allowed
	  in specification but not recommended. As the device is actively transmitting
	  beyond SP, the power consumption increases depending on the amount
	  of traffic available at the start of SP.

	  Please note that if a frame is sent after SP starts it will be queued and this
	  mechanism is not used.
endif

config WIFI_FIXED_MAC_ADDRESS
	string "WiFi Fixed MAC address in format XX:XX:XX:XX:XX:XX"
	help
		This overrides the MAC address read from OTP. Strictly for testing purposes only.

config NRF700X_RSSI_STALE_TIMEOUT_MS
	int "RSSI stale timeout in milliseconds"
	default 1000
	help
	  RSSI stale timeout is the period after which driver queries
	  RPU to get the RSSI the value.
	  If data is active (e.g. ping), driver stores the RSSI value from
	  the received frames and provides this stored information
	  to wpa_supplicant. In this case a higher value will be suitable
	  as stored RSSI value at driver will be updated regularly.
	  If data is not active or after the stale timeout duration,
	  driver queries the RPU to get the RSSI value
	  and provides it to wpa_supplicant. The value should be set to lower
	  value as driver does not store it and requires RPU to provide the
	  info.

if NETWORKING

# Finetune defaults for certain system components used by the driver
config HEAP_MEM_POOL_SIZE
	default 153000

config SYSTEM_WORKQUEUE_STACK_SIZE
	default 4096

config NET_TX_STACK_SIZE
	default 4096

config NET_RX_STACK_SIZE
	default 4096

config NET_TC_TX_COUNT
	default 1

endif # NETWORKING

# Override the Wi-Fi subsytems WIFI_MGMT_SCAN_SSID_FILT_MAX parameter,
# since we support a maximum of 2 SSIDs for scan result filtering.
config WIFI_MGMT_SCAN_SSID_FILT_MAX
	default 2
endif

config NRF_WIFI_SCAN_MAX_BSS_CNT
	int "Maximum number of scan results to return."
	default 0
	range 0 65535
	help
	  Maximum number of scan results to return. 0 represents unlimited number of BSSes.

config NRF_WIFI_BEAMFORMING
	bool "Enable Wi-Fi beamforming. Enabling beamforming can provide slight improvement in performance where as disabling it can provide better power saving in low network activity applications"
	default y

config WIFI_NRF700X_SCAN_TIMEOUT_S
	int "Scan timeout in seconds"
	default 30

config NRF_WIFI_2G_BAND
	bool "Set operation band to 2.4GHz"
	default y if NRF70_2_4G_ONLY

config NRF_WIFI_5G_BAND
	bool "Set operation band to 5GHz"
	depends on !NRF70_2_4G_ONLY

config NRF_WIFI_OP_BAND
	int "Options to set operation band"
	default 1 if NRF_WIFI_2G_BAND
	default 2 if NRF_WIFI_5G_BAND
	default 3
	help
	  Set this option to select frequency band
	  1 - 2.4GHz
	  2 - 5GHz
	  3 - All ( 2.4GHz and 5GHz )

config NRF_WIFI_IFACE_MTU
	int "MTU for Wi-Fi interface"
	range 576 2304 if NET_IPV4
	range 1280 2304 if NET_IPV6
	default 1500
config WIFI_NRF700X_SKIP_LOCAL_ADMIN_MAC
	bool "Suppress networks with non-individual MAC address as BSSID in the scan results"
	help
	  Wi-Fi access points use locally administered MAC address to manage
	  multiple virtual interfaces, for geo-location usecase these networks
	  from the virtual interfaces do not help in anyway as they are co-located with the primary interface
	  that has globally unique MAC address.

	  So, to save resources, this option drops such networks from the scan results.
config WIFI_NRF700X_SCAN_DISABLE_DFS_CHANNELS
	bool "Disables DFS channels in scan operation"
	help
	  This option disables inclusion of DFS channels in scan operation.
	  This is useful to reduce the scan time, as DFS channels are seldom used.

config NET_INTERFACE_NAME_LEN
	# nordic_wlanN
	default 15

config NRF_WIFI_AP_DEAD_DETECT_TIMEOUT
	int "Access point dead detection timeout in seconds"
	range 1 30
	default 20
	help
		The number of seconds after which AP is declared dead if no beacons
		are received from the AP. Used to detect AP silently going down e.g., power off.

choice NRF_WIFI_PS_DATA_RETRIEVAL_MECHANISM
	prompt "Power save data retrieval mechanism"
	default NRF_WIFI_PS_POLL_BASED_RETRIEVAL
	help
	  Select the mechanism to retrieve buffered data from AP.

config NRF_WIFI_PS_POLL_BASED_RETRIEVAL
	bool "PS-Poll frame based mechanism to retrieve buffered data from AP"
	help
	  When AP notifies about availability of buffered data, the STA stays in power save
	  and retrieves the frames one-by-one, this conserved more power but adds latency
	  to the traffic. Ideal for minimum number of frames.

config NRF_WIFI_QOS_NULL_BASED_RETRIEVAL
	bool "QoS null frame based mechanism to retrieve buffered data from AP"
	help
	  When AP notifies about availability of buffered data, the STA comes out of
	  power save and then AP can deliver all buffered frames without any additional
	  overhead or latency, but STA enters power save after a delay costing more power
	  depending on the delay. Ideal for heavy buffered traffic.

endchoice

config NRF_WIFI_MGMT_BUFF_OFFLOAD
	bool "Enable management buffer offload"
	default y

config NRF_WIFI_RPU_RECOVERY
	bool "Enable RPU recovery mechanism"
	depends on NRF_WIFI_LOW_POWER
	select EXPERIMENTAL
	default y
	help
		Enable RPU recovery mechanism to recover from RPU (nRF70) hang.
		This feature performs an interface reset (down and up) which triggers
		a RPU coldboot. Application's network connection will be lost during
		the recovery process and it is application's responsibility to
		re-establish the network connection.

config NRF_WIFI_CMD_EVENT_LOG
	bool "Enable command event logging"
	help
		Enable command event logging to help debug Wi-Fi command events.
if NRF_WIFI_RPU_RECOVERY

config NRF_WIFI_RPU_RECOVERY_PROPAGATION_DELAY_MS
	int "RPU recovery propagation delay in milliseconds"
	default 2000
	help
		Propagation delay in milliseconds to wait after RPU is powered down
		before powering it up. This delay is required to ensure that the recovery
		is propagted to all the applications and stack and have enough time to
		clean up the resources.

config NRF_WIFI_RPU_RECOVERY_PS_ACTIVE_TIMEOUT_MS
	int "RPU recovery power save active timeout in milliseconds"
	default 50000
	help
		Power save active timeout in milliseconds after which RPU recovery
		mechanism will be triggered. This timeout is used to ensure that the
		RPU attempts to enter power save mode in case of inactivity.

config NRF_WIFI_RPU_MIN_TIME_TO_ENTER_SLEEP_MS
	int "Minimum idle time to enter sleep in milliseconds"
	range 100 5000
	default 1000
	help
		Minimum time the host should de-assert WAKEUP_NOW and let RPU enter
		sleep mode, assuming there is no activity.

config NRF_WIFI_RPU_RECOVERY_DEBUG
	bool "Enable RPU recovery debug logs"
	help
		Enable RPU recovery debug logs to help debug RPU recovery mechanism.

config NRF_WIFI_RPU_RECOVERY_QUIET_PERIOD_MS
	int "RPU recovery quiet period in milliseconds"
	default 5000
	help
		Quiet period in milliseconds after RPU recovery is triggered. During
		this period, no new RPU recovery will be triggered.

config NRF_WIFI_RPU_RECOVERY_MAX_RETRIES
	int "Maximum number of consecutive RPU recovery retries, 0 to disable"
	default 0
	help
		Maximum number of consecutive RPU recovery retries before giving up
		and resetting the system. Set to 0 to keep retrying indefinitely.

config NRF_WIFI_RPU_RECOVERY_RETRY_WINDOW_S
	int "RPU recovery retry window in seconds"
	default 900
	help
		Window in seconds during which the number of consecutive RPU recovery
		retries are counted. If the number of consecutive RPU recovery retries
		exceeds NRF_WIFI_RPU_RECOVERY_MAX_RETRIES within this window, the system
		will be reset.

config NRF_WIFI_RPU_RECOVERY_PS_STATE_DEBUG
	bool "Enable RPU recovery power save state debug logs"
	help
		Enable RPU recovery power save state debug logs to help debug RPU recovery mechanism.


config NET_MGMT_EVENT_QUEUE_SIZE
	# Doing interface down and up even with delay puts a lot of events in the queue
	default 16
endif

config NRF_WIFI_FEAT_KEEPALIVE
	bool "Enable Wi-Fi keepalive feature"
	depends on NRF700X_STA_MODE
	help
		Enable Wi-Fi keepalive feature to keep the connection alive by sending
		keepalive packets to the AP. Primarily intended to interoperate with APs
		that disconnect idle clients without any explicit checks. Slightly increases
		power consumption.

if NRF_WIFI_FEAT_KEEPALIVE
config NRF_WIFI_KEEPALIVE_PERIOD_S
	int "Keepalive period in seconds"
	range 30 3600
	default 60
	help
		Keepalive period in seconds to send keepalive packets to the AP.
endif

choice NRF_WIFI_PS_EXIT_STRATEGY
	prompt "Power save exit strategy"
	default NRF_WIFI_PS_INT_PS
	help
	  Select the power save exit strategy to retrieve buffered data from AP.

config NRF_WIFI_PS_EXIT_EVERY_TIM
	bool "Exit power save every time to retrieve buffered data from AP"
	help
	  Exit power save every time to retrieve buffered data from AP. Entering back to
	  power save mode might take some time and power.

config NRF_WIFI_PS_INT_PS
	bool "Exit power save based on an intelligent algorithm"
	help
	  Exit power save based on an intelligent algorithm to retrieve buffered data from AP.
	  The algorithm tracks the buffered data at the AP and then dynamically decides
	  whether to stay in PS (for lower amount of buffered data) or exit PS (for higher
	  amount of buffered data).
endchoice

config NRF_WIFI_MAX_PS_POLL_FAIL_CNT
	int "Maximum number of PS-Poll Failures"
	default 10
	range 10 4294967295
	help
	  Maximum number of PS-Poll failures before entering QoS Null based power save.

config NRF_WIFI_RX_STBC_HT
	bool "Enable STBC for HT"
	default y
	help
	  Enable STBC (Space-Time Block Coding) for HT mode.

config NRF_WIFI_DYNAMIC_BANDWIDTH_SIGNALLING
	bool "Dynamic bandwidth signalling for Wi-Fi"
	help
	  This option enables support for dynamic bandwidth signalling.
```
