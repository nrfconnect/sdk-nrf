## drivers/net/Kconfig
```kconfig
#
# Copyright (c) 2018 Nordic Semiconductor
#
# SPDX-License-Identifier: LicenseRef-BSD-5-Clause-Nordic
#

# Ethernet over RTT driver configuration options

if HAS_SEGGER_RTT

menuconfig ETH_RTT
	select USE_SEGGER_RTT
	select NET_L2_ETHERNET
	bool "Ethernet over RTT driver"
	help
	  This option enables network interface driver that sends and receives
	  ethernet frames over RTT channel. The driver is intended primary for
	  debugging and testing.

if ETH_RTT

config ETH_RTT_DRV_NAME
	string "Ethernet over RTT driver name"
	default "eth_rtt"
	help
	  This option sets the driver name.

config ETH_RTT_MAC_ADDR
	string "MAC address for the interface"
	default ""
	help
	  Specify a MAC address for the Ethernet over RTT network interface
	  in the form of hex 8-bit chars separated by colons
	  (e.g.: aa:33:cc:22:e2:c0). The default is an empty string, which
	  selects random address (00:00:5E:00:53:xx) according to RFC 7042.

config ETH_RTT_CHANNEL
	int "RTT channel number"
	default 2
	help
	  Sets RTT channel that will be used to transfer ethernet frames in
	  both directions. Channels 0 and 1 have special purpose defined by
	  SEGGER, so it is safer to use channel 2 or above. This number must be
	  smaller than SEGGER_RTT_MAX_NUM_UP_BUFFERS and cannot be used by any
	  other module.

config ETH_RTT_UP_BUFFER_SIZE
	int "RTT up buffer size"
	default 256 if SOC_NRF52810 || SOC_SERIES_NRF51X
	default 1024 if SOC_NRF52832
	default 3072
	range 16 1048576
	help
	  Sets RTT buffer size for sending ethernet frames. Smaller values will
	  save the RAM, but will decrease the performance.

config ETH_RTT_DOWN_BUFFER_SIZE
	int "RTT down buffer size"
	default 128 if SOC_NRF52810 || SOC_SERIES_NRF51X
	default 512 if SOC_NRF52832
	default 3072
	range 16 1048576
	help
	  Sets RTT buffer size for receiving ethernet frames. Smaller values
	  will save the RAM, but will decrease the performance.

config ETH_RTT_MTU
	int "Maximum Transmission Unit (MTU)"
	default 1500
	range 68 65536
	help
	  Sets the Maximum Transmission Unit (MTU) for the Ethernet over RTT
	  network interface. Ethernet default is 1500 and using different value
	  may cause unpredictable behavior. Change this value only if you
	  really known what you are doing. IPv4 requires at least 68 and IPv6
	  requires at least 1280.

config ETH_POLL_PERIOD_MS
	int "Receive polling period (ms)"
	default 25
	range 1 200
	help
	  RTT has no interrupt, so read have to be done using polling. This
	  option sets time in milliseconds between two consecutive RTT read
	  attempts when there is no input transfer for some time. When transfer
	  is currently running ETH_POLL_ACTIVE_PERIOD_MS is used instead.

config ETH_POLL_ACTIVE_PERIOD_MS
	int "Receive polling period when transfer is running (ms)"
	default 5
	range 1 ETH_POLL_PERIOD_MS
	help
	  This option sets time in milliseconds between two consecutive RTT
	  read attempts when input transfer is running. When transfer stopped
	  some time ago driver will use ETH_POLL_PERIOD_MS again.

module=ETH_RTT
module-dep=LOG
module-str=Log level
module-help=Sets log level for Ethernet over RTT driver.
source "${ZEPHYR_BASE}/subsys/net/Kconfig.template.log_config.net"

config ETH_RTT_DEBUG_HEX_DUMP
	bool "Print hex dumps"
	depends on ETH_RTT_LOG_LEVEL >= 4
	help
	  Enabling this option prints out hex dumps of transferred data. There
	  are four types of hex dumps: data that flows from RTT, data that
	  flows to RTT, frames that are passed to network stack, frames that
	  are get from network stack. This option will produce a lot of debug
	  logs, so if you reading it make sure that logger did not discard
	  something because of buffer overrun.

endif

endif
```

## drivers/npmx/Kconfig
```kconfig
#
# Copyright (c) 2022 Nordic Semiconductor ASA
#
# SPDX-License-Identifier: LicenseRef-Nordic-5-Clause
#

config NPMX
	bool "Enabling npmx"

if NPMX

config NPMX_INIT_PRIORITY
	int "NPMX init priority"
	default 90
	help
	  NPMX initialization priority.

choice
	prompt "IC version"
	default NPMX_DEVICE_NPM1300_ENG_B

	config NPMX_DEVICE_NPM1300_ENG_B
		depends on I2C && GPIO
		bool "nPM1300 Engineering B"
endchoice

module = NPMX
module-str = npmx
source "subsys/logging/Kconfig.template.log_config"

endif # NPMX
```

## drivers/nrf_pulse_meas/Kconfig
```kconfig
#
# Copyright (c) 2026 Nordic Semiconductor
#
# SPDX-License-Identifier: LicenseRef-Nordic-5-Clause
#

DT_COMPAT_NORDIC_NRF_PULSE_MEAS := nordic,nrf-nrf_pulse_meas

config NRF_PULSE_MEAS
	bool "NRF PULSE MEASUREMENT driver"
	select NRFX_GPIOTE
	select NRFX_TIMER
	select NRFX_GPPI
```

## drivers/sdhc/Kconfig.semmc
```kconfig
# Copyright (c) 2026 Nordic Semiconductor ASA
# SPDX-License-Identifier: LicenseRef-Nordic-5-Clause

config SDHC_NRF_SEMMC
	bool "sEMMC driver"
	default y
	depends on DT_HAS_NORDIC_NRF_SEMMC_ENABLED
	select SDHC_SUPPORTS_NATIVE_MODE
	select PINCTRL

if SDHC_NRF_SEMMC

# sEMMC requires 32-bit aligned buffers
config SDHC_BUFFER_ALIGNMENT
	default 4

endif
```

## drivers/sensor/Kconfig
```kconfig
#
# Copyright (c) 2023 Nordic Semiconductor
#
# SPDX-License-Identifier: LicenseRef-Nordic-5-Clause
#

menuconfig SENSOR
	bool "Sensor Drivers"
	help
		Include sensor drivers in config

if SENSOR

rsource "bh1749/Kconfig"
rsource "sensor_sim/Kconfig"
rsource "sensor_stub/Kconfig"
rsource "pmw3360/Kconfig"
rsource "paw3212/Kconfig"
rsource "bme68x_iaq/Kconfig"

endif # SENSOR
```

## drivers/sensor/bh1749/Kconfig
```kconfig
#
#  Copyright (c) 2019 Nordic Semiconductor ASA
#
#  SPDX-License-Identifier: LicenseRef-Nordic-5-Clause
#

menuconfig BH1749
	bool "BH1749 Sensor"
	depends on I2C
	help
	  Enable driver for BH1749 sensors.

if BH1749

config BH1749_TRIGGER
	bool "Trigger for BH1749"
	depends on GPIO

config BH1749_READY_WAIT_TIME_MSEC
	int "Time to wait for sensor to be ready"
	default 10
	help
	  BH1749 requires certain configurations to happen with a delay, so that it may take some
	  time before the sensor is ready to be used.
	  This option configurues a wait time in milliseconds that the driver will wait for the sensor
	  to be ready in cases where it is still initializing.

endif # BH1749
```

## drivers/sensor/paw3212/Kconfig
```kconfig
# PAW3212 optical motion sensor
#
# Copyright (c) 2019 Nordic Semiconductor
#
# SPDX-License-Identifier: LicenseRef-BSD-5-Clause-Nordic
#

menuconfig PAW3212
	bool "PAW3212 mouse optical sensor"
	help
	  Enable PAW3212 mouse optical sensor.

if PAW3212

choice
	prompt "Select PAW3212 sensor orientation"
	default PAW3212_ORIENTATION_0

config PAW3212_ORIENTATION_0
	bool "PAW3212 not rotated"

config PAW3212_ORIENTATION_90
	bool "PAW3212 rotated 90 deg clockwise"

config PAW3212_ORIENTATION_180
	bool "PAW3212 rotated 180 deg clockwise"

config PAW3212_ORIENTATION_270
	bool "PAW3212 rotated 270 deg clockwise"

endchoice

choice
	prompt "Select PAW3212 sensor motion data length"
	default PAW3212_8_BIT_MODE

config PAW3212_8_BIT_MODE
	bool "PAW3212 8-bit motion data length"

config PAW3212_12_BIT_MODE
	bool "PAW3212 12-bit motion data length"

endchoice

module = PAW3212
module-str = PAW3212
source "${ZEPHYR_BASE}/subsys/logging/Kconfig.template.log_config"

endif #PAW3212
```

## drivers/sensor/pmw3360/Kconfig
```kconfig
# Sensor data simulator
#
# Copyright (c) 2019 Nordic Semiconductor
#
# SPDX-License-Identifier: LicenseRef-Nordic-5-Clause
#

menuconfig PMW3360
	bool "PMW3360 mouse optical sensor"
	help
	  Enable PMW3360 mouse optical sensor.

if PMW3360

config PMW3360_CPI
	int "PMW3360's default CPI"
	default 1600
	range 100 12000
	help
	  Default CPI value.

config PMW3360_RUN_DOWNSHIFT_TIME_MS
	int "PMW3360's default RUN mode downshift time"
	default 500
	range 10 2550
	help
	  Default RUN mode downshift down time in milliseconds.
	  Time after which sensor goes from RUN to REST1 mode.

config PMW3360_REST1_DOWNSHIFT_TIME_MS
	int "PMW3360's default REST1 mode downshift time"
	default 9220
	range 320 81600
	help
	  Default REST1 mode downshift down time in milliseconds.
	  Time after which sensor goes from REST1 to REST2 mode.

config PMW3360_REST2_DOWNSHIFT_TIME_MS
	int "PMW3360's default REST2 mode downshift time"
	default 150000
	range 3200 816000
	help
	  Default REST2 mode downshift down time in milliseconds.
	  Time after which sensor goes from REST2 to REST3 mode.

choice
	prompt "Select PMW3360 sensor orientation"
	default PMW3360_ORIENTATION_0

config PMW3360_ORIENTATION_0
	bool "PMW3360 not rotated"

config PMW3360_ORIENTATION_90
	bool "PMW3360 rotated 90 deg clockwise"

config PMW3360_ORIENTATION_180
	bool "PMW3360 rotated 180 deg clockwise"

config PMW3360_ORIENTATION_270
	bool "PMW3360 rotated 270 deg clockwise"

endchoice

module = PMW3360
module-str = PMW3360
source "${ZEPHYR_BASE}/subsys/logging/Kconfig.template.log_config"

endif #PMW3360
```

## drivers/sensor/sensor_sim/Kconfig
```kconfig
# Sensor data simulator
#
# Copyright (c) 2018-2022 Nordic Semiconductor
#
# SPDX-License-Identifier: LicenseRef-Nordic-5-Clause
#

DT_COMPAT_NORDIC_SENSOR_SIM := nordic,sensor-sim

menuconfig SENSOR_SIM
	bool "Sensor simulator"
	default y if $(dt_compat_enabled,$(DT_COMPAT_NORDIC_SENSOR_SIM))
	# FPU_SHARING needs to be enabled if FPU is enabled, as other contexts
	# might also use the FPU.
	select FPU_SHARING if FPU
	select WAVE_GEN_LIB
	help
	  Enable sensor simulator.

if SENSOR_SIM

config SENSOR_SIM_TRIGGER
	bool "Sensor simulator trigger"
	help
	  Enable trigger mode.

if SENSOR_SIM_TRIGGER

config SENSOR_SIM_THREAD_PRIORITY
	int "Thread priority"
	default 10
	help
	  Priority of thread used by the driver to handle interrupts.

config SENSOR_SIM_THREAD_STACK_SIZE
	int "Trigger thread stack size"
	default 512
	help
	  Stack size of thread used by the driver to handle interrupts.

endif #SENSOR_SIM_TRIGGER

endif #SENSOR_SIM
```
