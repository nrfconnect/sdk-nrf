## drivers/gps/Kconfig
```kconfig
# GPS Drivers
#
# Copyright (c) 2018-2019 Nordic Semiconductor ASA
#
# SPDX-License-Identifier: LicenseRef-Nordic-5-Clause
#

menu "GPS Drivers"

rsource "gps_sim/Kconfig"
rsource "nrf9160_gps/Kconfig"

endmenu
```

## drivers/gps/gps_sim/Kconfig
```kconfig
# GPS simulator
#
# Copyright (c) 2018 Nordic Semiconductor
#
# SPDX-License-Identifier: LicenseRef-BSD-5-Clause-Nordic
#

menuconfig GPS_SIM
	bool "GPS simulator"
	# FP_SHARING needs to be enabled if FLOAT is enabled, as other contexts
	# might also use the FPU.
	select FP_SHARING if FLOAT
	help
	  Enable GPS simulator.

if GPS_SIM

config GPS_SIM_DEV_NAME
	string "GPS simulator device name"
	default "GPS_SIM"
	help
	  GPS simulator device name.

config GPS_SIM_STACK_SIZE
	int "GPS simulator work queue stack size"
	default 2048

config GPS_SIM_WORKQUEUE_PRIORITY
	int "GPS simulator work queue (preemptive) priority"
	default 5

config GPS_SIM_BASE_LATITUDE
	int "Base latitude for GPS data"
	default 6325280
	help
	  Start-point latitude for simulated GPS data,
	  from which the generated data will continue.
	  Calculated by deg * 100000 + minutes * 1000,
	  for example 63 deg 25.280'N will be 6325280.
	  Positive values are North, while negative
	  values are South.

config GPS_SIM_BASE_LONGITUDE
	int "Base longitude for GPS data"
	default 1026201
	help
	  Start-point longitude for simulated GPS data,
	  from which the generated data will continue.
	  Calculated by deg * 100000 + minutes * 1000,
	  for example 10 deg 26.201'E will be 1026201.
	  Positive values are East, while negative
	  values are West.

config GPS_SIM_BASE_TIMESTAMP
	int "Base timestamp for GPS data"
	default 134627
	help
	  Timestamp at which the simulator will start counting.
	  Format is hour * 10000 + min * 100 + sec, which means that
	  13:46:27 becomes 134627.

config GPS_SIM_ELLIPSOID
	bool "Generate ellipsoid GPS path"
	default y
	help
	  GPS simulator will create a path that goes in an ellipsoid
	  shape.

config GPS_SIM_PSEUDO_RANDOM
	bool "Use pseudo-random values to generate GPS coordinates"
	help
	  Enables pseudo-random GPS coordinate creation. Based on uptime
	  that's input to a sine function, which causes the otuput
	  to not be uniformally distributed, but sinusoidal.

config GPS_SIM_DYNAMIC_VALUES
	bool "GPS simulator dynamically creates data values"
	default y
	select REQUIRES_FULL_LIBC
	imply NEWLIB_LIBC_FLOAT_PRINTF
	help
	  Enables dynamically created simulator otuput as opposed
	  to static values.

config GPS_SIM_FIX_TIME
	int "Time in milliseconds to get a position fix after search is started"
	range 500 3600000
	default 1000
	help
	  Time in milliseconds that the GPS simulator will "search" before
	  getting a position fix.

config GPS_SIM_MAX_STEP
	int "Maximum step size each iteration"
	default 100
	help
	  Sets the maximum step size that can be taken in latitude or longitude
	  for each simulation iteration. In units of 1/1000 degrees.

module = GPS_SIM
module-str = GPS simulator
source "${ZEPHYR_BASE}/subsys/logging/Kconfig.template.log_config"

endif #GPS_SIM
```

## drivers/gps/nrf9160_gps/Kconfig
```kconfig
# nRF9160 GPS driver
#
# Copyright (c) 2019 Nordic Semiconductor
#
# SPDX-License-Identifier: LicenseRef-Nordic-5-Clause
#

menuconfig NRF9160_GPS
	bool "nRF9160 GPS driver [experimental]"
	depends on NRF_MODEM_LIB
	# FPU_SHARING needs to be enabled if FPU is enabled, as other contexts
	# might also use the FPU.
	select FPU_SHARING if FPU
	help
	  Enable nRF9160 GPS driver.

if NRF9160_GPS

config NRF9160_GPS_DEV_NAME
	string "nRF9160 GPS device name"
	default "NRF9160_GPS"

config NRF9160_GPS_FIX_CHECK_INTERVAL
	int "Interval in seconds to check for GPS fix"
	default 1

config NRF9160_GPS_HANDLE_MODEM_CONFIGURATION
	bool "The GPS driver will handle modem configuration directly"
	depends on !LWM2M_CARRIER
	depends on AT_CMD
	depends on AT_CMD_PARSER
	default y
	help
	  Disabling this will cause the GPS driver to do no modem
	  configuration.  This is useful if you need to remove the
	  dependency on the at_cmd_host library from the GPS driver,
	  but it will require that some other part of the
	  application send the AT commands to configure the GPS
	  properly.

config NRF9160_GPS_PRIORITY_WINDOW_TIMEOUT_SEC
	int "Enable GPS priority window if the GPS is blocked for this duration"
	default 10
	help
	  This configuration sets the amount of time the GPS must be blocked by
	  LTE before requesting GPS priority. For GPS priority to be requested
	  after this timeout, the GPS must also be configured with the priority
	  flag enabled when starting it. When GPS priority is enabled, the
	  modem grants the GPS prioritized access to the radio at the cost of
	  LTE activity. If the value of this option is kept low, GPS priority is
	  requested at an earlier point of time after the GPS is actively
	  blocked by LTE activity. This means that data traffic scheduled during
	  a GPS search is more likely to be blocked by the GPS. Increasing the
	  value of this option will favor data traffic since the GPS will be
	  blocked for a longer duration before GPS priority is requested.
	  Note that GPS priority might not be granted by the modem, even though
	  it is requested by the driver.

if NRF9160_GPS_HANDLE_MODEM_CONFIGURATION

choice NRF9160_GPS_ANTENNA
	prompt "GPS antenna selection"
	default NRF9160_GPS_ANTENNA_ONBOARD

config NRF9160_GPS_ANTENNA_ONBOARD
	bool "Onboard antenna"

config NRF9160_GPS_ANTENNA_EXTERNAL
	bool "External antenna"

endchoice

config NRF9160_GPS_SET_MAGPIO
	bool "Let the driver set MAGPIO configuration"
	default y if BOARD_NRF9160DK_NRF9160NS || BOARD_THINGY91_NRF9160NS

if NRF9160_GPS_SET_MAGPIO

config NRF9160_GPS_MAGPIO_STRING
	string "MAGPIO string"
	default "AT\%XMAGPIO=1,0,0,1,1,1565,1586" if BOARD_NRF9160DK_NRF9160NS
	default "AT\%XMAGPIO=1,1,1,7,1,746,803,2,698,748,2,1710,2200,3,824,894,4,880,960,5,791,849,7,1565,1586" if BOARD_THINGY91_NRF9160NS

endif # NRF9160_GPS_SET_MAGPIO

config NRF9160_GPS_SET_COEX0
	bool "Let the driver set COEX0 configuration"
	default y if BOARD_NRF9160DK_NRF9160NS || BOARD_THINGY91_NRF9160NS

if NRF9160_GPS_SET_COEX0

config NRF9160_GPS_COEX0_STRING
	string "COEX0 string"
	default "AT\%XCOEX0=1,1,1565,1586" if (BOARD_NRF9160DK_NRF9160NS || BOARD_THINGY91_NRF9160NS) && NRF9160_GPS_ANTENNA_ONBOARD
	default "AT\%XCOEX0" if (BOARD_NRF9160DK_NRF9160NS || BOARD_THINGY91_NRF9160NS) && NRF9160_GPS_ANTENNA_EXTERNAL

endif # NRF9160_GPS_SET_COEX0

endif # NRF9160_GPS_HANDLE_MODEM_CONFIGURATION

menu "NMEA strings"
config NRF9160_GPS_NMEA_GSV
	bool "Enable GSV strings"

config NRF9160_GPS_NMEA_GSA
	bool "Enable GSA strings"

config NRF9160_GPS_NMEA_GLL
	bool "Enable GLL strings"

config NRF9160_GPS_NMEA_GGA
	bool "Enable GGA strings"
	default y

config NRF9160_GPS_NMEA_RMC
	bool "Enable RMC strings"
endmenu

config NRF9160_GPS_INIT_PRIO
	int "Initialization priority"
	default 90

config NRF9160_GPS_THREAD_PRIORITY
	int "Thread (preemtible) priority"
	default 10

config NRF9160_GPS_THREAD_STACK_SIZE
	int "Thread stack size"
	default 2048

module = NRF9160_GPS
module-str = nRF9160 GPS driver
source "${ZEPHYR_BASE}/subsys/logging/Kconfig.template.log_config"

endif #NRF9160_GPS
```

## drivers/gps_sim/Kconfig
```kconfig
# Kconfig - GPS data simulator
#
# Copyright (c) 2018 Nordic Semiconductor
#
# SPDX-License-Identifier: LicenseRef-BSD-5-Clause-Nordic
#

menuconfig GPS_SIM
	bool "GPS simulator"
	# FP_SHARING needs to be enabled if FLOAT is enabled, as other contexts
	# might also use the FPU.
	select FP_SHARING if FLOAT
	help
	  Enable GPS simulator.

if GPS_SIM

config GPS_SIM_DEV_NAME
	string "GPS simulator device name"
	default "GPS_SIM"
	help
		GPS simulator device name.

config GPS_SIM_BASE_LATITUDE
	int "Base latitude for GPS data"
	default 6325280
	help
		Start-point latitude for simulated GPS data,
		from which the generated data will continue.
		Calculated by deg * 100000 + minutes * 1000,
		for example 63 deg 25.280'N will be 6325280.
		Positive values are North, while negative
		values are South.

config GPS_SIM_BASE_LONGITUDE
	int "Base longitude for GPS data"
	default 1026201
	help
		Start-point longitude for simulated GPS data,
		from which the generated data will continue.
		Calculated by deg * 100000 + minutes * 1000,
		for example 10 deg 26.201'E will be 1026201.
		Positive values are East, while negative
		values are West.

config GPS_SIM_BASE_TIMESTAMP
	int "Base timestamp for GPS data"
	default 134627
	help
		Timestamp at which the simulator will start counting.
		Format is hour * 10000 + min * 100 + sec, which means that
		13:46:27 becomes 134627.

config GPS_SIM_ELLIPSOID
	bool "Generate ellipsoid GPS path"
	default y
	help
		GPS simulator will create a path that goes in an ellipsoid
		shape.

config GPS_SIM_PSEUDO_RANDOM
	bool "Use pseudo-random values to generate GPS coordinates"
	help
		Enables pseudo-random GPS coordinate creation. Based on uptime
		that's input to a sine function, which causes the otuput
		to not be uniformally distributed, but sinusoidal.

config GPS_SIM_DYNAMIC_VALUES
	bool "GPS simulator dynamically creates data values"
	default y
	select REQUIRES_FULL_LIBC
	select NEWLIB_LIBC_FLOAT_PRINTF
	help
		Enables dynamically created simulator otuput as opposed
		to static values.

config GPS_SIM_FIX_TIME
	int "Time in milliseconds between position generations"
	range 500 3600000
	default GPS_SIM_TRIGGER_TIMER_MSEC if GPS_SIM_TRIGGER_USE_TIMER
	default 1000
	help
		Time in milliseconds that the GPS simulator will return the same
		position before generating new coordinates.

config GPS_SIM_MAX_STEP
	int "Maximum step size each iteration"
	default 100
	help
		Sets the maximum step size that can be taken in latitude or longitude
		for each simulation iteration. In units of 1/1000 degrees.

config GPS_SIM_TRIGGER
	bool "GPS simulator trigger"
	help
		Enable trigger. When enabled, it will emit 'data ready'
		trigger event time either by button press or at specified
		timer intervals.

if GPS_SIM_TRIGGER

choice
	prompt "Trigger type"
	depends on GPS_SIM_TRIGGER
	default GPS_SIM_TRIGGER_USE_TIMER
	help
		Specify the type of trigger that will be used to emit the
		'data ready' trigger event.

config GPS_SIM_TRIGGER_USE_TIMER
	bool "Use timer for trigger"
	help
		Use timer to trigger 'data ready' event.

config GPS_SIM_TRIGGER_USE_BUTTON
	bool "Use button 2 as trigger"
	help
		Use button 2 to trigger 'data ready' event.

endchoice

if GPS_SIM_TRIGGER_USE_BUTTON
config GPS_SIM_GPIO_CONTROLLER
	string "GPIO controller"
	default "GPIO_0"
	help
		GPIO controller for GPS simulator trigger button.

config GPS_SIM_GPIO_PIN
	int "GPIO pin"
	default 6
	help
		GPIO pin for trigger button.
endif

config GPS_SIM_TRIGGER_TIMER_MSEC
	int "Time between triggers, in milliseconds"
	depends on GPS_SIM_TRIGGER_USE_TIMER
	default 1000
	help
		The time interval between each 'data ready' trigger event.

config GPS_SIM_THREAD_PRIORITY
	int "Thread priority"
	depends on GPS_SIM_TRIGGER
	default 10
	help
	  Priority of thread used by the driver to handle interrupts.

config GPS_SIM_THREAD_STACK_SIZE
	int "Trigger thread stack size"
	depends on GPS_SIM_TRIGGER
	default 1024
	help
	  Stack size of thread used by the driver to handle interrupts.

endif #GPS_SIM_TRIGGER

module = GPS_SIM
module-str = GPS simulator
source "${ZEPHYR_BASE}/subsys/logging/Kconfig.template.log_config"

endif #GPS_SIM
```

## drivers/hw_cc310/Kconfig
```kconfig
# Arm CC3xx hw driver for nRF52840 and nRF9160
#
# Copyright (c) 2019 Nordic Semiconductor
#
# SPDX-License-Identifier: LicenseRef-Nordic-5-Clause
#

# Defining MCUBOOT symbol here to avoid an issue discovered when building
# multi image zephyr/mcuboot.
config MCUBOOT
	bool

config HW_CC3XX_FORCE_ALT
	bool
	depends on SOC_COMPATIBLE_NRF
	help
	  This option can be enabled to force an alternative implementation of
	  the Arm CC3xx hardware driver.

if !HW_CC3XX_FORCE_ALT

config HW_CC3XX
	bool "Arm CC3xx hw driver for Nordic devices"
	depends on HAS_HW_NRF_CC310 || HAS_HW_NRF_CC312
	depends on !TRUSTED_EXECUTION_NONSECURE
	select NRF_CC3XX_PLATFORM
	default y
	help
	  This option enables the Arm CC3xx hw devices in nRF52840, nRF53, and nRF9160 devices.

endif # !HW_CC3XX_FORCE_ALT
```
