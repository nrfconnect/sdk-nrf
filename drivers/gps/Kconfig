## drivers/ieee802154/Kconfig
```kconfig
#
# Copyright (c) 2018-2020 Nordic Semiconductor ASA
#
# SPDX-License-Identifier: LicenseRef-BSD-5-Clause-Nordic
#

if NRF_802154_RADIO_DRIVER

menu "IEEE 802.15.4 nRF5 Radio Driver configuration"

config IEEE802154_NRF5_CFG_PRE_PRIO
	int "Radio driver pre-init configuration priority"
	default 75
	help
	  Set the configuration priority number. Must be lower than radio driver
	  initialization priority. Do not mess with it unless you know what you
	  are doing.

config IEEE802154_NRF5_CFG_POST_PRIO
	int "Radio driver post-init configuration priority"
	default 90
	help
	  Set the configuration priority number. Must be higher than radio driver
	  initialization priority. Do not mess with it unless you know what you
	  are doing.

choice IEEE802154_NRF5_ANT_DIVERSITY_MODE
	prompt "Antenna Diversity mode"
	default IEEE802154_NRF5_ANT_DIVERSITY_MODE_DISABLED
	help
	  Select Antenna Diversity mode

config IEEE802154_NRF5_ANT_DIVERSITY_MODE_DISABLED
	bool "Antenna Diversity disabled"

config IEEE802154_NRF5_ANT_DIVERSITY_MODE_MANUAL
	bool "Antenna Diversity manual"

config IEEE802154_NRF5_ANT_DIVERSITY_MODE_AUTO
	bool "Antenna Diversity automatic"

endchoice

if !IEEE802154_NRF5_ANT_DIVERSITY_MODE_DISABLED

menu "Antenna Diversity configuration"

choice IEEE802154_NRF5_ANT_DIVERSITY_ANTENNA
	prompt "Default antenna for Antenna Diversity"
	default IEEE802154_NRF5_ANT_DIVERSITY_ANTENNA_1
	help
	  Select default antenna used when Antenna Diversity is enabled.
	  Selected antenna is used for each frame transmission in manual
	  and auto modes. In manual mode the selected antenna is used for
	  each frame reception.

config IEEE802154_NRF5_ANT_DIVERSITY_ANTENNA_1
	bool "Antenna 1"

config IEEE802154_NRF5_ANT_DIVERSITY_ANTENNA_2
	bool "Antenna 2"

endchoice

config IEEE802154_NRF5_ANT_DIVERSITY_PIN
	int "Antenna selection pin"
	default 20
	help
	  Pin used for antenna selection.

config IEEE802154_NRF5_ANT_DIVERSITY_TOGGLE_TIME
	int "Toggle time"
	default 40
	help
	  Time between antenna switches in automatic mode [us]

config IEEE802154_NRF5_ANT_DIVERSITY_GPIOTE_CHANNEL
	int "GPIOTE channel for Antenna Diversity"
	default 4

config IEEE802154_NRF5_ANT_DIVERSITY_PPI_CHANNEL
	int "PPI channel for Antenna Diversity"
	default 4

config IEEE802154_NRF5_ANT_DIVERSITY_TIMER_INSTANCE
	int "TIMER peripheral instance for Antenna Diversity"
	default 3

endmenu

endif

menuconfig IEEE802154_NRF5_WIFI_COEX
	bool "Enable WiFi Coexistence"
	help
	  Enable WiFi Coexistence

if IEEE802154_NRF5_WIFI_COEX

config IEEE802154_NRF5_WIFI_COEX_REQ_PIN
	int "Request pin"
	default 15

config IEEE802154_NRF5_WIFI_COEX_REQ_ACTIVE_HIGH
	bool "Request pin active high"
	default y

config IEEE802154_NRF5_WIFI_COEX_PRIO_PIN
	int "Priority pin"
	default 16

config IEEE802154_NRF5_WIFI_COEX_PRIO_ACTIVE_HIGH
	bool "Priority pin active high"
	default y

config IEEE802154_NRF5_WIFI_COEX_GRA_PIN
	int "Grant pin"
	default 24

config IEEE802154_NRF5_WIFI_COEX_GRA_ACTIVE_HIGH
	bool "Grant pin active high"
	default y

config IEEE802154_NRF5_WIFI_COEX_GPIOTE_CHANNEL
	int "GPIOTE channel for WiFi Coexistence"
	default 3

choice IEEE802154_NRF5_WIFI_COEX_RX_REQ_MODE
	prompt "WiFi Coex RX request mode"
	default IEEE802154_NRF5_WIFI_COEX_RX_REQ_MODE_ED
	help
	  Mode of triggering receive request to Coex arbiter

config IEEE802154_NRF5_WIFI_COEX_RX_REQ_MODE_ED
	bool "Energy detected"

config IEEE802154_NRF5_WIFI_COEX_RX_REQ_MODE_PREAMBLE
	bool "Preamble reception"

config IEEE802154_NRF5_WIFI_COEX_RX_REQ_MODE_DESTINED
	bool "Frame detected"

endchoice

choice IEEE802154_NRF5_WIFI_COEX_TX_REQ_MODE
	prompt "WiFi Coex TX request mode"
	default IEEE802154_NRF5_WIFI_COEX_TX_REQ_MODE_FRAME_READY
	help
	  Mode of triggering transmit request to Coex arbiter

config IEEE802154_NRF5_WIFI_COEX_TX_REQ_MODE_FRAME_READY
	bool "Frame ready"

config IEEE802154_NRF5_WIFI_COEX_TX_REQ_MODE_CCA_START
	bool "Pre CCA"

config IEEE802154_NRF5_WIFI_COEX_TX_REQ_MODE_CCA_DONE
	bool "Post CCA"

endchoice

endif # IEEE802154_NRF5_WIFI_COEX

menuconfig IEEE802154_NRF5_FEM_PRESENT
	bool "Enable Front End Module (FEM) control"
	help
	  Enable FEM control and its configuration options.

if IEEE802154_NRF5_FEM_PRESENT

config IEEE802154_NRF5_FEM_PA_PIN_CTRL_ENABLE
	bool "Enable PA pin control"
	default y

config IEEE802154_NRF5_FEM_PA_TIME_IN_ADVANCE_US
	int "PA time advance"
	default 13
	help
	  Time in microseconds when PA GPIO is activated before the radio
	  is ready for transmission.

config IEEE802154_NRF5_FEM_LNA_PIN_CTRL_ENABLE
	bool "Enable LNA pin control"
	default y

config IEEE802154_NRF5_FEM_LNA_TIME_IN_ADVANCE_US
	int "LNA time advance"
	default 13
	help
	  Time in microseconds when LNA GPIO is activated before the radio
	  is ready for reception.

config IEEE802154_NRF5_FEM_PDN_PIN_CTRL_ENABLE
	bool "Enable PDN pin control"
	default y

config IEEE802154_NRF5_FEM_PDN_SETTLE_US
	int "PDN settle time"
	default 18
	help
	  The time between activating the PDN and asserting RX_EN/TX_EN.

config IEEE802154_NRF5_FEM_TRX_HOLD_US
	int "TRX hold time"
	default 5
	help
	  The time between deasserting the RX_EN/TX_EN and deactivating PDN.

config IEEE802154_NRF5_FEM_PA_PIN
	int "PA pin"
	default 22

config IEEE802154_NRF5_FEM_LNA_PIN
	int "LNA pin"
	default 19

config IEEE802154_NRF5_FEM_PDN_PIN
	int "PDN pin"
	default 23

config IEEE802154_NRF5_FEM_MODE_PIN
	int "Mode pin"
	default 17

menuconfig IEEE802154_NRF5_SPI
	bool "Configure SPI interface"
	default y

if IEEE802154_NRF5_SPI

config IEEE802154_NRF5_FEM_MOSI_PIN
	int "MOSI pin of the FEM module"
	default 45

config IEEE802154_NRF5_FEM_MISO_PIN
	int "MISO pin of the FEM module"
	default 46

config IEEE802154_NRF5_FEM_CLK_PIN
	int "CLK pin of the FEM module"
	default 47

config IEEE802154_NRF5_FEM_CSN_PIN
	int "CSN pin of the FEM module"
	default 21

endif

config IEEE802154_NRF5_FEM_SET_PPI_CHANNEL
	int "PPI channel for pin setting"
	default 15

config IEEE802154_NRF5_FEM_CLR_PPI_CHANNEL
	int "PPI channel for pin clearing"
	default 16

config IEEE802154_NRF5_FEM_PDN_PPI_CHANNEL
	int "PPI channel for PDN pin handling"
	default 5

config IEEE802154_NRF5_FEM_PDN_GPIOTE_CHANNEL
	int "GPIOTE channel for PDN control"
	default 5

config IEEE802154_NRF5_FEM_LNA_GPIOTE_CHANNEL
	int "GPIOTE channel for LNA control"
	default 6

config IEEE802154_NRF5_FEM_PA_GPIOTE_CHANNEL
	int "GPIOTE channel for PA control"
	default 7

endif # IEEE802154_NRF5_FEM_PRESENT

module = IEEE802154_NRF5_CFG
module-str = ieee802154_nrf5_cfg
source "${ZEPHYR_BASE}/subsys/logging/Kconfig.template.log_config"

endmenu

endif
```

## drivers/lcz_fem/Kconfig
```kconfig
#
# Copyright (c) 2023 Laird Connectivity
# SPDX-License-Identifier: LicenseRef-Nordic-5-Clause
#

DT_COMPAT_LCZ_FEM := lairdconnect,nrf21540-lcz-fem
DT_NODELABEL_LCZ_FEM := $(dt_nodelabel_path,lcz_fem)

config LCZ_FEM
	depends on MPSL_FEM
	def_bool $(dt_has_compat,$(DT_COMPAT_LCZ_FEM))
	help
	  This driver works alongside the Nordic MSPL FEM driver.
	  The driver sets the appropriate power levels for internal or
	  external antenna variants and for the region of use.
	  The driver controls the GPIO for the unused SPI signals and
	  antenna select.  Antenna select and chip select cannot
	  be static because of FEM errata.

if LCZ_FEM

module = LCZ_FEM
module-str = LCZ_FEM
source "subsys/logging/Kconfig.template.log_config"

config LCZ_FEM_INTERNAL_ANTENNA
	bool "Select internal antenna"
	default $(dt_node_bool_prop,$(DT_NODELABEL_LCZ_FEM),internal-antenna)

config LCZ_FEM_REGION
	int
	range 0 1
	default $(dt_node_int_prop_int,$(DT_NODELABEL_LCZ_FEM),power-table)

config LCZ_FEM_LOG_POWER_ADJUST_TABLE
	bool "Print power adjustment table"
	depends on LOG
	help
	  Resolution of soc may be limited

endif
```

## drivers/lte_link_control/Kconfig
```kconfig
#
# Copyright (c) 2018 Nordic Semiconductor
#
# SPDX-License-Identifier: LicenseRef-BSD-5-Clause-Nordic
#

menuconfig LTE_LINK_CONTROL
	bool "nRF91 LTE Link control library"
	select BSD_LIBRARY
	default n

if LTE_LINK_CONTROL

config LTE_AUTO_INIT_AND_CONNECT
	bool "Auto Initialize and Connect for the LTE link"
	default y
	help
		Turn on to make the LTE Link Controller to
		automatically initialize and connect the modem
		before the application starts

config LTE_LOCK_BANDS
	bool "Enable LTE bands lock"
	default y
	help
		Enable LTE band locks for bands 3, 4, 13 and 20.
		Other bands cannot be used when this setting is enabled.

endif # LTE_LINK_CONTROL
```

## drivers/mpsl/Kconfig
```kconfig
#
# Copyright (c) 2019 - 2020 Nordic Semiconductor ASA
#
# SPDX-License-Identifier: LicenseRef-Nordic-5-Clause
#

rsource "clock_control/Kconfig"
rsource "flash_sync/Kconfig"

if SENSOR

rsource "temp_nrf5/Kconfig"

endif # SENSOR
```

## drivers/mpsl/clock_control/Kconfig
```kconfig
#
# Copyright (c) 2018 - 2020 Nordic Semiconductor ASA
#
# SPDX-License-Identifier: LicenseRef-Nordic-5-Clause
#

config CLOCK_CONTROL_MPSL
	bool
	depends on MPSL
	depends on CLOCK_CONTROL
	depends on !MPSL_USE_EXTERNAL_CLOCK_CONTROL
	default y
	select CLOCK_CONTROL_NRF_FORCE_ALT
	help
	  Use the clock driver provided as part of the MPSL library.
```

## drivers/mpsl/flash_sync/Kconfig
```kconfig
#
# Copyright (c) 2020 Nordic Semiconductor ASA
#
# SPDX-License-Identifier: LicenseRef-Nordic-5-Clause
#

if SOC_FLASH_NRF || SOC_FLASH_NRF_RRAM || SOC_NRF54H20

config SOC_FLASH_NRF_RADIO_SYNC_RPC
	bool "Flash driver synchronization with radio protocols through RPC"
	help
	  Enable the flash synchronization between the application core and the radio core.
	  This Kconfig option is set based on the value of the SB_CONFIG_SOC_FLASH_NRF_RADIO_SYNC_RPC
	  sysbuild configuration option.

choice SOC_FLASH_NRF_RADIO_SYNC_CHOICE
	prompt "Nordic nRFx flash driver synchronization"
	default SOC_FLASH_NRF_RADIO_SYNC_MPSL if MPSL

config SOC_FLASH_NRF_RADIO_SYNC_MPSL
	bool "Nordic nRFx flash driver synchronized using MPSL"
	depends on MPSL
	help
	  Enable synchronization between flash memory driver and MPSL.

config SOC_FLASH_NRF_RADIO_SYNC_RPC_HOST
	bool "Nordic nRFx flash driver synchronized on the application core via RPC"
	depends on SOC_NRF54H20_CPUAPP
	depends on BT  # If sync with other radio protocols is needed, extend this
	depends on SOC_FLASH_NRF_RADIO_SYNC_RPC
	select NRF_RPC
	select NRF_RPC_CBOR
	help
	  Enable synchronization between the flash memory driver on the application core
	  and radio protocols on the radio core using RPC communication.

endchoice

endif

config SOC_FLASH_NRF_RADIO_SYNC_MPSL_NORMAL_PRIORITY_TIMEOUT_US
	int "Timeout for normal priority MPSL request [us]"
	depends on SOC_FLASH_NRF_RADIO_SYNC_MPSL
	range 0 1000000
	default 5000 if BT_MESH
	default 10000
	help
	  The flash synchronization mechanism relies on MPSL timeslots.
	  Initially the MPSL timeslot is requested with normal priority. After
	  timeout specified by this Kconfig option, a higher timeslot priority
	  is used to increase priority of the flash operation.

config SOC_FLASH_NRF_RADIO_SYNC_RPC_CONTROLLER
	bool "Nordic nRFx flash driver RPC synchronization controller"
	default y if SOC_FLASH_NRF_RADIO_SYNC_RPC
	depends on SOC_FLASH_NRF_RADIO_SYNC_MPSL
	select NRF_RPC
	select NRF_RPC_CBOR
	help
	  Enable the RPC controller (radio core part) for the flash driver synchronization
	  via RPC. This controller calls the proper flash sync MPSL API.

if SOC_FLASH_NRF_RADIO_SYNC_RPC_CONTROLLER

config SOC_FLASH_NRF_RADIO_SYNC_RPC_CONTROLLER_SWI_NUM
	int "SWI number to be used by the flash synchronization RPC controller"
	default 5
	range 0 7
	help
	  The interrupt coming from MPSL cannot be used to give semaphores.
	  Thus, the SWI is used as an "offload" to give the semaphore to the waiting thread.
	  This Kconfig option allows the user to select the SWI number to be used by the controller
	  for this purpose.

endif

config SOC_FLASH_NRF_RADIO_SYNC_MPSL_TIMESLOT_SESSION_COUNT
	int
	default 1 if SOC_FLASH_NRF_RADIO_SYNC_MPSL
	default 0
```

## drivers/mpsl/temp_nrf5/Kconfig
```kconfig
#
# Copyright (c) 2020 Nordic Semiconductor ASA
#
# SPDX-License-Identifier: LicenseRef-Nordic-5-Clause

# nRF5 MPSL temperature API configuration options

config TEMP_NRF5_MPSL
	bool "nRF5 MPSL Temperature Sensor"
	default y
	depends on DT_HAS_NORDIC_NRF_TEMP_ENABLED
	depends on HAS_HW_NRF_TEMP
	depends on MPSL
	select TEMP_NRF5_FORCE_ALT
	help
	  Enable MPSL driver for nRF5 temperature sensor.
```

## drivers/mspi/Kconfig
```kconfig
# Copyright (c) 2024 Nordic Semiconductor ASA
# SPDX-License-Identifier: LicenseRef-Nordic-5-Clause

if MSPI

rsource "Kconfig.hpf"
rsource "Kconfig.sqspi"

endif # MSPI
```

## drivers/mspi/Kconfig.hpf
```kconfig
# Copyright (c) 2024 Nordic Semiconductor ASA
# SPDX-License-Identifier: LicenseRef-Nordic-5-Clause

#
# MSPI_HPF Driver
#
menuconfig MSPI_HPF
	bool "HPF MSPI driver"
	default y
	depends on DT_HAS_NORDIC_HPF_MSPI_CONTROLLER_ENABLED
	select PINCTRL
	select MBOX
	select IPC_SERVICE
	select IPC_SERVICE_BACKEND_ICMSG
	help
	  Enable HPF MSPI driver.

if MSPI_HPF

config MSPI_HPF_INIT_PRIORITY
	int "HPF MSPI init priority"
	depends on MSPI_HPF
	default MSPI_INIT_PRIORITY
	help
	  HPF MSPI driver device initialization priority.
	  HPF MSPI initialization depends on IPC initialization
	  which is done at the same init level and has init priority equal to 46.

config MSPI_HPF_IPC_NO_COPY
	bool "IPC no copy mode"
	default y
	depends on SOC_NRF54L15
	help
	  If y Data is passed through IPC by reference,
	  this requires both cores to be able to access each others memory spaces.
	  If n Data is passed through IPC by copy.

config MSPI_HPF_FAULT_TIMER
	bool "HPF application fault timer"
	select COUNTER
	help
	  Enable HPF application fault timer.
	  Timer is used to detect application faults. If the timer expires,
	  the application is considered to be in a fault state.

if MSPI_HPF_FAULT_TIMER

config MSPI_HPF_FAULT_TIMEOUT
	int "HPF application fault timeout"
	default 1000000
	help
	  Fault timeout in microseconds.

endif # MSPI_HPF_FAULT_TIMER

endif # MSPI_HPF
```

## drivers/mspi/Kconfig.nrfe
```kconfig
# Copyright (c) 2024 Nordic Semiconductor ASA
# SPDX-License-Identifier: LicenseRef-Nordic-5-Clause

#
# MSPI_NRFE Driver
#
menuconfig MSPI_NRFE
	bool "SDP MSPI driver"
	default y
	depends on DT_HAS_NORDIC_NRFE_MSPI_CONTROLLER_ENABLED
	select MBOX
	select IPC_SERVICE
	select IPC_SERVICE_BACKEND_ICMSG
	help
	  Enable SDP MSPI driver.

if MSPI_NRFE

config MSPI_NRFE_INIT_PRIORITY
	int "SDP MSPI init priority"
	depends on MSPI_NRFE
	default MSPI_INIT_PRIORITY
	help
	  SDP MSPI driver device initialization priority.
	  SDP MSPI initialization depends on IPC initialization
	  which is done at the same init level and has init priority equal to 46.

config MSPI_NRFE_IPC_NO_COPY
	bool "IPC no copy mode"
	default y
	depends on SOC_NRF54L15
	help
	  If y Data is passed through IPC by reference,
	  this requires both cores to be able to access each others memory spaces.
	  If n Data is passed through IPC by copy.

config MSPI_NRFE_FAULT_TIMER
	bool "SDP application fault timer"
	select COUNTER
	help
	  Enable SDP application fault timer.
	  Timer is used to detect application faults. If the timer expires,
	  the application is considered to be in a fault state.

if MSPI_NRFE_FAULT_TIMER

config MSPI_NRFE_FAULT_TIMEOUT
	int "SDP application fault timeout"
	default 1000000
	help
	  Fault timeout in microseconds.

endif # MSPI_NRFE_FAULT_TIMER

endif # MSPI_NRFE
```

## drivers/mspi/Kconfig.sqspi
```kconfig
# Copyright (c) 2025 Nordic Semiconductor ASA
# SPDX-License-Identifier: LicenseRef-Nordic-5-Clause

config MSPI_NRF_SQSPI
	bool "sQSPI driver"
	default y
	depends on DT_HAS_NORDIC_NRF_SQSPI_ENABLED
	select PINCTRL
	select GPIO if $(dt_compat_any_has_prop,$(DT_COMPAT_NORDIC_NRF_SQSPI),ce-gpios)
```
